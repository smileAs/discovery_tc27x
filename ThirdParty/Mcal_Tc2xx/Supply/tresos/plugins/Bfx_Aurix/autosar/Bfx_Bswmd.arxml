AUTOSAR XML (schema 4-0-3)
# Copyright (C) Infineon Technologies (2015)
# All rights reserved.
package /AUTOSAR_Bfx/BswModuleDescriptions
  bsw module description Bfx: category=BSW_MODULE, module-id=205  # Bfx Library
    provided-entrys:
      Bfx_GetVersionInfo
      Bfx_ClrBit_u16u8
      Bfx_ClrBit_u32u8
      Bfx_ClrBit_u8u8
      Bfx_ClrBitMask_u16u16
      Bfx_ClrBitMask_u32u32
      Bfx_ClrBitMask_u8u8
      Bfx_CopyBit_u16u8u16u8
      Bfx_CopyBit_u32u8u32u8
      Bfx_CopyBit_u8u8u8u8
      Bfx_GetBit_u16u8_u8
      Bfx_GetBit_u32u8_u8
      Bfx_GetBit_u8u8_u8
      Bfx_GetBits_u16u8u8_u16
      Bfx_GetBits_u32u8u8_u32
      Bfx_GetBits_u8u8u8_u8
      Bfx_PutBit_u16u8u8
      Bfx_PutBit_u32u8u8
      Bfx_PutBit_u8u8u8
      Bfx_PutBits_u16u8u8u16
      Bfx_PutBits_u32u8u8u32
      Bfx_PutBits_u8u8u8u8
      Bfx_PutBitsMask_u16u16u16
      Bfx_PutBitsMask_u32u32u32
      Bfx_PutBitsMask_u8u8u8
      Bfx_RotBitLt_u16u8
      Bfx_RotBitLt_u32u8
      Bfx_RotBitLt_u8u8
      Bfx_RotBitRt_u16u8
      Bfx_RotBitRt_u32u8
      Bfx_RotBitRt_u8u8
      Bfx_SetBit_u16u8
      Bfx_SetBit_u32u8
      Bfx_SetBit_u8u8
      Bfx_SetBitMask_u16u16
      Bfx_SetBitMask_u32u32
      Bfx_SetBitMask_u8u8
      Bfx_SetBits_u16u8u8u8
      Bfx_SetBits_u32u8u8u8
      Bfx_SetBits_u8u8u8u8
      Bfx_ShiftBitLt_u16u8
      Bfx_ShiftBitLt_u32u8
      Bfx_ShiftBitLt_u8u8
      Bfx_ShiftBitRt_u16u8
      Bfx_ShiftBitRt_u32u8
      Bfx_ShiftBitRt_u8u8
      Bfx_ToggleBitMask_u16u16
      Bfx_ToggleBitMask_u32u32
      Bfx_ToggleBitMask_u8u8
      Bfx_ToggleBits_u16
      Bfx_ToggleBits_u32
      Bfx_ToggleBits_u8
      Bfx_TstBitLnMask_u16u16_u8
      Bfx_TstBitLnMask_u32u32_u8
      Bfx_TstBitLnMask_u8u8_u8
      Bfx_TstBitMask_u16u16_u8
      Bfx_TstBitMask_u32u32_u8
      Bfx_TstBitMask_u8u8_u8
      Bfx_TstParityEven_u16_u8
      Bfx_TstParityEven_u32_u8
      Bfx_TstParityEven_u8_u8
    bsw internal behavior BfxBehavior
      61 x bsw called entity:
        Bfx_GetVersionInfo: implemented-entry=Bfx_GetVersionInfo
        Bfx_ClrBit_u16u8: implemented-entry=Bfx_ClrBit_u16u8
        Bfx_ClrBit_u32u8: implemented-entry=Bfx_ClrBit_u32u8
        Bfx_ClrBit_u8u8: implemented-entry=Bfx_ClrBit_u8u8
        Bfx_ClrBitMask_u16u16: implemented-entry=Bfx_ClrBitMask_u16u16
        Bfx_ClrBitMask_u32u32: implemented-entry=Bfx_ClrBitMask_u32u32
        Bfx_ClrBitMask_u8u8: implemented-entry=Bfx_ClrBitMask_u8u8
        Bfx_CopyBit_u16u8u16u8: implemented-entry=Bfx_CopyBit_u16u8u16u8
        Bfx_CopyBit_u32u8u32u8: implemented-entry=Bfx_CopyBit_u32u8u32u8
        Bfx_CopyBit_u8u8u8u8: implemented-entry=Bfx_CopyBit_u8u8u8u8
        Bfx_GetBit_u16u8_u8: implemented-entry=Bfx_GetBit_u16u8_u8
        Bfx_GetBit_u32u8_u8: implemented-entry=Bfx_GetBit_u32u8_u8
        Bfx_GetBit_u8u8_u8: implemented-entry=Bfx_GetBit_u8u8_u8
        Bfx_GetBits_u16u8u8_u16: implemented-entry=Bfx_GetBits_u16u8u8_u16
        Bfx_GetBits_u32u8u8_u32: implemented-entry=Bfx_GetBits_u32u8u8_u32
        Bfx_GetBits_u8u8u8_u8: implemented-entry=Bfx_GetBits_u8u8u8_u8
        Bfx_PutBit_u16u8u8: implemented-entry=Bfx_PutBit_u16u8u8
        Bfx_PutBit_u32u8u8: implemented-entry=Bfx_PutBit_u32u8u8
        Bfx_PutBit_u8u8u8: implemented-entry=Bfx_PutBit_u8u8u8
        Bfx_PutBits_u16u8u8u16: implemented-entry=Bfx_PutBits_u16u8u8u16
        Bfx_PutBits_u32u8u8u32: implemented-entry=Bfx_PutBits_u32u8u8u32
        Bfx_PutBits_u8u8u8u8: implemented-entry=Bfx_PutBits_u8u8u8u8
        Bfx_PutBitsMask_u16u16u16: implemented-entry=Bfx_PutBitsMask_u16u16u16
        Bfx_PutBitsMask_u32u32u32: implemented-entry=Bfx_PutBitsMask_u32u32u32
        Bfx_PutBitsMask_u8u8u8: implemented-entry=Bfx_PutBitsMask_u8u8u8
        Bfx_RotBitLt_u16u8: implemented-entry=Bfx_RotBitLt_u16u8
        Bfx_RotBitLt_u32u8: implemented-entry=Bfx_RotBitLt_u32u8
        Bfx_RotBitLt_u8u8: implemented-entry=Bfx_RotBitLt_u8u8
        Bfx_RotBitRt_u16u8: implemented-entry=Bfx_RotBitRt_u16u8
        Bfx_RotBitRt_u32u8: implemented-entry=Bfx_RotBitRt_u32u8
        Bfx_RotBitRt_u8u8: implemented-entry=Bfx_RotBitRt_u8u8
        Bfx_SetBit_u16u8: implemented-entry=Bfx_SetBit_u16u8
        Bfx_SetBit_u32u8: implemented-entry=Bfx_SetBit_u32u8
        Bfx_SetBit_u8u8: implemented-entry=Bfx_SetBit_u8u8
        Bfx_SetBitMask_u16u16: implemented-entry=Bfx_SetBitMask_u16u16
        Bfx_SetBitMask_u32u32: implemented-entry=Bfx_SetBitMask_u32u32
        Bfx_SetBitMask_u8u8: implemented-entry=Bfx_SetBitMask_u8u8
        Bfx_SetBits_u16u8u8u8: implemented-entry=Bfx_SetBits_u16u8u8u8
        Bfx_SetBits_u32u8u8u8: implemented-entry=Bfx_SetBits_u32u8u8u8
        Bfx_SetBits_u8u8u8u8: implemented-entry=Bfx_SetBits_u8u8u8u8
        Bfx_ShiftBitLt_u16u8: implemented-entry=Bfx_ShiftBitLt_u16u8
        Bfx_ShiftBitLt_u32u8: implemented-entry=Bfx_ShiftBitLt_u32u8
        Bfx_ShiftBitLt_u8u8: implemented-entry=Bfx_ShiftBitLt_u8u8
        Bfx_ShiftBitRt_u16u8: implemented-entry=Bfx_ShiftBitRt_u16u8
        Bfx_ShiftBitRt_u32u8: implemented-entry=Bfx_ShiftBitRt_u32u8
        Bfx_ShiftBitRt_u8u8: implemented-entry=Bfx_ShiftBitRt_u8u8
        Bfx_ToggleBitMask_u16u16: implemented-entry=Bfx_ToggleBitMask_u16u16
        Bfx_ToggleBitMask_u32u32: implemented-entry=Bfx_ToggleBitMask_u32u32
        Bfx_ToggleBitMask_u8u8: implemented-entry=Bfx_ToggleBitMask_u8u8
        Bfx_ToggleBits_u16: implemented-entry=Bfx_ToggleBits_u16
        Bfx_ToggleBits_u32: implemented-entry=Bfx_ToggleBits_u32
        Bfx_ToggleBits_u8: implemented-entry=Bfx_ToggleBits_u8
        Bfx_TstBitLnMask_u16u16_u8: implemented-entry=Bfx_TstBitLnMask_u16u16_u8
        Bfx_TstBitLnMask_u32u32_u8: implemented-entry=Bfx_TstBitLnMask_u32u32_u8
        Bfx_TstBitLnMask_u8u8_u8: implemented-entry=Bfx_TstBitLnMask_u8u8_u8
        Bfx_TstBitMask_u16u16_u8: implemented-entry=Bfx_TstBitMask_u16u16_u8
        Bfx_TstBitMask_u32u32_u8: implemented-entry=Bfx_TstBitMask_u32u32_u8
        Bfx_TstBitMask_u8u8_u8: implemented-entry=Bfx_TstBitMask_u8u8_u8
        Bfx_TstParityEven_u16_u8: implemented-entry=Bfx_TstParityEven_u16_u8
        Bfx_TstParityEven_u32_u8: implemented-entry=Bfx_TstParityEven_u32_u8
        Bfx_TstParityEven_u8_u8: implemented-entry=Bfx_TstParityEven_u8_u8
package /AUTOSAR_Bfx/BswModuleEntrys
  61 x bsw module entry, all with is-reentrant=true, is-synchronous=true, call-type=REGULAR, execution-context=UNSPECIFIED:
    Bfx_GetVersionInfo: service-id=0, sw-service-impl-policy=MACRO
      sw service arg VersionInfoPtr: category=DATA_REFERENCE, sw-pointer-target-props={target-category=TYPE_REFERENCE, implementation-data-type=Std_VersionInfoType}
    Bfx_ClrBit_u16u8: service-id=7, sw-service-impl-policy=STANDARD
      sw service arg Data: category=DATA_REFERENCE, sw-pointer-target-props={target-category=TYPE_REFERENCE, implementation-data-type=uint16}
      sw service arg BitPn: implementation-data-type=uint8
    Bfx_ClrBit_u32u8: service-id=8, sw-service-impl-policy=STANDARD
      sw service arg Data: category=DATA_REFERENCE, sw-pointer-target-props={target-category=TYPE_REFERENCE, implementation-data-type=uint32}
      sw service arg BitPn: implementation-data-type=uint8
    Bfx_ClrBit_u8u8: service-id=6, sw-service-impl-policy=STANDARD
      sw service arg Data: category=DATA_REFERENCE, sw-pointer-target-props={target-category=TYPE_REFERENCE, implementation-data-type=uint8}
      sw service arg BitPn: implementation-data-type=uint8
    Bfx_ClrBitMask_u16u16: service-id=49, sw-service-impl-policy=STANDARD
      sw service arg Data: category=DATA_REFERENCE, sw-pointer-target-props={target-category=TYPE_REFERENCE, implementation-data-type=uint16}
      sw service arg Mask: implementation-data-type=uint16
    Bfx_ClrBitMask_u32u32: service-id=50, sw-service-impl-policy=STANDARD
      sw service arg Data: category=DATA_REFERENCE, sw-pointer-target-props={target-category=TYPE_REFERENCE, implementation-data-type=uint32}
      sw service arg Mask: implementation-data-type=uint32
    Bfx_ClrBitMask_u8u8: service-id=48, sw-service-impl-policy=STANDARD
      sw service arg Data: category=DATA_REFERENCE, sw-pointer-target-props={target-category=TYPE_REFERENCE, implementation-data-type=uint8}
      sw service arg Mask: implementation-data-type=uint8
    Bfx_CopyBit_u16u8u16u8: service-id=103, sw-service-impl-policy=STANDARD
      4 x sw service arg:
        DestinationData: category=DATA_REFERENCE, sw-pointer-target-props={target-category=TYPE_REFERENCE, implementation-data-type=uint16}
        DestinationPosition: implementation-data-type=uint8
        SourceData: implementation-data-type=uint16
        SourcePosition: implementation-data-type=uint8
    Bfx_CopyBit_u32u8u32u8: service-id=104, sw-service-impl-policy=STANDARD
      4 x sw service arg:
        DestinationData: category=DATA_REFERENCE, sw-pointer-target-props={target-category=TYPE_REFERENCE, implementation-data-type=uint32}
        DestinationPosition: implementation-data-type=uint8
        SourceData: implementation-data-type=uint32
        SourcePosition: implementation-data-type=uint8
    Bfx_CopyBit_u8u8u8u8: service-id=102, sw-service-impl-policy=STANDARD
      4 x sw service arg:
        DestinationData: category=DATA_REFERENCE, sw-pointer-target-props={target-category=TYPE_REFERENCE, implementation-data-type=uint8}
        DestinationPosition: implementation-data-type=uint8
        SourceData: implementation-data-type=uint8
        SourcePosition: implementation-data-type=uint8
    Bfx_GetBit_u16u8_u8: service-id=11, sw-service-impl-policy=STANDARD
      return type Return: implementation-data-type=boolean
      sw service arg Data: implementation-data-type=uint16
      sw service arg BitPn: implementation-data-type=uint8
    Bfx_GetBit_u32u8_u8: service-id=12, sw-service-impl-policy=STANDARD
      return type Return: implementation-data-type=boolean
      sw service arg Data: implementation-data-type=uint32
      sw service arg BitPn: implementation-data-type=uint8
    Bfx_GetBit_u8u8_u8: service-id=10, sw-service-impl-policy=STANDARD
      return type Return: implementation-data-type=boolean
      sw service arg Data: implementation-data-type=uint8
      sw service arg BitPn: implementation-data-type=uint8
    Bfx_GetBits_u16u8u8_u16: service-id=39, sw-service-impl-policy=STANDARD
      return type Return: implementation-data-type=uint16
      sw service arg Data: implementation-data-type=uint16
      sw service arg BitStartPn: implementation-data-type=uint8
      sw service arg BitLn: implementation-data-type=uint8
    Bfx_GetBits_u32u8u8_u32: service-id=40, sw-service-impl-policy=STANDARD
      return type Return: implementation-data-type=uint32
      sw service arg Data: implementation-data-type=uint32
      sw service arg BitStartPn: implementation-data-type=uint8
      sw service arg BitLn: implementation-data-type=uint8
    Bfx_GetBits_u8u8u8_u8: service-id=38, sw-service-impl-policy=STANDARD
      return type Return: implementation-data-type=uint8
      sw service arg Data: implementation-data-type=uint8
      sw service arg BitStartPn: implementation-data-type=uint8
      sw service arg BitLn: implementation-data-type=uint8
    Bfx_PutBit_u16u8u8: service-id=134, sw-service-impl-policy=STANDARD
      sw service arg Data: category=DATA_REFERENCE, sw-pointer-target-props={target-category=TYPE_REFERENCE, implementation-data-type=uint16}
      sw service arg BitPn: implementation-data-type=uint8
      sw service arg Status: implementation-data-type=uint8
    Bfx_PutBit_u32u8u8: service-id=135, sw-service-impl-policy=STANDARD
      sw service arg Data: category=DATA_REFERENCE, sw-pointer-target-props={target-category=TYPE_REFERENCE, implementation-data-type=uint32}
      sw service arg BitPn: implementation-data-type=uint8
      sw service arg Status: implementation-data-type=uint8
    Bfx_PutBit_u8u8u8: service-id=133, sw-service-impl-policy=STANDARD
      sw service arg Data: category=DATA_REFERENCE, sw-pointer-target-props={target-category=TYPE_REFERENCE, implementation-data-type=uint8}
      sw service arg BitPn: implementation-data-type=uint8
      sw service arg Status: implementation-data-type=uint8
    Bfx_PutBits_u16u8u8u16: service-id=113, sw-service-impl-policy=STANDARD
      4 x sw service arg:
        Data: category=DATA_REFERENCE, sw-pointer-target-props={target-category=TYPE_REFERENCE, implementation-data-type=uint16}
        BitStartPn: implementation-data-type=uint8
        BitLn: implementation-data-type=uint8
        Pattern: implementation-data-type=uint16
    Bfx_PutBits_u32u8u8u32: service-id=114, sw-service-impl-policy=STANDARD
      4 x sw service arg:
        Data: category=DATA_REFERENCE, sw-pointer-target-props={target-category=TYPE_REFERENCE, implementation-data-type=uint32}
        BitStartPn: implementation-data-type=uint8
        BitLn: implementation-data-type=uint8
        Pattern: implementation-data-type=uint32
    Bfx_PutBits_u8u8u8u8: service-id=112, sw-service-impl-policy=STANDARD
      4 x sw service arg:
        Data: category=DATA_REFERENCE, sw-pointer-target-props={target-category=TYPE_REFERENCE, implementation-data-type=uint8}
        BitStartPn: implementation-data-type=uint8
        BitLn: implementation-data-type=uint8
        Pattern: implementation-data-type=uint8
    Bfx_PutBitsMask_u16u16u16: service-id=129, sw-service-impl-policy=STANDARD
      sw service arg Data: category=DATA_REFERENCE, sw-pointer-target-props={target-category=TYPE_REFERENCE, implementation-data-type=uint16}
      sw service arg Pattern: implementation-data-type=uint16
      sw service arg Mask: implementation-data-type=uint16
    Bfx_PutBitsMask_u32u32u32: service-id=130, sw-service-impl-policy=STANDARD
      sw service arg Data: category=DATA_REFERENCE, sw-pointer-target-props={target-category=TYPE_REFERENCE, implementation-data-type=uint32}
      sw service arg Pattern: implementation-data-type=uint32
      sw service arg Mask: implementation-data-type=uint32
    Bfx_PutBitsMask_u8u8u8: service-id=128, sw-service-impl-policy=STANDARD
      sw service arg Data: category=DATA_REFERENCE, sw-pointer-target-props={target-category=TYPE_REFERENCE, implementation-data-type=uint8}
      sw service arg Pattern: implementation-data-type=uint8
      sw service arg Mask: implementation-data-type=uint8
    Bfx_RotBitLt_u16u8: service-id=97, sw-service-impl-policy=STANDARD
      sw service arg Data: category=DATA_REFERENCE, sw-pointer-target-props={target-category=TYPE_REFERENCE, implementation-data-type=uint16}
      sw service arg ShiftCnt: implementation-data-type=uint8
    Bfx_RotBitLt_u32u8: service-id=98, sw-service-impl-policy=STANDARD
      sw service arg Data: category=DATA_REFERENCE, sw-pointer-target-props={target-category=TYPE_REFERENCE, implementation-data-type=uint32}
      sw service arg ShiftCnt: implementation-data-type=uint8
    Bfx_RotBitLt_u8u8: service-id=96, sw-service-impl-policy=STANDARD
      sw service arg Data: category=DATA_REFERENCE, sw-pointer-target-props={target-category=TYPE_REFERENCE, implementation-data-type=uint8}
      sw service arg ShiftCnt: implementation-data-type=uint8
    Bfx_RotBitRt_u16u8: service-id=91, sw-service-impl-policy=STANDARD
      sw service arg Data: category=DATA_REFERENCE, sw-pointer-target-props={target-category=TYPE_REFERENCE, implementation-data-type=uint16}
      sw service arg ShiftCnt: implementation-data-type=uint8
    Bfx_RotBitRt_u32u8: service-id=92, sw-service-impl-policy=STANDARD
      sw service arg Data: category=DATA_REFERENCE, sw-pointer-target-props={target-category=TYPE_REFERENCE, implementation-data-type=uint32}
      sw service arg ShiftCnt: implementation-data-type=uint8
    Bfx_RotBitRt_u8u8: service-id=90, sw-service-impl-policy=STANDARD
      sw service arg Data: category=DATA_REFERENCE, sw-pointer-target-props={target-category=TYPE_REFERENCE, implementation-data-type=uint8}
      sw service arg ShiftCnt: implementation-data-type=uint8
    Bfx_SetBit_u16u8: service-id=2, sw-service-impl-policy=STANDARD
      sw service arg Data: category=DATA_REFERENCE, sw-pointer-target-props={target-category=TYPE_REFERENCE, implementation-data-type=uint16}
      sw service arg BitPn: implementation-data-type=uint8
    Bfx_SetBit_u32u8: service-id=3, sw-service-impl-policy=STANDARD
      sw service arg Data: category=DATA_REFERENCE, sw-pointer-target-props={target-category=TYPE_REFERENCE, implementation-data-type=uint32}
      sw service arg BitPn: implementation-data-type=uint8
    Bfx_SetBit_u8u8: service-id=1, sw-service-impl-policy=STANDARD
      sw service arg Data: category=DATA_REFERENCE, sw-pointer-target-props={target-category=TYPE_REFERENCE, implementation-data-type=uint8}
      sw service arg BitPn: implementation-data-type=uint8
    Bfx_SetBitMask_u16u16: service-id=43, sw-service-impl-policy=STANDARD
      sw service arg Data: category=DATA_REFERENCE, sw-pointer-target-props={target-category=TYPE_REFERENCE, implementation-data-type=uint16}
      sw service arg Mask: implementation-data-type=uint16
    Bfx_SetBitMask_u32u32: service-id=44, sw-service-impl-policy=STANDARD
      sw service arg Data: category=DATA_REFERENCE, sw-pointer-target-props={target-category=TYPE_REFERENCE, implementation-data-type=uint32}
      sw service arg Mask: implementation-data-type=uint32
    Bfx_SetBitMask_u8u8: service-id=42, sw-service-impl-policy=STANDARD
      sw service arg Data: category=DATA_REFERENCE, sw-pointer-target-props={target-category=TYPE_REFERENCE, implementation-data-type=uint8}
      sw service arg Mask: implementation-data-type=uint8
    Bfx_SetBits_u16u8u8u8: service-id=33, sw-service-impl-policy=STANDARD
      4 x sw service arg:
        Data: category=DATA_REFERENCE, sw-pointer-target-props={target-category=TYPE_REFERENCE, implementation-data-type=uint16}
        BitStartPn: implementation-data-type=uint8
        BitLn: implementation-data-type=uint8
        Status: implementation-data-type=uint8
    Bfx_SetBits_u32u8u8u8: service-id=34, sw-service-impl-policy=STANDARD
      4 x sw service arg:
        Data: category=DATA_REFERENCE, sw-pointer-target-props={target-category=TYPE_REFERENCE, implementation-data-type=uint32}
        BitStartPn: implementation-data-type=uint8
        BitLn: implementation-data-type=uint8
        Status: implementation-data-type=uint8
    Bfx_SetBits_u8u8u8u8: service-id=32, sw-service-impl-policy=STANDARD
      4 x sw service arg:
        Data: category=DATA_REFERENCE, sw-pointer-target-props={target-category=TYPE_REFERENCE, implementation-data-type=uint8}
        BitStartPn: implementation-data-type=uint8
        BitLn: implementation-data-type=uint8
        Status: implementation-data-type=uint8
    Bfx_ShiftBitLt_u16u8: service-id=87, sw-service-impl-policy=STANDARD
      sw service arg Data: category=DATA_REFERENCE, sw-pointer-target-props={target-category=TYPE_REFERENCE, implementation-data-type=uint16}
      sw service arg ShiftCnt: implementation-data-type=uint8
    Bfx_ShiftBitLt_u32u8: service-id=88, sw-service-impl-policy=STANDARD
      sw service arg Data: category=DATA_REFERENCE, sw-pointer-target-props={target-category=TYPE_REFERENCE, implementation-data-type=uint32}
      sw service arg ShiftCnt: implementation-data-type=uint8
    Bfx_ShiftBitLt_u8u8: service-id=86, sw-service-impl-policy=STANDARD
      sw service arg Data: category=DATA_REFERENCE, sw-pointer-target-props={target-category=TYPE_REFERENCE, implementation-data-type=uint8}
      sw service arg ShiftCnt: implementation-data-type=uint8
    Bfx_ShiftBitRt_u16u8: service-id=81, sw-service-impl-policy=STANDARD
      sw service arg Data: category=DATA_REFERENCE, sw-pointer-target-props={target-category=TYPE_REFERENCE, implementation-data-type=uint16}
      sw service arg ShiftCnt: implementation-data-type=uint8
    Bfx_ShiftBitRt_u32u8: service-id=82, sw-service-impl-policy=STANDARD
      sw service arg Data: category=DATA_REFERENCE, sw-pointer-target-props={target-category=TYPE_REFERENCE, implementation-data-type=uint32}
      sw service arg ShiftCnt: implementation-data-type=uint8
    Bfx_ShiftBitRt_u8u8: service-id=80, sw-service-impl-policy=STANDARD
      sw service arg Data: category=DATA_REFERENCE, sw-pointer-target-props={target-category=TYPE_REFERENCE, implementation-data-type=uint8}
      sw service arg ShiftCnt: implementation-data-type=uint8
    Bfx_ToggleBitMask_u16u16: service-id=75, sw-service-impl-policy=STANDARD
      sw service arg Data: category=DATA_REFERENCE, sw-pointer-target-props={target-category=TYPE_REFERENCE, implementation-data-type=uint16}
      sw service arg Mask: implementation-data-type=uint16
    Bfx_ToggleBitMask_u32u32: service-id=76, sw-service-impl-policy=STANDARD
      sw service arg Data: category=DATA_REFERENCE, sw-pointer-target-props={target-category=TYPE_REFERENCE, implementation-data-type=uint32}
      sw service arg Mask: implementation-data-type=uint32
    Bfx_ToggleBitMask_u8u8: service-id=74, sw-service-impl-policy=STANDARD
      sw service arg Data: category=DATA_REFERENCE, sw-pointer-target-props={target-category=TYPE_REFERENCE, implementation-data-type=uint8}
      sw service arg Mask: implementation-data-type=uint8
    Bfx_ToggleBits_u16: service-id=71, sw-service-impl-policy=STANDARD
      sw service arg Data: category=DATA_REFERENCE, sw-pointer-target-props={target-category=TYPE_REFERENCE, implementation-data-type=uint16}
    Bfx_ToggleBits_u32: service-id=72, sw-service-impl-policy=STANDARD
      sw service arg Data: category=DATA_REFERENCE, sw-pointer-target-props={target-category=TYPE_REFERENCE, implementation-data-type=uint32}
    Bfx_ToggleBits_u8: service-id=70, sw-service-impl-policy=STANDARD
      sw service arg Data: category=DATA_REFERENCE, sw-pointer-target-props={target-category=TYPE_REFERENCE, implementation-data-type=uint8}
    Bfx_TstBitLnMask_u16u16_u8: service-id=59, sw-service-impl-policy=STANDARD
      return type Return: implementation-data-type=boolean
      sw service arg Data: implementation-data-type=uint16
      sw service arg Mask: implementation-data-type=uint16
    Bfx_TstBitLnMask_u32u32_u8: service-id=60, sw-service-impl-policy=STANDARD
      return type Return: implementation-data-type=boolean
      sw service arg Data: implementation-data-type=uint32
      sw service arg Mask: implementation-data-type=uint32
    Bfx_TstBitLnMask_u8u8_u8: service-id=58, sw-service-impl-policy=STANDARD
      return type Return: implementation-data-type=boolean
      sw service arg Data: implementation-data-type=uint8
      sw service arg Mask: implementation-data-type=uint8
    Bfx_TstBitMask_u16u16_u8: service-id=55, sw-service-impl-policy=STANDARD
      return type Return: implementation-data-type=boolean
      sw service arg Data: implementation-data-type=uint16
      sw service arg Mask: implementation-data-type=uint16
    Bfx_TstBitMask_u32u32_u8: service-id=56, sw-service-impl-policy=STANDARD
      return type Return: implementation-data-type=boolean
      sw service arg Data: implementation-data-type=uint32
      sw service arg Mask: implementation-data-type=uint32
    Bfx_TstBitMask_u8u8_u8: service-id=54, sw-service-impl-policy=STANDARD
      return type Return: implementation-data-type=boolean
      sw service arg Data: implementation-data-type=uint8
      sw service arg Mask: implementation-data-type=uint8
    Bfx_TstParityEven_u16_u8: service-id=65, sw-service-impl-policy=STANDARD
      return type Return: implementation-data-type=boolean
      sw service arg Data: implementation-data-type=uint16
    Bfx_TstParityEven_u32_u8: service-id=66, sw-service-impl-policy=STANDARD
      return type Return: implementation-data-type=boolean
      sw service arg Data: implementation-data-type=uint32
    Bfx_TstParityEven_u8_u8: service-id=64, sw-service-impl-policy=STANDARD
      return type Return: implementation-data-type=boolean
      sw service arg Data: implementation-data-type=uint8
package /AUTOSAR_Bfx/Implementations
  bsw implementation Bfx: programming-language=C, sw-version=0.0.0, vendor-id=17, ar-release-version=4.0.3, behavior=BfxBehavior, vendor-specific-module-def=Bfx
    code-descriptors:
      code Files
        artifact-descriptors:
          short-label=ssc::src::Bfx.c, category=SWSRC
          short-label=ssc::inc::Bfx.h, category=SWHDR
          short-label=mak::bfx_infineon_tricore::ssc::mak::infineon_bfx_cfg.mak, category=SWMAKE
          short-label=mak::bfx_infineon_tricore::ssc::mak::infineon_bfx_check.mak, category=SWMAKE
          short-label=mak::bfx_infineon_tricore::ssc::mak::infineon_bfx_defs.mak, category=SWMAKE
          short-label=mak::bfx_infineon_tricore::ssc::mak::infineon_bfx_rules.mak, category=SWMAKE
    compiler TASKING_COMPILE: name=TASKING, options="-c --core=tc1.6.x -t -Wa-gAHLs --emit-locals=-equ,-symbols -Wa-Ogs -Wa--error-limit=42 --iso=90 --eabi-compliant --integer-enumeration --language=-comments,-gcc,+volatile,-strings --switch=auto --align=0 --default-near-size=0 --default-a0-size=0 --default-a1-size=0 -O2ROPYG --tradeoff=4 -g --source -D_TASKING_C_TRICORE_=1 $(CALLFUNCTION)", vendor=Tasking, version=Tasking
    compiler DIAB_COMPILE: name=DIAB, options="-c -tTC27xAstep16PMG:cross -Xdialect-c89 -Xno-common -Xalign-functions=4 -Xfp-fast -Xsection-split=1 -Xkeep-assembly-file=2 -g3 -ew4084 -ei4177,4550,4549,4068,5388 -XO -D_DIABDATA_C_TRICORE_=1 $(CALLFUNCTION)", vendor=WindRiver, version=WindRiver
    compiler GNU_COMPILE:
      name=GNU
      options="-c -save-temps=obj -std=iso9899:1990 -ansi -fno-asm -ffreestanding -Wundef -Wp,-std=iso9899:1990 -fno-short-enums -fpeel-loops -falign-functions=4 -frecord-gcc-switches -fsection-anchors -funsigned-bitfields -ffunction-sections -fno-ivopts -fno-peephole2 -nostartfiles -O3 -g3 -W -Wall -Wuninitialized -DTRIBOARD_TC27XX -mcpu=tc27xx -D_GNU_C_TRICORE_=1 $(CALLFUNCTION)"
      vendor=Hightec
      version=Hightec
    linker TASKING_LINK: name=TASKING, options="-t -d_mcal_pjt.lsl -D__CPU__=tc27x -Cmpe:vtc -Otxycl --error-limit=42 -M -mcrfiklsmnoduq -lc -lfp -lrt", vendor=Tasking, version=Tasking
    linker DIAB_LINK: name=DIAB, options="-m6 "_mcal_pjt.dld" -lc", vendor=WindRiver, version=WindRiver
    linker GNU_LINK: name=GNU, options="-T"_mcal_pjt.ld" -nostartfiles -Wl,--allow-multiple-definition -Wl,--cref -Wl,--oformat=elf32-tricore -Wl,--mcpu=tc161 -Wl,--mem-holes -Wl,--extmap="a"", vendor=Hightec, version=Hightec
    resource consumption ResourceConsumption
      memory section BFX_CODE: alignment=UNKNOWN, size=1230, sw-addrmethod=CODE
      section name prefix BFX
