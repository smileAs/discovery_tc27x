<?xml version="1.0" encoding="UTF-8"?> 
<!--
/******************************************************************************
**                                                                           **
** Copyright (C) Infineon Technologies (2015)                                **
**                                                                           **
** All rights reserved.                                                      **
**                                                                           **
** This document contains proprietary information belonging to Infineon      **
** Technologies. Passing on and copying of this document, and communication  **
** of its contents is not permitted without prior written authorization.     **
**                                                                           **
*******************************************************************************
**                                                                           **
**  $FILENAME   : Eth_17_EthMac_Bswmd.arxml $                                **
**                                                                           **
**  $CC VERSION : \main\37 $                                                 **
**                                                                           **
**  $DATE       : 2015-11-30 $                                               **
**                                                                           **
**  AUTHOR    : DL-AUTOSAR-Engineering                                       **
**                                                                           **
**  VENDOR    : Infineon Technologies                                        **
**                                                                           **
**  DESCRIPTION  : BSWMD for Eth driver                            **
**                                                                           **
**  MAY BE CHANGED BY USER [yes/no]: No                                      **
**                                                                           **
******************************************************************************/
/******************************************************************************
**  Traceability   :                                                         **
**   [cover parentID=DS_AS_ETH025,
    SAS_AS4XX_ETH_PR668,SAS_AS4XX_ETH_PR669,SAS_AS4XX_ETH_PR670,
    SAS_AS4XX_ETH_PR672,SAS_AS4XX_ETH_PR673,SAS_AS4XX_ETH_PR674,
    SAS_AS4XX_ETH_PR675,SAS_AS4XX_ETH_PR676,SAS_AS4XX_ETH_PR677,
    SAS_AS4XX_ETH_PR681,SAS_AS4XX_ETH_PR683,SAS_AS4XX_ETH_PR684,
    SAS_AS4XX_ETH_PR685,SAS_AS4XX_ETH_PR686,SAS_AS4XX_ETH_PR687,
    SAS_AS4XX_ETH_PR688,SAS_AS4XX_ETH_PR689,SAS_AS4XX_ETH_PR690,
    SAS_AS4XX_ETH_PR693,SAS_AS4XX_ETH_PR694,SAS_AS4XX_ETH_PR695,
    SAS_AS4XX_ETH_PR678,SAS_AS4XX_ETH_PR680]
    [/cover]
                                                                             **
******************************************************************************/
-->
<AUTOSAR xmlns="http://autosar.org/schema/r4.0" xmlns:xsi="http://www.w3.org/2001/XMLSchema-instance" xsi:schemaLocation="http://autosar.org/schema/r4.0 AUTOSAR_4-0-3.xsd"> 
[!AUTOSPACING!][!//
[!NOCODE!][!//
[!SELECT "as:modconf('Eth')[1]"!][!//
[!VAR "Eth_GetVerApi"="EthGeneral/EthVersionInfoApi"!][!//
[!SELECT "EthConfigSet/*[num:i(1)]/EthCtrlConfig/*[num:i(1)]"!][!//
[!VAR "Eth_TxIrqHdlrApi"="./EthCtrlEnableTxInterrupt"!][!//
[!VAR "Eth_RxIrqHdlrApi"="./EthCtrlEnableRxInterrupt"!][!//
[!VAR "Eth_MIIApi"="./EthCtrlEnableMii"!][!//
[!ENDSELECT!][!//
[!ENDSELECT!][!//
[!ENDNOCODE!][!//
<AR-PACKAGES>
    <AR-PACKAGE>
        <SHORT-NAME>AUTOSAR_Eth</SHORT-NAME>
        <AR-PACKAGES>
            <AR-PACKAGE>
                <SHORT-NAME>BswModuleDescriptions</SHORT-NAME>
                <CATEGORY>STANDARD</CATEGORY>
                <ELEMENTS>
                    <BSW-MODULE-DESCRIPTION>
                        <SHORT-NAME>Eth</SHORT-NAME>
                        <LONG-NAME>
                            <L-4 L="EN">ETH Driver</L-4>
                        </LONG-NAME>
                        <CATEGORY>BSW_MODULE</CATEGORY>
                        <MODULE-ID>88</MODULE-ID>
                        <PROVIDED-ENTRYS>
                            <BSW-MODULE-ENTRY-REF-CONDITIONAL>
                                <BSW-MODULE-ENTRY-REF DEST="BSW-MODULE-ENTRY">/AUTOSAR_Eth/BswModuleEntrys/Eth_Init</BSW-MODULE-ENTRY-REF>
                            </BSW-MODULE-ENTRY-REF-CONDITIONAL>
                            <BSW-MODULE-ENTRY-REF-CONDITIONAL>
                                <BSW-MODULE-ENTRY-REF DEST="BSW-MODULE-ENTRY">/AUTOSAR_Eth/BswModuleEntrys/Eth_ControllerInit</BSW-MODULE-ENTRY-REF>
                            </BSW-MODULE-ENTRY-REF-CONDITIONAL>
                            <BSW-MODULE-ENTRY-REF-CONDITIONAL>
                                <BSW-MODULE-ENTRY-REF DEST="BSW-MODULE-ENTRY">/AUTOSAR_Eth/BswModuleEntrys/Eth_SetControllerMode</BSW-MODULE-ENTRY-REF>
                            </BSW-MODULE-ENTRY-REF-CONDITIONAL>
                            <BSW-MODULE-ENTRY-REF-CONDITIONAL>
                                <BSW-MODULE-ENTRY-REF DEST="BSW-MODULE-ENTRY">/AUTOSAR_Eth/BswModuleEntrys/Eth_GetControllerMode</BSW-MODULE-ENTRY-REF>
                            </BSW-MODULE-ENTRY-REF-CONDITIONAL>
                            <BSW-MODULE-ENTRY-REF-CONDITIONAL>
                                <BSW-MODULE-ENTRY-REF DEST="BSW-MODULE-ENTRY">/AUTOSAR_Eth/BswModuleEntrys/Eth_GetPhysAddr</BSW-MODULE-ENTRY-REF>
                            </BSW-MODULE-ENTRY-REF-CONDITIONAL>
[!IF "$Eth_MIIApi = 'true'"!]
                            <BSW-MODULE-ENTRY-REF-CONDITIONAL>
                                <BSW-MODULE-ENTRY-REF DEST="BSW-MODULE-ENTRY">/AUTOSAR_Eth/BswModuleEntrys/Eth_WriteMii</BSW-MODULE-ENTRY-REF>
                            </BSW-MODULE-ENTRY-REF-CONDITIONAL>
[!ENDIF!][!//
[!IF "$Eth_MIIApi = 'true'"!]
                            <BSW-MODULE-ENTRY-REF-CONDITIONAL>
                                <BSW-MODULE-ENTRY-REF DEST="BSW-MODULE-ENTRY">/AUTOSAR_Eth/BswModuleEntrys/Eth_ReadMii</BSW-MODULE-ENTRY-REF>
                            </BSW-MODULE-ENTRY-REF-CONDITIONAL>
[!ENDIF!][!//
                            <BSW-MODULE-ENTRY-REF-CONDITIONAL>
                                <BSW-MODULE-ENTRY-REF DEST="BSW-MODULE-ENTRY">/AUTOSAR_Eth/BswModuleEntrys/Eth_GetCounterState</BSW-MODULE-ENTRY-REF>
                            </BSW-MODULE-ENTRY-REF-CONDITIONAL>
                            <BSW-MODULE-ENTRY-REF-CONDITIONAL>
                                <BSW-MODULE-ENTRY-REF DEST="BSW-MODULE-ENTRY">/AUTOSAR_Eth/BswModuleEntrys/Eth_ProvideTxBuffer</BSW-MODULE-ENTRY-REF>
                            </BSW-MODULE-ENTRY-REF-CONDITIONAL>
                            <BSW-MODULE-ENTRY-REF-CONDITIONAL>
                                <BSW-MODULE-ENTRY-REF DEST="BSW-MODULE-ENTRY">/AUTOSAR_Eth/BswModuleEntrys/Eth_Transmit</BSW-MODULE-ENTRY-REF>
                            </BSW-MODULE-ENTRY-REF-CONDITIONAL>
                            <BSW-MODULE-ENTRY-REF-CONDITIONAL>
                                <BSW-MODULE-ENTRY-REF DEST="BSW-MODULE-ENTRY">/AUTOSAR_Eth/BswModuleEntrys/Eth_Receive</BSW-MODULE-ENTRY-REF>
                            </BSW-MODULE-ENTRY-REF-CONDITIONAL>
                            <BSW-MODULE-ENTRY-REF-CONDITIONAL>
                                <BSW-MODULE-ENTRY-REF DEST="BSW-MODULE-ENTRY">/AUTOSAR_Eth/BswModuleEntrys/Eth_TxConfirmation</BSW-MODULE-ENTRY-REF>
                            </BSW-MODULE-ENTRY-REF-CONDITIONAL>
[!IF "$Eth_RxIrqHdlrApi = 'true'"!]
                            <BSW-MODULE-ENTRY-REF-CONDITIONAL>
                                <BSW-MODULE-ENTRY-REF DEST="BSW-MODULE-ENTRY">/AUTOSAR_Eth/BswModuleEntrys/Eth_RxIrqHdlr</BSW-MODULE-ENTRY-REF>
                            </BSW-MODULE-ENTRY-REF-CONDITIONAL>
[!ENDIF!][!//
[!IF "$Eth_TxIrqHdlrApi = 'true'"!]
                            <BSW-MODULE-ENTRY-REF-CONDITIONAL>
                                <BSW-MODULE-ENTRY-REF DEST="BSW-MODULE-ENTRY">/AUTOSAR_Eth/BswModuleEntrys/Eth_TxIrqHdlr</BSW-MODULE-ENTRY-REF>
                            </BSW-MODULE-ENTRY-REF-CONDITIONAL>
[!ENDIF!][!//
                            <BSW-MODULE-ENTRY-REF-CONDITIONAL>
                                <BSW-MODULE-ENTRY-REF DEST="BSW-MODULE-ENTRY">/AUTOSAR_Eth/BswModuleEntrys/Eth_TxRxIrqHandler</BSW-MODULE-ENTRY-REF>
                            </BSW-MODULE-ENTRY-REF-CONDITIONAL>
[!IF "$Eth_GetVerApi = 'true'"!]
                            <BSW-MODULE-ENTRY-REF-CONDITIONAL>
                                <BSW-MODULE-ENTRY-REF DEST="BSW-MODULE-ENTRY">/AUTOSAR_Eth/BswModuleEntrys/Eth_GetVersionInfo</BSW-MODULE-ENTRY-REF>
                            </BSW-MODULE-ENTRY-REF-CONDITIONAL>
[!ENDIF!][!//
                            <BSW-MODULE-ENTRY-REF-CONDITIONAL>
                                <BSW-MODULE-ENTRY-REF DEST="BSW-MODULE-ENTRY">/AUTOSAR_Eth/BswModuleEntrys/Eth_SetPhysAddr</BSW-MODULE-ENTRY-REF>
                            </BSW-MODULE-ENTRY-REF-CONDITIONAL>
                        </PROVIDED-ENTRYS>
                        <BSW-MODULE-DEPENDENCYS>
                            <BSW-MODULE-DEPENDENCY>
                                <SHORT-NAME>DemDependency</SHORT-NAME>
                                <TARGET-MODULE-ID>54</TARGET-MODULE-ID>
                                <REQUIRED-ENTRYS>
                                    <BSW-MODULE-ENTRY-REF-CONDITIONAL>
                                        <BSW-MODULE-ENTRY-REF DEST="BSW-MODULE-ENTRY">/AUTOSAR_Dem/BswModuleEntrys/Dem_ReportErrorStatus</BSW-MODULE-ENTRY-REF>
                                    </BSW-MODULE-ENTRY-REF-CONDITIONAL>
                                </REQUIRED-ENTRYS>
                            </BSW-MODULE-DEPENDENCY>
                            <BSW-MODULE-DEPENDENCY>
                                <SHORT-NAME>DetDependency</SHORT-NAME>
                                <TARGET-MODULE-ID>15</TARGET-MODULE-ID>
                                <REQUIRED-ENTRYS>
                                    <BSW-MODULE-ENTRY-REF-CONDITIONAL>
                                        <BSW-MODULE-ENTRY-REF DEST="BSW-MODULE-ENTRY">/AUTOSAR_Det/BswModuleEntrys/Det_ReportError</BSW-MODULE-ENTRY-REF>
                                    </BSW-MODULE-ENTRY-REF-CONDITIONAL>
                                </REQUIRED-ENTRYS>
                            </BSW-MODULE-DEPENDENCY>
                        </BSW-MODULE-DEPENDENCYS>
                        <INTERNAL-BEHAVIORS>
                          <BSW-INTERNAL-BEHAVIOR>
                            <SHORT-NAME>EthBehavior</SHORT-NAME>
                            <CONSTANT-MEMORYS>
                              <PARAMETER-DATA-PROTOTYPE>
                                <SHORT-NAME>Eth_17_kConfigPtr</SHORT-NAME>
                                <CATEGORY>DATA_REFERENCE</CATEGORY>
                                <SW-DATA-DEF-PROPS>
                                  <SW-DATA-DEF-PROPS-VARIANTS>
                                    <SW-DATA-DEF-PROPS-CONDITIONAL>
                                    <SW-POINTER-TARGET-PROPS>
                                <TARGET-CATEGORY>TYPE_REFERENCE</TARGET-CATEGORY>
                                    <SW-DATA-DEF-PROPS>
                                    <SW-DATA-DEF-PROPS-VARIANTS>
                                    <SW-DATA-DEF-PROPS-CONDITIONAL>
                                      <IMPLEMENTATION-DATA-TYPE-REF DEST = "IMPLEMENTATION-DATA-TYPE">/AUTOSAR_Eth/ImplementationDataTypes/Eth_ConfigType</IMPLEMENTATION-DATA-TYPE-REF>
                                    </SW-DATA-DEF-PROPS-CONDITIONAL>
                                    </SW-DATA-DEF-PROPS-VARIANTS>
                                    </SW-DATA-DEF-PROPS>
                                    </SW-POINTER-TARGET-PROPS>
                                    </SW-DATA-DEF-PROPS-CONDITIONAL>
                                  </SW-DATA-DEF-PROPS-VARIANTS>
                                </SW-DATA-DEF-PROPS>
                                <TYPE-TREF DEST = "IMPLEMENTATION-DATA-TYPE">/AUTOSAR_Eth/ImplementationDataTypes/Eth_ConfigType</TYPE-TREF>
                              </PARAMETER-DATA-PROTOTYPE>
                            </CONSTANT-MEMORYS>
                            <EXCLUSIVE-AREAS>
[!IF "$Eth_TxIrqHdlrApi = 'true' or $Eth_RxIrqHdlrApi = 'true'"!][!//
                              <EXCLUSIVE-AREA>
                                <SHORT-NAME>SetControllerMode</SHORT-NAME>
                              </EXCLUSIVE-AREA>
[!ENDIF!][!//
[!IF "$Eth_TxIrqHdlrApi = 'true'"!][!//
                              <EXCLUSIVE-AREA>
                                <SHORT-NAME>ProvideTxBuffer</SHORT-NAME>
                              </EXCLUSIVE-AREA>
[!ENDIF!][!//
[!IF "$Eth_TxIrqHdlrApi = 'true'"!][!//
                              <EXCLUSIVE-AREA>
                                <SHORT-NAME>Transmit</SHORT-NAME>
                              </EXCLUSIVE-AREA>
[!ENDIF!][!//
                            </EXCLUSIVE-AREAS>
                            <STATIC-MEMORYS>
                              <VARIABLE-DATA-PROTOTYPE>
                                <SHORT-NAME>Eth_DriverState</SHORT-NAME>
                                <SW-DATA-DEF-PROPS>
                                  <SW-DATA-DEF-PROPS-VARIANTS>
                                    <SW-DATA-DEF-PROPS-CONDITIONAL>
                                    <IMPLEMENTATION-DATA-TYPE-REF DEST = "IMPLEMENTATION-DATA-TYPE">/AUTOSAR_Eth/ImplementationDataTypes/Eth_17_EthMac_StateType</IMPLEMENTATION-DATA-TYPE-REF>
                                    </SW-DATA-DEF-PROPS-CONDITIONAL>
                                  </SW-DATA-DEF-PROPS-VARIANTS>
                                </SW-DATA-DEF-PROPS>
                                <TYPE-TREF DEST = "IMPLEMENTATION-DATA-TYPE">/AUTOSAR_Eth/ImplementationDataTypes/Eth_17_EthMac_StateType</TYPE-TREF>
                              </VARIABLE-DATA-PROTOTYPE>
                              <VARIABLE-DATA-PROTOTYPE>
                                <SHORT-NAME>Eth_RxBufTotal</SHORT-NAME>
                                <SW-DATA-DEF-PROPS>
                                  <SW-DATA-DEF-PROPS-VARIANTS>
                                    <SW-DATA-DEF-PROPS-CONDITIONAL>
                                    <IMPLEMENTATION-DATA-TYPE-REF DEST = "IMPLEMENTATION-DATA-TYPE">/AUTOSAR_Platform/ImplementationDataTypes/uint8</IMPLEMENTATION-DATA-TYPE-REF>
                                    </SW-DATA-DEF-PROPS-CONDITIONAL>
                                  </SW-DATA-DEF-PROPS-VARIANTS>
                                </SW-DATA-DEF-PROPS>
                                <TYPE-TREF DEST = "IMPLEMENTATION-DATA-TYPE">/AUTOSAR_Platform/ImplementationDataTypes/uint8</TYPE-TREF>
                              </VARIABLE-DATA-PROTOTYPE>
                              <VARIABLE-DATA-PROTOTYPE>
                                <SHORT-NAME>Eth_TxBufTotal</SHORT-NAME>
                                <SW-DATA-DEF-PROPS>
                                  <SW-DATA-DEF-PROPS-VARIANTS>
                                    <SW-DATA-DEF-PROPS-CONDITIONAL>
                                    <IMPLEMENTATION-DATA-TYPE-REF DEST = "IMPLEMENTATION-DATA-TYPE">/AUTOSAR_Platform/ImplementationDataTypes/uint8</IMPLEMENTATION-DATA-TYPE-REF>
                                    </SW-DATA-DEF-PROPS-CONDITIONAL>
                                  </SW-DATA-DEF-PROPS-VARIANTS>
                                </SW-DATA-DEF-PROPS>
                                <TYPE-TREF DEST = "IMPLEMENTATION-DATA-TYPE">/AUTOSAR_Platform/ImplementationDataTypes/uint8</TYPE-TREF>
                              </VARIABLE-DATA-PROTOTYPE>
                              <VARIABLE-DATA-PROTOTYPE>
                                <SHORT-NAME>Eth_CurrRxBufIdx</SHORT-NAME>
                                <SW-DATA-DEF-PROPS>
                                  <SW-DATA-DEF-PROPS-VARIANTS>
                                    <SW-DATA-DEF-PROPS-CONDITIONAL>
                                    <IMPLEMENTATION-DATA-TYPE-REF DEST = "IMPLEMENTATION-DATA-TYPE">/AUTOSAR_Platform/ImplementationDataTypes/uint8</IMPLEMENTATION-DATA-TYPE-REF>
                                    </SW-DATA-DEF-PROPS-CONDITIONAL>
                                  </SW-DATA-DEF-PROPS-VARIANTS>
                                </SW-DATA-DEF-PROPS>
                                <TYPE-TREF DEST = "IMPLEMENTATION-DATA-TYPE">/AUTOSAR_Platform/ImplementationDataTypes/uint8</TYPE-TREF>
                              </VARIABLE-DATA-PROTOTYPE>
                              <VARIABLE-DATA-PROTOTYPE>
                                <SHORT-NAME>Eth_NextTxBuffer</SHORT-NAME>
                                <SW-DATA-DEF-PROPS>
                                  <SW-DATA-DEF-PROPS-VARIANTS>
                                    <SW-DATA-DEF-PROPS-CONDITIONAL>
                                    <IMPLEMENTATION-DATA-TYPE-REF DEST = "IMPLEMENTATION-DATA-TYPE">/AUTOSAR_Platform/ImplementationDataTypes/uint8</IMPLEMENTATION-DATA-TYPE-REF>
                                    </SW-DATA-DEF-PROPS-CONDITIONAL>
                                  </SW-DATA-DEF-PROPS-VARIANTS>
                                </SW-DATA-DEF-PROPS>
                                <TYPE-TREF DEST = "IMPLEMENTATION-DATA-TYPE">/AUTOSAR_Platform/ImplementationDataTypes/uint8</TYPE-TREF>
                              </VARIABLE-DATA-PROTOTYPE>
                              <VARIABLE-DATA-PROTOTYPE>
                                <SHORT-NAME>Eth_RxStartIdx</SHORT-NAME>
                                <SW-DATA-DEF-PROPS>
                                  <SW-DATA-DEF-PROPS-VARIANTS>
                                    <SW-DATA-DEF-PROPS-CONDITIONAL>
                                    <IMPLEMENTATION-DATA-TYPE-REF DEST = "IMPLEMENTATION-DATA-TYPE">/AUTOSAR_Platform/ImplementationDataTypes/uint8</IMPLEMENTATION-DATA-TYPE-REF>
                                    </SW-DATA-DEF-PROPS-CONDITIONAL>
                                  </SW-DATA-DEF-PROPS-VARIANTS>
                                </SW-DATA-DEF-PROPS>
                                <TYPE-TREF DEST = "IMPLEMENTATION-DATA-TYPE">/AUTOSAR_Platform/ImplementationDataTypes/uint8</TYPE-TREF>
                              </VARIABLE-DATA-PROTOTYPE>
                              <VARIABLE-DATA-PROTOTYPE>
                                <SHORT-NAME>Eth_ConfirmTxBufIdx</SHORT-NAME>
                                <SW-DATA-DEF-PROPS>
                                  <SW-DATA-DEF-PROPS-VARIANTS>
                                    <SW-DATA-DEF-PROPS-CONDITIONAL>
                                    <IMPLEMENTATION-DATA-TYPE-REF DEST = "IMPLEMENTATION-DATA-TYPE">/AUTOSAR_Platform/ImplementationDataTypes/uint8</IMPLEMENTATION-DATA-TYPE-REF>
                                    </SW-DATA-DEF-PROPS-CONDITIONAL>
                                  </SW-DATA-DEF-PROPS-VARIANTS>
                                </SW-DATA-DEF-PROPS>
                                <TYPE-TREF DEST = "IMPLEMENTATION-DATA-TYPE">/AUTOSAR_Platform/ImplementationDataTypes/uint8</TYPE-TREF>
                              </VARIABLE-DATA-PROTOTYPE>
                              <VARIABLE-DATA-PROTOTYPE>
                                <SHORT-NAME>Eth_RxBufLength</SHORT-NAME>
                                <SW-DATA-DEF-PROPS>
                                  <SW-DATA-DEF-PROPS-VARIANTS>
                                    <SW-DATA-DEF-PROPS-CONDITIONAL>
                                    <IMPLEMENTATION-DATA-TYPE-REF DEST = "IMPLEMENTATION-DATA-TYPE">/AUTOSAR_Platform/ImplementationDataTypes/uint16</IMPLEMENTATION-DATA-TYPE-REF>
                                    </SW-DATA-DEF-PROPS-CONDITIONAL>
                                  </SW-DATA-DEF-PROPS-VARIANTS>
                                </SW-DATA-DEF-PROPS>
                                <TYPE-TREF DEST = "IMPLEMENTATION-DATA-TYPE">/AUTOSAR_Platform/ImplementationDataTypes/uint16</TYPE-TREF>
                              </VARIABLE-DATA-PROTOTYPE>
                              <VARIABLE-DATA-PROTOTYPE>
                                <SHORT-NAME>Eth_TxBufLength</SHORT-NAME>
                                <SW-DATA-DEF-PROPS>
                                  <SW-DATA-DEF-PROPS-VARIANTS>
                                    <SW-DATA-DEF-PROPS-CONDITIONAL>
                                    <IMPLEMENTATION-DATA-TYPE-REF DEST = "IMPLEMENTATION-DATA-TYPE">/AUTOSAR_Platform/ImplementationDataTypes/uint16</IMPLEMENTATION-DATA-TYPE-REF>
                                    </SW-DATA-DEF-PROPS-CONDITIONAL>
                                  </SW-DATA-DEF-PROPS-VARIANTS>
                                </SW-DATA-DEF-PROPS>
                                <TYPE-TREF DEST = "IMPLEMENTATION-DATA-TYPE">/AUTOSAR_Platform/ImplementationDataTypes/uint16</TYPE-TREF>
                              </VARIABLE-DATA-PROTOTYPE>
                              <VARIABLE-DATA-PROTOTYPE>
                                <SHORT-NAME>Eth_DemAccessID</SHORT-NAME>
                                <SW-DATA-DEF-PROPS>
                                  <SW-DATA-DEF-PROPS-VARIANTS>
                                    <SW-DATA-DEF-PROPS-CONDITIONAL>
                                    <IMPLEMENTATION-DATA-TYPE-REF DEST = "IMPLEMENTATION-DATA-TYPE">/AUTOSAR_Dem/ImplementationDataTypes/Dem_EventIdType</IMPLEMENTATION-DATA-TYPE-REF>
                                    </SW-DATA-DEF-PROPS-CONDITIONAL>
                                  </SW-DATA-DEF-PROPS-VARIANTS>
                                </SW-DATA-DEF-PROPS>
                                <TYPE-TREF DEST = "IMPLEMENTATION-DATA-TYPE">/AUTOSAR_Dem/ImplementationDataTypes/Dem_EventIdType</TYPE-TREF>
                              </VARIABLE-DATA-PROTOTYPE>
                              <VARIABLE-DATA-PROTOTYPE>
                                <SHORT-NAME>Eth_DemTimeout</SHORT-NAME>
                                <SW-DATA-DEF-PROPS>
                                  <SW-DATA-DEF-PROPS-VARIANTS>
                                    <SW-DATA-DEF-PROPS-CONDITIONAL>
                                    <IMPLEMENTATION-DATA-TYPE-REF DEST = "IMPLEMENTATION-DATA-TYPE">/AUTOSAR_Dem/ImplementationDataTypes/Dem_EventIdType</IMPLEMENTATION-DATA-TYPE-REF>
                                    </SW-DATA-DEF-PROPS-CONDITIONAL>
                                  </SW-DATA-DEF-PROPS-VARIANTS>
                                </SW-DATA-DEF-PROPS>
                                <TYPE-TREF DEST = "IMPLEMENTATION-DATA-TYPE">/AUTOSAR_Dem/ImplementationDataTypes/Dem_EventIdType</TYPE-TREF>
                              </VARIABLE-DATA-PROTOTYPE>
                              <VARIABLE-DATA-PROTOTYPE>
                                <SHORT-NAME>Eth_DemEthSeq</SHORT-NAME>
                                <SW-DATA-DEF-PROPS>
                                  <SW-DATA-DEF-PROPS-VARIANTS>
                                    <SW-DATA-DEF-PROPS-CONDITIONAL>
                                    <IMPLEMENTATION-DATA-TYPE-REF DEST = "IMPLEMENTATION-DATA-TYPE">/AUTOSAR_Dem/ImplementationDataTypes/Dem_EventIdType</IMPLEMENTATION-DATA-TYPE-REF>
                                    </SW-DATA-DEF-PROPS-CONDITIONAL>
                                  </SW-DATA-DEF-PROPS-VARIANTS>
                                </SW-DATA-DEF-PROPS>
                                <TYPE-TREF DEST = "IMPLEMENTATION-DATA-TYPE">/AUTOSAR_Dem/ImplementationDataTypes/Dem_EventIdType</TYPE-TREF>
                              </VARIABLE-DATA-PROTOTYPE>
                              <VARIABLE-DATA-PROTOTYPE>
                                <SHORT-NAME>Eth_TxDesc</SHORT-NAME>
                                <SW-DATA-DEF-PROPS>
                                  <SW-DATA-DEF-PROPS-VARIANTS>
                                    <SW-DATA-DEF-PROPS-CONDITIONAL>
                                    <IMPLEMENTATION-DATA-TYPE-REF DEST = "IMPLEMENTATION-DATA-TYPE">/AUTOSAR_Eth/ImplementationDataTypes/Eth_DmaDescType</IMPLEMENTATION-DATA-TYPE-REF>
                                    </SW-DATA-DEF-PROPS-CONDITIONAL>
                                  </SW-DATA-DEF-PROPS-VARIANTS>
                                </SW-DATA-DEF-PROPS>
                                <TYPE-TREF DEST = "IMPLEMENTATION-DATA-TYPE">/AUTOSAR_Eth/ImplementationDataTypes/Eth_DmaDescType</TYPE-TREF>
                              </VARIABLE-DATA-PROTOTYPE>
                              <VARIABLE-DATA-PROTOTYPE>
                                <SHORT-NAME>Eth_RxDesc</SHORT-NAME>
                                <SW-DATA-DEF-PROPS>
                                  <SW-DATA-DEF-PROPS-VARIANTS>
                                    <SW-DATA-DEF-PROPS-CONDITIONAL>
                                    <IMPLEMENTATION-DATA-TYPE-REF DEST = "IMPLEMENTATION-DATA-TYPE">/AUTOSAR_Eth/ImplementationDataTypes/Eth_DmaDescType</IMPLEMENTATION-DATA-TYPE-REF>
                                    </SW-DATA-DEF-PROPS-CONDITIONAL>
                                  </SW-DATA-DEF-PROPS-VARIANTS>
                                </SW-DATA-DEF-PROPS>
                                <TYPE-TREF DEST = "IMPLEMENTATION-DATA-TYPE">/AUTOSAR_Eth/ImplementationDataTypes/Eth_DmaDescType</TYPE-TREF>
                              </VARIABLE-DATA-PROTOTYPE>
                              <VARIABLE-DATA-PROTOTYPE>
                                <SHORT-NAME>Eth_TxBuffer</SHORT-NAME>
                                <SW-DATA-DEF-PROPS>
                                  <SW-DATA-DEF-PROPS-VARIANTS>
                                    <SW-DATA-DEF-PROPS-CONDITIONAL>
                                    <IMPLEMENTATION-DATA-TYPE-REF DEST = "IMPLEMENTATION-DATA-TYPE">/AUTOSAR_Platform/ImplementationDataTypes/uint8</IMPLEMENTATION-DATA-TYPE-REF>
                                    </SW-DATA-DEF-PROPS-CONDITIONAL>
                                  </SW-DATA-DEF-PROPS-VARIANTS>
                                </SW-DATA-DEF-PROPS>
                                <TYPE-TREF DEST = "IMPLEMENTATION-DATA-TYPE">/AUTOSAR_Platform/ImplementationDataTypes/uint8</TYPE-TREF>
                              </VARIABLE-DATA-PROTOTYPE>
                              <VARIABLE-DATA-PROTOTYPE>
                                <SHORT-NAME>Eth_RxBuffer</SHORT-NAME>
                                <SW-DATA-DEF-PROPS>
                                  <SW-DATA-DEF-PROPS-VARIANTS>
                                    <SW-DATA-DEF-PROPS-CONDITIONAL>
                                    <IMPLEMENTATION-DATA-TYPE-REF DEST = "IMPLEMENTATION-DATA-TYPE">/AUTOSAR_Platform/ImplementationDataTypes/uint8</IMPLEMENTATION-DATA-TYPE-REF>
                                    </SW-DATA-DEF-PROPS-CONDITIONAL>
                                  </SW-DATA-DEF-PROPS-VARIANTS>
                                </SW-DATA-DEF-PROPS>
                                <TYPE-TREF DEST = "IMPLEMENTATION-DATA-TYPE">/AUTOSAR_Platform/ImplementationDataTypes/uint8</TYPE-TREF>
                              </VARIABLE-DATA-PROTOTYPE>
                              <VARIABLE-DATA-PROTOTYPE>
                                <SHORT-NAME>Eth_TxBufftable</SHORT-NAME>
                                <SW-DATA-DEF-PROPS>
                                  <SW-DATA-DEF-PROPS-VARIANTS>
                                    <SW-DATA-DEF-PROPS-CONDITIONAL>
                                    <IMPLEMENTATION-DATA-TYPE-REF DEST = "IMPLEMENTATION-DATA-TYPE">/AUTOSAR_Eth/ImplementationDataTypes/Eth_TxBuffTableType</IMPLEMENTATION-DATA-TYPE-REF>
                                    </SW-DATA-DEF-PROPS-CONDITIONAL>
                                  </SW-DATA-DEF-PROPS-VARIANTS>
                                </SW-DATA-DEF-PROPS>
                                <TYPE-TREF DEST = "IMPLEMENTATION-DATA-TYPE">/AUTOSAR_Eth/ImplementationDataTypes/Eth_TxBuffTableType</TYPE-TREF>
                              </VARIABLE-DATA-PROTOTYPE>
                            </STATIC-MEMORYS>
                            <ENTITYS>
                              <BSW-CALLED-ENTITY>
                                <SHORT-NAME>Eth_Init</SHORT-NAME>
                                <MINIMUM-START-INTERVAL>0.0</MINIMUM-START-INTERVAL>
                                <IMPLEMENTED-ENTRY-REF DEST="BSW-MODULE-ENTRY">/AUTOSAR_Eth/BswModuleEntrys/Eth_Init</IMPLEMENTED-ENTRY-REF>
                              </BSW-CALLED-ENTITY>
                              <BSW-CALLED-ENTITY>
                                <SHORT-NAME>Eth_ControllerInit</SHORT-NAME>
                                <MINIMUM-START-INTERVAL>0.0</MINIMUM-START-INTERVAL>
                                <IMPLEMENTED-ENTRY-REF DEST="BSW-MODULE-ENTRY">/AUTOSAR_Eth/BswModuleEntrys/Eth_ControllerInit</IMPLEMENTED-ENTRY-REF>
                              </BSW-CALLED-ENTITY>
                              <BSW-CALLED-ENTITY>
                                <SHORT-NAME>Eth_SetControllerMode</SHORT-NAME>
[!IF "$Eth_TxIrqHdlrApi = 'true' or $Eth_RxIrqHdlrApi = 'true'"!][!//
                                <CAN-ENTER-EXCLUSIVE-AREA-REFS>
                                  <CAN-ENTER-EXCLUSIVE-AREA-REF DEST="EXCLUSIVE-AREA">/AUTOSAR_Eth/BswModuleDescriptions/Eth/EthBehavior/SetControllerMode</CAN-ENTER-EXCLUSIVE-AREA-REF>
                                </CAN-ENTER-EXCLUSIVE-AREA-REFS>
[!ENDIF!][!//
                                <MINIMUM-START-INTERVAL>0.0</MINIMUM-START-INTERVAL>
                                <IMPLEMENTED-ENTRY-REF DEST="BSW-MODULE-ENTRY">/AUTOSAR_Eth/BswModuleEntrys/Eth_SetControllerMode</IMPLEMENTED-ENTRY-REF>
                              </BSW-CALLED-ENTITY>
                              <BSW-CALLED-ENTITY>
                                <SHORT-NAME>Eth_GetControllerMode</SHORT-NAME>
                                <MINIMUM-START-INTERVAL>0.0</MINIMUM-START-INTERVAL>
                                <IMPLEMENTED-ENTRY-REF DEST="BSW-MODULE-ENTRY">/AUTOSAR_Eth/BswModuleEntrys/Eth_GetControllerMode</IMPLEMENTED-ENTRY-REF>
                              </BSW-CALLED-ENTITY>
                              <BSW-CALLED-ENTITY>
                                <SHORT-NAME>Eth_GetPhysAddr</SHORT-NAME>
                                <MINIMUM-START-INTERVAL>0.0</MINIMUM-START-INTERVAL>
                                <IMPLEMENTED-ENTRY-REF DEST="BSW-MODULE-ENTRY">/AUTOSAR_Eth/BswModuleEntrys/Eth_GetPhysAddr</IMPLEMENTED-ENTRY-REF>
                              </BSW-CALLED-ENTITY>
[!IF "$Eth_MIIApi = 'true'"!]
                              <BSW-CALLED-ENTITY>
                                <SHORT-NAME>Eth_WriteMii</SHORT-NAME>
                                <MINIMUM-START-INTERVAL>0.0</MINIMUM-START-INTERVAL>
                                <IMPLEMENTED-ENTRY-REF DEST="BSW-MODULE-ENTRY">/AUTOSAR_Eth/BswModuleEntrys/Eth_WriteMii</IMPLEMENTED-ENTRY-REF>
                              </BSW-CALLED-ENTITY>
[!ENDIF!][!//
[!IF "$Eth_MIIApi = 'true'"!]
                              <BSW-CALLED-ENTITY>
                                <SHORT-NAME>Eth_ReadMii</SHORT-NAME>
                                <MINIMUM-START-INTERVAL>0.0</MINIMUM-START-INTERVAL>
                                <IMPLEMENTED-ENTRY-REF DEST="BSW-MODULE-ENTRY">/AUTOSAR_Eth/BswModuleEntrys/Eth_ReadMii</IMPLEMENTED-ENTRY-REF>
                              </BSW-CALLED-ENTITY>
[!ENDIF!][!//
                              <BSW-CALLED-ENTITY>
                                <SHORT-NAME>Eth_GetCounterState</SHORT-NAME>
                                <MINIMUM-START-INTERVAL>0.0</MINIMUM-START-INTERVAL>
                                <IMPLEMENTED-ENTRY-REF DEST="BSW-MODULE-ENTRY">/AUTOSAR_Eth/BswModuleEntrys/Eth_GetCounterState</IMPLEMENTED-ENTRY-REF>
                              </BSW-CALLED-ENTITY>
                              <BSW-CALLED-ENTITY>
                                <SHORT-NAME>Eth_ProvideTxBuffer</SHORT-NAME>
[!IF "$Eth_TxIrqHdlrApi = 'true'"!][!//
                                <CAN-ENTER-EXCLUSIVE-AREA-REFS>
                                  <CAN-ENTER-EXCLUSIVE-AREA-REF DEST="EXCLUSIVE-AREA">/AUTOSAR_Eth/BswModuleDescriptions/Eth/EthBehavior/ProvideTxBuffer</CAN-ENTER-EXCLUSIVE-AREA-REF>
                                </CAN-ENTER-EXCLUSIVE-AREA-REFS>
[!ENDIF!][!//
                                <MINIMUM-START-INTERVAL>0.0</MINIMUM-START-INTERVAL>
                                <IMPLEMENTED-ENTRY-REF DEST="BSW-MODULE-ENTRY">/AUTOSAR_Eth/BswModuleEntrys/Eth_ProvideTxBuffer</IMPLEMENTED-ENTRY-REF>
                              </BSW-CALLED-ENTITY>
                              <BSW-CALLED-ENTITY>
                                <SHORT-NAME>Eth_Transmit</SHORT-NAME>
[!IF "$Eth_TxIrqHdlrApi = 'true'"!][!//
                                <CAN-ENTER-EXCLUSIVE-AREA-REFS>
                                  <CAN-ENTER-EXCLUSIVE-AREA-REF DEST="EXCLUSIVE-AREA">/AUTOSAR_Eth/BswModuleDescriptions/Eth/EthBehavior/Transmit</CAN-ENTER-EXCLUSIVE-AREA-REF>
                                </CAN-ENTER-EXCLUSIVE-AREA-REFS>
[!ENDIF!][!//
                                <MINIMUM-START-INTERVAL>0.0</MINIMUM-START-INTERVAL>
                                <IMPLEMENTED-ENTRY-REF DEST="BSW-MODULE-ENTRY">/AUTOSAR_Eth/BswModuleEntrys/Eth_Transmit</IMPLEMENTED-ENTRY-REF>
                              </BSW-CALLED-ENTITY>
                              <BSW-CALLED-ENTITY>
                                <SHORT-NAME>Eth_Receive</SHORT-NAME>
                                <MINIMUM-START-INTERVAL>0.0</MINIMUM-START-INTERVAL>
                                <IMPLEMENTED-ENTRY-REF DEST="BSW-MODULE-ENTRY">/AUTOSAR_Eth/BswModuleEntrys/Eth_Receive</IMPLEMENTED-ENTRY-REF>
                              </BSW-CALLED-ENTITY>
                              <BSW-CALLED-ENTITY>
                                <SHORT-NAME>Eth_TxConfirmation</SHORT-NAME>
                                <MINIMUM-START-INTERVAL>0.0</MINIMUM-START-INTERVAL>
                                <IMPLEMENTED-ENTRY-REF DEST="BSW-MODULE-ENTRY">/AUTOSAR_Eth/BswModuleEntrys/Eth_TxConfirmation</IMPLEMENTED-ENTRY-REF>
                              </BSW-CALLED-ENTITY>
[!IF "$Eth_GetVerApi = 'true'"!]
                              <BSW-CALLED-ENTITY>
                                <SHORT-NAME>Eth_GetVersionInfo</SHORT-NAME>
                                <MINIMUM-START-INTERVAL>0.0</MINIMUM-START-INTERVAL>
                                <IMPLEMENTED-ENTRY-REF DEST="BSW-MODULE-ENTRY">/AUTOSAR_Eth/BswModuleEntrys/Eth_GetVersionInfo</IMPLEMENTED-ENTRY-REF>
                              </BSW-CALLED-ENTITY>
[!ENDIF!][!//
                              <BSW-CALLED-ENTITY>
                                <SHORT-NAME>Eth_SetPhysAddr</SHORT-NAME>
                                <MINIMUM-START-INTERVAL>0.0</MINIMUM-START-INTERVAL>
                                <IMPLEMENTED-ENTRY-REF DEST="BSW-MODULE-ENTRY">/AUTOSAR_Eth/BswModuleEntrys/Eth_SetPhysAddr</IMPLEMENTED-ENTRY-REF>
                              </BSW-CALLED-ENTITY>
[!IF "$Eth_RxIrqHdlrApi = 'true'"!]
                              <BSW-INTERRUPT-ENTITY>
                                  <SHORT-NAME>Eth_RxIrqHdlr</SHORT-NAME>
                                  <MINIMUM-START-INTERVAL>0.0</MINIMUM-START-INTERVAL>
                                  <IMPLEMENTED-ENTRY-REF DEST="BSW-MODULE-ENTRY">/AUTOSAR_Eth/BswModuleEntrys/Eth_RxIrqHdlr</IMPLEMENTED-ENTRY-REF>
                                  <INTERRUPT-CATEGORY>CAT-1</INTERRUPT-CATEGORY>
                                  <INTERRUPT-SOURCE>SRC_ETH</INTERRUPT-SOURCE>
                              </BSW-INTERRUPT-ENTITY>
[!ENDIF!][!//
[!IF "$Eth_TxIrqHdlrApi = 'true'"!]
                              <BSW-INTERRUPT-ENTITY>
                                  <SHORT-NAME>Eth_TxIrqHdlr</SHORT-NAME>
                                  <MINIMUM-START-INTERVAL>0.0</MINIMUM-START-INTERVAL>
                                  <IMPLEMENTED-ENTRY-REF DEST="BSW-MODULE-ENTRY">/AUTOSAR_Eth/BswModuleEntrys/Eth_TxIrqHdlr</IMPLEMENTED-ENTRY-REF>
                                  <INTERRUPT-CATEGORY>CAT-1</INTERRUPT-CATEGORY>
                                  <INTERRUPT-SOURCE>SRC_ETH</INTERRUPT-SOURCE>
                              </BSW-INTERRUPT-ENTITY>
[!ENDIF!][!//
                              <BSW-INTERRUPT-ENTITY>
                                  <SHORT-NAME>Eth_TxRxIrqHandler</SHORT-NAME>
                                  <MINIMUM-START-INTERVAL>0.0</MINIMUM-START-INTERVAL>
                                  <IMPLEMENTED-ENTRY-REF DEST="BSW-MODULE-ENTRY">/AUTOSAR_Eth/BswModuleEntrys/Eth_TxRxIrqHandler</IMPLEMENTED-ENTRY-REF>
                                  <INTERRUPT-CATEGORY>CAT-1</INTERRUPT-CATEGORY>
                                  <INTERRUPT-SOURCE>SRC_ETH</INTERRUPT-SOURCE>
                              </BSW-INTERRUPT-ENTITY>
                            </ENTITYS>
                          </BSW-INTERNAL-BEHAVIOR>
                        </INTERNAL-BEHAVIORS>
                    </BSW-MODULE-DESCRIPTION>
                </ELEMENTS>
            </AR-PACKAGE>
            <AR-PACKAGE>
                <SHORT-NAME>BswModuleEntrys</SHORT-NAME>
                <CATEGORY>STANDARD</CATEGORY>
                <ELEMENTS>
                    <BSW-MODULE-ENTRY>
                        <SHORT-NAME>Eth_Init</SHORT-NAME>
                        <SERVICE-ID>1</SERVICE-ID>
                        <IS-REENTRANT>false</IS-REENTRANT>
                        <IS-SYNCHRONOUS>true</IS-SYNCHRONOUS>
                        <CALL-TYPE>REGULAR</CALL-TYPE>
                        <EXECUTION-CONTEXT>UNSPECIFIED</EXECUTION-CONTEXT>
                        <SW-SERVICE-IMPL-POLICY>STANDARD</SW-SERVICE-IMPL-POLICY>
                        <ARGUMENTS>
                          <SW-SERVICE-ARG>
                            <SHORT-NAME>CfgPtr</SHORT-NAME>
                            <CATEGORY>DATA_REFERENCE</CATEGORY>
                            <SW-DATA-DEF-PROPS>
                              <SW-DATA-DEF-PROPS-VARIANTS>
                                <SW-DATA-DEF-PROPS-CONDITIONAL>
                                <SW-POINTER-TARGET-PROPS>
                                <TARGET-CATEGORY>TYPE_REFERENCE</TARGET-CATEGORY>
                                <SW-DATA-DEF-PROPS>
                                <SW-DATA-DEF-PROPS-VARIANTS>
                                <SW-DATA-DEF-PROPS-CONDITIONAL>
                                <IMPLEMENTATION-DATA-TYPE-REF DEST = "IMPLEMENTATION-DATA-TYPE">/AUTOSAR_Eth/ImplementationDataTypes/Eth_ConfigType</IMPLEMENTATION-DATA-TYPE-REF>
                                </SW-DATA-DEF-PROPS-CONDITIONAL>
                                </SW-DATA-DEF-PROPS-VARIANTS>
                                </SW-DATA-DEF-PROPS>
                                </SW-POINTER-TARGET-PROPS>
                                </SW-DATA-DEF-PROPS-CONDITIONAL>
                              </SW-DATA-DEF-PROPS-VARIANTS>
                            </SW-DATA-DEF-PROPS>
                          </SW-SERVICE-ARG>
                        </ARGUMENTS>
                    </BSW-MODULE-ENTRY>
                    <BSW-MODULE-ENTRY>
                        <SHORT-NAME>Eth_ControllerInit</SHORT-NAME>
                        <SERVICE-ID>2</SERVICE-ID>
                        <IS-REENTRANT>false</IS-REENTRANT>
                        <IS-SYNCHRONOUS>true</IS-SYNCHRONOUS>
                        <CALL-TYPE>REGULAR</CALL-TYPE>
                        <EXECUTION-CONTEXT>UNSPECIFIED</EXECUTION-CONTEXT>
                        <SW-SERVICE-IMPL-POLICY>STANDARD</SW-SERVICE-IMPL-POLICY>
                        <RETURN-TYPE>
                          <SHORT-NAME>Return</SHORT-NAME>
                          <SW-DATA-DEF-PROPS>
                            <SW-DATA-DEF-PROPS-VARIANTS>
                              <SW-DATA-DEF-PROPS-CONDITIONAL>
                                <IMPLEMENTATION-DATA-TYPE-REF DEST = "IMPLEMENTATION-DATA-TYPE">/AUTOSAR_Std/ImplementationDataTypes/Std_ReturnType</IMPLEMENTATION-DATA-TYPE-REF>
                              </SW-DATA-DEF-PROPS-CONDITIONAL>
                            </SW-DATA-DEF-PROPS-VARIANTS>
                          </SW-DATA-DEF-PROPS>
                        </RETURN-TYPE>
                        <ARGUMENTS>
                          <SW-SERVICE-ARG>
                            <SHORT-NAME>CtrlIdx</SHORT-NAME>
                            <SW-DATA-DEF-PROPS>
                              <SW-DATA-DEF-PROPS-VARIANTS>
                                <SW-DATA-DEF-PROPS-CONDITIONAL>
                                <IMPLEMENTATION-DATA-TYPE-REF DEST = "IMPLEMENTATION-DATA-TYPE">/AUTOSAR_Platform/ImplementationDataTypes/uint8</IMPLEMENTATION-DATA-TYPE-REF>
                                </SW-DATA-DEF-PROPS-CONDITIONAL>
                              </SW-DATA-DEF-PROPS-VARIANTS>
                            </SW-DATA-DEF-PROPS>
                          </SW-SERVICE-ARG>
                          <SW-SERVICE-ARG>
                            <SHORT-NAME>CfgIdx</SHORT-NAME>
                            <SW-DATA-DEF-PROPS>
                              <SW-DATA-DEF-PROPS-VARIANTS>
                                <SW-DATA-DEF-PROPS-CONDITIONAL>
                                <IMPLEMENTATION-DATA-TYPE-REF DEST = "IMPLEMENTATION-DATA-TYPE">/AUTOSAR_Platform/ImplementationDataTypes/uint8</IMPLEMENTATION-DATA-TYPE-REF>
                                </SW-DATA-DEF-PROPS-CONDITIONAL>
                              </SW-DATA-DEF-PROPS-VARIANTS>
                            </SW-DATA-DEF-PROPS>
                          </SW-SERVICE-ARG>
                        </ARGUMENTS>
                    </BSW-MODULE-ENTRY>
                    <BSW-MODULE-ENTRY>
                        <SHORT-NAME>Eth_SetControllerMode</SHORT-NAME>
                        <SERVICE-ID>3</SERVICE-ID>
                        <IS-REENTRANT>false</IS-REENTRANT>
                        <IS-SYNCHRONOUS>true</IS-SYNCHRONOUS>
                        <CALL-TYPE>REGULAR</CALL-TYPE>
                        <EXECUTION-CONTEXT>UNSPECIFIED</EXECUTION-CONTEXT>
                        <SW-SERVICE-IMPL-POLICY>STANDARD</SW-SERVICE-IMPL-POLICY>
                        <RETURN-TYPE>
                          <SHORT-NAME>Return</SHORT-NAME>
                          <SW-DATA-DEF-PROPS>
                            <SW-DATA-DEF-PROPS-VARIANTS>
                              <SW-DATA-DEF-PROPS-CONDITIONAL>
                                <IMPLEMENTATION-DATA-TYPE-REF DEST = "IMPLEMENTATION-DATA-TYPE">/AUTOSAR_Std/ImplementationDataTypes/Std_ReturnType</IMPLEMENTATION-DATA-TYPE-REF>
                              </SW-DATA-DEF-PROPS-CONDITIONAL>
                            </SW-DATA-DEF-PROPS-VARIANTS>
                          </SW-DATA-DEF-PROPS>
                        </RETURN-TYPE>
                        <ARGUMENTS>
                          <SW-SERVICE-ARG>
                            <SHORT-NAME>CtrlIdx</SHORT-NAME>
                            <SW-DATA-DEF-PROPS>
                              <SW-DATA-DEF-PROPS-VARIANTS>
                                <SW-DATA-DEF-PROPS-CONDITIONAL>
                                <IMPLEMENTATION-DATA-TYPE-REF DEST = "IMPLEMENTATION-DATA-TYPE">/AUTOSAR_Platform/ImplementationDataTypes/uint8</IMPLEMENTATION-DATA-TYPE-REF>
                                </SW-DATA-DEF-PROPS-CONDITIONAL>
                              </SW-DATA-DEF-PROPS-VARIANTS>
                            </SW-DATA-DEF-PROPS>
                          </SW-SERVICE-ARG>
                          <SW-SERVICE-ARG>
                            <SHORT-NAME>CtrlMode</SHORT-NAME>
                            <SW-DATA-DEF-PROPS>
                              <SW-DATA-DEF-PROPS-VARIANTS>
                                <SW-DATA-DEF-PROPS-CONDITIONAL>
                                <IMPLEMENTATION-DATA-TYPE-REF DEST = "IMPLEMENTATION-DATA-TYPE">/AUTOSAR_Eth/ImplementationDataTypes/Eth_ModeType</IMPLEMENTATION-DATA-TYPE-REF>
                                </SW-DATA-DEF-PROPS-CONDITIONAL>
                              </SW-DATA-DEF-PROPS-VARIANTS>
                            </SW-DATA-DEF-PROPS>
                          </SW-SERVICE-ARG>
                        </ARGUMENTS>
                    </BSW-MODULE-ENTRY>
                    <BSW-MODULE-ENTRY>
                        <SHORT-NAME>Eth_GetControllerMode</SHORT-NAME>
                        <SERVICE-ID>4</SERVICE-ID>
                        <IS-REENTRANT>false</IS-REENTRANT>
                        <IS-SYNCHRONOUS>true</IS-SYNCHRONOUS>
                        <CALL-TYPE>REGULAR</CALL-TYPE>
                        <EXECUTION-CONTEXT>UNSPECIFIED</EXECUTION-CONTEXT>
                        <SW-SERVICE-IMPL-POLICY>STANDARD</SW-SERVICE-IMPL-POLICY>
                        <RETURN-TYPE>
                          <SHORT-NAME>Return</SHORT-NAME>
                          <SW-DATA-DEF-PROPS>
                            <SW-DATA-DEF-PROPS-VARIANTS>
                              <SW-DATA-DEF-PROPS-CONDITIONAL>
                                <IMPLEMENTATION-DATA-TYPE-REF DEST = "IMPLEMENTATION-DATA-TYPE">/AUTOSAR_Std/ImplementationDataTypes/Std_ReturnType</IMPLEMENTATION-DATA-TYPE-REF>
                              </SW-DATA-DEF-PROPS-CONDITIONAL>
                            </SW-DATA-DEF-PROPS-VARIANTS>
                          </SW-DATA-DEF-PROPS>
                        </RETURN-TYPE>
                        <ARGUMENTS>
                          <SW-SERVICE-ARG>
                            <SHORT-NAME>CtrlIdx</SHORT-NAME>
                            <SW-DATA-DEF-PROPS>
                              <SW-DATA-DEF-PROPS-VARIANTS>
                                <SW-DATA-DEF-PROPS-CONDITIONAL>
                                <IMPLEMENTATION-DATA-TYPE-REF DEST = "IMPLEMENTATION-DATA-TYPE">/AUTOSAR_Platform/ImplementationDataTypes/uint8</IMPLEMENTATION-DATA-TYPE-REF>
                                </SW-DATA-DEF-PROPS-CONDITIONAL>
                              </SW-DATA-DEF-PROPS-VARIANTS>
                            </SW-DATA-DEF-PROPS>
                          </SW-SERVICE-ARG>
                          <SW-SERVICE-ARG>
                            <SHORT-NAME>CtrlModePtr</SHORT-NAME>
                            <CATEGORY>DATA_REFERENCE</CATEGORY>
                            <SW-DATA-DEF-PROPS>
                              <SW-DATA-DEF-PROPS-VARIANTS>
                                <SW-DATA-DEF-PROPS-CONDITIONAL>
                                <SW-POINTER-TARGET-PROPS>
                                <TARGET-CATEGORY>TYPE_REFERENCE</TARGET-CATEGORY>
                                <SW-DATA-DEF-PROPS>
                                <SW-DATA-DEF-PROPS-VARIANTS>
                                <SW-DATA-DEF-PROPS-CONDITIONAL>
                                <IMPLEMENTATION-DATA-TYPE-REF DEST = "IMPLEMENTATION-DATA-TYPE">/AUTOSAR_Eth/ImplementationDataTypes/Eth_ModeType</IMPLEMENTATION-DATA-TYPE-REF>
                                </SW-DATA-DEF-PROPS-CONDITIONAL>
                                </SW-DATA-DEF-PROPS-VARIANTS>
                                </SW-DATA-DEF-PROPS>
                                </SW-POINTER-TARGET-PROPS>
                                </SW-DATA-DEF-PROPS-CONDITIONAL>
                              </SW-DATA-DEF-PROPS-VARIANTS>
                            </SW-DATA-DEF-PROPS>
                          </SW-SERVICE-ARG>
                        </ARGUMENTS>
                    </BSW-MODULE-ENTRY>
                    <BSW-MODULE-ENTRY>
                        <SHORT-NAME>Eth_GetPhysAddr</SHORT-NAME>
                        <SERVICE-ID>8</SERVICE-ID>
                        <IS-REENTRANT>false</IS-REENTRANT>
                        <IS-SYNCHRONOUS>true</IS-SYNCHRONOUS>
                        <CALL-TYPE>REGULAR</CALL-TYPE>
                        <EXECUTION-CONTEXT>UNSPECIFIED</EXECUTION-CONTEXT>
                        <SW-SERVICE-IMPL-POLICY>STANDARD</SW-SERVICE-IMPL-POLICY>
                        <ARGUMENTS>
                          <SW-SERVICE-ARG>
                            <SHORT-NAME>CtrlIdx</SHORT-NAME>
                            <SW-DATA-DEF-PROPS>
                              <SW-DATA-DEF-PROPS-VARIANTS>
                                <SW-DATA-DEF-PROPS-CONDITIONAL>
                                <IMPLEMENTATION-DATA-TYPE-REF DEST = "IMPLEMENTATION-DATA-TYPE">/AUTOSAR_Platform/ImplementationDataTypes/uint8</IMPLEMENTATION-DATA-TYPE-REF>
                                </SW-DATA-DEF-PROPS-CONDITIONAL>
                              </SW-DATA-DEF-PROPS-VARIANTS>
                            </SW-DATA-DEF-PROPS>
                          </SW-SERVICE-ARG>
                          <SW-SERVICE-ARG>
                            <SHORT-NAME>PhysAddrPtr</SHORT-NAME>
                            <CATEGORY>DATA_REFERENCE</CATEGORY>
                            <SW-DATA-DEF-PROPS>
                              <SW-DATA-DEF-PROPS-VARIANTS>
                                <SW-DATA-DEF-PROPS-CONDITIONAL>
                                <SW-POINTER-TARGET-PROPS>
                                <TARGET-CATEGORY>TYPE_REFERENCE</TARGET-CATEGORY>
                                <SW-DATA-DEF-PROPS>
                                <SW-DATA-DEF-PROPS-VARIANTS>
                                <SW-DATA-DEF-PROPS-CONDITIONAL>
                                <IMPLEMENTATION-DATA-TYPE-REF DEST = "IMPLEMENTATION-DATA-TYPE">/AUTOSAR_Platform/ImplementationDataTypes/uint8</IMPLEMENTATION-DATA-TYPE-REF>
                                </SW-DATA-DEF-PROPS-CONDITIONAL>
                                </SW-DATA-DEF-PROPS-VARIANTS>
                                </SW-DATA-DEF-PROPS>
                                </SW-POINTER-TARGET-PROPS>
                                </SW-DATA-DEF-PROPS-CONDITIONAL>
                              </SW-DATA-DEF-PROPS-VARIANTS>
                            </SW-DATA-DEF-PROPS>
                          </SW-SERVICE-ARG>
                        </ARGUMENTS>
                    </BSW-MODULE-ENTRY>
[!IF "$Eth_MIIApi = 'true'"!]
                    <BSW-MODULE-ENTRY>
                        <SHORT-NAME>Eth_WriteMii</SHORT-NAME>
                        <SERVICE-ID>5</SERVICE-ID>
                        <IS-REENTRANT>false</IS-REENTRANT>
                        <IS-SYNCHRONOUS>true</IS-SYNCHRONOUS>
                        <CALL-TYPE>REGULAR</CALL-TYPE>
                        <EXECUTION-CONTEXT>UNSPECIFIED</EXECUTION-CONTEXT>
                        <SW-SERVICE-IMPL-POLICY>STANDARD</SW-SERVICE-IMPL-POLICY>
                        <ARGUMENTS>
                          <SW-SERVICE-ARG>
                            <SHORT-NAME>CtrlIdx</SHORT-NAME>
                            <SW-DATA-DEF-PROPS>
                              <SW-DATA-DEF-PROPS-VARIANTS>
                                <SW-DATA-DEF-PROPS-CONDITIONAL>
                                <IMPLEMENTATION-DATA-TYPE-REF DEST = "IMPLEMENTATION-DATA-TYPE">/AUTOSAR_Platform/ImplementationDataTypes/uint8</IMPLEMENTATION-DATA-TYPE-REF>
                                </SW-DATA-DEF-PROPS-CONDITIONAL>
                              </SW-DATA-DEF-PROPS-VARIANTS>
                            </SW-DATA-DEF-PROPS>
                          </SW-SERVICE-ARG>
                          <SW-SERVICE-ARG>
                            <SHORT-NAME>TrcvIdx</SHORT-NAME>
                            <SW-DATA-DEF-PROPS>
                              <SW-DATA-DEF-PROPS-VARIANTS>
                                <SW-DATA-DEF-PROPS-CONDITIONAL>
                                <IMPLEMENTATION-DATA-TYPE-REF DEST = "IMPLEMENTATION-DATA-TYPE">/AUTOSAR_Platform/ImplementationDataTypes/uint8</IMPLEMENTATION-DATA-TYPE-REF>
                                </SW-DATA-DEF-PROPS-CONDITIONAL>
                              </SW-DATA-DEF-PROPS-VARIANTS>
                            </SW-DATA-DEF-PROPS>
                          </SW-SERVICE-ARG>
                          <SW-SERVICE-ARG>
                            <SHORT-NAME>RegIdx</SHORT-NAME>
                            <SW-DATA-DEF-PROPS>
                              <SW-DATA-DEF-PROPS-VARIANTS>
                                <SW-DATA-DEF-PROPS-CONDITIONAL>
                                <IMPLEMENTATION-DATA-TYPE-REF DEST = "IMPLEMENTATION-DATA-TYPE">/AUTOSAR_Platform/ImplementationDataTypes/uint8</IMPLEMENTATION-DATA-TYPE-REF>
                                </SW-DATA-DEF-PROPS-CONDITIONAL>
                              </SW-DATA-DEF-PROPS-VARIANTS>
                            </SW-DATA-DEF-PROPS>
                          </SW-SERVICE-ARG>
                          <SW-SERVICE-ARG>
                            <SHORT-NAME>RegVal</SHORT-NAME>
                            <SW-DATA-DEF-PROPS>
                              <SW-DATA-DEF-PROPS-VARIANTS>
                                <SW-DATA-DEF-PROPS-CONDITIONAL>
                                <IMPLEMENTATION-DATA-TYPE-REF DEST = "IMPLEMENTATION-DATA-TYPE">/AUTOSAR_Platform/ImplementationDataTypes/uint16</IMPLEMENTATION-DATA-TYPE-REF>
                                </SW-DATA-DEF-PROPS-CONDITIONAL>
                              </SW-DATA-DEF-PROPS-VARIANTS>
                            </SW-DATA-DEF-PROPS>
                          </SW-SERVICE-ARG>
                        </ARGUMENTS>
                    </BSW-MODULE-ENTRY>
[!ENDIF!][!//
[!IF "$Eth_MIIApi = 'true'"!]
                    <BSW-MODULE-ENTRY>
                        <SHORT-NAME>Eth_ReadMii</SHORT-NAME>
                        <SERVICE-ID>6</SERVICE-ID>
                        <IS-REENTRANT>false</IS-REENTRANT>
                        <IS-SYNCHRONOUS>true</IS-SYNCHRONOUS>
                        <CALL-TYPE>REGULAR</CALL-TYPE>
                        <EXECUTION-CONTEXT>UNSPECIFIED</EXECUTION-CONTEXT>
                        <SW-SERVICE-IMPL-POLICY>STANDARD</SW-SERVICE-IMPL-POLICY>
                        <ARGUMENTS>
                          <SW-SERVICE-ARG>
                            <SHORT-NAME>CtrlIdx</SHORT-NAME>
                            <SW-DATA-DEF-PROPS>
                              <SW-DATA-DEF-PROPS-VARIANTS>
                                <SW-DATA-DEF-PROPS-CONDITIONAL>
                                <IMPLEMENTATION-DATA-TYPE-REF DEST = "IMPLEMENTATION-DATA-TYPE">/AUTOSAR_Platform/ImplementationDataTypes/uint8</IMPLEMENTATION-DATA-TYPE-REF>
                                </SW-DATA-DEF-PROPS-CONDITIONAL>
                              </SW-DATA-DEF-PROPS-VARIANTS>
                            </SW-DATA-DEF-PROPS>
                          </SW-SERVICE-ARG>
                          <SW-SERVICE-ARG>
                            <SHORT-NAME>TrcvIdx</SHORT-NAME>
                            <SW-DATA-DEF-PROPS>
                              <SW-DATA-DEF-PROPS-VARIANTS>
                                <SW-DATA-DEF-PROPS-CONDITIONAL>
                                <IMPLEMENTATION-DATA-TYPE-REF DEST = "IMPLEMENTATION-DATA-TYPE">/AUTOSAR_Platform/ImplementationDataTypes/uint8</IMPLEMENTATION-DATA-TYPE-REF>
                                </SW-DATA-DEF-PROPS-CONDITIONAL>
                              </SW-DATA-DEF-PROPS-VARIANTS>
                            </SW-DATA-DEF-PROPS>
                          </SW-SERVICE-ARG>
                          <SW-SERVICE-ARG>
                            <SHORT-NAME>RegIdx</SHORT-NAME>
                            <SW-DATA-DEF-PROPS>
                              <SW-DATA-DEF-PROPS-VARIANTS>
                                <SW-DATA-DEF-PROPS-CONDITIONAL>
                                <IMPLEMENTATION-DATA-TYPE-REF DEST = "IMPLEMENTATION-DATA-TYPE">/AUTOSAR_Platform/ImplementationDataTypes/uint8</IMPLEMENTATION-DATA-TYPE-REF>
                                </SW-DATA-DEF-PROPS-CONDITIONAL>
                              </SW-DATA-DEF-PROPS-VARIANTS>
                            </SW-DATA-DEF-PROPS>
                          </SW-SERVICE-ARG>
                          <SW-SERVICE-ARG>
                            <SHORT-NAME>RegValPtr</SHORT-NAME>
                            <CATEGORY>DATA_REFERENCE</CATEGORY>
                            <SW-DATA-DEF-PROPS>
                              <SW-DATA-DEF-PROPS-VARIANTS>
                                <SW-DATA-DEF-PROPS-CONDITIONAL>
                                <SW-POINTER-TARGET-PROPS>
                                <TARGET-CATEGORY>TYPE_REFERENCE</TARGET-CATEGORY>
                                <SW-DATA-DEF-PROPS>
                                <SW-DATA-DEF-PROPS-VARIANTS>
                                <SW-DATA-DEF-PROPS-CONDITIONAL>
                                <IMPLEMENTATION-DATA-TYPE-REF DEST = "IMPLEMENTATION-DATA-TYPE">/AUTOSAR_Platform/ImplementationDataTypes/uint16</IMPLEMENTATION-DATA-TYPE-REF>
                                </SW-DATA-DEF-PROPS-CONDITIONAL>
                                </SW-DATA-DEF-PROPS-VARIANTS>
                                </SW-DATA-DEF-PROPS>
                                </SW-POINTER-TARGET-PROPS>
                                </SW-DATA-DEF-PROPS-CONDITIONAL>
                              </SW-DATA-DEF-PROPS-VARIANTS>
                            </SW-DATA-DEF-PROPS>
                          </SW-SERVICE-ARG>
                        </ARGUMENTS>
                    </BSW-MODULE-ENTRY>
[!ENDIF!][!//
                    <BSW-MODULE-ENTRY>
                        <SHORT-NAME>Eth_GetCounterState</SHORT-NAME>
                        <SERVICE-ID>7</SERVICE-ID>
                        <IS-REENTRANT>false</IS-REENTRANT>
                        <IS-SYNCHRONOUS>true</IS-SYNCHRONOUS>
                        <CALL-TYPE>REGULAR</CALL-TYPE>
                        <EXECUTION-CONTEXT>UNSPECIFIED</EXECUTION-CONTEXT>
                        <SW-SERVICE-IMPL-POLICY>STANDARD</SW-SERVICE-IMPL-POLICY>
                        <ARGUMENTS>
                          <SW-SERVICE-ARG>
                            <SHORT-NAME>CtrlIdx</SHORT-NAME>
                            <SW-DATA-DEF-PROPS>
                              <SW-DATA-DEF-PROPS-VARIANTS>
                                <SW-DATA-DEF-PROPS-CONDITIONAL>
                                <IMPLEMENTATION-DATA-TYPE-REF DEST = "IMPLEMENTATION-DATA-TYPE">/AUTOSAR_Platform/ImplementationDataTypes/uint8</IMPLEMENTATION-DATA-TYPE-REF>
                                </SW-DATA-DEF-PROPS-CONDITIONAL>
                              </SW-DATA-DEF-PROPS-VARIANTS>
                            </SW-DATA-DEF-PROPS>
                          </SW-SERVICE-ARG>
                          <SW-SERVICE-ARG>
                            <SHORT-NAME>CtrOffs</SHORT-NAME>
                            <SW-DATA-DEF-PROPS>
                              <SW-DATA-DEF-PROPS-VARIANTS>
                                <SW-DATA-DEF-PROPS-CONDITIONAL>
                                <IMPLEMENTATION-DATA-TYPE-REF DEST = "IMPLEMENTATION-DATA-TYPE">/AUTOSAR_Platform/ImplementationDataTypes/uint16</IMPLEMENTATION-DATA-TYPE-REF>
                                </SW-DATA-DEF-PROPS-CONDITIONAL>
                              </SW-DATA-DEF-PROPS-VARIANTS>
                            </SW-DATA-DEF-PROPS>
                          </SW-SERVICE-ARG>
                          <SW-SERVICE-ARG>
                            <SHORT-NAME>CtrValPtr</SHORT-NAME>
                            <CATEGORY>DATA_REFERENCE</CATEGORY>
                            <SW-DATA-DEF-PROPS>
                              <SW-DATA-DEF-PROPS-VARIANTS>
                                <SW-DATA-DEF-PROPS-CONDITIONAL>
                                <SW-POINTER-TARGET-PROPS>
                                <TARGET-CATEGORY>TYPE_REFERENCE</TARGET-CATEGORY>
                                <SW-DATA-DEF-PROPS>
                                <SW-DATA-DEF-PROPS-VARIANTS>
                                <SW-DATA-DEF-PROPS-CONDITIONAL>
                                <IMPLEMENTATION-DATA-TYPE-REF DEST = "IMPLEMENTATION-DATA-TYPE">/AUTOSAR_Platform/ImplementationDataTypes/uint32</IMPLEMENTATION-DATA-TYPE-REF>
                                </SW-DATA-DEF-PROPS-CONDITIONAL>
                                </SW-DATA-DEF-PROPS-VARIANTS>
                                </SW-DATA-DEF-PROPS>
                                </SW-POINTER-TARGET-PROPS>
                                </SW-DATA-DEF-PROPS-CONDITIONAL>
                              </SW-DATA-DEF-PROPS-VARIANTS>
                            </SW-DATA-DEF-PROPS>
                          </SW-SERVICE-ARG>
                        </ARGUMENTS>
                    </BSW-MODULE-ENTRY>
                    <BSW-MODULE-ENTRY>
                        <SHORT-NAME>Eth_ProvideTxBuffer</SHORT-NAME>
                        <SERVICE-ID>9</SERVICE-ID>
                        <IS-REENTRANT>false</IS-REENTRANT>
                        <IS-SYNCHRONOUS>true</IS-SYNCHRONOUS>
                        <CALL-TYPE>REGULAR</CALL-TYPE>
                        <EXECUTION-CONTEXT>UNSPECIFIED</EXECUTION-CONTEXT>
                        <SW-SERVICE-IMPL-POLICY>STANDARD</SW-SERVICE-IMPL-POLICY>
                        <RETURN-TYPE>
                          <SHORT-NAME>Return</SHORT-NAME>
                          <SW-DATA-DEF-PROPS>
                            <SW-DATA-DEF-PROPS-VARIANTS>
                              <SW-DATA-DEF-PROPS-CONDITIONAL>
                                <IMPLEMENTATION-DATA-TYPE-REF DEST = "IMPLEMENTATION-DATA-TYPE">/AUTOSAR_Std/ImplementationDataTypes/Std_ReturnType</IMPLEMENTATION-DATA-TYPE-REF>
                              </SW-DATA-DEF-PROPS-CONDITIONAL>
                            </SW-DATA-DEF-PROPS-VARIANTS>
                          </SW-DATA-DEF-PROPS>
                        </RETURN-TYPE>
                        <ARGUMENTS>
                          <SW-SERVICE-ARG>
                            <SHORT-NAME>CtrlIdx</SHORT-NAME>
                            <SW-DATA-DEF-PROPS>
                              <SW-DATA-DEF-PROPS-VARIANTS>
                                <SW-DATA-DEF-PROPS-CONDITIONAL>
                                <IMPLEMENTATION-DATA-TYPE-REF DEST = "IMPLEMENTATION-DATA-TYPE">/AUTOSAR_Platform/ImplementationDataTypes/uint8</IMPLEMENTATION-DATA-TYPE-REF>
                                </SW-DATA-DEF-PROPS-CONDITIONAL>
                              </SW-DATA-DEF-PROPS-VARIANTS>
                            </SW-DATA-DEF-PROPS>
                          </SW-SERVICE-ARG>
                          <SW-SERVICE-ARG>
                            <SHORT-NAME>BufIdxPtr</SHORT-NAME>
                            <CATEGORY>DATA_REFERENCE</CATEGORY>
                            <SW-DATA-DEF-PROPS>
                              <SW-DATA-DEF-PROPS-VARIANTS>
                                <SW-DATA-DEF-PROPS-CONDITIONAL>
                                <SW-POINTER-TARGET-PROPS>
                                <TARGET-CATEGORY>TYPE_REFERENCE</TARGET-CATEGORY>
                                <SW-DATA-DEF-PROPS>
                                <SW-DATA-DEF-PROPS-VARIANTS>
                                <SW-DATA-DEF-PROPS-CONDITIONAL>
                                <IMPLEMENTATION-DATA-TYPE-REF DEST = "IMPLEMENTATION-DATA-TYPE">/AUTOSAR_Platform/ImplementationDataTypes/uint8</IMPLEMENTATION-DATA-TYPE-REF>
                                </SW-DATA-DEF-PROPS-CONDITIONAL>
                                </SW-DATA-DEF-PROPS-VARIANTS>
                                </SW-DATA-DEF-PROPS>
                                </SW-POINTER-TARGET-PROPS>
                                </SW-DATA-DEF-PROPS-CONDITIONAL>
                              </SW-DATA-DEF-PROPS-VARIANTS>
                            </SW-DATA-DEF-PROPS>
                          </SW-SERVICE-ARG>
                          <SW-SERVICE-ARG>
                            <SHORT-NAME>BufPtr</SHORT-NAME>
                            <CATEGORY>DATA_REFERENCE</CATEGORY>
                            <SW-DATA-DEF-PROPS>
                              <SW-DATA-DEF-PROPS-VARIANTS>
                                <SW-DATA-DEF-PROPS-CONDITIONAL>
                                <SW-POINTER-TARGET-PROPS>
                                <TARGET-CATEGORY>TYPE_REFERENCE</TARGET-CATEGORY>
                                <SW-DATA-DEF-PROPS>
                                <SW-DATA-DEF-PROPS-VARIANTS>
                                <SW-DATA-DEF-PROPS-CONDITIONAL>
                                <IMPLEMENTATION-DATA-TYPE-REF DEST = "IMPLEMENTATION-DATA-TYPE">/AUTOSAR_Platform/ImplementationDataTypes/uint8</IMPLEMENTATION-DATA-TYPE-REF>
                                </SW-DATA-DEF-PROPS-CONDITIONAL>
                                </SW-DATA-DEF-PROPS-VARIANTS>
                                </SW-DATA-DEF-PROPS>
                                </SW-POINTER-TARGET-PROPS>
                                </SW-DATA-DEF-PROPS-CONDITIONAL>
                              </SW-DATA-DEF-PROPS-VARIANTS>
                            </SW-DATA-DEF-PROPS>
                          </SW-SERVICE-ARG>
                          <SW-SERVICE-ARG>
                            <SHORT-NAME>LenBytePtr</SHORT-NAME>
                            <CATEGORY>DATA_REFERENCE</CATEGORY>
                            <SW-DATA-DEF-PROPS>
                              <SW-DATA-DEF-PROPS-VARIANTS>
                                <SW-DATA-DEF-PROPS-CONDITIONAL>
                                <SW-POINTER-TARGET-PROPS>
                                <TARGET-CATEGORY>TYPE_REFERENCE</TARGET-CATEGORY>
                                <SW-DATA-DEF-PROPS>
                                <SW-DATA-DEF-PROPS-VARIANTS>
                                <SW-DATA-DEF-PROPS-CONDITIONAL>
                                <IMPLEMENTATION-DATA-TYPE-REF DEST = "IMPLEMENTATION-DATA-TYPE">/AUTOSAR_Platform/ImplementationDataTypes/uint16</IMPLEMENTATION-DATA-TYPE-REF>
                                </SW-DATA-DEF-PROPS-CONDITIONAL>
                                </SW-DATA-DEF-PROPS-VARIANTS>
                                </SW-DATA-DEF-PROPS>
                                </SW-POINTER-TARGET-PROPS>
                                </SW-DATA-DEF-PROPS-CONDITIONAL>
                              </SW-DATA-DEF-PROPS-VARIANTS>
                            </SW-DATA-DEF-PROPS>
                          </SW-SERVICE-ARG>
                        </ARGUMENTS>
                    </BSW-MODULE-ENTRY>
                    <BSW-MODULE-ENTRY>
                        <SHORT-NAME>Eth_Transmit</SHORT-NAME>
                        <SERVICE-ID>10</SERVICE-ID>
                        <IS-REENTRANT>false</IS-REENTRANT>
                        <IS-SYNCHRONOUS>true</IS-SYNCHRONOUS>
                        <CALL-TYPE>REGULAR</CALL-TYPE>
                        <EXECUTION-CONTEXT>UNSPECIFIED</EXECUTION-CONTEXT>
                        <SW-SERVICE-IMPL-POLICY>STANDARD</SW-SERVICE-IMPL-POLICY>
                        <RETURN-TYPE>
                          <SHORT-NAME>Return</SHORT-NAME>
                          <SW-DATA-DEF-PROPS>
                            <SW-DATA-DEF-PROPS-VARIANTS>
                              <SW-DATA-DEF-PROPS-CONDITIONAL>
                                <IMPLEMENTATION-DATA-TYPE-REF DEST = "IMPLEMENTATION-DATA-TYPE">/AUTOSAR_Std/ImplementationDataTypes/Std_ReturnType</IMPLEMENTATION-DATA-TYPE-REF>
                              </SW-DATA-DEF-PROPS-CONDITIONAL>
                            </SW-DATA-DEF-PROPS-VARIANTS>
                          </SW-DATA-DEF-PROPS>
                        </RETURN-TYPE>
                        <ARGUMENTS>
                          <SW-SERVICE-ARG>
                            <SHORT-NAME>CtrlIdx</SHORT-NAME>
                            <SW-DATA-DEF-PROPS>
                              <SW-DATA-DEF-PROPS-VARIANTS>
                                <SW-DATA-DEF-PROPS-CONDITIONAL>
                                <IMPLEMENTATION-DATA-TYPE-REF DEST = "IMPLEMENTATION-DATA-TYPE">/AUTOSAR_Platform/ImplementationDataTypes/uint8</IMPLEMENTATION-DATA-TYPE-REF>
                                </SW-DATA-DEF-PROPS-CONDITIONAL>
                              </SW-DATA-DEF-PROPS-VARIANTS>
                            </SW-DATA-DEF-PROPS>
                          </SW-SERVICE-ARG>
                          <SW-SERVICE-ARG>
                            <SHORT-NAME>BufIdx</SHORT-NAME>
                            <SW-DATA-DEF-PROPS>
                              <SW-DATA-DEF-PROPS-VARIANTS>
                                <SW-DATA-DEF-PROPS-CONDITIONAL>
                                <IMPLEMENTATION-DATA-TYPE-REF DEST = "IMPLEMENTATION-DATA-TYPE">/AUTOSAR_Platform/ImplementationDataTypes/uint8</IMPLEMENTATION-DATA-TYPE-REF>
                                </SW-DATA-DEF-PROPS-CONDITIONAL>
                              </SW-DATA-DEF-PROPS-VARIANTS>
                            </SW-DATA-DEF-PROPS>
                          </SW-SERVICE-ARG>
                          <SW-SERVICE-ARG>
                            <SHORT-NAME>FrameType</SHORT-NAME>
                            <SW-DATA-DEF-PROPS>
                              <SW-DATA-DEF-PROPS-VARIANTS>
                                <SW-DATA-DEF-PROPS-CONDITIONAL>
                                <IMPLEMENTATION-DATA-TYPE-REF DEST = "IMPLEMENTATION-DATA-TYPE">/AUTOSAR_Eth/ImplementationDataTypes/Eth_FrameType</IMPLEMENTATION-DATA-TYPE-REF>
                                </SW-DATA-DEF-PROPS-CONDITIONAL>
                              </SW-DATA-DEF-PROPS-VARIANTS>
                            </SW-DATA-DEF-PROPS>
                          </SW-SERVICE-ARG>
                          <SW-SERVICE-ARG>
                            <SHORT-NAME>TxConfirmation</SHORT-NAME>
                            <SW-DATA-DEF-PROPS>
                              <SW-DATA-DEF-PROPS-VARIANTS>
                                <SW-DATA-DEF-PROPS-CONDITIONAL>
                                <IMPLEMENTATION-DATA-TYPE-REF DEST = "IMPLEMENTATION-DATA-TYPE">/AUTOSAR_Platform/ImplementationDataTypes/boolean</IMPLEMENTATION-DATA-TYPE-REF>
                                </SW-DATA-DEF-PROPS-CONDITIONAL>
                              </SW-DATA-DEF-PROPS-VARIANTS>
                            </SW-DATA-DEF-PROPS>
                          </SW-SERVICE-ARG>
                          <SW-SERVICE-ARG>
                            <SHORT-NAME>LenByte</SHORT-NAME>
                            <SW-DATA-DEF-PROPS>
                              <SW-DATA-DEF-PROPS-VARIANTS>
                                <SW-DATA-DEF-PROPS-CONDITIONAL>
                                <IMPLEMENTATION-DATA-TYPE-REF DEST = "IMPLEMENTATION-DATA-TYPE">/AUTOSAR_Platform/ImplementationDataTypes/uint16</IMPLEMENTATION-DATA-TYPE-REF>
                                </SW-DATA-DEF-PROPS-CONDITIONAL>
                              </SW-DATA-DEF-PROPS-VARIANTS>
                            </SW-DATA-DEF-PROPS>
                          </SW-SERVICE-ARG>
                          <SW-SERVICE-ARG>
                            <SHORT-NAME>PhysAddrPtr</SHORT-NAME>
                            <CATEGORY>DATA_REFERENCE</CATEGORY>
                            <SW-DATA-DEF-PROPS>
                              <SW-DATA-DEF-PROPS-VARIANTS>
                                <SW-DATA-DEF-PROPS-CONDITIONAL>
                                <SW-POINTER-TARGET-PROPS>
                                <TARGET-CATEGORY>TYPE_REFERENCE</TARGET-CATEGORY>
                                <SW-DATA-DEF-PROPS>
                                <SW-DATA-DEF-PROPS-VARIANTS>
                                <SW-DATA-DEF-PROPS-CONDITIONAL>
                                <IMPLEMENTATION-DATA-TYPE-REF DEST = "IMPLEMENTATION-DATA-TYPE">/AUTOSAR_Platform/ImplementationDataTypes/uint8</IMPLEMENTATION-DATA-TYPE-REF>
                                </SW-DATA-DEF-PROPS-CONDITIONAL>
                                </SW-DATA-DEF-PROPS-VARIANTS>
                                </SW-DATA-DEF-PROPS>
                                </SW-POINTER-TARGET-PROPS>
                                </SW-DATA-DEF-PROPS-CONDITIONAL>
                              </SW-DATA-DEF-PROPS-VARIANTS>
                            </SW-DATA-DEF-PROPS>
                          </SW-SERVICE-ARG>
                        </ARGUMENTS>
                    </BSW-MODULE-ENTRY>
                    <BSW-MODULE-ENTRY>
                        <SHORT-NAME>Eth_Receive</SHORT-NAME>
                        <SERVICE-ID>11</SERVICE-ID>
                        <IS-REENTRANT>false</IS-REENTRANT>
                        <IS-SYNCHRONOUS>true</IS-SYNCHRONOUS>
                        <CALL-TYPE>REGULAR</CALL-TYPE>
                        <EXECUTION-CONTEXT>UNSPECIFIED</EXECUTION-CONTEXT>
                        <SW-SERVICE-IMPL-POLICY>STANDARD</SW-SERVICE-IMPL-POLICY>
                        <ARGUMENTS>
                          <SW-SERVICE-ARG>
                            <SHORT-NAME>CtrlIdx</SHORT-NAME>
                            <SW-DATA-DEF-PROPS>
                              <SW-DATA-DEF-PROPS-VARIANTS>
                                <SW-DATA-DEF-PROPS-CONDITIONAL>
                                <IMPLEMENTATION-DATA-TYPE-REF DEST = "IMPLEMENTATION-DATA-TYPE">/AUTOSAR_Platform/ImplementationDataTypes/uint8</IMPLEMENTATION-DATA-TYPE-REF>
                                </SW-DATA-DEF-PROPS-CONDITIONAL>
                              </SW-DATA-DEF-PROPS-VARIANTS>
                            </SW-DATA-DEF-PROPS>
                          </SW-SERVICE-ARG>
                        </ARGUMENTS>
                    </BSW-MODULE-ENTRY>
                    <BSW-MODULE-ENTRY>
                        <SHORT-NAME>Eth_TxConfirmation</SHORT-NAME>
                        <SERVICE-ID>12</SERVICE-ID>
                        <IS-REENTRANT>false</IS-REENTRANT>
                        <IS-SYNCHRONOUS>true</IS-SYNCHRONOUS>
                        <CALL-TYPE>REGULAR</CALL-TYPE>
                        <EXECUTION-CONTEXT>UNSPECIFIED</EXECUTION-CONTEXT>
                        <SW-SERVICE-IMPL-POLICY>STANDARD</SW-SERVICE-IMPL-POLICY>
                        <ARGUMENTS>
                          <SW-SERVICE-ARG>
                            <SHORT-NAME>CtrlIdx</SHORT-NAME>
                            <SW-DATA-DEF-PROPS>
                              <SW-DATA-DEF-PROPS-VARIANTS>
                                <SW-DATA-DEF-PROPS-CONDITIONAL>
                                <IMPLEMENTATION-DATA-TYPE-REF DEST = "IMPLEMENTATION-DATA-TYPE">/AUTOSAR_Platform/ImplementationDataTypes/uint8</IMPLEMENTATION-DATA-TYPE-REF>
                                </SW-DATA-DEF-PROPS-CONDITIONAL>
                              </SW-DATA-DEF-PROPS-VARIANTS>
                            </SW-DATA-DEF-PROPS>
                          </SW-SERVICE-ARG>
                        </ARGUMENTS>
                    </BSW-MODULE-ENTRY>
[!IF "$Eth_RxIrqHdlrApi = 'true'"!]
                    <BSW-MODULE-ENTRY>
                        <SHORT-NAME>Eth_RxIrqHdlr</SHORT-NAME>
                        <SERVICE-ID>16</SERVICE-ID>
                        <IS-REENTRANT>false</IS-REENTRANT>
                        <IS-SYNCHRONOUS>true</IS-SYNCHRONOUS>
                        <CALL-TYPE>INTERRUPT</CALL-TYPE>
                        <EXECUTION-CONTEXT>INTERRUPT-CAT-1</EXECUTION-CONTEXT>
                        <SW-SERVICE-IMPL-POLICY>STANDARD</SW-SERVICE-IMPL-POLICY>
                    </BSW-MODULE-ENTRY>
[!ENDIF!][!//
[!IF "$Eth_TxIrqHdlrApi = 'true'"!]
                    <BSW-MODULE-ENTRY>
                        <SHORT-NAME>Eth_TxIrqHdlr</SHORT-NAME>
                        <SERVICE-ID>17</SERVICE-ID>
                        <IS-REENTRANT>false</IS-REENTRANT>
                        <IS-SYNCHRONOUS>true</IS-SYNCHRONOUS>
                        <CALL-TYPE>INTERRUPT</CALL-TYPE>
                        <EXECUTION-CONTEXT>INTERRUPT-CAT-1</EXECUTION-CONTEXT>
                        <SW-SERVICE-IMPL-POLICY>STANDARD</SW-SERVICE-IMPL-POLICY>
                    </BSW-MODULE-ENTRY>
[!ENDIF!][!//
                    <BSW-MODULE-ENTRY>
                        <SHORT-NAME>Eth_TxRxIrqHandler</SHORT-NAME>
                        <SERVICE-ID>0</SERVICE-ID>
                        <IS-REENTRANT>false</IS-REENTRANT>
                        <IS-SYNCHRONOUS>true</IS-SYNCHRONOUS>
                        <CALL-TYPE>INTERRUPT</CALL-TYPE>
                        <EXECUTION-CONTEXT>INTERRUPT-CAT-1</EXECUTION-CONTEXT>
                        <SW-SERVICE-IMPL-POLICY>STANDARD</SW-SERVICE-IMPL-POLICY>
                    </BSW-MODULE-ENTRY>
[!IF "$Eth_GetVerApi = 'true'"!]
                    <BSW-MODULE-ENTRY>
                        <SHORT-NAME>Eth_GetVersionInfo</SHORT-NAME>
                        <SERVICE-ID>13</SERVICE-ID>
                        <IS-REENTRANT>false</IS-REENTRANT>
                        <IS-SYNCHRONOUS>true</IS-SYNCHRONOUS>
                        <CALL-TYPE>REGULAR</CALL-TYPE>
                        <EXECUTION-CONTEXT>UNSPECIFIED</EXECUTION-CONTEXT>
                        <SW-SERVICE-IMPL-POLICY>MACRO</SW-SERVICE-IMPL-POLICY>
                        <ARGUMENTS>
                          <SW-SERVICE-ARG>
                            <SHORT-NAME>VersioninfoPtr</SHORT-NAME>
                            <CATEGORY>DATA_REFERENCE</CATEGORY>
                            <SW-DATA-DEF-PROPS>
                              <SW-DATA-DEF-PROPS-VARIANTS>
                                <SW-DATA-DEF-PROPS-CONDITIONAL>
                                <SW-POINTER-TARGET-PROPS>
                                <TARGET-CATEGORY>TYPE_REFERENCE</TARGET-CATEGORY>
                                <SW-DATA-DEF-PROPS>
                                <SW-DATA-DEF-PROPS-VARIANTS>
                                <SW-DATA-DEF-PROPS-CONDITIONAL>
                                <IMPLEMENTATION-DATA-TYPE-REF DEST = "IMPLEMENTATION-DATA-TYPE">/AUTOSAR_Std/ImplementationDataTypes/Std_VersionInfoType</IMPLEMENTATION-DATA-TYPE-REF>
                                </SW-DATA-DEF-PROPS-CONDITIONAL>
                                </SW-DATA-DEF-PROPS-VARIANTS>
                                </SW-DATA-DEF-PROPS>
                                </SW-POINTER-TARGET-PROPS>
                                </SW-DATA-DEF-PROPS-CONDITIONAL>
                              </SW-DATA-DEF-PROPS-VARIANTS>
                            </SW-DATA-DEF-PROPS>
                          </SW-SERVICE-ARG>
                        </ARGUMENTS>
                    </BSW-MODULE-ENTRY>
[!ENDIF!][!//
                    <BSW-MODULE-ENTRY>
                        <SHORT-NAME>Eth_SetPhysAddr</SHORT-NAME>
                        <SERVICE-ID>19</SERVICE-ID>
                        <IS-REENTRANT>false</IS-REENTRANT>
                        <IS-SYNCHRONOUS>true</IS-SYNCHRONOUS>
                        <CALL-TYPE>REGULAR</CALL-TYPE>
                        <EXECUTION-CONTEXT>UNSPECIFIED</EXECUTION-CONTEXT>
                        <SW-SERVICE-IMPL-POLICY>STANDARD</SW-SERVICE-IMPL-POLICY>
                        <ARGUMENTS>
                          <SW-SERVICE-ARG>
                            <SHORT-NAME>CtrlIdx</SHORT-NAME>
                            <SW-DATA-DEF-PROPS>
                              <SW-DATA-DEF-PROPS-VARIANTS>
                                <SW-DATA-DEF-PROPS-CONDITIONAL>
                                <IMPLEMENTATION-DATA-TYPE-REF DEST = "IMPLEMENTATION-DATA-TYPE">/AUTOSAR_Platform/ImplementationDataTypes/uint8</IMPLEMENTATION-DATA-TYPE-REF>
                                </SW-DATA-DEF-PROPS-CONDITIONAL>
                              </SW-DATA-DEF-PROPS-VARIANTS>
                            </SW-DATA-DEF-PROPS>
                          </SW-SERVICE-ARG>
                          <SW-SERVICE-ARG>
                            <SHORT-NAME>PhysAddrPtr</SHORT-NAME>
                            <CATEGORY>DATA_REFERENCE</CATEGORY>
                            <SW-DATA-DEF-PROPS>
                              <SW-DATA-DEF-PROPS-VARIANTS>
                                <SW-DATA-DEF-PROPS-CONDITIONAL>
                                <SW-POINTER-TARGET-PROPS>
                                <TARGET-CATEGORY>TYPE_REFERENCE</TARGET-CATEGORY>
                                <SW-DATA-DEF-PROPS>
                                <SW-DATA-DEF-PROPS-VARIANTS>
                                <SW-DATA-DEF-PROPS-CONDITIONAL>
                                <IMPLEMENTATION-DATA-TYPE-REF DEST = "IMPLEMENTATION-DATA-TYPE">/AUTOSAR_Platform/ImplementationDataTypes/uint8</IMPLEMENTATION-DATA-TYPE-REF>
                                </SW-DATA-DEF-PROPS-CONDITIONAL>
                                </SW-DATA-DEF-PROPS-VARIANTS>
                                </SW-DATA-DEF-PROPS>
                                </SW-POINTER-TARGET-PROPS>
                                </SW-DATA-DEF-PROPS-CONDITIONAL>
                              </SW-DATA-DEF-PROPS-VARIANTS>
                            </SW-DATA-DEF-PROPS>
                          </SW-SERVICE-ARG>
                        </ARGUMENTS>
                    </BSW-MODULE-ENTRY>
                </ELEMENTS>
            </AR-PACKAGE>
            <AR-PACKAGE>
                <SHORT-NAME>Implementations</SHORT-NAME>
                <ELEMENTS>
                    <BSW-IMPLEMENTATION>
                        <SHORT-NAME>Eth</SHORT-NAME>
                        <CODE-DESCRIPTORS>
                            <CODE>
                                <SHORT-NAME>Files</SHORT-NAME>
                                <ARTIFACT-DESCRIPTORS>
                                    <AUTOSAR-ENGINEERING-OBJECT>
                                        <SHORT-LABEL>ssc::src::Eth_17_EthMac.c</SHORT-LABEL>
                                        <CATEGORY>SWSRC</CATEGORY>
                                    </AUTOSAR-ENGINEERING-OBJECT>
                                    <AUTOSAR-ENGINEERING-OBJECT>
                                        <SHORT-LABEL>ssc::inc::Eth_17_EthMac.h</SHORT-LABEL>
                                        <CATEGORY>SWHDR</CATEGORY>
                                    </AUTOSAR-ENGINEERING-OBJECT>
                                    <AUTOSAR-ENGINEERING-OBJECT>
                                        <SHORT-LABEL>ssc::inc::Eth_17_EthMac_Dbg.h</SHORT-LABEL>
                                        <CATEGORY>SWHDR</CATEGORY>
                                    </AUTOSAR-ENGINEERING-OBJECT>
                                    <AUTOSAR-ENGINEERING-OBJECT>
                                        <SHORT-LABEL>ssc::inc::Eth_17_EthMac_Types.h</SHORT-LABEL>
                                        <CATEGORY>SWHDR</CATEGORY>
                                    </AUTOSAR-ENGINEERING-OBJECT>
                                    <AUTOSAR-ENGINEERING-OBJECT>
                                        <SHORT-LABEL>ssc::mak::infineon_eth_17_ethmac_cfg.mak</SHORT-LABEL>
                                        <CATEGORY>SWMAKE</CATEGORY>
                                    </AUTOSAR-ENGINEERING-OBJECT>
                                    <AUTOSAR-ENGINEERING-OBJECT>
                                        <SHORT-LABEL>ssc::mak::infineon_eth_17_ethmac_check.mak</SHORT-LABEL>
                                        <CATEGORY>SWMAKE</CATEGORY>
                                    </AUTOSAR-ENGINEERING-OBJECT>
                                    <AUTOSAR-ENGINEERING-OBJECT>
                                        <SHORT-LABEL>ssc::mak::infineon_eth_17_ethmac_defs.mak</SHORT-LABEL>
                                        <CATEGORY>SWMAKE</CATEGORY>
                                    </AUTOSAR-ENGINEERING-OBJECT>
                                    <AUTOSAR-ENGINEERING-OBJECT>
                                        <SHORT-LABEL>ssc::mak::infineon_eth_17_ethmac_rules.mak</SHORT-LABEL>
                                        <CATEGORY>SWMAKE</CATEGORY>
                                    </AUTOSAR-ENGINEERING-OBJECT>
                                </ARTIFACT-DESCRIPTORS>
                            </CODE>
                        </CODE-DESCRIPTORS>
                        <COMPILERS>
                            <COMPILER>
                                <SHORT-NAME>TASKING_COMPILE</SHORT-NAME>
                                <NAME>TASKING</NAME>
                                <OPTIONS>&quot;-c --core=tc1.6.x -t -Wa-gAHLs --emit-locals=-equ,-symbols -Wa-Ogs -Wa--error-limit=42 --iso=90 --eabi-compliant --integer-enumeration --language=-comments,-gcc,+volatile,-strings --switch=auto --align=0 --default-near-size=0 --default-a0-size=0 --default-a1-size=0 -O2ROPYG --tradeoff=4 -g --source -D_TASKING_C_TRICORE_=1 $(CALLFUNCTION)&quot;</OPTIONS>
                                <VENDOR>Tasking</VENDOR>
                                <VERSION>Tasking</VERSION>
                            </COMPILER>
                            <COMPILER>
                                <SHORT-NAME>DIAB_COMPILE</SHORT-NAME>
                                <NAME>DIAB</NAME>
                                <OPTIONS>&quot;-c -tTC27xAstep16PMG:cross -Xdialect-c89 -Xno-common -Xalign-functions=4 -Xfp-fast -Xsection-split=1 -Xkeep-assembly-file=2 -g3 -ew4084 -ei4177,4550,4549,4068,5388 -XO -D_DIABDATA_C_TRICORE_=1 $(CALLFUNCTION)&quot;</OPTIONS>
                                <VENDOR>WindRiver</VENDOR>
                                <VERSION>WindRiver</VERSION>
                            </COMPILER>
                            <COMPILER>
                                <SHORT-NAME>GNU_COMPILE</SHORT-NAME>
                                <NAME>GNU</NAME>
                                <OPTIONS>&quot;-c -save-temps=obj -std=iso9899:1990 -ansi -fno-asm -ffreestanding -Wundef -Wp,-std=iso9899:1990 -fno-short-enums -fpeel-loops -falign-functions=4 -frecord-gcc-switches -fsection-anchors -funsigned-bitfields -ffunction-sections -fno-ivopts -fno-peephole2 -nostartfiles -O3 -g3 -W -Wall -Wuninitialized -DTRIBOARD_TC27XX -mcpu=tc27xx -D_GNU_C_TRICORE_=1 $(CALLFUNCTION)&quot;</OPTIONS>
                                <VENDOR>Hightec</VENDOR>
                                <VERSION>Hightec</VERSION>
                            </COMPILER>
                        </COMPILERS>
                        <GENERATED-ARTIFACTS>
                            <DEPENDENCY-ON-ARTIFACT>
                                <SHORT-NAME>Eth_PBCfg_c</SHORT-NAME>
                                <ARTIFACT-DESCRIPTOR>
                                    <SHORT-LABEL>generate::src::Eth_17_EthMac_PBCfg.c</SHORT-LABEL>
                                    <CATEGORY>SWSRC</CATEGORY>
                                </ARTIFACT-DESCRIPTOR>
                                <USAGES>
                                    <USAGE>CODEGENERATION</USAGE>
                                </USAGES>
                            </DEPENDENCY-ON-ARTIFACT>
                            <DEPENDENCY-ON-ARTIFACT>
                                <SHORT-NAME>Eth_Cfg_h</SHORT-NAME>
                                <ARTIFACT-DESCRIPTOR>
                                    <SHORT-LABEL>generate::inc::Eth_17_EthMac_Cfg.h</SHORT-LABEL>
                                    <CATEGORY>SWHDR</CATEGORY>
                                </ARTIFACT-DESCRIPTOR>
                                <USAGES>
                                    <USAGE>CODEGENERATION</USAGE>
                                </USAGES>
                            </DEPENDENCY-ON-ARTIFACT>
                            <DEPENDENCY-ON-ARTIFACT>
                                <SHORT-NAME>Eth_xdm</SHORT-NAME>
                                <ARTIFACT-DESCRIPTOR>
                                    <SHORT-LABEL>config::Eth_17_EthMac.xdm</SHORT-LABEL>
                                    <CATEGORY>SWTOOL</CATEGORY>
                                </ARTIFACT-DESCRIPTOR>
                                <USAGES>
                                    <USAGE>CODEGENERATION</USAGE>
                                </USAGES>
                            </DEPENDENCY-ON-ARTIFACT>
                            <DEPENDENCY-ON-ARTIFACT>
                                <SHORT-NAME>Eth_bmd</SHORT-NAME>
                                <ARTIFACT-DESCRIPTOR>
                                    <SHORT-LABEL>autosar::Eth_17_EthMac.bmd</SHORT-LABEL>
                                    <CATEGORY>SWTOOL</CATEGORY>
                                </ARTIFACT-DESCRIPTOR>
                                <USAGES>
                                    <USAGE>CODEGENERATION</USAGE>
                                </USAGES>
                            </DEPENDENCY-ON-ARTIFACT>
                        </GENERATED-ARTIFACTS>
                        <LINKERS>
                            <LINKER>
                                <SHORT-NAME>TASKING_LINK</SHORT-NAME>
                                <NAME>TASKING</NAME>
                                <OPTIONS>&quot;-t -d_mcal_pjt.lsl -D__CPU__=tc27x -Cmpe:vtc -Otxycl --error-limit=42 -M -mcrfiklsmnoduq -lc -lfp -lrt&quot;</OPTIONS>
                                <VENDOR>Tasking</VENDOR>
                                <VERSION>Tasking</VERSION>
                            </LINKER>
                            <LINKER>
                                <SHORT-NAME>DIAB_LINK</SHORT-NAME>
                                <NAME>DIAB</NAME>
                                <OPTIONS>&quot;-m6 &quot;_mcal_pjt.dld&quot; -lc&quot;</OPTIONS>
                                <VENDOR>WindRiver</VENDOR>
                                <VERSION>WindRiver</VERSION>
                            </LINKER>
                            <LINKER>
                                <SHORT-NAME>GNU_LINK</SHORT-NAME>
                                <NAME>GNU</NAME>
                                <OPTIONS>&quot;-T&quot;_mcal_pjt.ld&quot; -nostartfiles -Wl,--allow-multiple-definition -Wl,--cref -Wl,--oformat=elf32-tricore -Wl,--mcpu=tc161 -Wl,--mem-holes -Wl,--extmap=&quot;a&quot;&quot;</OPTIONS>
                                <VENDOR>Hightec</VENDOR>
                                <VERSION>Hightec</VERSION>
                            </LINKER>
                        </LINKERS>
                        <PROGRAMMING-LANGUAGE>C</PROGRAMMING-LANGUAGE>
                        <RESOURCE-CONSUMPTION>
                            <SHORT-NAME>ResourceConsumption</SHORT-NAME>
                            <MEMORY-SECTIONS>
                                <MEMORY-SECTION>
                                    <SHORT-NAME>ETH_17_ETHMAC_CODE</SHORT-NAME>
                                    <ALIGNMENT>UNSPECIFIED</ALIGNMENT>
                                    <SIZE>3180</SIZE>
                                    <SW-ADDRMETHOD-REF DEST="SW-ADDR-METHOD">/AUTOSAR_MemMap/SwAddrMethods/CODE</SW-ADDRMETHOD-REF>
                                </MEMORY-SECTION>
                                <MEMORY-SECTION>
                                    <SHORT-NAME>ETH_17_ETHMAC_VAR_8BIT</SHORT-NAME>
                                    <ALIGNMENT>8</ALIGNMENT>
                                    <SIZE>6</SIZE>
                                    <SW-ADDRMETHOD-REF DEST="SW-ADDR-METHOD">/AUTOSAR_MemMap/SwAddrMethods/VAR</SW-ADDRMETHOD-REF>
                                </MEMORY-SECTION>
                                <MEMORY-SECTION>
                                    <SHORT-NAME>ETH_17_ETHMAC_VAR_16BIT</SHORT-NAME>
                                    <ALIGNMENT>16</ALIGNMENT>
                                    <SIZE>10</SIZE>
                                    <SW-ADDRMETHOD-REF DEST="SW-ADDR-METHOD">/AUTOSAR_MemMap/SwAddrMethods/VAR</SW-ADDRMETHOD-REF>
                                </MEMORY-SECTION>
                                <MEMORY-SECTION>
                                    <SHORT-NAME>ETH_17_ETHMAC_VAR_32BIT</SHORT-NAME>
                                    <ALIGNMENT>32</ALIGNMENT>
                                    <SIZE>12472</SIZE>
                                    <SW-ADDRMETHOD-REF DEST="SW-ADDR-METHOD">/AUTOSAR_MemMap/SwAddrMethods/VAR</SW-ADDRMETHOD-REF>
                                </MEMORY-SECTION>
                                <MEMORY-SECTION>
                                    <SHORT-NAME>ETH_17_ETHMAC_CONST_32BIT</SHORT-NAME>
                                    <ALIGNMENT>32</ALIGNMENT>
                                    <SIZE>4</SIZE>
                                    <SW-ADDRMETHOD-REF DEST="SW-ADDR-METHOD">/AUTOSAR_MemMap/SwAddrMethods/CONST</SW-ADDRMETHOD-REF>
                                </MEMORY-SECTION>
                                <MEMORY-SECTION>
                                    <SHORT-NAME>ETH_17_ETHMAC_POSTBUILDCFG</SHORT-NAME>
                                    <ALIGNMENT>UNSPECIFIED</ALIGNMENT>
                                    <SIZE>16</SIZE>
                                    <SW-ADDRMETHOD-REF DEST="SW-ADDR-METHOD">/AUTOSAR_MemMap/SwAddrMethods/CONFIG_DATA</SW-ADDRMETHOD-REF>
                                </MEMORY-SECTION>
                            </MEMORY-SECTIONS>
                            <SECTION-NAME-PREFIXS>
                                <SECTION-NAME-PREFIX>
                                    <SHORT-NAME>ETH_17_ETHMAC</SHORT-NAME>
                                    <SYMBOL>ETH_17_ETHMAC</SYMBOL>
                                </SECTION-NAME-PREFIX>
                            </SECTION-NAME-PREFIXS>
                        </RESOURCE-CONSUMPTION>
                        <SW-VERSION>0.0.0</SW-VERSION>
                        <VENDOR-ID>17</VENDOR-ID>
                        <AR-RELEASE-VERSION>4.0.3</AR-RELEASE-VERSION>
                        <BEHAVIOR-REF DEST="BSW-INTERNAL-BEHAVIOR">/AUTOSAR_Eth/BswModuleDescriptions/Eth/EthBehavior</BEHAVIOR-REF>
                        <VENDOR-API-INFIX>EthMac</VENDOR-API-INFIX>
                        <VENDOR-SPECIFIC-MODULE-DEF-REFS>
                                <VENDOR-SPECIFIC-MODULE-DEF-REF DEST="ECUC-MODULE-DEF">/AURIX/Eth</VENDOR-SPECIFIC-MODULE-DEF-REF>
                        </VENDOR-SPECIFIC-MODULE-DEF-REFS>
                    </BSW-IMPLEMENTATION>
                </ELEMENTS>
            </AR-PACKAGE>
            <AR-PACKAGE>
                <SHORT-NAME>ImplementationDataTypes</SHORT-NAME>
                <CATEGORY>STANDARD</CATEGORY>
                <ELEMENTS>
                    <IMPLEMENTATION-DATA-TYPE>
                     <SHORT-NAME>Eth_FrameType</SHORT-NAME>
                     <CATEGORY>TYPE_REFERENCE</CATEGORY>
                     <SW-DATA-DEF-PROPS>
                       <SW-DATA-DEF-PROPS-VARIANTS>
                         <SW-DATA-DEF-PROPS-CONDITIONAL>
                           <IMPLEMENTATION-DATA-TYPE-REF DEST="IMPLEMENTATION-DATA-TYPE">/AUTOSAR_Platform/ImplementationDataTypes/uint16</IMPLEMENTATION-DATA-TYPE-REF>
                         </SW-DATA-DEF-PROPS-CONDITIONAL>
                       </SW-DATA-DEF-PROPS-VARIANTS>
                     </SW-DATA-DEF-PROPS>
                     <TYPE-EMITTER>BSW</TYPE-EMITTER>
                    </IMPLEMENTATION-DATA-TYPE>
                    <IMPLEMENTATION-DATA-TYPE>
                     <SHORT-NAME>Eth_DataType</SHORT-NAME>
                     <CATEGORY>TYPE_REFERENCE</CATEGORY>
                     <SW-DATA-DEF-PROPS>
                       <SW-DATA-DEF-PROPS-VARIANTS>
                         <SW-DATA-DEF-PROPS-CONDITIONAL>
                           <IMPLEMENTATION-DATA-TYPE-REF DEST="IMPLEMENTATION-DATA-TYPE">/AUTOSAR_Platform/ImplementationDataTypes/uint8</IMPLEMENTATION-DATA-TYPE-REF>
                         </SW-DATA-DEF-PROPS-CONDITIONAL>
                       </SW-DATA-DEF-PROPS-VARIANTS>
                     </SW-DATA-DEF-PROPS>
                     <TYPE-EMITTER>BSW</TYPE-EMITTER>
                    </IMPLEMENTATION-DATA-TYPE>
                    <IMPLEMENTATION-DATA-TYPE>
                     <SHORT-NAME>Eth_ModeType</SHORT-NAME>
                     <CATEGORY>TYPE_REFERENCE</CATEGORY>
                     <SW-DATA-DEF-PROPS>
                       <SW-DATA-DEF-PROPS-VARIANTS>
                         <SW-DATA-DEF-PROPS-CONDITIONAL>
                           <COMPU-METHOD-REF DEST="COMPU-METHOD">/AUTOSAR_Eth/CompuMethods/Eth_ModeType</COMPU-METHOD-REF>
                           <IMPLEMENTATION-DATA-TYPE-REF DEST="IMPLEMENTATION-DATA-TYPE">/AUTOSAR_Platform/ImplementationDataTypes/uint32</IMPLEMENTATION-DATA-TYPE-REF>
                         </SW-DATA-DEF-PROPS-CONDITIONAL>
                       </SW-DATA-DEF-PROPS-VARIANTS>
                     </SW-DATA-DEF-PROPS>
                     <TYPE-EMITTER>BSW</TYPE-EMITTER>
                    </IMPLEMENTATION-DATA-TYPE>
                    <IMPLEMENTATION-DATA-TYPE>
                     <SHORT-NAME>Eth_StateType</SHORT-NAME>
                     <CATEGORY>TYPE_REFERENCE</CATEGORY>
                     <SW-DATA-DEF-PROPS>
                       <SW-DATA-DEF-PROPS-VARIANTS>
                         <SW-DATA-DEF-PROPS-CONDITIONAL>
                           <COMPU-METHOD-REF DEST="COMPU-METHOD">/AUTOSAR_Eth/CompuMethods/Eth_StateType</COMPU-METHOD-REF>
                           <IMPLEMENTATION-DATA-TYPE-REF DEST="IMPLEMENTATION-DATA-TYPE">/AUTOSAR_Platform/ImplementationDataTypes/uint32</IMPLEMENTATION-DATA-TYPE-REF>
                         </SW-DATA-DEF-PROPS-CONDITIONAL>
                       </SW-DATA-DEF-PROPS-VARIANTS>
                     </SW-DATA-DEF-PROPS>
                     <TYPE-EMITTER>BSW</TYPE-EMITTER>
                    </IMPLEMENTATION-DATA-TYPE>
                    <IMPLEMENTATION-DATA-TYPE>
                     <SHORT-NAME>Eth_17_EthMac_StateType</SHORT-NAME>
                     <CATEGORY>TYPE_REFERENCE</CATEGORY>
                     <SW-DATA-DEF-PROPS>
                       <SW-DATA-DEF-PROPS-VARIANTS>
                         <SW-DATA-DEF-PROPS-CONDITIONAL>
                           <COMPU-METHOD-REF DEST="COMPU-METHOD">/AUTOSAR_Eth/CompuMethods/Eth_17_EthMac_StateType</COMPU-METHOD-REF>
                           <IMPLEMENTATION-DATA-TYPE-REF DEST="IMPLEMENTATION-DATA-TYPE">/AUTOSAR_Platform/ImplementationDataTypes/uint32</IMPLEMENTATION-DATA-TYPE-REF>
                         </SW-DATA-DEF-PROPS-CONDITIONAL>
                       </SW-DATA-DEF-PROPS-VARIANTS>
                     </SW-DATA-DEF-PROPS>
                     <TYPE-EMITTER>BSW</TYPE-EMITTER>
                    </IMPLEMENTATION-DATA-TYPE>
                    <IMPLEMENTATION-DATA-TYPE>
                     <SHORT-NAME>Eth_ConfigType</SHORT-NAME>
                     <CATEGORY>STRUCTURE</CATEGORY>
                     <SUB-ELEMENTS>
                       <IMPLEMENTATION-DATA-TYPE-ELEMENT>
                         <SHORT-NAME>Eth_CtrlConfigType*</SHORT-NAME>
                       </IMPLEMENTATION-DATA-TYPE-ELEMENT>
                     </SUB-ELEMENTS>
                     <TYPE-EMITTER>BSW</TYPE-EMITTER>
                    </IMPLEMENTATION-DATA-TYPE>
                    <IMPLEMENTATION-DATA-TYPE>
                     <SHORT-NAME>Eth_DmaDescType</SHORT-NAME>
                     <CATEGORY>STRUCTURE</CATEGORY>
                     <SUB-ELEMENTS>
                       <IMPLEMENTATION-DATA-TYPE-ELEMENT>
                         <SHORT-NAME>uint32</SHORT-NAME>
                       </IMPLEMENTATION-DATA-TYPE-ELEMENT>
                     </SUB-ELEMENTS>
                     <TYPE-EMITTER>BSW</TYPE-EMITTER>
                    </IMPLEMENTATION-DATA-TYPE>
                    <IMPLEMENTATION-DATA-TYPE>
                     <SHORT-NAME>Eth_CtrlConfigType</SHORT-NAME>
                     <CATEGORY>STRUCTURE</CATEGORY>
                     <SUB-ELEMENTS>
                       <IMPLEMENTATION-DATA-TYPE-ELEMENT>
                         <SHORT-NAME>uint16</SHORT-NAME>
                       </IMPLEMENTATION-DATA-TYPE-ELEMENT>
                     </SUB-ELEMENTS>
                     <TYPE-EMITTER>BSW</TYPE-EMITTER>
                    </IMPLEMENTATION-DATA-TYPE>
                    <IMPLEMENTATION-DATA-TYPE>
                     <SHORT-NAME>Eth_TxBuffTableType</SHORT-NAME>
                     <CATEGORY>STRUCTURE</CATEGORY>
                     <SUB-ELEMENTS>
                       <IMPLEMENTATION-DATA-TYPE-ELEMENT>
                         <SHORT-NAME>uint8</SHORT-NAME>
                       </IMPLEMENTATION-DATA-TYPE-ELEMENT>
                     </SUB-ELEMENTS>
                     <TYPE-EMITTER>BSW</TYPE-EMITTER>
                    </IMPLEMENTATION-DATA-TYPE>
                </ELEMENTS>
            </AR-PACKAGE>
            <AR-PACKAGE>
                <SHORT-NAME>CompuMethods</SHORT-NAME>
                <CATEGORY>STANDARD</CATEGORY>
                <ELEMENTS>
                    <COMPU-METHOD>
                      <SHORT-NAME>Eth_ModeType</SHORT-NAME>
                      <CATEGORY>TEXTTABLE</CATEGORY>
                      <COMPU-INTERNAL-TO-PHYS>
                        <COMPU-SCALES>
                          <COMPU-SCALE>
                            <LOWER-LIMIT INTERVAL-TYPE="CLOSED">0</LOWER-LIMIT>
                            <UPPER-LIMIT INTERVAL-TYPE="CLOSED">0</UPPER-LIMIT>
                            <COMPU-CONST><VT>ETH_MODE_DOWN</VT></COMPU-CONST>
                          </COMPU-SCALE>
                          <COMPU-SCALE>
                            <LOWER-LIMIT INTERVAL-TYPE="CLOSED">0</LOWER-LIMIT>
                            <UPPER-LIMIT INTERVAL-TYPE="CLOSED">0</UPPER-LIMIT>
                            <COMPU-CONST><VT>ETH_MODE_ACTIVE</VT></COMPU-CONST>
                          </COMPU-SCALE>
                        </COMPU-SCALES>
                      </COMPU-INTERNAL-TO-PHYS>
                    </COMPU-METHOD>
                    <COMPU-METHOD>
                      <SHORT-NAME>Eth_StateType</SHORT-NAME>
                      <CATEGORY>TEXTTABLE</CATEGORY>
                      <COMPU-INTERNAL-TO-PHYS>
                        <COMPU-SCALES>
                          <COMPU-SCALE>
                            <LOWER-LIMIT INTERVAL-TYPE="CLOSED">0</LOWER-LIMIT>
                            <UPPER-LIMIT INTERVAL-TYPE="CLOSED">0</UPPER-LIMIT>
                            <COMPU-CONST><VT>ETH_STATE_UNINIT</VT></COMPU-CONST>
                          </COMPU-SCALE>
                          <COMPU-SCALE>
                            <LOWER-LIMIT INTERVAL-TYPE="CLOSED">0</LOWER-LIMIT>
                            <UPPER-LIMIT INTERVAL-TYPE="CLOSED">0</UPPER-LIMIT>
                            <COMPU-CONST><VT>ETH_STATE_INIT</VT></COMPU-CONST>
                          </COMPU-SCALE>
                          <COMPU-SCALE>
                            <LOWER-LIMIT INTERVAL-TYPE="CLOSED">0</LOWER-LIMIT>
                            <UPPER-LIMIT INTERVAL-TYPE="CLOSED">0</UPPER-LIMIT>
                            <COMPU-CONST><VT>ETH_STATE_ACTIVE</VT></COMPU-CONST>
                          </COMPU-SCALE>
                        </COMPU-SCALES>
                      </COMPU-INTERNAL-TO-PHYS>
                    </COMPU-METHOD>
                    <COMPU-METHOD>
                      <SHORT-NAME>Eth_17_EthMac_StateType</SHORT-NAME>
                      <CATEGORY>TEXTTABLE</CATEGORY>
                      <COMPU-INTERNAL-TO-PHYS>
                        <COMPU-SCALES>
                          <COMPU-SCALE>
                            <LOWER-LIMIT INTERVAL-TYPE="CLOSED">0</LOWER-LIMIT>
                            <UPPER-LIMIT INTERVAL-TYPE="CLOSED">0</UPPER-LIMIT>
                            <COMPU-CONST><VT>ETH_STATE_UNINIT</VT></COMPU-CONST>
                          </COMPU-SCALE>
                          <COMPU-SCALE>
                            <LOWER-LIMIT INTERVAL-TYPE="CLOSED">0</LOWER-LIMIT>
                            <UPPER-LIMIT INTERVAL-TYPE="CLOSED">0</UPPER-LIMIT>
                            <COMPU-CONST><VT>ETH_STATE_INIT</VT></COMPU-CONST>
                          </COMPU-SCALE>
                          <COMPU-SCALE>
                            <LOWER-LIMIT INTERVAL-TYPE="CLOSED">0</LOWER-LIMIT>
                            <UPPER-LIMIT INTERVAL-TYPE="CLOSED">0</UPPER-LIMIT>
                            <COMPU-CONST><VT>ETH_STATE_ACTIVE</VT></COMPU-CONST>
                          </COMPU-SCALE>
                        </COMPU-SCALES>
                      </COMPU-INTERNAL-TO-PHYS>
                    </COMPU-METHOD>
                </ELEMENTS>
            </AR-PACKAGE>
        </AR-PACKAGES>
    </AR-PACKAGE>
</AR-PACKAGES>
</AUTOSAR>
