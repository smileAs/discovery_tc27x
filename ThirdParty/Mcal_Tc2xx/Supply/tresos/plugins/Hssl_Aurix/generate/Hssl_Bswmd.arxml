AUTOSAR XML (schema 4-0-3)
# Copyright (C) Infineon Technologies (2015)
# All rights reserved.
package /AURIX_Hssl/BswModuleDescriptions
  bsw module description Hssl: category=BSW_MODULE, module-id=255  # High Speed Serial Link
    provided-entrys:
      Hssl_SetMode
      Hssl_Init
      Hssl_Reset
      Hssl_InitChannel
      Hssl_Write
      Hssl_WriteAck
      Hssl_Read
      Hssl_ReadRply
      Hssl_Id
      Hssl_StartStream
      Hssl_StopStream
      Hssl_MultiWrite
      Hssl_MultiRead
    bsw module dependency DetDependency: target-module-id=15, required-entrys=Det_ReportError
    bsw internal behavior HsslBehavior
      static-memorys:
        data Hssl_DriverState: implementation-data-type=uint8, type=uint8
        data Hssl_InterfaceMode: implementation-data-type=uint8, type=uint8
      13 x bsw called entity:
        Hssl_SetMode: implemented-entry=Hssl_SetMode
        Hssl_Init: implemented-entry=Hssl_Init
        Hssl_Reset: implemented-entry=Hssl_Reset
        Hssl_InitChannel: implemented-entry=Hssl_InitChannel
        Hssl_Write: implemented-entry=Hssl_Write
        Hssl_WriteAck: implemented-entry=Hssl_WriteAck
        Hssl_Read: implemented-entry=Hssl_Read
        Hssl_ReadRply: implemented-entry=Hssl_ReadRply
        Hssl_Id: implemented-entry=Hssl_Id
        Hssl_StartStream: implemented-entry=Hssl_StartStream
        Hssl_StopStream: implemented-entry=Hssl_StopStream
        Hssl_MultiWrite: implemented-entry=Hssl_MultiWrite
        Hssl_MultiRead: implemented-entry=Hssl_MultiRead
package /AURIX_Hssl/BswModuleEntrys
  13 x bsw module entry, all with is-synchronous=true, call-type=REGULAR, execution-context=TASK, sw-service-impl-policy=STANDARD:
    Hssl_SetMode: service-id=1, is-reentrant=false
      return type Return: implementation-data-type=uint8
      sw service arg Mode: implementation-data-type=uint8
    Hssl_Init: service-id=2, is-reentrant=false
      return type Return: implementation-data-type=uint8
      sw service arg ClockPrescale: implementation-data-type=uint16
    Hssl_Reset: service-id=3, is-reentrant=true
      return type Return: implementation-data-type=uint8
    Hssl_InitChannel: service-id=4, is-reentrant=true
      return type Return: implementation-data-type=uint8
      7 x sw service arg:
        Channel: implementation-data-type=Hssl_ChannelType
        WriteAck: implementation-data-type=uint8
        ReadAns: implementation-data-type=uint8
        Trigger: implementation-data-type=uint8
        TimeoutErr: implementation-data-type=uint8
        TransID: implementation-data-type=uint8
        AckErr: implementation-data-type=uint8
    Hssl_Write: service-id=5, is-reentrant=true
      return type Return: implementation-data-type=uint8
      4 x sw service arg:
        WriteData: category=DATA_REFERENCE, sw-pointer-target-props={target-category=TYPE_REFERENCE, implementation-data-type=Hssl_DataTemplateType}
        DataSize: implementation-data-type=uint16
        Channel: implementation-data-type=Hssl_ChannelType
        InjectedError: implementation-data-type=uint8
    Hssl_WriteAck: service-id=6, is-reentrant=true
      return type Return: implementation-data-type=uint8
      sw service arg Channel: implementation-data-type=Hssl_ChannelType
    Hssl_Read: service-id=7, is-reentrant=true
      return type Return: implementation-data-type=uint8
      4 x sw service arg:
        DataAddress: category=DATA_REFERENCE, sw-pointer-target-props={target-category=TYPE_REFERENCE, implementation-data-type=Hssl_DataTemplateType}
        DataSize: implementation-data-type=uint16
        Channel: implementation-data-type=Hssl_ChannelType
        InjectedError: implementation-data-type=uint8
    Hssl_ReadRply: service-id=8, is-reentrant=true
      return type Return: implementation-data-type=uint8
      sw service arg ReadData: category=DATA_REFERENCE, sw-pointer-target-props={target-category=TYPE_REFERENCE, implementation-data-type=Hssl_DataTemplateType}
      sw service arg Channel: implementation-data-type=Hssl_ChannelType
    Hssl_Id: service-id=9, is-reentrant=false
      return type Return: implementation-data-type=uint32
      sw service arg StoreAddress: category=DATA_REFERENCE, sw-pointer-target-props={target-category=TYPE_REFERENCE, implementation-data-type=uint32}
    Hssl_StartStream: service-id=10, is-reentrant=false
      return type Return: implementation-data-type=uint8
      sw service arg SourceAddressStart: category=DATA_REFERENCE, sw-pointer-target-props={target-category=TYPE_REFERENCE, implementation-data-type=uint32}
      sw service arg DataSize: implementation-data-type=uint16
      sw service arg InjectedError: implementation-data-type=uint8
    Hssl_StopStream: service-id=11, is-reentrant=true
    Hssl_MultiWrite: service-id=12, is-reentrant=true
      return type Return: implementation-data-type=uint8
      5 x sw service arg:
        WriteArray: category=DATA_REFERENCE, sw-pointer-target-props={target-category=TYPE_REFERENCE, implementation-data-type=Hssl_DataTemplateType}
        DataSize: implementation-data-type=uint16
        NumCmd: implementation-data-type=uint16
        Channel: implementation-data-type=Hssl_ChannelType
        InjectedError: implementation-data-type=uint8
    Hssl_MultiRead: service-id=13, is-reentrant=true
      return type Return: implementation-data-type=uint8
      5 x sw service arg:
        ReadArray: category=DATA_REFERENCE, sw-pointer-target-props={target-category=TYPE_REFERENCE, implementation-data-type=Hssl_DataTemplateType}
        DataSize: implementation-data-type=uint16
        NumCmd: implementation-data-type=uint16
        Channel: implementation-data-type=Hssl_ChannelType
        InjectedError: implementation-data-type=uint8
package /AURIX_Hssl/Implementations
  bsw implementation Hssl: programming-language=C, sw-version=0.0.0, vendor-id=17, ar-release-version=4.0.3, behavior=HsslBehavior, vendor-specific-module-def=Hssl
    code-descriptors:
      code Files
        artifact-descriptors:
          short-label=ssc::src::Hssl.c, category=SWSRC
          short-label=ssc::inc::Hssl.h, category=SWHDR
          short-label=mak::hssl_infineon_tricore::ssc::mak::infineon_hssl_cfg.mak, category=SWMAKE
          short-label=mak::hssl_infineon_tricore::ssc::mak::infineon_hssl_check.mak, category=SWMAKE
          short-label=mak::hssl_infineon_tricore::ssc::mak::infineon_hssl_defs.mak, category=SWMAKE
          short-label=mak::hssl_infineon_tricore::ssc::mak::infineon_hssl_rules.mak, category=SWMAKE
    compiler TASKING_COMPILE: name=TASKING, options="-c --core=tc1.6.x -t -Wa-gAHLs --emit-locals=-equ,-symbols -Wa-Ogs -Wa--error-limit=42 --iso=90 --eabi-compliant --integer-enumeration --language=-comments,-gcc,+volatile,-strings --switch=auto --align=0 --default-near-size=0 --default-a0-size=0 --default-a1-size=0 -O2ROPYG --tradeoff=4 -g --source -D_TASKING_C_TRICORE_=1 $(CALLFUNCTION)", vendor=Tasking, version=Tasking
    compiler DIAB_COMPILE: name=DIAB, options="-c -tTC27xAstep16PMG:cross -Xdialect-c89 -Xno-common -Xalign-functions=4 -Xfp-fast -Xsection-split=1 -Xkeep-assembly-file=2 -g3 -ew4084 -ei4177,4550,4549,4068,5388 -XO -D_DIABDATA_C_TRICORE_=1 $(CALLFUNCTION)", vendor=WindRiver, version=WindRiver
    compiler GNU_COMPILE:
      name=GNU
      options="-c -save-temps=obj -std=iso9899:1990 -ansi -fno-asm -ffreestanding -Wundef -Wp,-std=iso9899:1990 -fno-short-enums -fpeel-loops -falign-functions=4 -frecord-gcc-switches -fsection-anchors -funsigned-bitfields -ffunction-sections -fno-ivopts -fno-peephole2 -nostartfiles -O3 -g3 -W -Wall -Wuninitialized -DTRIBOARD_TC27XX -mcpu=tc27xx -D_GNU_C_TRICORE_=1 $(CALLFUNCTION)"
      vendor=Hightec
      version=Hightec
    generated-artifacts:
      dependency on artifact Hssl_Cfg_h: artifact-descriptor={short-label=generate::inc::Hssl_Cfg.h, category=SWHDR}, usages=CODEGENERATION
      dependency on artifact Hssl_xdm: artifact-descriptor={short-label=config::Hssl.xdm, category=SWTOOL}, usages=CODEGENERATION
      dependency on artifact Hssl_bmd: artifact-descriptor={short-label=autosar::Hssl.bmd, category=SWTOOL}, usages=CODEGENERATION
    linker TASKING_LINK: name=TASKING, options="-t -d_mcal_pjt.lsl -D__CPU__=tc27x -Cmpe:vtc -Otxycl --error-limit=42 -M -mcrfiklsmnoduq -lc -lfp -lrt", vendor=Tasking, version=Tasking
    linker DIAB_LINK: name=DIAB, options="-m6 "_mcal_pjt.dld" -lc", vendor=WindRiver, version=WindRiver
    linker GNU_LINK: name=GNU, options="-T"_mcal_pjt.ld" -nostartfiles -Wl,--allow-multiple-definition -Wl,--cref -Wl,--oformat=elf32-tricore -Wl,--mcpu=tc161 -Wl,--mem-holes -Wl,--extmap="a"", vendor=Hightec, version=Hightec
    resource consumption ResourceConsumption
      memory section HSSL_VAR_32BIT: alignment=32, size=4, sw-addrmethod=VAR
      memory section HSSL_VAR_8BIT: alignment=8, size=2, sw-addrmethod=VAR
      memory section HSSL_CODE: alignment=UNSPECIFIED, size=2278, sw-addrmethod=CODE
      section name prefix HSSL
package /AURIX_Hssl/ImplementationDataTypes
  impl type Hssl_DataTemplateType: category=STRUCTURE, type-emitter=BSW
    element uint32
  impl type Hssl_ChannelType: category=STRUCTURE, type-emitter=BSW
    element uint8
