<?xml version="1.0" encoding="UTF-8"?> 
<!--
/******************************************************************************
**                                                                           **
** Copyright (C) Infineon Technologies (2015)                                **
**                                                                           **
** All rights reserved.                                                      **
**                                                                           **
** This document contains proprietary information belonging to Infineon      **
** Technologies. Passing on and copying of this document, and communication  **
** of its contents is not permitted without prior written authorization.     **
**                                                                           **
*******************************************************************************
**                                                                           **
**  $FILENAME   : Dio_Bswmd.arxml $                                          **
**                                                                           **
**  $CC VERSION : \main\27 $                                                 **
**                                                                           **
**  $DATE       : 2015-11-30 $                                               **
**                                                                           **
**  AUTHOR    : DL-AUTOSAR-Engineering                                       **
**                                                                           **
**  VENDOR    : Infineon Technologies                                        **
**                                                                           **
**  DESCRIPTION  : BSWMD for Dio driver                            **
**                                                                           **
**  MAY BE CHANGED BY USER [yes/no]: No                                      **
**                                                                           **
******************************************************************************/
/******************************************************************************
**  Traceability   :                                                         **
** [cover parentID=
SAS_AS4XX_DIO_PR669,SAS_AS4XX_DIO_PR672,SAS_AS4XX_DIO_PR673,SAS_AS4XX_DIO_PR674,
SAS_AS4XX_DIO_PR675,SAS_AS4XX_DIO_PR676,SAS_AS4XX_DIO_PR677,SAS_AS4XX_DIO_PR681,
SAS_AS4XX_DIO_PR683,SAS_AS4XX_DIO_PR684,SAS_AS4XX_DIO_PR685,SAS_AS4XX_DIO_PR686,
SAS_AS4XX_DIO_PR687,SAS_AS4XX_DIO_PR688,SAS_AS4XX_DIO_PR689,SAS_AS4XX_DIO_PR690,
SAS_AS4XX_DIO_PR693,SAS_AS4XX_DIO_PR694,SAS_AS4XX_DIO_PR695,SAS_AS4XX_DIO_PR670
    [/cover] 
                                                                             **
******************************************************************************/
-->
<AUTOSAR xmlns="http://autosar.org/schema/r4.0" xmlns:xsi="http://www.w3.org/2001/XMLSchema-instance" xsi:schemaLocation="http://autosar.org/schema/r4.0 AUTOSAR_4-0-3.xsd"> 
[!NOCODE!][!//
[!SELECT "as:modconf('Dio')[1]"!][!//
[!VAR "Dio_FlipChannelApi"="./DioGeneral/DioFlipChannelApi"!][!//
[!VAR "Dio_VersionInfoApi"="./DioGeneral/DioVersionInfoApi"!][!//
[!VAR "Dio_SafetyEnable"="./DioSafety/DioSafetyEnable"!][!//
[!VAR "Dio_InitCheckApi"="./DioSafety/DioInitCheckApi"!][!//
[!ENDSELECT!][!//
[!ENDNOCODE!][!//
<AR-PACKAGES>
    <AR-PACKAGE>
        <SHORT-NAME>AUTOSAR_Dio</SHORT-NAME>
        <AR-PACKAGES>
            <AR-PACKAGE>
                <SHORT-NAME>BswModuleDescriptions</SHORT-NAME>
                <CATEGORY>STANDARD</CATEGORY>
                <ELEMENTS>
                    <BSW-MODULE-DESCRIPTION>
                        <SHORT-NAME>Dio</SHORT-NAME>
                        <LONG-NAME>
                            <L-4 L="EN">DIO Driver</L-4>
                        </LONG-NAME>
                        <CATEGORY>BSW_MODULE</CATEGORY>
                        <MODULE-ID>120</MODULE-ID>
                        <PROVIDED-ENTRYS>
                            <BSW-MODULE-ENTRY-REF-CONDITIONAL>
                                <BSW-MODULE-ENTRY-REF DEST="BSW-MODULE-ENTRY">/AUTOSAR_Dio/BswModuleEntrys/Dio_ReadChannel</BSW-MODULE-ENTRY-REF>
                            </BSW-MODULE-ENTRY-REF-CONDITIONAL>
                            <BSW-MODULE-ENTRY-REF-CONDITIONAL>
                                <BSW-MODULE-ENTRY-REF DEST="BSW-MODULE-ENTRY">/AUTOSAR_Dio/BswModuleEntrys/Dio_WriteChannel</BSW-MODULE-ENTRY-REF>
                            </BSW-MODULE-ENTRY-REF-CONDITIONAL>
                            <BSW-MODULE-ENTRY-REF-CONDITIONAL>
                                <BSW-MODULE-ENTRY-REF DEST="BSW-MODULE-ENTRY">/AUTOSAR_Dio/BswModuleEntrys/Dio_ReadPort</BSW-MODULE-ENTRY-REF>
                            </BSW-MODULE-ENTRY-REF-CONDITIONAL>
                            <BSW-MODULE-ENTRY-REF-CONDITIONAL>
                                <BSW-MODULE-ENTRY-REF DEST="BSW-MODULE-ENTRY">/AUTOSAR_Dio/BswModuleEntrys/Dio_WritePort</BSW-MODULE-ENTRY-REF>
                            </BSW-MODULE-ENTRY-REF-CONDITIONAL>
                            <BSW-MODULE-ENTRY-REF-CONDITIONAL>
                                <BSW-MODULE-ENTRY-REF DEST="BSW-MODULE-ENTRY">/AUTOSAR_Dio/BswModuleEntrys/Dio_ReadChannelGroup</BSW-MODULE-ENTRY-REF>
                            </BSW-MODULE-ENTRY-REF-CONDITIONAL>
                            <BSW-MODULE-ENTRY-REF-CONDITIONAL>
                                <BSW-MODULE-ENTRY-REF DEST="BSW-MODULE-ENTRY">/AUTOSAR_Dio/BswModuleEntrys/Dio_WriteChannelGroup</BSW-MODULE-ENTRY-REF>
                            </BSW-MODULE-ENTRY-REF-CONDITIONAL>
                            <BSW-MODULE-ENTRY-REF-CONDITIONAL>
                                <BSW-MODULE-ENTRY-REF DEST="BSW-MODULE-ENTRY">/AUTOSAR_Dio/BswModuleEntrys/Dio_Init</BSW-MODULE-ENTRY-REF>
                            </BSW-MODULE-ENTRY-REF-CONDITIONAL>
[!IF "$Dio_FlipChannelApi = 'true'"!][!//
                            <BSW-MODULE-ENTRY-REF-CONDITIONAL>
                                <BSW-MODULE-ENTRY-REF DEST="BSW-MODULE-ENTRY">/AUTOSAR_Dio/BswModuleEntrys/Dio_FlipChannel</BSW-MODULE-ENTRY-REF>
                            </BSW-MODULE-ENTRY-REF-CONDITIONAL>
[!ENDIF!][!//
[!IF "$Dio_VersionInfoApi = 'true'"!][!//
                            <BSW-MODULE-ENTRY-REF-CONDITIONAL>
                                <BSW-MODULE-ENTRY-REF DEST="BSW-MODULE-ENTRY">/AUTOSAR_Dio/BswModuleEntrys/Dio_GetVersionInfo</BSW-MODULE-ENTRY-REF>
                            </BSW-MODULE-ENTRY-REF-CONDITIONAL>
[!ENDIF!][!//
[!IF "$Dio_SafetyEnable = 'true' and $Dio_InitCheckApi = 'true'"!][!//
                            <BSW-MODULE-ENTRY-REF-CONDITIONAL>
                                <BSW-MODULE-ENTRY-REF DEST="BSW-MODULE-ENTRY">/AUTOSAR_Dio/BswModuleEntrys/Dio_InitCheck</BSW-MODULE-ENTRY-REF>
                            </BSW-MODULE-ENTRY-REF-CONDITIONAL>
[!ENDIF!][!//
                        </PROVIDED-ENTRYS>
                        <BSW-MODULE-DEPENDENCYS>
                            <BSW-MODULE-DEPENDENCY>
                                <SHORT-NAME>DetDependency</SHORT-NAME>
                                <TARGET-MODULE-ID>15</TARGET-MODULE-ID>
                                <REQUIRED-ENTRYS>
                                    <BSW-MODULE-ENTRY-REF-CONDITIONAL>
                                        <BSW-MODULE-ENTRY-REF DEST="BSW-MODULE-ENTRY">/AUTOSAR_Det/BswModuleEntrys/Det_ReportError</BSW-MODULE-ENTRY-REF>
                                    </BSW-MODULE-ENTRY-REF-CONDITIONAL>
                                </REQUIRED-ENTRYS>
                            </BSW-MODULE-DEPENDENCY>
                            <BSW-MODULE-DEPENDENCY>
                                <SHORT-NAME>SafeMcalDependency</SHORT-NAME>
                                <TARGET-MODULE-ID>255</TARGET-MODULE-ID>
                                <REQUIRED-ENTRYS>
                                    <BSW-MODULE-ENTRY-REF-CONDITIONAL>
                                        <BSW-MODULE-ENTRY-REF DEST="BSW-MODULE-ENTRY">/AUTOSAR_SafeMcal/BswModuleEntrys/SafeMcal_ReportError</BSW-MODULE-ENTRY-REF>
                                    </BSW-MODULE-ENTRY-REF-CONDITIONAL>
                                </REQUIRED-ENTRYS>
                            </BSW-MODULE-DEPENDENCY>
                        </BSW-MODULE-DEPENDENCYS>
                        <INTERNAL-BEHAVIORS>
                          <BSW-INTERNAL-BEHAVIOR>
                            <SHORT-NAME>DioBehavior</SHORT-NAME>
                            <CONSTANT-MEMORYS>
                              <PARAMETER-DATA-PROTOTYPE>
                                <SHORT-NAME>Dio_kConfigPtr</SHORT-NAME>
                                <CATEGORY>DATA_REFERENCE</CATEGORY>
                                <SW-DATA-DEF-PROPS>
                                  <SW-DATA-DEF-PROPS-VARIANTS>
                                    <SW-DATA-DEF-PROPS-CONDITIONAL>
                                    <SW-POINTER-TARGET-PROPS>
                                <TARGET-CATEGORY>TYPE_REFERENCE</TARGET-CATEGORY>
                                    <SW-DATA-DEF-PROPS>
                                    <SW-DATA-DEF-PROPS-VARIANTS>
                                    <SW-DATA-DEF-PROPS-CONDITIONAL>
                                      <IMPLEMENTATION-DATA-TYPE-REF DEST = "IMPLEMENTATION-DATA-TYPE">/AUTOSAR_Dio/ImplementationDataTypes/Dio_ConfigType</IMPLEMENTATION-DATA-TYPE-REF>
                                    </SW-DATA-DEF-PROPS-CONDITIONAL>
                                    </SW-DATA-DEF-PROPS-VARIANTS>
                                    </SW-DATA-DEF-PROPS>
                                    </SW-POINTER-TARGET-PROPS>
                                    </SW-DATA-DEF-PROPS-CONDITIONAL>
                                  </SW-DATA-DEF-PROPS-VARIANTS>
                                </SW-DATA-DEF-PROPS>
                                <TYPE-TREF DEST = "IMPLEMENTATION-DATA-TYPE">/AUTOSAR_Dio/ImplementationDataTypes/Dio_ConfigType</TYPE-TREF>
                              </PARAMETER-DATA-PROTOTYPE>
                              <PARAMETER-DATA-PROTOTYPE>
                                <SHORT-NAME>Dio_kMSPortPin</SHORT-NAME>
                                <SW-DATA-DEF-PROPS>
                                  <SW-DATA-DEF-PROPS-VARIANTS>
                                    <SW-DATA-DEF-PROPS-CONDITIONAL>
                                      <IMPLEMENTATION-DATA-TYPE-REF DEST = "IMPLEMENTATION-DATA-TYPE">/AUTOSAR_Platform/ImplementationDataTypes/uint8</IMPLEMENTATION-DATA-TYPE-REF>
                                    </SW-DATA-DEF-PROPS-CONDITIONAL>
                                  </SW-DATA-DEF-PROPS-VARIANTS>
                                </SW-DATA-DEF-PROPS>
                                <TYPE-TREF DEST = "IMPLEMENTATION-DATA-TYPE">/AUTOSAR_Platform/ImplementationDataTypes/uint8</TYPE-TREF>
                              </PARAMETER-DATA-PROTOTYPE>
                              <PARAMETER-DATA-PROTOTYPE>
                                <SHORT-NAME>Dio_kMaskUndefinedPortPins</SHORT-NAME>
                                <CATEGORY>DATA_REFERENCE</CATEGORY>
                                <SW-DATA-DEF-PROPS>
                                  <SW-DATA-DEF-PROPS-VARIANTS>
                                    <SW-DATA-DEF-PROPS-CONDITIONAL>
                                    <SW-POINTER-TARGET-PROPS>
                                <TARGET-CATEGORY>TYPE_REFERENCE</TARGET-CATEGORY>
                                    <SW-DATA-DEF-PROPS>
                                    <SW-DATA-DEF-PROPS-VARIANTS>
                                    <SW-DATA-DEF-PROPS-CONDITIONAL>
                                      <IMPLEMENTATION-DATA-TYPE-REF DEST = "IMPLEMENTATION-DATA-TYPE">/AUTOSAR_Dio/ImplementationDataTypes/Dio_PortLevelType</IMPLEMENTATION-DATA-TYPE-REF>
                                    </SW-DATA-DEF-PROPS-CONDITIONAL>
                                    </SW-DATA-DEF-PROPS-VARIANTS>
                                    </SW-DATA-DEF-PROPS>
                                    </SW-POINTER-TARGET-PROPS>
                                    </SW-DATA-DEF-PROPS-CONDITIONAL>
                                  </SW-DATA-DEF-PROPS-VARIANTS>
                                </SW-DATA-DEF-PROPS>
                                <TYPE-TREF DEST = "IMPLEMENTATION-DATA-TYPE">/AUTOSAR_Dio/ImplementationDataTypes/Dio_PortLevelType</TYPE-TREF>
                              </PARAMETER-DATA-PROTOTYPE>
                            </CONSTANT-MEMORYS>
                            <STATIC-MEMORYS>
                              <VARIABLE-DATA-PROTOTYPE>
                                <SHORT-NAME>Dio_InitStatus</SHORT-NAME>
                                <SW-DATA-DEF-PROPS>
                                  <SW-DATA-DEF-PROPS-VARIANTS>
                                    <SW-DATA-DEF-PROPS-CONDITIONAL>
                                    <IMPLEMENTATION-DATA-TYPE-REF DEST = "IMPLEMENTATION-DATA-TYPE">/AUTOSAR_Platform/ImplementationDataTypes/uint8</IMPLEMENTATION-DATA-TYPE-REF>
                                    </SW-DATA-DEF-PROPS-CONDITIONAL>
                                  </SW-DATA-DEF-PROPS-VARIANTS>
                                </SW-DATA-DEF-PROPS>
                                <TYPE-TREF DEST = "IMPLEMENTATION-DATA-TYPE">/AUTOSAR_Platform/ImplementationDataTypes/uint8</TYPE-TREF>
                              </VARIABLE-DATA-PROTOTYPE>
                            </STATIC-MEMORYS>
                            <ENTITYS>
                              <BSW-CALLED-ENTITY>
                                <SHORT-NAME>Dio_ReadChannel</SHORT-NAME>
                                <MINIMUM-START-INTERVAL>0.0</MINIMUM-START-INTERVAL>
                                <IMPLEMENTED-ENTRY-REF DEST="BSW-MODULE-ENTRY">/AUTOSAR_Dio/BswModuleEntrys/Dio_ReadChannel</IMPLEMENTED-ENTRY-REF>
                              </BSW-CALLED-ENTITY>
                              <BSW-CALLED-ENTITY>
                                <SHORT-NAME>Dio_WriteChannel</SHORT-NAME>
                                <MINIMUM-START-INTERVAL>0.0</MINIMUM-START-INTERVAL>
                                <IMPLEMENTED-ENTRY-REF DEST="BSW-MODULE-ENTRY">/AUTOSAR_Dio/BswModuleEntrys/Dio_WriteChannel</IMPLEMENTED-ENTRY-REF>
                              </BSW-CALLED-ENTITY>
                              <BSW-CALLED-ENTITY>
                                <SHORT-NAME>Dio_ReadPort</SHORT-NAME>
                                <MINIMUM-START-INTERVAL>0.0</MINIMUM-START-INTERVAL>
                                <IMPLEMENTED-ENTRY-REF DEST="BSW-MODULE-ENTRY">/AUTOSAR_Dio/BswModuleEntrys/Dio_ReadPort</IMPLEMENTED-ENTRY-REF>
                              </BSW-CALLED-ENTITY>
                              <BSW-CALLED-ENTITY>
                                <SHORT-NAME>Dio_WritePort</SHORT-NAME>
                                <MINIMUM-START-INTERVAL>0.0</MINIMUM-START-INTERVAL>
                                <IMPLEMENTED-ENTRY-REF DEST="BSW-MODULE-ENTRY">/AUTOSAR_Dio/BswModuleEntrys/Dio_WritePort</IMPLEMENTED-ENTRY-REF>
                              </BSW-CALLED-ENTITY>
                              <BSW-CALLED-ENTITY>
                                <SHORT-NAME>Dio_ReadChannelGroup</SHORT-NAME>
                                <MINIMUM-START-INTERVAL>0.0</MINIMUM-START-INTERVAL>
                                <IMPLEMENTED-ENTRY-REF DEST="BSW-MODULE-ENTRY">/AUTOSAR_Dio/BswModuleEntrys/Dio_ReadChannelGroup</IMPLEMENTED-ENTRY-REF>
                              </BSW-CALLED-ENTITY>
                              <BSW-CALLED-ENTITY>
                                <SHORT-NAME>Dio_WriteChannelGroup</SHORT-NAME>
                                <MINIMUM-START-INTERVAL>0.0</MINIMUM-START-INTERVAL>
                                <IMPLEMENTED-ENTRY-REF DEST="BSW-MODULE-ENTRY">/AUTOSAR_Dio/BswModuleEntrys/Dio_WriteChannelGroup</IMPLEMENTED-ENTRY-REF>
                              </BSW-CALLED-ENTITY>
                              <BSW-CALLED-ENTITY>
                                <SHORT-NAME>Dio_Init</SHORT-NAME>
                                <MINIMUM-START-INTERVAL>0.0</MINIMUM-START-INTERVAL>
                                <IMPLEMENTED-ENTRY-REF DEST="BSW-MODULE-ENTRY">/AUTOSAR_Dio/BswModuleEntrys/Dio_Init</IMPLEMENTED-ENTRY-REF>
                              </BSW-CALLED-ENTITY>
[!IF "$Dio_FlipChannelApi = 'true'"!][!//
                              <BSW-CALLED-ENTITY>
                                <SHORT-NAME>Dio_FlipChannel</SHORT-NAME>
                                <MINIMUM-START-INTERVAL>0.0</MINIMUM-START-INTERVAL>
                                <IMPLEMENTED-ENTRY-REF DEST="BSW-MODULE-ENTRY">/AUTOSAR_Dio/BswModuleEntrys/Dio_FlipChannel</IMPLEMENTED-ENTRY-REF>
                              </BSW-CALLED-ENTITY>
[!ENDIF!][!//
[!IF "$Dio_VersionInfoApi = 'true'"!][!//
                              <BSW-CALLED-ENTITY>
                                <SHORT-NAME>Dio_GetVersionInfo</SHORT-NAME>
                                <MINIMUM-START-INTERVAL>0.0</MINIMUM-START-INTERVAL>
                                <IMPLEMENTED-ENTRY-REF DEST="BSW-MODULE-ENTRY">/AUTOSAR_Dio/BswModuleEntrys/Dio_GetVersionInfo</IMPLEMENTED-ENTRY-REF>
                              </BSW-CALLED-ENTITY>
[!ENDIF!][!//
[!IF "$Dio_SafetyEnable = 'true' and $Dio_InitCheckApi = 'true'"!][!//
                              <BSW-CALLED-ENTITY>
                                <SHORT-NAME>Dio_InitCheck</SHORT-NAME>
                                <MINIMUM-START-INTERVAL>0.0</MINIMUM-START-INTERVAL>
                                <IMPLEMENTED-ENTRY-REF DEST="BSW-MODULE-ENTRY">/AUTOSAR_Dio/BswModuleEntrys/Dio_InitCheck</IMPLEMENTED-ENTRY-REF>
                              </BSW-CALLED-ENTITY>
[!ENDIF!][!//
                            </ENTITYS>
                          </BSW-INTERNAL-BEHAVIOR>
                        </INTERNAL-BEHAVIORS>
                    </BSW-MODULE-DESCRIPTION>
                </ELEMENTS>
            </AR-PACKAGE>
            <AR-PACKAGE>
                <SHORT-NAME>BswModuleEntrys</SHORT-NAME>
                <CATEGORY>STANDARD</CATEGORY>
                <ELEMENTS>
                    <BSW-MODULE-ENTRY>
                        <SHORT-NAME>Dio_ReadChannel</SHORT-NAME>
                        <SERVICE-ID>0</SERVICE-ID>
                        <IS-REENTRANT>true</IS-REENTRANT>
                        <IS-SYNCHRONOUS>true</IS-SYNCHRONOUS>
                        <CALL-TYPE>REGULAR</CALL-TYPE>
                        <EXECUTION-CONTEXT>UNSPECIFIED</EXECUTION-CONTEXT>
                        <SW-SERVICE-IMPL-POLICY>STANDARD</SW-SERVICE-IMPL-POLICY>
                        <RETURN-TYPE>
                          <SHORT-NAME>Return</SHORT-NAME>
                          <SW-DATA-DEF-PROPS>
                            <SW-DATA-DEF-PROPS-VARIANTS>
                              <SW-DATA-DEF-PROPS-CONDITIONAL>
                                <IMPLEMENTATION-DATA-TYPE-REF DEST = "IMPLEMENTATION-DATA-TYPE">/AUTOSAR_Dio/ImplementationDataTypes/Dio_LevelType</IMPLEMENTATION-DATA-TYPE-REF>
                              </SW-DATA-DEF-PROPS-CONDITIONAL>
                            </SW-DATA-DEF-PROPS-VARIANTS>
                          </SW-DATA-DEF-PROPS>
                        </RETURN-TYPE>
                        <ARGUMENTS>
                          <SW-SERVICE-ARG>
                            <SHORT-NAME>ChannelId</SHORT-NAME>
                            <SW-DATA-DEF-PROPS>
                              <SW-DATA-DEF-PROPS-VARIANTS>
                                <SW-DATA-DEF-PROPS-CONDITIONAL>
                                <IMPLEMENTATION-DATA-TYPE-REF DEST = "IMPLEMENTATION-DATA-TYPE">/AUTOSAR_Dio/ImplementationDataTypes/Dio_ChannelType</IMPLEMENTATION-DATA-TYPE-REF>
                                </SW-DATA-DEF-PROPS-CONDITIONAL>
                              </SW-DATA-DEF-PROPS-VARIANTS>
                            </SW-DATA-DEF-PROPS>
                          </SW-SERVICE-ARG>
                        </ARGUMENTS>
                    </BSW-MODULE-ENTRY>
                    <BSW-MODULE-ENTRY>
                        <SHORT-NAME>Dio_WriteChannel</SHORT-NAME>
                        <SERVICE-ID>1</SERVICE-ID>
                        <IS-REENTRANT>true</IS-REENTRANT>
                        <IS-SYNCHRONOUS>true</IS-SYNCHRONOUS>
                        <CALL-TYPE>REGULAR</CALL-TYPE>
                        <EXECUTION-CONTEXT>UNSPECIFIED</EXECUTION-CONTEXT>
                        <SW-SERVICE-IMPL-POLICY>STANDARD</SW-SERVICE-IMPL-POLICY>
                        <ARGUMENTS>
                          <SW-SERVICE-ARG>
                            <SHORT-NAME>ChannelId</SHORT-NAME>
                            <SW-DATA-DEF-PROPS>
                              <SW-DATA-DEF-PROPS-VARIANTS>
                                <SW-DATA-DEF-PROPS-CONDITIONAL>
                                <IMPLEMENTATION-DATA-TYPE-REF DEST = "IMPLEMENTATION-DATA-TYPE">/AUTOSAR_Dio/ImplementationDataTypes/Dio_ChannelType</IMPLEMENTATION-DATA-TYPE-REF>
                                </SW-DATA-DEF-PROPS-CONDITIONAL>
                              </SW-DATA-DEF-PROPS-VARIANTS>
                            </SW-DATA-DEF-PROPS>
                          </SW-SERVICE-ARG>
                          <SW-SERVICE-ARG>
                            <SHORT-NAME>Level</SHORT-NAME>
                            <SW-DATA-DEF-PROPS>
                              <SW-DATA-DEF-PROPS-VARIANTS>
                                <SW-DATA-DEF-PROPS-CONDITIONAL>
                                <IMPLEMENTATION-DATA-TYPE-REF DEST = "IMPLEMENTATION-DATA-TYPE">/AUTOSAR_Dio/ImplementationDataTypes/Dio_LevelType</IMPLEMENTATION-DATA-TYPE-REF>
                                </SW-DATA-DEF-PROPS-CONDITIONAL>
                              </SW-DATA-DEF-PROPS-VARIANTS>
                            </SW-DATA-DEF-PROPS>
                          </SW-SERVICE-ARG>
                        </ARGUMENTS>
                    </BSW-MODULE-ENTRY>
                    <BSW-MODULE-ENTRY>
                        <SHORT-NAME>Dio_ReadPort</SHORT-NAME>
                        <SERVICE-ID>2</SERVICE-ID>
                        <IS-REENTRANT>true</IS-REENTRANT>
                        <IS-SYNCHRONOUS>true</IS-SYNCHRONOUS>
                        <CALL-TYPE>REGULAR</CALL-TYPE>
                        <EXECUTION-CONTEXT>UNSPECIFIED</EXECUTION-CONTEXT>
                        <SW-SERVICE-IMPL-POLICY>STANDARD</SW-SERVICE-IMPL-POLICY>
                        <RETURN-TYPE>
                          <SHORT-NAME>Return</SHORT-NAME>
                          <SW-DATA-DEF-PROPS>
                            <SW-DATA-DEF-PROPS-VARIANTS>
                              <SW-DATA-DEF-PROPS-CONDITIONAL>
                                <IMPLEMENTATION-DATA-TYPE-REF DEST = "IMPLEMENTATION-DATA-TYPE">/AUTOSAR_Dio/ImplementationDataTypes/Dio_PortLevelType</IMPLEMENTATION-DATA-TYPE-REF>
                              </SW-DATA-DEF-PROPS-CONDITIONAL>
                            </SW-DATA-DEF-PROPS-VARIANTS>
                          </SW-DATA-DEF-PROPS>
                        </RETURN-TYPE>
                        <ARGUMENTS>
                          <SW-SERVICE-ARG>
                            <SHORT-NAME>PortId</SHORT-NAME>
                            <SW-DATA-DEF-PROPS>
                              <SW-DATA-DEF-PROPS-VARIANTS>
                                <SW-DATA-DEF-PROPS-CONDITIONAL>
                                <IMPLEMENTATION-DATA-TYPE-REF DEST = "IMPLEMENTATION-DATA-TYPE">/AUTOSAR_Dio/ImplementationDataTypes/Dio_PortType</IMPLEMENTATION-DATA-TYPE-REF>
                                </SW-DATA-DEF-PROPS-CONDITIONAL>
                              </SW-DATA-DEF-PROPS-VARIANTS>
                            </SW-DATA-DEF-PROPS>
                          </SW-SERVICE-ARG>
                        </ARGUMENTS>
                    </BSW-MODULE-ENTRY>
                    <BSW-MODULE-ENTRY>
                        <SHORT-NAME>Dio_WritePort</SHORT-NAME>
                        <SERVICE-ID>3</SERVICE-ID>
                        <IS-REENTRANT>true</IS-REENTRANT>
                        <IS-SYNCHRONOUS>true</IS-SYNCHRONOUS>
                        <CALL-TYPE>REGULAR</CALL-TYPE>
                        <EXECUTION-CONTEXT>UNSPECIFIED</EXECUTION-CONTEXT>
                        <SW-SERVICE-IMPL-POLICY>STANDARD</SW-SERVICE-IMPL-POLICY>
                        <ARGUMENTS>
                          <SW-SERVICE-ARG>
                            <SHORT-NAME>PortId</SHORT-NAME>
                            <SW-DATA-DEF-PROPS>
                              <SW-DATA-DEF-PROPS-VARIANTS>
                                <SW-DATA-DEF-PROPS-CONDITIONAL>
                                <IMPLEMENTATION-DATA-TYPE-REF DEST = "IMPLEMENTATION-DATA-TYPE">/AUTOSAR_Dio/ImplementationDataTypes/Dio_PortType</IMPLEMENTATION-DATA-TYPE-REF>
                                </SW-DATA-DEF-PROPS-CONDITIONAL>
                              </SW-DATA-DEF-PROPS-VARIANTS>
                            </SW-DATA-DEF-PROPS>
                          </SW-SERVICE-ARG>
                          <SW-SERVICE-ARG>
                            <SHORT-NAME>Level</SHORT-NAME>
                            <SW-DATA-DEF-PROPS>
                              <SW-DATA-DEF-PROPS-VARIANTS>
                                <SW-DATA-DEF-PROPS-CONDITIONAL>
                                <IMPLEMENTATION-DATA-TYPE-REF DEST = "IMPLEMENTATION-DATA-TYPE">/AUTOSAR_Dio/ImplementationDataTypes/Dio_PortLevelType</IMPLEMENTATION-DATA-TYPE-REF>
                                </SW-DATA-DEF-PROPS-CONDITIONAL>
                              </SW-DATA-DEF-PROPS-VARIANTS>
                            </SW-DATA-DEF-PROPS>
                          </SW-SERVICE-ARG>
                        </ARGUMENTS>
                    </BSW-MODULE-ENTRY>
                    <BSW-MODULE-ENTRY>
                        <SHORT-NAME>Dio_ReadChannelGroup</SHORT-NAME>
                        <SERVICE-ID>4</SERVICE-ID>
                        <IS-REENTRANT>true</IS-REENTRANT>
                        <IS-SYNCHRONOUS>true</IS-SYNCHRONOUS>
                        <CALL-TYPE>REGULAR</CALL-TYPE>
                        <EXECUTION-CONTEXT>UNSPECIFIED</EXECUTION-CONTEXT>
                        <SW-SERVICE-IMPL-POLICY>STANDARD</SW-SERVICE-IMPL-POLICY>
                        <RETURN-TYPE>
                          <SHORT-NAME>Return</SHORT-NAME>
                          <SW-DATA-DEF-PROPS>
                            <SW-DATA-DEF-PROPS-VARIANTS>
                              <SW-DATA-DEF-PROPS-CONDITIONAL>
                                <IMPLEMENTATION-DATA-TYPE-REF DEST = "IMPLEMENTATION-DATA-TYPE">/AUTOSAR_Dio/ImplementationDataTypes/Dio_PortLevelType</IMPLEMENTATION-DATA-TYPE-REF>
                              </SW-DATA-DEF-PROPS-CONDITIONAL>
                            </SW-DATA-DEF-PROPS-VARIANTS>
                          </SW-DATA-DEF-PROPS>
                        </RETURN-TYPE>
                        <ARGUMENTS>
                          <SW-SERVICE-ARG>
                            <SHORT-NAME>ChannelGroupIdPtr</SHORT-NAME>
                            <CATEGORY>DATA_REFERENCE</CATEGORY>
                            <SW-DATA-DEF-PROPS>
                              <SW-DATA-DEF-PROPS-VARIANTS>
                                <SW-DATA-DEF-PROPS-CONDITIONAL>
                                <SW-POINTER-TARGET-PROPS>
                                <TARGET-CATEGORY>TYPE_REFERENCE</TARGET-CATEGORY>
                                <SW-DATA-DEF-PROPS>
                                <SW-DATA-DEF-PROPS-VARIANTS>
                                <SW-DATA-DEF-PROPS-CONDITIONAL>
                                <IMPLEMENTATION-DATA-TYPE-REF DEST = "IMPLEMENTATION-DATA-TYPE">/AUTOSAR_Dio/ImplementationDataTypes/Dio_ChannelGroupType</IMPLEMENTATION-DATA-TYPE-REF>
                                </SW-DATA-DEF-PROPS-CONDITIONAL>
                                </SW-DATA-DEF-PROPS-VARIANTS>
                                </SW-DATA-DEF-PROPS>
                                </SW-POINTER-TARGET-PROPS>
                                </SW-DATA-DEF-PROPS-CONDITIONAL>
                              </SW-DATA-DEF-PROPS-VARIANTS>
                            </SW-DATA-DEF-PROPS>
                          </SW-SERVICE-ARG>
                        </ARGUMENTS>
                    </BSW-MODULE-ENTRY>
                    <BSW-MODULE-ENTRY>
                        <SHORT-NAME>Dio_WriteChannelGroup</SHORT-NAME>
                        <SERVICE-ID>5</SERVICE-ID>
                        <IS-REENTRANT>true</IS-REENTRANT>
                        <IS-SYNCHRONOUS>true</IS-SYNCHRONOUS>
                        <CALL-TYPE>REGULAR</CALL-TYPE>
                        <EXECUTION-CONTEXT>UNSPECIFIED</EXECUTION-CONTEXT>
                        <SW-SERVICE-IMPL-POLICY>STANDARD</SW-SERVICE-IMPL-POLICY>
                        <ARGUMENTS>
                          <SW-SERVICE-ARG>
                            <SHORT-NAME>ChannelGroupIdPtr</SHORT-NAME>
                            <CATEGORY>DATA_REFERENCE</CATEGORY>
                            <SW-DATA-DEF-PROPS>
                              <SW-DATA-DEF-PROPS-VARIANTS>
                                <SW-DATA-DEF-PROPS-CONDITIONAL>
                                <SW-POINTER-TARGET-PROPS>
                                <TARGET-CATEGORY>TYPE_REFERENCE</TARGET-CATEGORY>
                                <SW-DATA-DEF-PROPS>
                                <SW-DATA-DEF-PROPS-VARIANTS>
                                <SW-DATA-DEF-PROPS-CONDITIONAL>
                                <IMPLEMENTATION-DATA-TYPE-REF DEST = "IMPLEMENTATION-DATA-TYPE">/AUTOSAR_Dio/ImplementationDataTypes/Dio_ChannelGroupType</IMPLEMENTATION-DATA-TYPE-REF>
                                </SW-DATA-DEF-PROPS-CONDITIONAL>
                                </SW-DATA-DEF-PROPS-VARIANTS>
                                </SW-DATA-DEF-PROPS>
                                </SW-POINTER-TARGET-PROPS>
                                </SW-DATA-DEF-PROPS-CONDITIONAL>
                              </SW-DATA-DEF-PROPS-VARIANTS>
                            </SW-DATA-DEF-PROPS>
                          </SW-SERVICE-ARG>
                          <SW-SERVICE-ARG>
                            <SHORT-NAME>Level</SHORT-NAME>
                            <SW-DATA-DEF-PROPS>
                              <SW-DATA-DEF-PROPS-VARIANTS>
                                <SW-DATA-DEF-PROPS-CONDITIONAL>
                                <IMPLEMENTATION-DATA-TYPE-REF DEST = "IMPLEMENTATION-DATA-TYPE">/AUTOSAR_Dio/ImplementationDataTypes/Dio_PortLevelType</IMPLEMENTATION-DATA-TYPE-REF>
                                </SW-DATA-DEF-PROPS-CONDITIONAL>
                              </SW-DATA-DEF-PROPS-VARIANTS>
                            </SW-DATA-DEF-PROPS>
                          </SW-SERVICE-ARG>
                        </ARGUMENTS>
                    </BSW-MODULE-ENTRY>
                    <BSW-MODULE-ENTRY>
                        <SHORT-NAME>Dio_Init</SHORT-NAME>
                        <SERVICE-ID>16</SERVICE-ID>
                        <IS-REENTRANT>false</IS-REENTRANT>
                        <IS-SYNCHRONOUS>true</IS-SYNCHRONOUS>
                        <CALL-TYPE>REGULAR</CALL-TYPE>
                        <EXECUTION-CONTEXT>UNSPECIFIED</EXECUTION-CONTEXT>
                        <SW-SERVICE-IMPL-POLICY>STANDARD</SW-SERVICE-IMPL-POLICY>
                        <ARGUMENTS>
                          <SW-SERVICE-ARG>
                            <SHORT-NAME>ConfigPtr</SHORT-NAME>
                            <CATEGORY>DATA_REFERENCE</CATEGORY>
                            <SW-DATA-DEF-PROPS>
                              <SW-DATA-DEF-PROPS-VARIANTS>
                                <SW-DATA-DEF-PROPS-CONDITIONAL>
                                <SW-POINTER-TARGET-PROPS>
                                <TARGET-CATEGORY>TYPE_REFERENCE</TARGET-CATEGORY>
                                <SW-DATA-DEF-PROPS>
                                <SW-DATA-DEF-PROPS-VARIANTS>
                                <SW-DATA-DEF-PROPS-CONDITIONAL>
                                <IMPLEMENTATION-DATA-TYPE-REF DEST = "IMPLEMENTATION-DATA-TYPE">/AUTOSAR_Dio/ImplementationDataTypes/Dio_ConfigType</IMPLEMENTATION-DATA-TYPE-REF>
                                </SW-DATA-DEF-PROPS-CONDITIONAL>
                                </SW-DATA-DEF-PROPS-VARIANTS>
                                </SW-DATA-DEF-PROPS>
                                </SW-POINTER-TARGET-PROPS>
                                </SW-DATA-DEF-PROPS-CONDITIONAL>
                              </SW-DATA-DEF-PROPS-VARIANTS>
                            </SW-DATA-DEF-PROPS>
                          </SW-SERVICE-ARG>
                        </ARGUMENTS>
                    </BSW-MODULE-ENTRY>
[!IF "$Dio_FlipChannelApi = 'true'"!][!//
                    <BSW-MODULE-ENTRY>
                        <SHORT-NAME>Dio_FlipChannel</SHORT-NAME>
                        <SERVICE-ID>17</SERVICE-ID>
                        <IS-REENTRANT>false</IS-REENTRANT>
                        <IS-SYNCHRONOUS>true</IS-SYNCHRONOUS>
                        <CALL-TYPE>REGULAR</CALL-TYPE>
                        <EXECUTION-CONTEXT>UNSPECIFIED</EXECUTION-CONTEXT>
                        <SW-SERVICE-IMPL-POLICY>STANDARD</SW-SERVICE-IMPL-POLICY>
                        <RETURN-TYPE>
                          <SHORT-NAME>Return</SHORT-NAME>
                          <SW-DATA-DEF-PROPS>
                            <SW-DATA-DEF-PROPS-VARIANTS>
                              <SW-DATA-DEF-PROPS-CONDITIONAL>
                                <IMPLEMENTATION-DATA-TYPE-REF DEST = "IMPLEMENTATION-DATA-TYPE">/AUTOSAR_Dio/ImplementationDataTypes/Dio_LevelType</IMPLEMENTATION-DATA-TYPE-REF>
                              </SW-DATA-DEF-PROPS-CONDITIONAL>
                            </SW-DATA-DEF-PROPS-VARIANTS>
                          </SW-DATA-DEF-PROPS>
                        </RETURN-TYPE>
                        <ARGUMENTS>
                          <SW-SERVICE-ARG>
                            <SHORT-NAME>ChannelId</SHORT-NAME>
                            <SW-DATA-DEF-PROPS>
                              <SW-DATA-DEF-PROPS-VARIANTS>
                                <SW-DATA-DEF-PROPS-CONDITIONAL>
                                <IMPLEMENTATION-DATA-TYPE-REF DEST = "IMPLEMENTATION-DATA-TYPE">/AUTOSAR_Dio/ImplementationDataTypes/Dio_ChannelType</IMPLEMENTATION-DATA-TYPE-REF>
                                </SW-DATA-DEF-PROPS-CONDITIONAL>
                              </SW-DATA-DEF-PROPS-VARIANTS>
                            </SW-DATA-DEF-PROPS>
                          </SW-SERVICE-ARG>
                        </ARGUMENTS>
                    </BSW-MODULE-ENTRY>
[!ENDIF!][!//
[!IF "$Dio_VersionInfoApi = 'true'"!][!//
                    <BSW-MODULE-ENTRY>
                        <SHORT-NAME>Dio_GetVersionInfo</SHORT-NAME>
                        <SERVICE-ID>18</SERVICE-ID>
                        <IS-REENTRANT>false</IS-REENTRANT>
                        <IS-SYNCHRONOUS>true</IS-SYNCHRONOUS>
                        <CALL-TYPE>REGULAR</CALL-TYPE>
                        <EXECUTION-CONTEXT>UNSPECIFIED</EXECUTION-CONTEXT>
                        <SW-SERVICE-IMPL-POLICY>MACRO</SW-SERVICE-IMPL-POLICY>
                        <ARGUMENTS>
                          <SW-SERVICE-ARG>
                            <SHORT-NAME>VersionInfo</SHORT-NAME>
                            <CATEGORY>DATA_REFERENCE</CATEGORY>
                            <SW-DATA-DEF-PROPS>
                              <SW-DATA-DEF-PROPS-VARIANTS>
                                <SW-DATA-DEF-PROPS-CONDITIONAL>
                                <SW-POINTER-TARGET-PROPS>
                                <TARGET-CATEGORY>TYPE_REFERENCE</TARGET-CATEGORY>
                                <SW-DATA-DEF-PROPS>
                                <SW-DATA-DEF-PROPS-VARIANTS>
                                <SW-DATA-DEF-PROPS-CONDITIONAL>
                                <IMPLEMENTATION-DATA-TYPE-REF DEST = "IMPLEMENTATION-DATA-TYPE">/AUTOSAR_Std/ImplementationDataTypes/Std_VersionInfoType</IMPLEMENTATION-DATA-TYPE-REF>
                                </SW-DATA-DEF-PROPS-CONDITIONAL>
                                </SW-DATA-DEF-PROPS-VARIANTS>
                                </SW-DATA-DEF-PROPS>
                                </SW-POINTER-TARGET-PROPS>
                                </SW-DATA-DEF-PROPS-CONDITIONAL>
                              </SW-DATA-DEF-PROPS-VARIANTS>
                            </SW-DATA-DEF-PROPS>
                          </SW-SERVICE-ARG>
                        </ARGUMENTS>
                    </BSW-MODULE-ENTRY>
[!ENDIF!][!//
[!IF "$Dio_SafetyEnable = 'true' and $Dio_InitCheckApi = 'true'"!][!//
                    <BSW-MODULE-ENTRY>
                        <SHORT-NAME>Dio_InitCheck</SHORT-NAME>
                        <SERVICE-ID>0</SERVICE-ID>
                        <IS-REENTRANT>false</IS-REENTRANT>
                        <IS-SYNCHRONOUS>true</IS-SYNCHRONOUS>
                        <CALL-TYPE>REGULAR</CALL-TYPE>
                        <EXECUTION-CONTEXT>UNSPECIFIED</EXECUTION-CONTEXT>
                        <SW-SERVICE-IMPL-POLICY>STANDARD</SW-SERVICE-IMPL-POLICY>
                        <RETURN-TYPE>
                          <SHORT-NAME>Return</SHORT-NAME>
                          <SW-DATA-DEF-PROPS>
                            <SW-DATA-DEF-PROPS-VARIANTS>
                              <SW-DATA-DEF-PROPS-CONDITIONAL>
                                <IMPLEMENTATION-DATA-TYPE-REF DEST = "IMPLEMENTATION-DATA-TYPE">/AUTOSAR_Std/ImplementationDataTypes/Std_ReturnType</IMPLEMENTATION-DATA-TYPE-REF>
                              </SW-DATA-DEF-PROPS-CONDITIONAL>
                            </SW-DATA-DEF-PROPS-VARIANTS>
                          </SW-DATA-DEF-PROPS>
                        </RETURN-TYPE>
                        <ARGUMENTS>
                          <SW-SERVICE-ARG>
                            <SHORT-NAME>ConfigPtr</SHORT-NAME>
                            <CATEGORY>DATA_REFERENCE</CATEGORY>
                            <SW-DATA-DEF-PROPS>
                              <SW-DATA-DEF-PROPS-VARIANTS>
                                <SW-DATA-DEF-PROPS-CONDITIONAL>
                                <SW-POINTER-TARGET-PROPS>
                                <TARGET-CATEGORY>TYPE_REFERENCE</TARGET-CATEGORY>
                                <SW-DATA-DEF-PROPS>
                                <SW-DATA-DEF-PROPS-VARIANTS>
                                <SW-DATA-DEF-PROPS-CONDITIONAL>
                                <IMPLEMENTATION-DATA-TYPE-REF DEST = "IMPLEMENTATION-DATA-TYPE">/AUTOSAR_Dio/ImplementationDataTypes/Dio_ConfigType</IMPLEMENTATION-DATA-TYPE-REF>
                                </SW-DATA-DEF-PROPS-CONDITIONAL>
                                </SW-DATA-DEF-PROPS-VARIANTS>
                                </SW-DATA-DEF-PROPS>
                                </SW-POINTER-TARGET-PROPS>
                                </SW-DATA-DEF-PROPS-CONDITIONAL>
                              </SW-DATA-DEF-PROPS-VARIANTS>
                            </SW-DATA-DEF-PROPS>
                          </SW-SERVICE-ARG>
                        </ARGUMENTS>
                    </BSW-MODULE-ENTRY>
[!ENDIF!][!//
                </ELEMENTS>
            </AR-PACKAGE>
            <AR-PACKAGE>
                <SHORT-NAME>Implementations</SHORT-NAME>
                <ELEMENTS>
                    <BSW-IMPLEMENTATION>
                        <SHORT-NAME>Dio</SHORT-NAME>
                        <CODE-DESCRIPTORS>
                            <CODE>
                                <SHORT-NAME>Files</SHORT-NAME>
                                <ARTIFACT-DESCRIPTORS>
                                    <AUTOSAR-ENGINEERING-OBJECT>
                                        <SHORT-LABEL>ssc::src::Dio.c</SHORT-LABEL>
                                        <CATEGORY>SWSRC</CATEGORY>
                                    </AUTOSAR-ENGINEERING-OBJECT>
                                    <AUTOSAR-ENGINEERING-OBJECT>
                                        <SHORT-LABEL>ssc::src::Dio_Ver.c</SHORT-LABEL>
                                        <CATEGORY>SWSRC</CATEGORY>
                                    </AUTOSAR-ENGINEERING-OBJECT>
                                    <AUTOSAR-ENGINEERING-OBJECT>
                                        <SHORT-LABEL>ssc::src::Dio.h</SHORT-LABEL>
                                        <CATEGORY>SWHDR</CATEGORY>
                                    </AUTOSAR-ENGINEERING-OBJECT>
                                    <AUTOSAR-ENGINEERING-OBJECT>
                                        <SHORT-LABEL>ssc::src::Dio_Ver.h</SHORT-LABEL>
                                        <CATEGORY>SWHDR</CATEGORY>
                                    </AUTOSAR-ENGINEERING-OBJECT>
                                    <AUTOSAR-ENGINEERING-OBJECT>
                                        <SHORT-LABEL>mak::dio_infineon_tricore::ssc::mak::infineon_dio_cfg.mak</SHORT-LABEL>
                                        <CATEGORY>SWMAKE</CATEGORY>
                                    </AUTOSAR-ENGINEERING-OBJECT>
                                    <AUTOSAR-ENGINEERING-OBJECT>
                                        <SHORT-LABEL>mak::dio_infineon_tricore::ssc::mak::infineon_dio_check.mak</SHORT-LABEL>
                                        <CATEGORY>SWMAKE</CATEGORY>
                                    </AUTOSAR-ENGINEERING-OBJECT>
                                    <AUTOSAR-ENGINEERING-OBJECT>
                                        <SHORT-LABEL>mak::dio_infineon_tricore::ssc::mak::infineon_dio_defs.mak</SHORT-LABEL>
                                        <CATEGORY>SWMAKE</CATEGORY>
                                    </AUTOSAR-ENGINEERING-OBJECT>
                                    <AUTOSAR-ENGINEERING-OBJECT>
                                        <SHORT-LABEL>mak::dio_infineon_tricore::ssc::mak::infineon_dio_rules.mak</SHORT-LABEL>
                                        <CATEGORY>SWMAKE</CATEGORY>
                                    </AUTOSAR-ENGINEERING-OBJECT>
                                </ARTIFACT-DESCRIPTORS>
                            </CODE>
                        </CODE-DESCRIPTORS>
                        <COMPILERS>
                            <COMPILER>
                                <SHORT-NAME>TASKING_COMPILE</SHORT-NAME>
                                <NAME>TASKING</NAME>
                                <OPTIONS>&quot;-c --core=tc1.6.x -t -Wa-gAHLs --emit-locals=-equ,-symbols -Wa-Ogs -Wa--error-limit=42 --iso=90 --eabi-compliant --integer-enumeration --language=-comments,-gcc,+volatile,-strings --switch=auto --align=0 --default-near-size=0 --default-a0-size=0 --default-a1-size=0 -O2ROPYG --tradeoff=4 -g --source -D_TASKING_C_TRICORE_=1 $(CALLFUNCTION)&quot;</OPTIONS>
                                <VENDOR>Tasking</VENDOR>
                                <VERSION>Tasking</VERSION>
                            </COMPILER>
                            <COMPILER>
                                <SHORT-NAME>DIAB_COMPILE</SHORT-NAME>
                                <NAME>DIAB</NAME>
                                <OPTIONS>&quot;-c -tTC27xAstep16PMG:cross -Xdialect-c89 -Xno-common -Xalign-functions=4 -Xfp-fast -Xsection-split=1 -Xkeep-assembly-file=2 -g3 -ew4084 -ei4177,4550,4549,4068,5388 -XO -D_DIABDATA_C_TRICORE_=1 $(CALLFUNCTION)&quot;</OPTIONS>
                                <VENDOR>WindRiver</VENDOR>
                                <VERSION>WindRiver</VERSION>
                            </COMPILER>
                            <COMPILER>
                                <SHORT-NAME>GNU_COMPILE</SHORT-NAME>
                                <NAME>GNU</NAME>
                                <OPTIONS>&quot;-c -save-temps=obj -std=iso9899:1990 -ansi -fno-asm -ffreestanding -Wundef -Wp,-std=iso9899:1990 -fno-short-enums -fpeel-loops -falign-functions=4 -frecord-gcc-switches -fsection-anchors -funsigned-bitfields -ffunction-sections -fno-ivopts -fno-peephole2 -nostartfiles -O3 -g3 -W -Wall -Wuninitialized -DTRIBOARD_TC27XX -mcpu=tc27xx -D_GNU_C_TRICORE_=1 $(CALLFUNCTION)&quot;</OPTIONS>
                                <VENDOR>Hightec</VENDOR>
                                <VERSION>Hightec</VERSION>
                            </COMPILER>
                        </COMPILERS>
                        <GENERATED-ARTIFACTS>
                            <DEPENDENCY-ON-ARTIFACT>
                                <SHORT-NAME>Dio_PBCfg_c</SHORT-NAME>
                                <ARTIFACT-DESCRIPTOR>
                                    <SHORT-LABEL>generate::src::Dio_PBCfg.c</SHORT-LABEL>
                                    <CATEGORY>SWSRC</CATEGORY>
                                </ARTIFACT-DESCRIPTOR>
                                <USAGES>
                                    <USAGE>CODEGENERATION</USAGE>
                                </USAGES>
                            </DEPENDENCY-ON-ARTIFACT>
                            <DEPENDENCY-ON-ARTIFACT>
                                <SHORT-NAME>Dio_Cfg_h</SHORT-NAME>
                                <ARTIFACT-DESCRIPTOR>
                                    <SHORT-LABEL>generate::src::Dio_Cfg.h</SHORT-LABEL>
                                    <CATEGORY>SWHDR</CATEGORY>
                                </ARTIFACT-DESCRIPTOR>
                                <USAGES>
                                    <USAGE>CODEGENERATION</USAGE>
                                </USAGES>
                            </DEPENDENCY-ON-ARTIFACT>
                            <DEPENDENCY-ON-ARTIFACT>
                                <SHORT-NAME>Dio_xdm</SHORT-NAME>
                                <ARTIFACT-DESCRIPTOR>
                                    <SHORT-LABEL>config::Dio.xdm</SHORT-LABEL>
                                    <CATEGORY>SWTOOL</CATEGORY>
                                </ARTIFACT-DESCRIPTOR>
                                <USAGES>
                                    <USAGE>CODEGENERATION</USAGE>
                                </USAGES>
                            </DEPENDENCY-ON-ARTIFACT>
                            <DEPENDENCY-ON-ARTIFACT>
                                <SHORT-NAME>Dio_bmd</SHORT-NAME>
                                <ARTIFACT-DESCRIPTOR>
                                    <SHORT-LABEL>autosar::Dio.bmd</SHORT-LABEL>
                                    <CATEGORY>SWTOOL</CATEGORY>
                                </ARTIFACT-DESCRIPTOR>
                                <USAGES>
                                    <USAGE>CODEGENERATION</USAGE>
                                </USAGES>
                            </DEPENDENCY-ON-ARTIFACT>
                            <DEPENDENCY-ON-ARTIFACT>
                                <SHORT-NAME>Dio_ConfigDoc_html</SHORT-NAME>
                                <ARTIFACT-DESCRIPTOR>
                                    <SHORT-LABEL>generate::Dio_ConfigDoc.html</SHORT-LABEL>
                                    <CATEGORY>SWTOOL</CATEGORY>
                                </ARTIFACT-DESCRIPTOR>
                                <USAGES>
                                    <USAGE>CODEGENERATION</USAGE>
                                </USAGES>
                            </DEPENDENCY-ON-ARTIFACT>
                        </GENERATED-ARTIFACTS>
                        <LINKERS>
                            <LINKER>
                                <SHORT-NAME>TASKING_LINK</SHORT-NAME>
                                <NAME>TASKING</NAME>
                                <OPTIONS>&quot;-t -d_mcal_pjt.lsl -D__CPU__=tc27x -Cmpe:vtc -Otxycl --error-limit=42 -M -mcrfiklsmnoduq -lc -lfp -lrt&quot;</OPTIONS>
                                <VENDOR>Tasking</VENDOR>
                                <VERSION>Tasking</VERSION>
                            </LINKER>
                            <LINKER>
                                <SHORT-NAME>DIAB_LINK</SHORT-NAME>
                                <NAME>DIAB</NAME>
                                <OPTIONS>&quot;-m6 &quot;_mcal_pjt.dld&quot; -lc&quot;</OPTIONS>
                                <VENDOR>WindRiver</VENDOR>
                                <VERSION>WindRiver</VERSION>
                            </LINKER>
                            <LINKER>
                                <SHORT-NAME>GNU_LINK</SHORT-NAME>
                                <NAME>GNU</NAME>
                                <OPTIONS>&quot;-T&quot;_mcal_pjt.ld&quot; -nostartfiles -Wl,--allow-multiple-definition -Wl,--cref -Wl,--oformat=elf32-tricore -Wl,--mcpu=tc161 -Wl,--mem-holes -Wl,--extmap=&quot;a&quot;&quot;</OPTIONS>
                                <VENDOR>Hightec</VENDOR>
                                <VERSION>Hightec</VERSION>
                            </LINKER>
                        </LINKERS>
                        <PROGRAMMING-LANGUAGE>C</PROGRAMMING-LANGUAGE>
                        <RESOURCE-CONSUMPTION>
                            <SHORT-NAME>ResourceConsumption</SHORT-NAME>
                            <MEMORY-SECTIONS>
                                <MEMORY-SECTION>
                                    <SHORT-NAME>DIO_CONST_8BIT</SHORT-NAME>
                                    <ALIGNMENT>8</ALIGNMENT>
                                    <SIZE>41</SIZE>
                                    <SW-ADDRMETHOD-REF DEST="SW-ADDR-METHOD">/AUTOSAR_MemMap/SwAddrMethods/CONST</SW-ADDRMETHOD-REF>
                                </MEMORY-SECTION>
                                <MEMORY-SECTION>
                                    <SHORT-NAME>DIO_CONST_16BIT</SHORT-NAME>
                                    <ALIGNMENT>16</ALIGNMENT>
                                    <SIZE>82</SIZE>
                                    <SW-ADDRMETHOD-REF DEST="SW-ADDR-METHOD">/AUTOSAR_MemMap/SwAddrMethods/CONST</SW-ADDRMETHOD-REF>
                                </MEMORY-SECTION>
                                <MEMORY-SECTION>
                                    <SHORT-NAME>DIO_VAR_32BIT</SHORT-NAME>
                                    <ALIGNMENT>32</ALIGNMENT>
                                    <SIZE>4</SIZE>
                                    <SW-ADDRMETHOD-REF DEST="SW-ADDR-METHOD">/AUTOSAR_MemMap/SwAddrMethods/VAR</SW-ADDRMETHOD-REF>
                                </MEMORY-SECTION>
                                <MEMORY-SECTION>
                                    <SHORT-NAME>DIO_CONST_32BIT</SHORT-NAME>
                                    <ALIGNMENT>32</ALIGNMENT>
                                    <SIZE>4</SIZE>
                                    <SW-ADDRMETHOD-REF DEST="SW-ADDR-METHOD">/AUTOSAR_MemMap/SwAddrMethods/CONST</SW-ADDRMETHOD-REF>
                                </MEMORY-SECTION>
                                <MEMORY-SECTION>
                                    <SHORT-NAME>DIO_CODE</SHORT-NAME>
                                    <ALIGNMENT>UNSPECIFIED</ALIGNMENT>
                                    <SIZE>1390</SIZE>
                                    <SW-ADDRMETHOD-REF DEST="SW-ADDR-METHOD">/AUTOSAR_MemMap/SwAddrMethods/CODE</SW-ADDRMETHOD-REF>
                                </MEMORY-SECTION>
                                <MEMORY-SECTION>
                                    <SHORT-NAME>DIO_VAR_8BIT</SHORT-NAME>
                                    <ALIGNMENT>8</ALIGNMENT>
                                    <SIZE>1</SIZE>
                                    <SW-ADDRMETHOD-REF DEST="SW-ADDR-METHOD">/AUTOSAR_MemMap/SwAddrMethods/VAR</SW-ADDRMETHOD-REF>
                                </MEMORY-SECTION>
                                <MEMORY-SECTION>
                                    <SHORT-NAME>DIO_POSTBUILDCFG</SHORT-NAME>
                                    <ALIGNMENT>UNSPECIFIED</ALIGNMENT>
                                    <SIZE>132</SIZE>
                                    <SW-ADDRMETHOD-REF DEST="SW-ADDR-METHOD">/AUTOSAR_MemMap/SwAddrMethods/CONFIG_DATA</SW-ADDRMETHOD-REF>
                                </MEMORY-SECTION>
                            </MEMORY-SECTIONS>
                            <SECTION-NAME-PREFIXS>
                                <SECTION-NAME-PREFIX>
                                    <SHORT-NAME>DIO</SHORT-NAME>
                                    <SYMBOL>DIO</SYMBOL>
                                </SECTION-NAME-PREFIX>
                            </SECTION-NAME-PREFIXS>
                        </RESOURCE-CONSUMPTION>
                        <SW-VERSION>0.0.0</SW-VERSION>
                        <VENDOR-ID>17</VENDOR-ID>
                        <AR-RELEASE-VERSION>4.0.3</AR-RELEASE-VERSION>
                        <BEHAVIOR-REF DEST="BSW-INTERNAL-BEHAVIOR">/AUTOSAR_Dio/BswModuleDescriptions/Dio/DioBehavior</BEHAVIOR-REF>
                        <VENDOR-SPECIFIC-MODULE-DEF-REFS>
                                <VENDOR-SPECIFIC-MODULE-DEF-REF DEST="ECUC-MODULE-DEF">/AURIX/Dio</VENDOR-SPECIFIC-MODULE-DEF-REF>
                        </VENDOR-SPECIFIC-MODULE-DEF-REFS>
                    </BSW-IMPLEMENTATION>
                </ELEMENTS>
            </AR-PACKAGE>
            <AR-PACKAGE>
                <SHORT-NAME>ImplementationDataTypes</SHORT-NAME>
                <CATEGORY>STANDARD</CATEGORY>
                <ELEMENTS>
                    <IMPLEMENTATION-DATA-TYPE>
                     <SHORT-NAME>Dio_ChannelType</SHORT-NAME>
                     <CATEGORY>TYPE_REFERENCE</CATEGORY>
                     <SW-DATA-DEF-PROPS>
                       <SW-DATA-DEF-PROPS-VARIANTS>
                         <SW-DATA-DEF-PROPS-CONDITIONAL>
                           <IMPLEMENTATION-DATA-TYPE-REF DEST="IMPLEMENTATION-DATA-TYPE">/AUTOSAR_Platform/ImplementationDataTypes/uint16</IMPLEMENTATION-DATA-TYPE-REF>
                         </SW-DATA-DEF-PROPS-CONDITIONAL>
                       </SW-DATA-DEF-PROPS-VARIANTS>
                     </SW-DATA-DEF-PROPS>
                     <TYPE-EMITTER>BSW</TYPE-EMITTER>
                    </IMPLEMENTATION-DATA-TYPE>
                    <IMPLEMENTATION-DATA-TYPE>
                     <SHORT-NAME>Dio_LevelType</SHORT-NAME>
                     <CATEGORY>TYPE_REFERENCE</CATEGORY>
                     <SW-DATA-DEF-PROPS>
                       <SW-DATA-DEF-PROPS-VARIANTS>
                         <SW-DATA-DEF-PROPS-CONDITIONAL>
                           <IMPLEMENTATION-DATA-TYPE-REF DEST="IMPLEMENTATION-DATA-TYPE">/AUTOSAR_Platform/ImplementationDataTypes/uint8</IMPLEMENTATION-DATA-TYPE-REF>
                         </SW-DATA-DEF-PROPS-CONDITIONAL>
                       </SW-DATA-DEF-PROPS-VARIANTS>
                     </SW-DATA-DEF-PROPS>
                     <TYPE-EMITTER>BSW</TYPE-EMITTER>
                    </IMPLEMENTATION-DATA-TYPE>
                    <IMPLEMENTATION-DATA-TYPE>
                     <SHORT-NAME>Dio_PortType</SHORT-NAME>
                     <CATEGORY>TYPE_REFERENCE</CATEGORY>
                     <SW-DATA-DEF-PROPS>
                       <SW-DATA-DEF-PROPS-VARIANTS>
                         <SW-DATA-DEF-PROPS-CONDITIONAL>
                           <IMPLEMENTATION-DATA-TYPE-REF DEST="IMPLEMENTATION-DATA-TYPE">/AUTOSAR_Platform/ImplementationDataTypes/uint8</IMPLEMENTATION-DATA-TYPE-REF>
                         </SW-DATA-DEF-PROPS-CONDITIONAL>
                       </SW-DATA-DEF-PROPS-VARIANTS>
                     </SW-DATA-DEF-PROPS>
                     <TYPE-EMITTER>BSW</TYPE-EMITTER>
                    </IMPLEMENTATION-DATA-TYPE>
                    <IMPLEMENTATION-DATA-TYPE>
                     <SHORT-NAME>Dio_PortLevelType</SHORT-NAME>
                     <CATEGORY>TYPE_REFERENCE</CATEGORY>
                     <SW-DATA-DEF-PROPS>
                       <SW-DATA-DEF-PROPS-VARIANTS>
                         <SW-DATA-DEF-PROPS-CONDITIONAL>
                           <IMPLEMENTATION-DATA-TYPE-REF DEST="IMPLEMENTATION-DATA-TYPE">/AUTOSAR_Platform/ImplementationDataTypes/uint16</IMPLEMENTATION-DATA-TYPE-REF>
                         </SW-DATA-DEF-PROPS-CONDITIONAL>
                       </SW-DATA-DEF-PROPS-VARIANTS>
                     </SW-DATA-DEF-PROPS>
                     <TYPE-EMITTER>BSW</TYPE-EMITTER>
                    </IMPLEMENTATION-DATA-TYPE>
                    <IMPLEMENTATION-DATA-TYPE>
                     <SHORT-NAME>Dio_ChannelGroupType</SHORT-NAME>
                     <CATEGORY>STRUCTURE</CATEGORY>
                     <SUB-ELEMENTS>
                       <IMPLEMENTATION-DATA-TYPE-ELEMENT>
                         <SHORT-NAME>Dio_PortLevelType</SHORT-NAME>
                       </IMPLEMENTATION-DATA-TYPE-ELEMENT>
                     </SUB-ELEMENTS>
                     <TYPE-EMITTER>BSW</TYPE-EMITTER>
                    </IMPLEMENTATION-DATA-TYPE>
                    <IMPLEMENTATION-DATA-TYPE>
                     <SHORT-NAME>Dio_ConfigType</SHORT-NAME>
                     <CATEGORY>STRUCTURE</CATEGORY>
                     <SUB-ELEMENTS>
                       <IMPLEMENTATION-DATA-TYPE-ELEMENT>
                         <SHORT-NAME>Dio_PortChannelIdType*</SHORT-NAME>
                       </IMPLEMENTATION-DATA-TYPE-ELEMENT>
                     </SUB-ELEMENTS>
                     <TYPE-EMITTER>BSW</TYPE-EMITTER>
                    </IMPLEMENTATION-DATA-TYPE>
                </ELEMENTS>
            </AR-PACKAGE>
            <AR-PACKAGE>
                <SHORT-NAME>CompuMethods</SHORT-NAME>
                <CATEGORY>STANDARD</CATEGORY>
                <ELEMENTS>
                </ELEMENTS>
            </AR-PACKAGE>
        </AR-PACKAGES>
    </AR-PACKAGE>
</AR-PACKAGES>
</AUTOSAR>
