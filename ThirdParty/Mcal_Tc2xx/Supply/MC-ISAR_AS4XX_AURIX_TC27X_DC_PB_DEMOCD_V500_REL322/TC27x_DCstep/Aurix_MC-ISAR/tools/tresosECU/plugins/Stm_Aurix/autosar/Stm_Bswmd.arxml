AUTOSAR XML (schema 4-0-3)
# Copyright (C) Infineon Technologies (2015)
# All rights reserved.
package /AURIX_Stm/BswModuleDescriptions
  bsw module description Stm: category=BSW_MODULE, module-id=255  # System timer
    provided-entrys:
      Stm_EnableModule
      Stm_EnableAlarm
      Stm_DisableAlarm
      Stm_SetCompareMatchControl
      Stm_ReadTimerValue
      Stm_ReadTotalTimerValue
      Stm_InterruptNodeSelection
      Stm_SetAccessEnable
      Stm_GetAccessEnable
      BswModuleEntrys/Stm_SleepModeHandle
      BswModuleEntrys/Stm_SleepModeHandle
      Stm_Isr
      Stm_TimerNotification
    bsw internal behavior StmBehavior
      static-memorys:
        data Stm_ModuleParameter: implementation-data-type=Stm_ModuleParameterType, type=Stm_ModuleParameterType
      12 x bsw called entity:
        Stm_EnableModule: implemented-entry=Stm_EnableModule
        Stm_EnableAlarm: implemented-entry=Stm_EnableAlarm
        Stm_DisableAlarm: implemented-entry=Stm_DisableAlarm
        Stm_SetCompareMatchControl: implemented-entry=Stm_SetCompareMatchControl
        Stm_ReadTimerValue: implemented-entry=Stm_ReadTimerValue
        Stm_ReadTotalTimerValue: implemented-entry=Stm_ReadTotalTimerValue
        Stm_InterruptNodeSelection: implemented-entry=Stm_InterruptNodeSelection
        Stm_SetAccessEnable: implemented-entry=Stm_SetAccessEnable
        Stm_GetAccessEnable: implemented-entry=Stm_GetAccessEnable
        Stm_SleepModeHandle: implemented-entry=BswModuleEntrys/Stm_SleepModeHandle
        Stm_SleepModeHandle: implemented-entry=BswModuleEntrys/Stm_SleepModeHandle
        Stm_TimerNotification: implemented-entry=Stm_TimerNotification
      bsw interrupt entity Stm_Isr: implemented-entry=Stm_Isr, interrupt-category=CAT-1, interrupt-source=SRC_STMx_SRy
package /AURIX_Stm/BswModuleEntrys
  13 x bsw module entry, all with is-synchronous=true:
    Stm_EnableModule: service-id=0, is-reentrant=false, call-type=REGULAR, execution-context=UNSPECIFIED, sw-service-impl-policy=STANDARD
      sw service arg ModuleNumber: implementation-data-type=uint8
    Stm_EnableAlarm: service-id=1, is-reentrant=false, call-type=REGULAR, execution-context=UNSPECIFIED, sw-service-impl-policy=STANDARD
      5 x sw service arg:
        ModuleNumber: implementation-data-type=uint8
        CompareRegisterId: implementation-data-type=uint8
        TimerMode: implementation-data-type=uint8
        Ticks: implementation-data-type=uint32
        Stm_Applicationfunction: implementation-data-type=Stm_CallbackFnPtrType
    Stm_DisableAlarm: service-id=2, is-reentrant=false, call-type=REGULAR, execution-context=UNSPECIFIED, sw-service-impl-policy=STANDARD
      sw service arg ModuleNumber: implementation-data-type=uint8
      sw service arg CompareRegisterId: implementation-data-type=uint8
    Stm_SetCompareMatchControl: service-id=3, is-reentrant=false, call-type=REGULAR, execution-context=UNSPECIFIED, sw-service-impl-policy=STANDARD
      4 x sw service arg, all with implementation-data-type=uint8:
        ModuleNumber
        CompareRegisterId
        Mstart
        Msize
    Stm_ReadTimerValue: service-id=4, is-reentrant=false, call-type=REGULAR, execution-context=UNSPECIFIED, sw-service-impl-policy=STANDARD
      return type Return: implementation-data-type=uint32
      sw service arg ModuleNumber: implementation-data-type=uint8
      sw service arg TimerNumber: implementation-data-type=uint8
    Stm_ReadTotalTimerValue: service-id=5, is-reentrant=false, call-type=REGULAR, execution-context=UNSPECIFIED, sw-service-impl-policy=STANDARD
      return type Return: implementation-data-type=Stm_TotalTimerCaptureType
      sw service arg ModuleNumber: implementation-data-type=uint8
    Stm_InterruptNodeSelection: service-id=6, is-reentrant=false, call-type=REGULAR, execution-context=UNSPECIFIED, sw-service-impl-policy=STANDARD
      sw service arg ModuleNumber: implementation-data-type=uint8
      sw service arg CompareRegisterId: implementation-data-type=uint8
      sw service arg InterruptNodeNum: implementation-data-type=uint8
    Stm_SetAccessEnable: service-id=7, is-reentrant=false, call-type=REGULAR, execution-context=UNSPECIFIED, sw-service-impl-policy=STANDARD
      sw service arg ModuleNumber: implementation-data-type=uint8
      sw service arg WriteAccessValue: implementation-data-type=uint32
    Stm_GetAccessEnable: service-id=8, is-reentrant=false, call-type=REGULAR, execution-context=UNSPECIFIED, sw-service-impl-policy=STANDARD
      return type Return: implementation-data-type=uint32
      sw service arg ModuleNumber: implementation-data-type=uint8
    Stm_SleepModeHandle: service-id=9, is-reentrant=false, call-type=REGULAR, execution-context=UNSPECIFIED, sw-service-impl-policy=STANDARD
      sw service arg ModuleNumber: implementation-data-type=uint8
      sw service arg SleemodeControl: implementation-data-type=uint8
    Stm_SleepModeHandle: service-id=11, is-reentrant=false, call-type=REGULAR, execution-context=UNSPECIFIED, sw-service-impl-policy=MACRO
      sw service arg VersionInfoPtr: category=DATA_REFERENCE, sw-pointer-target-props={target-category=TYPE_REFERENCE, implementation-data-type=Std_VersionInfoType}
    Stm_Isr: service-id=10, is-reentrant=true, call-type=INTERRUPT, execution-context=INTERRUPT-CAT-1, sw-service-impl-policy=STANDARD
      sw service arg ModuleNumber: implementation-data-type=uint8
      sw service arg InterruptNode: implementation-data-type=uint8
    Stm_TimerNotification: service-id=255, is-reentrant=true, call-type=REGULAR, execution-context=INTERRUPT-CAT-1, sw-service-impl-policy=STANDARD
package /AURIX_Stm/Implementations
  bsw implementation Stm: programming-language=C, sw-version=0.0.0, vendor-id=17, ar-release-version=4.0.3, behavior=StmBehavior, vendor-specific-module-def=Stm
    code-descriptors:
      code Files
        artifact-descriptors:
          short-label=ssc::src::Stm.c, category=SWSRC
          short-label=ssc::inc::Stm.h, category=SWHDR
          short-label=irq_infineon_tricore::ssc::src::Stm_Irq.c, category=SWSRC
          short-label=ssc::mak::infineon_stm_cfg.mak, category=SWMAKE
          short-label=ssc::mak::infineon_stm_check.mak, category=SWMAKE
          short-label=ssc::mak::infineon_stm_defs.mak, category=SWMAKE
          short-label=ssc::mak::infineon_stm_rules.mak, category=SWMAKE
    compiler TASKING_COMPILE: name=TASKING, options="-c --core=tc1.6.x -t -Wa-gAHLs --emit-locals=-equ,-symbols -Wa-Ogs -Wa--error-limit=42 --iso=90 --eabi-compliant --integer-enumeration --language=-comments,-gcc,+volatile,-strings --switch=auto --align=0 --default-near-size=0 --default-a0-size=0 --default-a1-size=0 -O2ROPYG --tradeoff=4 -g --source -D_TASKING_C_TRICORE_=1 $(CALLFUNCTION)", vendor=Tasking, version=Tasking
    compiler DIAB_COMPILE: name=DIAB, options="-c -tTC27xAstep16PMG:cross -Xdialect-c89 -Xno-common -Xalign-functions=4 -Xfp-fast -Xsection-split=1 -Xkeep-assembly-file=2 -g3 -ew4084 -ei4177,4550,4549,4068,5388 -XO -D_DIABDATA_C_TRICORE_=1 $(CALLFUNCTION)", vendor=WindRiver, version=WindRiver
    compiler GNU_COMPILE:
      name=GNU
      options="-c -save-temps=obj -std=iso9899:1990 -ansi -fno-asm -ffreestanding -Wundef -Wp,-std=iso9899:1990 -fno-short-enums -fpeel-loops -falign-functions=4 -frecord-gcc-switches -fsection-anchors -funsigned-bitfields -ffunction-sections -fno-ivopts -fno-peephole2 -nostartfiles -O3 -g3 -W -Wall -Wuninitialized -DTRIBOARD_TC27XX -mcpu=tc27xx -D_GNU_C_TRICORE_=1 $(CALLFUNCTION)"
      vendor=Hightec
      version=Hightec
    linker TASKING_LINK: name=TASKING, options="-t -d_mcal_pjt.lsl -D__CPU__=tc27x -Cmpe:vtc -Otxycl --error-limit=42 -M -mcrfiklsmnoduq -lc -lfp -lrt", vendor=Tasking, version=Tasking
    linker DIAB_LINK: name=DIAB, options="-m6 "_mcal_pjt.dld" -lc", vendor=WindRiver, version=WindRiver
    linker GNU_LINK: name=GNU, options="-T"_mcal_pjt.ld" -nostartfiles -Wl,--allow-multiple-definition -Wl,--cref -Wl,--oformat=elf32-tricore -Wl,--mcpu=tc161 -Wl,--mem-holes -Wl,--extmap="a"", vendor=Hightec, version=Hightec
    resource consumption ResourceConsumption
      memory section STM_VAR_32BIT: alignment=32, size=84, sw-addrmethod=VAR
      memory section STM_CODE: alignment=UNSPECIFIED, size=654, sw-addrmethod=CODE
      section name prefix STM
package /AURIX_Stm/ImplementationDataTypes
  impl type Stm_ModuleParameterType: category=STRUCTURE, type-emitter=BSW
    element uint32
  impl type Stm_TotalTimerCaptureType: category=STRUCTURE, type-emitter=BSW
    element uint32
  impl type Stm_CallbackFnPtrType: category=FUNCTION_REFERENCE, sw-pointer-target-props=function-pointer-signature=Stm_TimerNotification, type-emitter=BSW
