AUTOSAR XML (schema 4-2-1)
package /COM/VECTOR/CFG/WORKFLOW/SYSDESC/SYNC
  flat map FLATMAP
    flat instance descriptor disc_ecu: upstream-reference=ECU_Composition.disc_ecu, ecu-extract-reference=COMPOSITIONTYPE.disc_ecu
