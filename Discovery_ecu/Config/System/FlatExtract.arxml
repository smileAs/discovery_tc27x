AUTOSAR XML (schema 4-3-0)
package /COM/VECTOR/CFG/WORKFLOW/SYSDESC/SYNC
  system SYSTEM
    system mapping MAPPINGS
    root-software-compositions:
      root sw composition prototype COMPOSITIONTYPE: flat-map=FLATMAP, software-composition=COMPOSITIONTYPE
  composition sw component type COMPOSITIONTYPE  # UB:Derived from original system description
    9 x component:
      BswM: type=BswM
      EcuM: type=EcuM
      Os_OsCore_Core{0..2}_swc: type=Os_OsCore_Core{0..2}_swc
      disc_ecu: type=disc_ecu
      ComM: type=ComM
      Dcm: type=Dcm
      Cycle_Task_1ms: type=cycle_task
    connect BswM.Switch_ESH_ModeSwitch -> BswM.Notification_ESH_ModeNotification
  end to end protection set E2EPROTECTIONSET
  port interface mapping set PORTINTERFACEMAPPINGSET
