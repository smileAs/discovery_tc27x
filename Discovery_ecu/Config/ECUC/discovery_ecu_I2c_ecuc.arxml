AUTOSAR XML (schema 4-2-1)
package /ActiveEcuC
  module config I2c: implementation-config-variant=VARIANT-POST-BUILD-LOADABLE
    I2cGeneral:
      I2cDevErrorDetect = false
      I2cVersionInfoApi = true
      I2cHwStatusApi = true
      I2cPBFixedAddress = false
      I2cAsyncReadWrite = true
      I2cResetSfrAtInit = false
      I2cAsyncNotification = false
      I2cCancelApi = true
      I2cRunningInUser0Mode = false
      I2cUserModeDeInitApiEnable = false
      I2cUserModeInitApiEnable = false
      I2cUserModeRuntimeApiEnable = false
    I2cHwConfiguration: I2cCommunicationType=SYNCHRONOUS, I2cSleepEnable=false
    I2cDriver: I2cMaxPacket=0, I2cSystemClock=McuClockReferencePoint
      I2c_Packet_AccX (I2cPacket): I2cPacketId=1, I2cPacketAddress=2, I2cPacketLength=2, I2cPacketEndNotification=NULL_PTR, I2cDeviceAssignment=I2c_Smi130_Acc
      3 x I2cExternalDevice, all with I2cSpeed=STANDARD_MODE, I2cAddressingMode=ADDRESSING_MODE_7_BIT, I2cPortSelect=SDA_SCL_0_B, I2cRmc=1, I2cSdaDelayStageDataHoldTime=0, I2cSclDelayStageHoldTimeStartBit=0, I2cSetFastModeSclLowPerTime=false, I2cEnCfgFastModeSclLowLength=false, I2cFastModeSclLowLength=0:
        I2c_Mcp79411_Rtc: I2cExternalDeviceAddress=111, I2cFractionalDividerDec=64, I2cFractionalDividerInc=16
        I2c_Smi130_Acc: I2cExternalDeviceAddress=48, I2cFractionalDividerDec=232, I2cFractionalDividerInc=1
        I2c_Smi130_Gyro: I2cExternalDeviceAddress=208, I2cFractionalDividerDec=232, I2cFractionalDividerInc=1
      5 x I2cPacket, all with I2cPacketLength=2, I2cPacketEndNotification=NULL_PTR:
        I2c_Packet_AccY: I2cPacketId=2, I2cPacketAddress=4, I2cDeviceAssignment=I2c_Smi130_Acc
        I2c_Packet_AccZ: I2cPacketId=3, I2cPacketAddress=6, I2cDeviceAssignment=I2c_Smi130_Acc
        I2c_Packet_GyroY: I2cPacketId=5, I2cPacketAddress=4, I2cDeviceAssignment=I2c_Smi130_Gyro
        I2c_Packet_GyroZ: I2cPacketId=6, I2cPacketAddress=6, I2cDeviceAssignment=I2c_Smi130_Gyro
        I2c_Packet_GyroX: I2cPacketId=4, I2cPacketAddress=2, I2cDeviceAssignment=I2c_Smi130_Gyro
    I2cPublishedInformation: I2cMaxHwUnit=1
    CommonPublishedInformation:
      ArMajorVersion = 0
      ArMinorVersion = 0
      ArPatchVersion = 0
      SwMajorVersion = 1
      SwMinorVersion = 1
      SwPatchVersion = 0
      ModuleId = 255
      VendorId = 17
      VendorApiInfix = 
      Release = _TRICORE_TC277
