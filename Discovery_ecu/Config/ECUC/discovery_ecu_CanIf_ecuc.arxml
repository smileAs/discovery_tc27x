AUTOSAR XML (schema 4-2-1)
package /ActiveEcuC
  module config CanIf: implementation-config-variant=VARIANT-PRE-COMPILE, module-description=CanIf_Impl
    CanIfDispatchCfg:
      CanIfDispatchUserCtrlBusOffName = CanSM_ControllerBusOff
      CanIfDispatchUserCtrlBusOffUL = CAN_SM
      CanIfDispatchUserCtrlModeIndicationName = CanSM_ControllerModeIndication
      CanIfDispatchUserCtrlModeIndicationUL = CAN_SM
      CanIfDispatchUserTrcvModeIndicationUL = CAN_SM
      CanIfDispatchUserTrcvModeIndicationName = CanSM_TransceiverModeIndication
    CanIfInitCfg
      CanIfInitHohCfg: CanIfInitRefCfgSet=CanConfigSet
        CN_CAN00_388e5969_Rx_Std (CanIfHrhCfg): CanIfHrhSoftwareFilter=true, CanIfHrhCanCtrlIdRef=CT_CAN00_388e5969, CanIfHrhIdSymRef=CN_CAN00_388e5969_Rx_Std
        CN_CAN00_388e5969_Tx_Std (CanIfHthCfg): CanIfHthCanCtrlIdRef=CT_CAN00_388e5969, CanIfHthIdSymRef=CN_CAN00_388e5969_Tx_Std
        CN_CAN01_388e5969_Rx_Std (CanIfHrhCfg): CanIfHrhSoftwareFilter=true, CanIfHrhCanCtrlIdRef=CT_CAN01_388e5969, CanIfHrhIdSymRef=CN_CAN01_388e5969_Rx_Std
        CN_CAN01_388e5969_Tx_Std (CanIfHthCfg): CanIfHthCanCtrlIdRef=CT_CAN01_388e5969, CanIfHthIdSymRef=CN_CAN01_388e5969_Tx_Std
        CN_CAN02_388e5969_Tx_Std (CanIfHthCfg): CanIfHthCanCtrlIdRef=CT_CAN02_388e5969, CanIfHthIdSymRef=CN_CAN02_388e5969_Tx_Std
        CN_CAN02_388e5969_Rx_Std (CanIfHrhCfg): CanIfHrhSoftwareFilter=true, CanIfHrhCanCtrlIdRef=CT_CAN02_388e5969, CanIfHrhIdSymRef=CN_CAN02_388e5969_Rx_Std
        CanIfHrh_CN_CAN01_Rx_Std_Extended (CanIfHrhCfg): CanIfHrhSoftwareFilter=true, CanIfHrhCanCtrlIdRef=CT_CAN01_388e5969, CanIfHrhIdSymRef=CanHardware_CN_CAN01_Rx_Std_Extended
      DIAG_FuncReq_HSC2_oCAN00_Rx_3abd61be (CanIfRxPduCfg):
        CanIfRxPduCanId = 2015
        CanIfRxPduCanIdType = STANDARD_CAN
        CanIfRxPduDlc = 8
        CanIfRxPduUserRxIndicationName = CanTp_RxIndication
        CanIfRxPduUserRxIndicationUL = CAN_TP
        CanIfRxPduId = 0
        CanIfRxPduReadData = false
        CanIfRxPduReadNotifyStatus = false
        CanIfRxPduDlcCheck = true
        CanIfRxPduUserRxIndicationType = PDUID_PDUINFOPTR
        CanIfRxPduHrhIdRef = CN_CAN00_388e5969_Rx_Std
        CanIfRxPduRef = diag_request_tp_rx_functional_address
      CanIfBufferCfg_Tx_Std_0fb271d2 (CanIfBufferCfg):  # CHNL
        CanIfBufferSize = 9
        CanIfTxBufferHandlingType = PRIO_BY_CANID
        CanIfTxBufferMappedTxPdus = 9
        CanIfTxBufferMaxPduLength = 8
        CanIfBufferHthRef = CN_CAN00_388e5969_Tx_Std
      GW_HSC2_FrP00_oCAN00_Rx_3abd61be (CanIfRxPduCfg):
        CanIfRxPduCanId = 361
        CanIfRxPduCanIdType = STANDARD_CAN
        CanIfRxPduDlc = 6
        CanIfRxPduUserRxIndicationName = PduR_CanIfRxIndication
        CanIfRxPduUserRxIndicationUL = PDUR
        CanIfRxPduId = 29
        CanIfRxPduReadData = false
        CanIfRxPduReadNotifyStatus = false
        CanIfRxPduDlcCheck = true
        CanIfRxPduHrhIdRef = CN_CAN00_388e5969_Rx_Std
        CanIfRxPduRef = PT_GW_HSC2_FrP00_PP_GW_HSC2_FrP00_Rx_0fb271d2_c07658fd
      SCS_HSC2_FrP15_oCAN00_Rx_3abd61be (CanIfRxPduCfg):
        CanIfRxPduCanId = 851
        CanIfRxPduCanIdType = STANDARD_CAN
        CanIfRxPduDlc = 8
        CanIfRxPduUserRxIndicationName = PduR_CanIfRxIndication
        CanIfRxPduUserRxIndicationUL = PDUR
        CanIfRxPduId = 9
        CanIfRxPduReadData = false
        CanIfRxPduReadNotifyStatus = false
        CanIfRxPduDlcCheck = true
        CanIfRxPduHrhIdRef = CN_CAN00_388e5969_Rx_Std
        CanIfRxPduRef = PT_SCS_HSC2_FrP15_PP_SCS_HSC2_FrP15_Rx_0fb271d2_c07658fd
      P2P_DIAG_DTCInfo_APA_oCAN00_Tx_3abd61be (CanIfTxPduCfg):
        CanIfTxPduCanId = 1945
        CanIfTxPduCanIdType = STANDARD_CAN
        CanIfTxPduDlc = 7
        CanIfTxPduUserTxConfirmationName = NULL_PTR
        CanIfTxPduUserTxConfirmationUL = NONE
        CanIfTxPduId = 1
        CanIfTxPduReadNotifyStatus = false
        CanIfTxPduType = STATIC
        CanIfTxPduBufferRef = CanIfBufferCfg_Tx_Std_0fb271d2
        CanIfTxPduRef = PT_P2P_DIAG_DTCInfo_APA_PP_P2P_DIAG_DTCInfo_APA_Tx_0fb271d2_c07658fd
      GW_HSC2_FICM_FrP02_oCAN00_Rx_3abd61be (CanIfRxPduCfg):
        CanIfRxPduCanId = 886
        CanIfRxPduCanIdType = STANDARD_CAN
        CanIfRxPduDlc = 8
        CanIfRxPduUserRxIndicationName = PduR_CanIfRxIndication
        CanIfRxPduUserRxIndicationUL = PDUR
        CanIfRxPduId = 8
        CanIfRxPduReadData = false
        CanIfRxPduReadNotifyStatus = false
        CanIfRxPduDlcCheck = true
        CanIfRxPduHrhIdRef = CN_CAN00_388e5969_Rx_Std
        CanIfRxPduRef = PT_GW_HSC2_FICM_FrP02_PP_GW_HSC2_FICM_FrP02_Rx_0fb271d2_c07658fd
      P2P_HSC2_FrS01_oCAN00_Tx_3abd61be (CanIfTxPduCfg):
        CanIfTxPduCanId = 1538
        CanIfTxPduCanIdType = STANDARD_CAN
        CanIfTxPduDlc = 8
        CanIfTxPduUserTxConfirmationName = NULL_PTR
        CanIfTxPduUserTxConfirmationUL = NONE
        CanIfTxPduId = 3
        CanIfTxPduReadNotifyStatus = false
        CanIfTxPduType = STATIC
        CanIfTxPduBufferRef = CanIfBufferCfg_Tx_Std_0fb271d2
        CanIfTxPduRef = PT_P2P_HSC2_FrS01_PP_P2P_HSC2_FrS01_Tx_0fb271d2_c07658fd
      EHBS_HSC2_FrP00_oCAN00_Rx_3abd61be (CanIfRxPduCfg):
        CanIfRxPduCanId = 438
        CanIfRxPduCanIdType = STANDARD_CAN
        CanIfRxPduDlc = 8
        CanIfRxPduUserRxIndicationName = PduR_CanIfRxIndication
        CanIfRxPduUserRxIndicationUL = PDUR
        CanIfRxPduId = 21
        CanIfRxPduReadData = false
        CanIfRxPduReadNotifyStatus = false
        CanIfRxPduDlcCheck = true
        CanIfRxPduHrhIdRef = CN_CAN00_388e5969_Rx_Std
        CanIfRxPduRef = PT_EHBS_HSC2_FrP00_PP_EHBS_HSC2_FrP00_Rx_0fb271d2_c07658fd
      SCS_HSC2_FrP00_oCAN00_Rx_3abd61be (CanIfRxPduCfg):
        CanIfRxPduCanId = 193
        CanIfRxPduCanIdType = STANDARD_CAN
        CanIfRxPduDlc = 8
        CanIfRxPduUserRxIndicationName = PduR_CanIfRxIndication
        CanIfRxPduUserRxIndicationUL = PDUR
        CanIfRxPduId = 33
        CanIfRxPduReadData = false
        CanIfRxPduReadNotifyStatus = false
        CanIfRxPduDlcCheck = true
        CanIfRxPduHrhIdRef = CN_CAN00_388e5969_Rx_Std
        CanIfRxPduRef = PT_SCS_HSC2_FrP00_PP_SCS_HSC2_FrP00_Rx_0fb271d2_c07658fd
      DIAG_DTCInfo_P2P_oCAN00_Tx_3abd61be (CanIfTxPduCfg):
        CanIfTxPduCanId = 1950
        CanIfTxPduCanIdType = STANDARD_CAN
        CanIfTxPduDlc = 7
        CanIfTxPduUserTxConfirmationName = NULL_PTR
        CanIfTxPduUserTxConfirmationUL = NONE
        CanIfTxPduId = 0
        CanIfTxPduReadNotifyStatus = false
        CanIfTxPduType = STATIC
        CanIfTxPduBufferRef = CanIfBufferCfg_Tx_Std_0fb271d2
        CanIfTxPduRef = PT_DIAG_DTCInfo_P2P_PP_DIAG_DTCInfo_P2P_Tx_0fb271d2_c07658fd
      GW_HSC2_SCU_FrP00_oCAN00_Rx_3abd61be (CanIfRxPduCfg):
        CanIfRxPduCanId = 157
        CanIfRxPduCanIdType = STANDARD_CAN
        CanIfRxPduDlc = 8
        CanIfRxPduUserRxIndicationName = PduR_CanIfRxIndication
        CanIfRxPduUserRxIndicationUL = PDUR
        CanIfRxPduId = 35
        CanIfRxPduReadData = false
        CanIfRxPduReadNotifyStatus = false
        CanIfRxPduDlcCheck = true
        CanIfRxPduHrhIdRef = CN_CAN00_388e5969_Rx_Std
        CanIfRxPduRef = PT_GW_HSC2_SCU_FrP00_PP_GW_HSC2_SCU_FrP00_Rx_0fb271d2_c07658fd
      P2P_HSC2_FrP04_oCAN00_Tx_3abd61be (CanIfTxPduCfg):
        CanIfTxPduCanId = 567
        CanIfTxPduCanIdType = STANDARD_CAN
        CanIfTxPduDlc = 8
        CanIfTxPduUserTxConfirmationName = NULL_PTR
        CanIfTxPduUserTxConfirmationUL = NONE
        CanIfTxPduId = 6
        CanIfTxPduReadNotifyStatus = false
        CanIfTxPduType = STATIC
        CanIfTxPduBufferRef = CanIfBufferCfg_Tx_Std_0fb271d2
        CanIfTxPduRef = PT_P2P_HSC2_FrP04_PP_P2P_HSC2_FrP04_Tx_0fb271d2_c07658fd
      5 x CanIfRxPduCfg, all with CanIfRxPduCanIdType=STANDARD_CAN, CanIfRxPduUserRxIndicationName=PduR_CanIfRxIndication, CanIfRxPduUserRxIndicationUL=PDUR, CanIfRxPduReadData=false, CanIfRxPduReadNotifyStatus=false, CanIfRxPduDlcCheck=true, CanIfRxPduHrhIdRef=CN_CAN00_388e5969_Rx_Std:
        GW_HSC2_FrP01_oCAN00_Rx_3abd61be: CanIfRxPduCanId=497, CanIfRxPduDlc=8, CanIfRxPduId=17, CanIfRxPduRef=PT_GW_HSC2_FrP01_PP_GW_HSC2_FrP01_Rx_0fb271d2_c07658fd
        SCS_HSC2_FrP02_oCAN00_Rx_3abd61be: CanIfRxPduCanId=389, CanIfRxPduDlc=4, CanIfRxPduId=28, CanIfRxPduRef=PT_SCS_HSC2_FrP02_PP_SCS_HSC2_FrP02_Rx_0fb271d2_c07658fd
        SCS_HSC2_FrP01_oCAN00_Rx_3abd61be: CanIfRxPduCanId=197, CanIfRxPduDlc=8, CanIfRxPduId=32, CanIfRxPduRef=PT_SCS_HSC2_FrP01_PP_SCS_HSC2_FrP01_Rx_0fb271d2_c07658fd
        GW_HSC2_HCU_FrP00_oCAN00_Rx_3abd61be: CanIfRxPduCanId=175, CanIfRxPduDlc=8, CanIfRxPduId=34, CanIfRxPduRef=PT_GW_HSC2_HCU_FrP00_PP_GW_HSC2_HCU_FrP00_Rx_0fb271d2_c07658fd
        SCS_HSC2_FrP03_oCAN00_Rx_3abd61be: CanIfRxPduCanId=455, CanIfRxPduDlc=8, CanIfRxPduId=20, CanIfRxPduRef=PT_SCS_HSC2_FrP03_PP_SCS_HSC2_FrP03_Rx_0fb271d2_c07658fd
      DIAG_PhysResp_P2P_oCAN00_Tx_3abd61be (CanIfTxPduCfg):
        CanIfTxPduCanId = 1854
        CanIfTxPduCanIdType = STANDARD_CAN
        CanIfTxPduDlc = 8
        CanIfTxPduUserTxConfirmationName = CanTp_TxConfirmation
        CanIfTxPduUserTxConfirmationUL = CAN_TP
        CanIfTxPduId = 2
        CanIfTxPduReadNotifyStatus = false
        CanIfTxPduType = STATIC
        CanIfTxPduBufferRef = CanIfBufferCfg_Tx_Std_0fb271d2
        CanIfTxPduRef = diag_response_tp_tx
      P2P_HSC2_FrP02_oCAN00_Tx_3abd61be (CanIfTxPduCfg):
        CanIfTxPduCanId = 966
        CanIfTxPduCanIdType = STANDARD_CAN
        CanIfTxPduDlc = 8
        CanIfTxPduUserTxConfirmationName = NULL_PTR
        CanIfTxPduUserTxConfirmationUL = NONE
        CanIfTxPduId = 4
        CanIfTxPduReadNotifyStatus = false
        CanIfTxPduType = STATIC
        CanIfTxPduBufferRef = CanIfBufferCfg_Tx_Std_0fb271d2
        CanIfTxPduRef = PT_P2P_HSC2_FrP02_PP_P2P_HSC2_FrP02_Tx_0fb271d2_c07658fd
      GW_HSC2_HCU_FrP01_oCAN00_Rx_3abd61be (CanIfRxPduCfg):
        CanIfRxPduCanId = 406
        CanIfRxPduCanIdType = STANDARD_CAN
        CanIfRxPduDlc = 8
        CanIfRxPduUserRxIndicationName = PduR_CanIfRxIndication
        CanIfRxPduUserRxIndicationUL = PDUR
        CanIfRxPduId = 26
        CanIfRxPduReadData = false
        CanIfRxPduReadNotifyStatus = false
        CanIfRxPduDlcCheck = true
        CanIfRxPduHrhIdRef = CN_CAN00_388e5969_Rx_Std
        CanIfRxPduRef = PT_GW_HSC2_HCU_FrP01_PP_GW_HSC2_HCU_FrP01_Rx_0fb271d2_c07658fd
      3 x CanIfTxPduCfg, all with CanIfTxPduCanIdType=STANDARD_CAN, CanIfTxPduUserTxConfirmationName=NULL_PTR, CanIfTxPduUserTxConfirmationUL=NONE, CanIfTxPduReadNotifyStatus=false, CanIfTxPduType=STATIC, CanIfTxPduBufferRef=CanIfBufferCfg_Tx_Std_0fb271d2:
        P2P_HSC2_FrP03_oCAN00_Tx_3abd61be: CanIfTxPduCanId=573, CanIfTxPduDlc=8, CanIfTxPduId=5, CanIfTxPduRef=PT_P2P_HSC2_FrP03_PP_P2P_HSC2_FrP03_Tx_0fb271d2_c07658fd
        P2P_HSC2_FrP01_oCAN00_Tx_3abd61be: CanIfTxPduCanId=437, CanIfTxPduDlc=8, CanIfTxPduId=7, CanIfTxPduRef=PT_P2P_HSC2_FrP01_PP_P2P_HSC2_FrP01_Tx_0fb271d2_c07658fd
        P2P_HSC2_FrP00_oCAN00_Tx_3abd61be: CanIfTxPduCanId=424, CanIfTxPduDlc=6, CanIfTxPduId=8, CanIfTxPduRef=PT_P2P_HSC2_FrP00_PP_P2P_HSC2_FrP00_Tx_0fb271d2_c07658fd
      23 x CanIfRxPduCfg, all with CanIfRxPduCanIdType=STANDARD_CAN, CanIfRxPduReadData=false, CanIfRxPduReadNotifyStatus=false, CanIfRxPduDlcCheck=true, CanIfRxPduHrhIdRef=CN_CAN00_388e5969_Rx_Std:
        GW_HSC2_FrP08_oCAN00_Rx_3abd61be: CanIfRxPduCanId=1344, CanIfRxPduDlc=8, CanIfRxPduUserRxIndicationName=PduR_CanIfRxIndication, CanIfRxPduUserRxIndicationUL=PDUR, CanIfRxPduId=5, CanIfRxPduRef=PT_GW_HSC2_FrP08_PP_GW_HSC2_FrP08_Rx_0fb271d2_c07658fd
        GW_HSC2_FrP10_oCAN00_Rx_3abd61be: CanIfRxPduCanId=1009, CanIfRxPduDlc=8, CanIfRxPduUserRxIndicationName=PduR_CanIfRxIndication, CanIfRxPduUserRxIndicationUL=PDUR, CanIfRxPduId=7, CanIfRxPduRef=PT_GW_HSC2_FrP10_PP_GW_HSC2_FrP10_Rx_0fb271d2_c07658fd
        SCS_HSC2_FrP05_oCAN00_Rx_3abd61be: CanIfRxPduCanId=489, CanIfRxPduDlc=8, CanIfRxPduUserRxIndicationName=PduR_CanIfRxIndication, CanIfRxPduUserRxIndicationUL=PDUR, CanIfRxPduId=18, CanIfRxPduRef=PT_SCS_HSC2_FrP05_PP_SCS_HSC2_FrP05_Rx_0fb271d2_c07658fd
        Tester_HSC2_ECM_FrP00_oCAN00_Rx_3abd61be: CanIfRxPduCanId=201, CanIfRxPduDlc=8, CanIfRxPduUserRxIndicationName=PduR_CanIfRxIndication, CanIfRxPduUserRxIndicationUL=PDUR, CanIfRxPduId=31, CanIfRxPduRef=PT_Tester_HSC2_ECM_FrP00_PP_Tester_HSC2_ECM_FrP00_Rx_0fb271d2_c07658fd
        GW_HSC2_HCU_FrP13_oCAN00_Rx_3abd61be: CanIfRxPduCanId=412, CanIfRxPduDlc=8, CanIfRxPduUserRxIndicationName=PduR_CanIfRxIndication, CanIfRxPduUserRxIndicationUL=PDUR, CanIfRxPduId=25, CanIfRxPduRef=PT_GW_HSC2_HCU_FrP13_PP_GW_HSC2_HCU_FrP13_Rx_0fb271d2_c07658fd
        GW_HSC2_FICM_FrP08_oCAN00_Rx_3abd61be: CanIfRxPduCanId=758, CanIfRxPduDlc=8, CanIfRxPduUserRxIndicationName=PduR_CanIfRxIndication, CanIfRxPduUserRxIndicationUL=PDUR, CanIfRxPduId=12, CanIfRxPduRef=PT_GW_HSC2_FICM_FrP08_PP_GW_HSC2_FICM_FrP08_Rx_0fb271d2_c07658fd
        GW_HSC2_ECM_FrP04_oCAN00_Rx_3abd61be: CanIfRxPduCanId=404, CanIfRxPduDlc=8, CanIfRxPduUserRxIndicationName=PduR_CanIfRxIndication, CanIfRxPduUserRxIndicationUL=PDUR, CanIfRxPduId=27, CanIfRxPduRef=PT_GW_HSC2_ECM_FrP04_PP_GW_HSC2_ECM_FrP04_Rx_0fb271d2_c07658fd
        SCS_HSC2_FrP11_oCAN00_Rx_3abd61be: CanIfRxPduCanId=840, CanIfRxPduDlc=8, CanIfRxPduUserRxIndicationName=PduR_CanIfRxIndication, CanIfRxPduUserRxIndicationUL=PDUR, CanIfRxPduId=11, CanIfRxPduRef=PT_SCS_HSC2_FrP11_PP_SCS_HSC2_FrP11_Rx_0fb271d2_c07658fd
        DIAG_PhysReq_P2P_oCAN00_Rx_3abd61be: CanIfRxPduCanId=1846, CanIfRxPduDlc=8, CanIfRxPduUserRxIndicationName=CanTp_RxIndication, CanIfRxPduUserRxIndicationUL=CAN_TP, CanIfRxPduId=1, CanIfRxPduUserRxIndicationType=PDUID_PDUINFOPTR, CanIfRxPduRef=diag_request_tp_rx_physical_address
        GW_HSC2_FrP13_oCAN00_Rx_3abd61be: CanIfRxPduCanId=425, CanIfRxPduDlc=8, CanIfRxPduUserRxIndicationName=PduR_CanIfRxIndication, CanIfRxPduUserRxIndicationUL=PDUR, CanIfRxPduId=24, CanIfRxPduRef=PT_GW_HSC2_FrP13_PP_GW_HSC2_FrP13_Rx_0fb271d2_c07658fd
        EPB_HSC2_FrP01_oCAN00_Rx_3abd61be: CanIfRxPduCanId=554, CanIfRxPduDlc=2, CanIfRxPduUserRxIndicationName=PduR_CanIfRxIndication, CanIfRxPduUserRxIndicationUL=PDUR, CanIfRxPduId=14, CanIfRxPduRef=PT_EPB_HSC2_FrP01_PP_EPB_HSC2_FrP01_Rx_0fb271d2_c07658fd
        EPB_HSC2_FrP00_oCAN00_Rx_3abd61be: CanIfRxPduCanId=560, CanIfRxPduDlc=8, CanIfRxPduUserRxIndicationName=PduR_CanIfRxIndication, CanIfRxPduUserRxIndicationUL=PDUR, CanIfRxPduId=13, CanIfRxPduRef=PT_EPB_HSC2_FrP00_PP_EPB_HSC2_FrP00_Rx_0fb271d2_c07658fd
        SCS_HSC2_FrP12_oCAN00_Rx_3abd61be: CanIfRxPduCanId=842, CanIfRxPduDlc=8, CanIfRxPduUserRxIndicationName=PduR_CanIfRxIndication, CanIfRxPduUserRxIndicationUL=PDUR, CanIfRxPduId=10, CanIfRxPduRef=PT_SCS_HSC2_FrP12_PP_SCS_HSC2_FrP12_Rx_0fb271d2_c07658fd
        GW_HSC2_BCM_FrP04_oCAN00_Rx_3abd61be: CanIfRxPduCanId=1130, CanIfRxPduDlc=8, CanIfRxPduUserRxIndicationName=PduR_CanIfRxIndication, CanIfRxPduUserRxIndicationUL=PDUR, CanIfRxPduId=6, CanIfRxPduRef=PT_GW_HSC2_BCM_FrP04_PP_GW_HSC2_BCM_FrP04_Rx_0fb271d2_c07658fd
        GW_HSC2_SDM_FrP00_oCAN00_Rx_3abd61be: CanIfRxPduCanId=355, CanIfRxPduDlc=8, CanIfRxPduUserRxIndicationName=PduR_CanIfRxIndication, CanIfRxPduUserRxIndicationUL=PDUR, CanIfRxPduId=30, CanIfRxPduRef=PT_GW_HSC2_SDM_FrP00_PP_GW_HSC2_SDM_FrP00_Rx_0fb271d2_c07658fd
        GW_HSC2_IPK_FrP06_oCAN00_Rx_3abd61be: CanIfRxPduCanId=1345, CanIfRxPduDlc=8, CanIfRxPduUserRxIndicationName=PduR_CanIfRxIndication, CanIfRxPduUserRxIndicationUL=PDUR, CanIfRxPduId=4, CanIfRxPduRef=PT_GW_HSC2_IPK_FrP06_PP_GW_HSC2_IPK_FrP06_Rx_0fb271d2_c07658fd
        SAS_HSC2_FrP00_oCAN00_Rx_3abd61be: CanIfRxPduCanId=485, CanIfRxPduDlc=8, CanIfRxPduUserRxIndicationName=PduR_CanIfRxIndication, CanIfRxPduUserRxIndicationUL=PDUR, CanIfRxPduId=19, CanIfRxPduRef=PT_SAS_HSC2_FrP00_PP_SAS_HSC2_FrP00_Rx_0fb271d2_c07658fd
        EPS_HSC2_FrP02_oCAN00_Rx_3abd61be: CanIfRxPduCanId=433, CanIfRxPduDlc=4, CanIfRxPduUserRxIndicationName=PduR_CanIfRxIndication, CanIfRxPduUserRxIndicationUL=PDUR, CanIfRxPduId=22, CanIfRxPduRef=PT_EPS_HSC2_FrP02_PP_EPS_HSC2_FrP02_Rx_0fb271d2_c07658fd
        Tester_HSC2_GW_FrP14_oCAN00_Rx_3abd61be: CanIfRxPduCanId=429, CanIfRxPduDlc=6, CanIfRxPduUserRxIndicationName=PduR_CanIfRxIndication, CanIfRxPduUserRxIndicationUL=PDUR, CanIfRxPduId=23, CanIfRxPduRef=PT_Tester_HSC2_GW_FrP14_PP_Tester_HSC2_GW_FrP14_Rx_0fb271d2_c07658fd
        GW_HSC2_BCM_FrP06_oCAN00_Rx_3abd61be: CanIfRxPduCanId=540, CanIfRxPduDlc=8, CanIfRxPduUserRxIndicationName=PduR_CanIfRxIndication, CanIfRxPduUserRxIndicationUL=PDUR, CanIfRxPduId=15, CanIfRxPduRef=PT_GW_HSC2_BCM_FrP06_PP_GW_HSC2_BCM_FrP06_Rx_0fb271d2_c07658fd
        GW_HSC2_BCM_FrS16_oCAN00_Rx_3abd61be: CanIfRxPduCanId=1539, CanIfRxPduDlc=8, CanIfRxPduUserRxIndicationName=PduR_CanIfRxIndication, CanIfRxPduUserRxIndicationUL=PDUR, CanIfRxPduId=3, CanIfRxPduRef=PT_GW_HSC2_BCM_FrS16_PP_GW_HSC2_BCM_FrS16_Rx_0fb271d2_c07658fd
        GW_HSC2_BCM_FrP07_oCAN00_Rx_3abd61be: CanIfRxPduCanId=498, CanIfRxPduDlc=2, CanIfRxPduUserRxIndicationName=PduR_CanIfRxIndication, CanIfRxPduUserRxIndicationUL=PDUR, CanIfRxPduId=16, CanIfRxPduRef=PT_GW_HSC2_BCM_FrP07_PP_GW_HSC2_BCM_FrP07_Rx_0fb271d2_c07658fd
        GW_HSC2_FrS00_oCAN00_Rx_3abd61be: CanIfRxPduCanId=1699, CanIfRxPduDlc=8, CanIfRxPduUserRxIndicationName=PduR_CanIfRxIndication, CanIfRxPduUserRxIndicationUL=PDUR, CanIfRxPduId=2, CanIfRxPduRef=PT_GW_HSC2_FrS00_PP_GW_HSC2_FrS00_Rx_0fb271d2_c07658fd
      CanIfBufferCfg_Tx_Std_c4eea277 (CanIfBufferCfg):  # CHNL
        CanIfBufferSize = 0
        CanIfTxBufferHandlingType = NONE
        CanIfTxBufferMappedTxPdus = 4
        CanIfTxBufferMaxPduLength = 8
        CanIfBufferHthRef = CN_CAN01_388e5969_Tx_Std
      10 x CanIfRxPduCfg, all with CanIfRxPduCanIdType=STANDARD_CAN, CanIfRxPduDlc=8, CanIfRxPduUserRxIndicationName=PduR_CanIfRxIndication, CanIfRxPduUserRxIndicationUL=PDUR, CanIfRxPduReadData=false, CanIfRxPduReadNotifyStatus=false, CanIfRxPduDlcCheck=true, CanIfRxPduHrhIdRef=CN_CAN01_388e5969_Rx_Std:
        FICM_HSC4_FrP33_oCAN01_Rx_3abd61be: CanIfRxPduCanId=822, CanIfRxPduId=46, CanIfRxPduRef=PT_FICM_HSC4_FrP33_PP_FICM_HSC4_FrP33_Rx_c4eea277_b771686b
        GW_HSC4_PEPS_FrP02_oCAN01_Rx_3abd61be: CanIfRxPduCanId=569, CanIfRxPduId=51, CanIfRxPduRef=PT_GW_HSC4_PEPS_FrP02_PP_GW_HSC4_PEPS_FrP02_Rx_c4eea277_b771686b
        GW_HSC4_BCM_FrP04_oCAN01_Rx_3abd61be: CanIfRxPduCanId=1130, CanIfRxPduId=40, CanIfRxPduRef=PT_GW_HSC4_BCM_FrP04_PP_GW_HSC4_BCM_FrP04_Rx_c4eea277_b771686b
        FICM_HSC4_FrP13_oCAN01_Rx_3abd61be: CanIfRxPduCanId=754, CanIfRxPduId=48, CanIfRxPduRef=PT_FICM_HSC4_FrP13_PP_FICM_HSC4_FrP13_Rx_c4eea277_b771686b
        RDA_HSC4_P02_oCAN01_Rx_3abd61be: CanIfRxPduCanId=516, CanIfRxPduId=52, CanIfRxPduRef=PT_RDA_HSC4_P02_PP_RDA_HSC4_P02_Rx_c4eea277_b771686b
        FICM_HSC4_FrP08_oCAN01_Rx_3abd61be: CanIfRxPduCanId=758, CanIfRxPduId=47, CanIfRxPduRef=PT_FICM_HSC4_FrP08_PP_FICM_HSC4_FrP08_Rx_c4eea277_b771686b
        IPK_HSC4_FrP06_oCAN01_Rx_3abd61be: CanIfRxPduCanId=1345, CanIfRxPduId=37, CanIfRxPduRef=PT_IPK_HSC4_FrP06_PP_IPK_HSC4_FrP06_Rx_c4eea277_b771686b
        TPMS_HSC3_FrP01_oCAN01_Rx_3abd61be: CanIfRxPduCanId=1149, CanIfRxPduId=39, CanIfRxPduRef=PT_TPMS_HSC3_FrP01_PP_TPMS_HSC3_FrP01_Rx_c4eea277_b771686b
        TPMS_HSC3_FrP02_oCAN01_Rx_3abd61be: CanIfRxPduCanId=1150, CanIfRxPduId=38, CanIfRxPduRef=PT_TPMS_HSC3_FrP02_PP_TPMS_HSC3_FrP02_Rx_c4eea277_b771686b
        FICM_HSC4_FrP02_oCAN01_Rx_3abd61be: CanIfRxPduCanId=886, CanIfRxPduId=42, CanIfRxPduRef=PT_FICM_HSC4_FrP02_PP_FICM_HSC4_FrP02_Rx_c4eea277_b771686b
      P2P_HSC4_FrP03_oCAN01_Tx_3abd61be (CanIfTxPduCfg):
        CanIfTxPduCanId = 781
        CanIfTxPduCanIdType = STANDARD_CAN
        CanIfTxPduDlc = 8
        CanIfTxPduUserTxConfirmationName = NULL_PTR
        CanIfTxPduUserTxConfirmationUL = NONE
        CanIfTxPduId = 11
        CanIfTxPduReadNotifyStatus = false
        CanIfTxPduType = STATIC
        CanIfTxPduBufferRef = CanIfBufferCfg_Tx_Std_c4eea277
        CanIfTxPduRef = PT_P2P_HSC4_FrP03_PP_P2P_HSC4_FrP03_Tx_c4eea277_b771686b
      8 x CanIfRxPduCfg, all with CanIfRxPduCanIdType=STANDARD_CAN, CanIfRxPduDlc=8, CanIfRxPduUserRxIndicationName=PduR_CanIfRxIndication, CanIfRxPduUserRxIndicationUL=PDUR, CanIfRxPduReadData=false, CanIfRxPduReadNotifyStatus=false, CanIfRxPduDlcCheck=true, CanIfRxPduHrhIdRef=CN_CAN01_388e5969_Rx_Std:
        FICM_HSC4_FrP18_oCAN01_Rx_3abd61be: CanIfRxPduCanId=893, CanIfRxPduId=41, CanIfRxPduRef=PT_FICM_HSC4_FrP18_PP_FICM_HSC4_FrP18_Rx_c4eea277_b771686b
        GW_HSC4_PEPS_FrP01_oCAN01_Rx_3abd61be: CanIfRxPduCanId=379, CanIfRxPduId=54, CanIfRxPduRef=PT_GW_HSC4_PEPS_FrP01_PP_GW_HSC4_PEPS_FrP01_Rx_c4eea277_b771686b
        FICM_HSC4_FrP32_oCAN01_Rx_3abd61be: CanIfRxPduCanId=128, CanIfRxPduId=56, CanIfRxPduRef=PT_FICM_HSC4_FrP32_PP_FICM_HSC4_FrP32_Rx_c4eea277_b771686b
        GW_HSC4_TBOX_FrS10_oCAN01_Rx_3abd61be: CanIfRxPduCanId=1553, CanIfRxPduId=36, CanIfRxPduRef=PT_GW_HSC4_TBOX_FrS10_PP_GW_HSC4_TBOX_FrS10_Rx_c4eea277_b771686b
        GW_HSC4_BCM_FrS10_oCAN01_Rx_3abd61be: CanIfRxPduCanId=61, CanIfRxPduId=57, CanIfRxPduRef=PT_GW_HSC4_BCM_FrS10_PP_GW_HSC4_BCM_FrS10_Rx_c4eea277_b771686b
        GW_HSC4_TBOX_FrP05_oCAN01_Rx_3abd61be: CanIfRxPduCanId=434, CanIfRxPduId=53, CanIfRxPduRef=PT_GW_HSC4_TBOX_FrP05_PP_GW_HSC4_TBOX_FrP05_Rx_c4eea277_b771686b
        GW_HSC4_TBOX_FrP01_oCAN01_Rx_3abd61be: CanIfRxPduCanId=845, CanIfRxPduId=43, CanIfRxPduRef=PT_GW_HSC4_TBOX_FrP01_PP_GW_HSC4_TBOX_FrP01_Rx_c4eea277_b771686b
        GW_HSC4_BMS_FrP07_oCAN01_Rx_3abd61be: CanIfRxPduCanId=667, CanIfRxPduId=49, CanIfRxPduRef=PT_GW_HSC4_BMS_FrP07_PP_GW_HSC4_BMS_FrP07_Rx_c4eea277_b771686b
      P2P_HSC4_FrS01_oCAN01_Tx_3abd61be (CanIfTxPduCfg):
        CanIfTxPduCanId = 1551
        CanIfTxPduCanIdType = STANDARD_CAN
        CanIfTxPduDlc = 8
        CanIfTxPduUserTxConfirmationName = NULL_PTR
        CanIfTxPduUserTxConfirmationUL = NONE
        CanIfTxPduId = 9
        CanIfTxPduReadNotifyStatus = false
        CanIfTxPduType = STATIC
        CanIfTxPduBufferRef = CanIfBufferCfg_Tx_Std_c4eea277
        CanIfTxPduRef = PT_P2P_HSC4_FrS01_PP_P2P_HSC4_FrS01_Tx_c4eea277_b771686b
      GW_HSC4_BCM_FrS09_oCAN01_Rx_3abd61be (CanIfRxPduCfg):
        CanIfRxPduCanId = 60
        CanIfRxPduCanIdType = STANDARD_CAN
        CanIfRxPduDlc = 8
        CanIfRxPduUserRxIndicationName = PduR_CanIfRxIndication
        CanIfRxPduUserRxIndicationUL = PDUR
        CanIfRxPduId = 58
        CanIfRxPduReadData = false
        CanIfRxPduReadNotifyStatus = false
        CanIfRxPduDlcCheck = true
        CanIfRxPduHrhIdRef = CN_CAN01_388e5969_Rx_Std
        CanIfRxPduRef = PT_GW_HSC4_BCM_FrS09_PP_GW_HSC4_BCM_FrS09_Rx_c4eea277_b771686b
      P2P_IECU_HSC4_FrP02_oCAN01_Tx_3abd61be (CanIfTxPduCfg):
        CanIfTxPduCanId = 912
        CanIfTxPduCanIdType = STANDARD_CAN
        CanIfTxPduDlc = 8
        CanIfTxPduUserTxConfirmationName = NULL_PTR
        CanIfTxPduUserTxConfirmationUL = NONE
        CanIfTxPduId = 10
        CanIfTxPduReadNotifyStatus = false
        CanIfTxPduType = STATIC
        CanIfTxPduBufferRef = CanIfBufferCfg_Tx_Std_c4eea277
        CanIfTxPduRef = PT_P2P_IECU_HSC4_FrP02_PP_P2P_IECU_HSC4_FrP02_Tx_c4eea277_b771686b
      GW_HSC4_TC_FrP01_oCAN01_Rx_3abd61be (CanIfRxPduCfg):
        CanIfRxPduCanId = 148
        CanIfRxPduCanIdType = STANDARD_CAN
        CanIfRxPduDlc = 8
        CanIfRxPduUserRxIndicationName = PduR_CanIfRxIndication
        CanIfRxPduUserRxIndicationUL = PDUR
        CanIfRxPduId = 55
        CanIfRxPduReadData = false
        CanIfRxPduReadNotifyStatus = false
        CanIfRxPduDlcCheck = true
        CanIfRxPduHrhIdRef = CN_CAN01_388e5969_Rx_Std
        CanIfRxPduRef = PT_GW_HSC4_TC_FrP01_PP_GW_HSC4_TC_FrP01_Rx_c4eea277_b771686b
      P2P_IECU_HSC4_FrP01_oCAN01_Tx_3abd61be (CanIfTxPduCfg):
        CanIfTxPduCanId = 764
        CanIfTxPduCanIdType = STANDARD_CAN
        CanIfTxPduDlc = 8
        CanIfTxPduUserTxConfirmationName = NULL_PTR
        CanIfTxPduUserTxConfirmationUL = NONE
        CanIfTxPduId = 12
        CanIfTxPduReadNotifyStatus = false
        CanIfTxPduType = STATIC
        CanIfTxPduBufferRef = CanIfBufferCfg_Tx_Std_c4eea277
        CanIfTxPduRef = PT_P2P_IECU_HSC4_FrP01_PP_P2P_IECU_HSC4_FrP01_Tx_c4eea277_b771686b
      APA_SecCH_FrP02_oCAN02_Rx_3abd61be (CanIfRxPduCfg):
        CanIfRxPduCanId = 966
        CanIfRxPduCanIdType = STANDARD_CAN
        CanIfRxPduDlc = 8
        CanIfRxPduUserRxIndicationName = PduR_CanIfRxIndication
        CanIfRxPduUserRxIndicationUL = PDUR
        CanIfRxPduId = 60
        CanIfRxPduReadData = false
        CanIfRxPduReadNotifyStatus = false
        CanIfRxPduDlcCheck = true
        CanIfRxPduHrhIdRef = CN_CAN02_388e5969_Rx_Std
        CanIfRxPduRef = PT_APA_SecCH_FrP02_PP_APA_SecCH_FrP02_Rx_427ad0d9_2e7839d1
      12 x CanIfTxPduCfg, all with CanIfTxPduCanIdType=STANDARD_CAN, CanIfTxPduUserTxConfirmationName=NULL_PTR, CanIfTxPduUserTxConfirmationUL=NONE, CanIfTxPduReadNotifyStatus=false, CanIfTxPduType=STATIC, CanIfTxPduBufferRef=CanIfBufferCfg_Tx_Std_427ad0d9:
        P2P_SecCH_SCS_FrP03_oCAN02_Tx_3abd61be: CanIfTxPduCanId=455, CanIfTxPduDlc=8, CanIfTxPduId=31, CanIfTxPduRef=PT_P2P_SecCH_SCS_FrP03_PP_P2P_SecCH_SCS_FrP03_Tx_427ad0d9_2e7839d1
        P2P_SecCH_HCU_FrP01_oCAN02_Tx_3abd61be: CanIfTxPduCanId=406, CanIfTxPduDlc=8, CanIfTxPduId=36, CanIfTxPduRef=PT_P2P_SecCH_HCU_FrP01_PP_P2P_SecCH_HCU_FrP01_Tx_427ad0d9_2e7839d1
        P2P_SecCH_EPB_FrP00_oCAN02_Tx_3abd61be: CanIfTxPduCanId=560, CanIfTxPduDlc=8, CanIfTxPduId=25, CanIfTxPduRef=PT_P2P_SecCH_EPB_FrP00_PP_P2P_SecCH_EPB_FrP00_Tx_427ad0d9_2e7839d1
        P2P_SecCH_Tester_GW_FrP14_oCAN02_Tx_3abd61be: CanIfTxPduCanId=429, CanIfTxPduDlc=8, CanIfTxPduId=33, CanIfTxPduRef=PT_P2P_SecCH_Tester_GW_FrP14_PP_P2P_SecCH_Tester_GW_FrP14_Tx_427ad0d9_2e7839d1
        P2P_SecCH_GW_FrP01_oCAN02_Tx_3abd61be: CanIfTxPduCanId=497, CanIfTxPduDlc=8, CanIfTxPduId=28, CanIfTxPduRef=PT_P2P_SecCH_GW_FrP01_PP_P2P_SecCH_GW_FrP01_Tx_427ad0d9_2e7839d1
        P2P_SecCH_FICM_FrP18_oCAN02_Tx_3abd61be: CanIfTxPduCanId=893, CanIfTxPduDlc=8, CanIfTxPduId=19, CanIfTxPduRef=PT_P2P_SecCH_FICM_FrP18_PP_P2P_SecCH_FICM_FrP18_Tx_427ad0d9_2e7839d1
        P2P_SecCH_SCS_FrP12_oCAN02_Tx_3abd61be: CanIfTxPduCanId=842, CanIfTxPduDlc=8, CanIfTxPduId=22, CanIfTxPduRef=PT_P2P_SecCH_SCS_FrP12_PP_P2P_SecCH_SCS_FrP12_Tx_427ad0d9_2e7839d1
        P2P_SecCH_SCS_FrP02_oCAN02_Tx_3abd61be: CanIfTxPduCanId=389, CanIfTxPduDlc=4, CanIfTxPduId=38, CanIfTxPduRef=PT_P2P_SecCH_SCS_FrP02_PP_P2P_SecCH_SCS_FrP02_Tx_427ad0d9_2e7839d1
        P2P_SecCH_SCS_FrP00_oCAN02_Tx_3abd61be: CanIfTxPduCanId=193, CanIfTxPduDlc=8, CanIfTxPduId=43, CanIfTxPduRef=PT_P2P_SecCH_SCS_FrP00_PP_P2P_SecCH_SCS_FrP00_Tx_427ad0d9_2e7839d1
        P2P_SecCH_HCU_FrP00_oCAN02_Tx_3abd61be: CanIfTxPduCanId=175, CanIfTxPduDlc=8, CanIfTxPduId=44, CanIfTxPduRef=PT_P2P_SecCH_HCU_FrP00_PP_P2P_SecCH_HCU_FrP00_Tx_427ad0d9_2e7839d1
        P2P_SecCH_TC_FrP07_oCAN02_Tx_3abd61be: CanIfTxPduCanId=148, CanIfTxPduDlc=8, CanIfTxPduId=46, CanIfTxPduRef=PT_P2P_SecCH_TC_FrP07_PP_P2P_SecCH_TC_FrP07_Tx_427ad0d9_2e7839d1
        P2P_SecCH_EPB_FrP01_oCAN02_Tx_3abd61be: CanIfTxPduCanId=554, CanIfTxPduDlc=2, CanIfTxPduId=26, CanIfTxPduRef=PT_P2P_SecCH_EPB_FrP01_PP_P2P_SecCH_EPB_FrP01_Tx_427ad0d9_2e7839d1
      PDC_SecCH_FrP00_oCAN02_Rx_3abd61be (CanIfRxPduCfg):
        CanIfRxPduCanId = 573
        CanIfRxPduCanIdType = STANDARD_CAN
        CanIfRxPduDlc = 8
        CanIfRxPduUserRxIndicationName = PduR_CanIfRxIndication
        CanIfRxPduUserRxIndicationUL = PDUR
        CanIfRxPduId = 63
        CanIfRxPduReadData = false
        CanIfRxPduReadNotifyStatus = false
        CanIfRxPduDlcCheck = true
        CanIfRxPduHrhIdRef = CN_CAN02_388e5969_Rx_Std
        CanIfRxPduRef = PT_PDC_SecCH_FrP00_PP_PDC_SecCH_FrP00_Rx_427ad0d9_2e7839d1
      PDC_SecCH_FrP01_oCAN02_Rx_3abd61be (CanIfRxPduCfg):
        CanIfRxPduCanId = 567
        CanIfRxPduCanIdType = STANDARD_CAN
        CanIfRxPduDlc = 8
        CanIfRxPduUserRxIndicationName = PduR_CanIfRxIndication
        CanIfRxPduUserRxIndicationUL = PDUR
        CanIfRxPduId = 64
        CanIfRxPduReadData = false
        CanIfRxPduReadNotifyStatus = false
        CanIfRxPduDlcCheck = true
        CanIfRxPduHrhIdRef = CN_CAN02_388e5969_Rx_Std
        CanIfRxPduRef = PT_PDC_SecCH_FrP01_PP_PDC_SecCH_FrP01_Rx_427ad0d9_2e7839d1
      8 x CanIfTxPduCfg, all with CanIfTxPduCanIdType=STANDARD_CAN, CanIfTxPduUserTxConfirmationName=NULL_PTR, CanIfTxPduUserTxConfirmationUL=NONE, CanIfTxPduReadNotifyStatus=false, CanIfTxPduType=STATIC, CanIfTxPduBufferRef=CanIfBufferCfg_Tx_Std_427ad0d9:
        P2P_SecCH_BCM_FrP07_oCAN02_Tx_3abd61be: CanIfTxPduCanId=498, CanIfTxPduDlc=2, CanIfTxPduId=27, CanIfTxPduRef=PT_P2P_SecCH_BCM_FrP07_PP_P2P_SecCH_BCM_FrP07_Tx_427ad0d9_2e7839d1
        P2P_SecCH_BCM_FrP04_oCAN02_Tx_3abd61be: CanIfTxPduCanId=1130, CanIfTxPduDlc=8, CanIfTxPduId=17, CanIfTxPduRef=PT_P2P_SecCH_BCM_FrP04_PP_P2P_SecCH_BCM_FrP04_Tx_427ad0d9_2e7839d1
        P2P_SecCH_HCU_FrP13_oCAN02_Tx_3abd61be: CanIfTxPduCanId=412, CanIfTxPduDlc=8, CanIfTxPduId=35, CanIfTxPduRef=PT_P2P_SecCH_HCU_FrP13_PP_P2P_SecCH_HCU_FrP13_Tx_427ad0d9_2e7839d1
        P2P_SecCH_SAS_FrP00_oCAN02_Tx_3abd61be: CanIfTxPduCanId=485, CanIfTxPduDlc=8, CanIfTxPduId=30, CanIfTxPduRef=PT_P2P_SecCH_SAS_FrP00_PP_P2P_SecCH_SAS_FrP00_Tx_427ad0d9_2e7839d1
        P2P_SecCH_BCM_FrP03_oCAN02_Tx_3abd61be: CanIfTxPduCanId=1146, CanIfTxPduDlc=8, CanIfTxPduId=16, CanIfTxPduRef=PT_P2P_SecCH_BCM_FrP03_PP_P2P_SecCH_BCM_FrP03_Tx_427ad0d9_2e7839d1
        P2P_SecCH_SCU_FrP00_oCAN02_Tx_3abd61be: CanIfTxPduCanId=157, CanIfTxPduDlc=8, CanIfTxPduId=45, CanIfTxPduRef=PT_P2P_SecCH_SCU_FrP00_PP_P2P_SecCH_SCU_FrP00_Tx_427ad0d9_2e7839d1
        P2P_SecCH_SCS_FrP05_oCAN02_Tx_3abd61be: CanIfTxPduCanId=489, CanIfTxPduDlc=8, CanIfTxPduId=29, CanIfTxPduRef=PT_P2P_SecCH_SCS_FrP05_PP_P2P_SecCH_SCS_FrP05_Tx_427ad0d9_2e7839d1
        P2P_SecCH_SCS_FrP01_oCAN02_Tx_3abd61be: CanIfTxPduCanId=197, CanIfTxPduDlc=8, CanIfTxPduId=42, CanIfTxPduRef=PT_P2P_SecCH_SCS_FrP01_PP_P2P_SecCH_SCS_FrP01_Tx_427ad0d9_2e7839d1
      3 x CanIfRxPduCfg, all with CanIfRxPduCanIdType=STANDARD_CAN, CanIfRxPduUserRxIndicationName=PduR_CanIfRxIndication, CanIfRxPduUserRxIndicationUL=PDUR, CanIfRxPduReadData=false, CanIfRxPduReadNotifyStatus=false, CanIfRxPduDlcCheck=true, CanIfRxPduHrhIdRef=CN_CAN02_388e5969_Rx_Std:
        APA_SecCH_FrP00_oCAN02_Rx_3abd61be: CanIfRxPduCanId=424, CanIfRxPduDlc=6, CanIfRxPduId=66, CanIfRxPduRef=PT_APA_SecCH_FrP00_PP_APA_SecCH_FrP00_Rx_427ad0d9_2e7839d1
        APA_SecCH_FrP04_oCAN02_Rx_3abd61be: CanIfRxPduCanId=652, CanIfRxPduDlc=8, CanIfRxPduId=61, CanIfRxPduRef=PT_APA_SecCH_FrP04_PP_APA_SecCH_FrP04_Rx_427ad0d9_2e7839d1
        DIAG_DTCInfo_APA_oCAN02_Rx_3abd61be: CanIfRxPduCanId=1945, CanIfRxPduDlc=7, CanIfRxPduId=59, CanIfRxPduRef=PT_DIAG_DTCInfo_APA_PP_DIAG_DTCInfo_APA_Rx_427ad0d9_2e7839d1
      5 x CanIfTxPduCfg, all with CanIfTxPduCanIdType=STANDARD_CAN, CanIfTxPduDlc=8, CanIfTxPduUserTxConfirmationName=NULL_PTR, CanIfTxPduUserTxConfirmationUL=NONE, CanIfTxPduReadNotifyStatus=false, CanIfTxPduType=STATIC, CanIfTxPduBufferRef=CanIfBufferCfg_Tx_Std_427ad0d9:
        P2P_SecCH_HCU_ECM_FrP04_oCAN02_Tx_3abd61be: CanIfTxPduCanId=404, CanIfTxPduId=37, CanIfTxPduRef=PT_P2P_SecCH_HCU_ECM_FrP04_PP_P2P_SecCH_HCU_ECM_FrP04_Tx_427ad0d9_2e7839d1
        P2P_SecCH_SCS_FrP11_oCAN02_Tx_3abd61be: CanIfTxPduCanId=840, CanIfTxPduId=23, CanIfTxPduRef=PT_P2P_SecCH_SCS_FrP11_PP_P2P_SecCH_SCS_FrP11_Tx_427ad0d9_2e7839d1
        P2P_SecCH_SCS_FrP15_oCAN02_Tx_3abd61be: CanIfTxPduCanId=851, CanIfTxPduId=21, CanIfTxPduRef=PT_P2P_SecCH_SCS_FrP15_PP_P2P_SecCH_SCS_FrP15_Tx_427ad0d9_2e7839d1
        P2P_SecCH_SDM_FrP00_oCAN02_Tx_3abd61be: CanIfTxPduCanId=355, CanIfTxPduId=40, CanIfTxPduRef=PT_P2P_SecCH_SDM_FrP00_PP_P2P_SecCH_SDM_FrP00_Tx_427ad0d9_2e7839d1
        P2P_SecCH_GW_FrS00_oCAN02_Tx_3abd61be: CanIfTxPduCanId=1699, CanIfTxPduId=13, CanIfTxPduRef=PT_P2P_SecCH_GW_FrS00_PP_P2P_SecCH_GW_FrS00_Tx_427ad0d9_2e7839d1
      CanIfBufferCfg_Tx_Std_427ad0d9 (CanIfBufferCfg):  # CHNL
        CanIfBufferSize = 0
        CanIfTxBufferHandlingType = NONE
        CanIfTxBufferMappedTxPdus = 34
        CanIfTxBufferMaxPduLength = 8
        CanIfBufferHthRef = CN_CAN02_388e5969_Tx_Std
      P2P_SecCH_FICM_FrP08_oCAN02_Tx_3abd61be (CanIfTxPduCfg):
        CanIfTxPduCanId = 758
        CanIfTxPduCanIdType = STANDARD_CAN
        CanIfTxPduDlc = 8
        CanIfTxPduUserTxConfirmationName = NULL_PTR
        CanIfTxPduUserTxConfirmationUL = NONE
        CanIfTxPduId = 24
        CanIfTxPduReadNotifyStatus = false
        CanIfTxPduType = STATIC
        CanIfTxPduBufferRef = CanIfBufferCfg_Tx_Std_427ad0d9
        CanIfTxPduRef = PT_P2P_SecCH_FICM_FrP08_PP_P2P_SecCH_FICM_FrP08_Tx_427ad0d9_2e7839d1
      APA_SecCH_FrP03_oCAN02_Rx_3abd61be (CanIfRxPduCfg):
        CanIfRxPduCanId = 651
        CanIfRxPduCanIdType = STANDARD_CAN
        CanIfRxPduDlc = 8
        CanIfRxPduUserRxIndicationName = PduR_CanIfRxIndication
        CanIfRxPduUserRxIndicationUL = PDUR
        CanIfRxPduId = 62
        CanIfRxPduReadData = false
        CanIfRxPduReadNotifyStatus = false
        CanIfRxPduDlcCheck = true
        CanIfRxPduHrhIdRef = CN_CAN02_388e5969_Rx_Std
        CanIfRxPduRef = PT_APA_SecCH_FrP03_PP_APA_SecCH_FrP03_Rx_427ad0d9_2e7839d1
      APA_SecCH_FrP01_oCAN02_Rx_3abd61be (CanIfRxPduCfg):
        CanIfRxPduCanId = 437
        CanIfRxPduCanIdType = STANDARD_CAN
        CanIfRxPduDlc = 8
        CanIfRxPduUserRxIndicationName = PduR_CanIfRxIndication
        CanIfRxPduUserRxIndicationUL = PDUR
        CanIfRxPduId = 65
        CanIfRxPduReadData = false
        CanIfRxPduReadNotifyStatus = false
        CanIfRxPduDlcCheck = true
        CanIfRxPduHrhIdRef = CN_CAN02_388e5969_Rx_Std
        CanIfRxPduRef = PT_APA_SecCH_FrP01_PP_APA_SecCH_FrP01_Rx_427ad0d9_2e7839d1
      8 x CanIfTxPduCfg, all with CanIfTxPduCanIdType=STANDARD_CAN, CanIfTxPduUserTxConfirmationName=NULL_PTR, CanIfTxPduUserTxConfirmationUL=NONE, CanIfTxPduReadNotifyStatus=false, CanIfTxPduType=STATIC, CanIfTxPduBufferRef=CanIfBufferCfg_Tx_Std_427ad0d9:
        P2P_SecCH_GW_FrP08_oCAN02_Tx_3abd61be: CanIfTxPduCanId=1344, CanIfTxPduDlc=8, CanIfTxPduId=15, CanIfTxPduRef=PT_P2P_SecCH_GW_FrP08_PP_P2P_SecCH_GW_FrP08_Tx_427ad0d9_2e7839d1
        P2P_SecCH_FICM_FrP02_oCAN02_Tx_3abd61be: CanIfTxPduCanId=886, CanIfTxPduDlc=8, CanIfTxPduId=20, CanIfTxPduRef=PT_P2P_SecCH_FICM_FrP02_PP_P2P_SecCH_FICM_FrP02_Tx_427ad0d9_2e7839d1
        P2P_SecCH_IPK_FrP06_oCAN02_Tx_3abd61be: CanIfTxPduCanId=1345, CanIfTxPduDlc=8, CanIfTxPduId=14, CanIfTxPduRef=PT_P2P_SecCH_IPK_FrP06_PP_P2P_SecCH_IPK_FrP06_Tx_427ad0d9_2e7839d1
        P2P_SecCH_EPS_FrP02_oCAN02_Tx_3abd61be: CanIfTxPduCanId=433, CanIfTxPduDlc=4, CanIfTxPduId=32, CanIfTxPduRef=PT_P2P_SecCH_EPS_FrP02_PP_P2P_SecCH_EPS_FrP02_Tx_427ad0d9_2e7839d1
        P2P_SecCH_GW_FrP00_oCAN02_Tx_3abd61be: CanIfTxPduCanId=361, CanIfTxPduDlc=6, CanIfTxPduId=39, CanIfTxPduRef=PT_P2P_SecCH_GW_FrP00_PP_P2P_SecCH_GW_FrP00_Tx_427ad0d9_2e7839d1
        P2P_SecCH_ECM_FrP00_oCAN02_Tx_3abd61be: CanIfTxPduCanId=201, CanIfTxPduDlc=8, CanIfTxPduId=41, CanIfTxPduRef=PT_P2P_SecCH_ECM_FrP00_PP_P2P_SecCH_ECM_FrP00_Tx_427ad0d9_2e7839d1
        P2P_SecCH_GW_FrP13_oCAN02_Tx_3abd61be: CanIfTxPduCanId=425, CanIfTxPduDlc=8, CanIfTxPduId=34, CanIfTxPduRef=PT_P2P_SecCH_GW_FrP13_PP_P2P_SecCH_GW_FrP13_Tx_427ad0d9_2e7839d1
        P2P_SecCH_GW_FrP10_oCAN02_Tx_3abd61be: CanIfTxPduCanId=1009, CanIfTxPduDlc=8, CanIfTxPduId=18, CanIfTxPduRef=PT_P2P_SecCH_GW_FrP10_PP_P2P_SecCH_GW_FrP10_Tx_427ad0d9_2e7839d1
      3 x CanIfRxPduCfg, all with CanIfRxPduCanIdType=EXTENDED_CAN, CanIfRxPduDlc=8, CanIfRxPduReadData=false, CanIfRxPduReadNotifyStatus=false, CanIfRxPduUserRxIndicationName=PduR_CanIfRxIndication, CanIfRxPduUserRxIndicationUL=PDUR, CanIfRxPduDlcCheck=true, CanIfRxPduHrhIdRef=CanIfHrh_CN_CAN01_Rx_Std_Extended:
        CanIfRxPduCfg_Aceinna_Accel: CanIfRxPduId=50, CanIfRxPduCanId=149958016, CanIfRxPduRef=Pdu_Aceinna_Accel
        CanIfRxPduCfg_Aceinna_AngleRate: CanIfRxPduId=44, CanIfRxPduCanId=217066112, CanIfRxPduRef=Pdu_Aceinna_AngleRate
        CanIfRxPduCfg_Aceinna_Angles: CanIfRxPduId=45, CanIfRxPduCanId=217065856, CanIfRxPduRef=Pdu_Aceinna_Angles
    CanIfPrivateCfg:
      CanIfPrivateSoftwareFilterType = LINEAR
      CanIfPrivateDlcCheck = true
      CanIfSupportTTCAN = false
      CanIfTransceiverMapping = false
      CanIfTransceiverHandling = true
      CanIfSupportExtendedIds = true
      CanIfSupportNmOsek = false
      CanIfTxBufferType = BYTE_QUEUE
      CanIfOptimizeOneController = false
      CanIfWakeupSupport = false
      CanIfStaticFdTxBufferSupport = false
      CanIfRxSearchConsiderMsgType = false
      CanIfMultipleBasicCANTxObjects = false
      CanIfTxBufferFifoSupport = false
      CanIfSetPduReceptionModeSupport = false
      CanIfDataChecksumRxSupport = false
      CanIfDataChecksumTxSupport = false
    CanIfPublicCfg:
      CanIfPublicPnSupport = false
      CanIfPublicCancelTransmitSupport = false
      CanIfPublicDevErrorDetect = false
      CanIfPublicHandleTypeEnum = UINT8
      CanIfPublicMultipleDrvSupport = false
      CanIfPublicNumberOfCanHwUnits = 1
      CanIfPublicReadRxPduDataApi = false
      CanIfPublicReadRxPduNotifyStatusApi = false
      CanIfPublicReadTxPduNotifyStatusApi = false
      CanIfPublicSetDynamicTxIdApi = false
      CanIfPublicTxBuffering = true
      CanIfPublicTxConfirmPollingSupport = false
      CanIfPublicVersionInfoApi = false
      CanIfPublicWakeupCheckValidSupport = false
      CanIfPnWakeupTxPduFilterSupport = false
      CanIfPnTrcvHandlingSupport = false
      CanIfJ1939DynAddrSupport = DISABLED
      CanIfSafeBswChecks = false
      CanIfSetBaudrateApi = false
      CanIfExtendedRamCheckSupport = false
    CanIfTrcvDrvCfg
      CanIfTrcvCfg: CanIfTrcvId=0, CanIfTrcvWakeupSupport=false, CanIfTrcvCanTrcvRef=CanTrcvChannel
    Can (CanIfCtrlDrvCfg): CanIfCtrlDrvTxCancellation=false, CanIfCtrlDrvInitHohConfigRef=CanIfInitHohCfg, CanIfCtrlDrvNameRef=CanGeneral
      3 x CanIfCtrlCfg, all with CanIfCtrlWakeupSupport=false, CanIfCtrlJ1939DynAddrSupport=DISABLED:
        CT_CAN00_388e5969: CanIfCtrlId=0, CanIfCtrlCanCtrlRef=CT_CAN00_388e5969, CanIfCtrlTrcvCfgRef=CanIfTrcvCfg
        CT_CAN01_388e5969: CanIfCtrlId=1, CanIfCtrlCanCtrlRef=CT_CAN01_388e5969
        CT_CAN02_388e5969: CanIfCtrlId=2, CanIfCtrlCanCtrlRef=CT_CAN02_388e5969
