AUTOSAR XML (schema 4-2-1)
package /ActiveEcuC
  module config CanTrcv: implementation-config-variant=VARIANT-PRE-COMPILE, module-description=CanTrcv_Impl
    CanTrcvConfigSet
      CanTrcvChannel:
        CanTrcvHwPnSupport = false
        CanTrcvInitState = CANTRCV_OP_MODE_NORMAL
        CanTrcvChannelId = 0
        CanTrcvChannelUsed = true
        CanTrcvControlsPowerSupply = false
        CanTrcvMaxBaudrate = 1000
        CanTrcvWakeupByBusUsed = false
        CanTrcvAccess
          CanTrcvDioAccess
            3 x CanTrcvDioChannelAccess:
              PinEN: CanTrcvHardwareInterfaceName=PinEN, CanTrcvDioSymNameRef=CAN_Enable
              PinSTB: CanTrcvHardwareInterfaceName=PinSTB, CanTrcvDioSymNameRef=CAN_Stb
              PinERR: CanTrcvHardwareInterfaceName=PinERR, CanTrcvDioSymNameRef=CAN_Err
    CanTrcvGeneral:
      CanTrcvDevErrorDetect = false
      CanTrcvGetVersionInfo = false
      CanTrcvWakeUpSupport = CANTRCV_WAKEUP_NOT_SUPPORTED
      CanTrcvIndex = 0
      CanTrcvMainFunctionPeriod = 0.01
