AUTOSAR XML (schema 4-2-1)
package /ActiveEcuC
  module config Pwm: implementation-config-variant=VARIANT-POST-BUILD-LOADABLE, module-description=Pwm_Impl
    PwmChannelConfigSet
      PwmChannel_0 (PwmChannel):
        PwmChannelClass = PWM_FIXED_PERIOD
        PwmSafetySignal = PWM_QM_TYPE
        PwmChannelId = 0
        PwmDutycycleDefault = 0
        PwmIdleState = PWM_LOW
        PwmPolarity = PWM_LOW
        PwmAssignedHwUnit = AtomChannel_1
    PwmConfigurationOfOptApiServices:
      PwmDeInitApi = false
      PwmGetOutputState = false
      PwmSetDutyCycle = false
      PwmSetOutputToIdle = false
      PwmSetPeriodAndDuty = false
      PwmVersionInfoApi = false
      PwmSyncGrpUpdateDutiesApi = false
    PwmGeneral:
      PwmDevErrorDetect = false
      PwmChannelCoherentSelection = false
      PwmIndex = 0
      PwmNotificationSupported = false
      PwmPBFixedAddress = false
      PwmDutyShiftInTicks = false
      PwmHandleShiftByOffset = false
      PwmRunningInUser0Mode = false
      PwmUserModeInitApiEnable = false
      PwmUserModeDeInitApiEnable = false
      PwmUserModeRuntimeApiEnable = false
      PwmPeriodUpdatedEndperiod = false
    CommonPublishedInformation:
      ArMajorVersion = 2
      ArMinorVersion = 5
      ArPatchVersion = 0
      SwMajorVersion = 5
      SwMinorVersion = 1
      SwPatchVersion = 0
      ModuleId = 121
      VendorId = 17
      VendorApiInfix = Gtm
      Release = _TRICORE_TC277
    PwmSafety: PwmSafetyEnable=false
