[part 1 of 2: package /ActiveEcuC]
AUTOSAR XML (schema 4-2-1)
package /ActiveEcuC
  module config Mcu: implementation-config-variant=VARIANT-POST-BUILD-LOADABLE, module-description=Mcu_Impl
    McuGeneralConfiguration:
      McuMainOscillatorFrequency = 20
      McuPllInitDelay = 10
      McuErayPllInitDelay = 10
      McuSystemModeCpuCore = CPU_CORE_0
      McuIdleModeCpuCore = INDIVIDUAL_CORES
      McuDevErrorDetect = false
      McuInitClock = true
      McuNoPll = false
      McuPerformResetApi = false
      McuVersionInfoApi = false
      McuFmPllEnable = false
      McuPBFixedAddress = false
      McuGetRamStateApi = false
      McuClearColdResetApi = false
      McuDeInitApi = false
      McuResetSfrAtInit = false
      McuRunningInUser0Mode = false
      McuUserModeInitApiEnable = false
      McuUserModeDeInitApiEnable = false
      McuUserModeRuntimeApiEnable = false
    McuModuleConfiguration:
      McuClockSrcFailureNotification = DISABLED
      McuNumberOfMcuModes = 1
      McuRamSectors = 0
      McuStm{0..2}ResetDisable = false
      McuResetSetting = 1
      McuTriggerReset: SMUResetTrigger=0, ESR0ResetTrigger=0, ESR1ResetTrigger=0, STM0ResetTrigger=0, STM1ResetTrigger=0, STM2ResetTrigger=0
      McuClockSettingConfig: McuClockSettingId=0
        McuClockReferencePoint:
          McuClockSettingMode = NORMAL_MODE
          McuPllPDivider = 1
          McuPllNDivider = 47
          McuPllK1Divider = 1
          McuPllK2Divider = 2
          McuPllK3Divider = 5
          McuK2DivSteps = 2
          McuK2DivRampToPllConfDelay = 10
          McuK2DivRampToBackUpConfDelay = 10
          McuFMPllModAmp = 1.25
          McuClockReferencePointFrequency = 160000000
          McuClockReferencePoint2Frequency = 80000000
          McuSRIDivider = 1
          McuClockSRIFrequency = 160000000
          McuCPU0Divider = 32
          McuClockCPU0Frequency = 80000000
          McuCPU1Divider = 32
          McuClockCPU1Frequency = 80000000
          McuCPU2Divider = 32
          McuClockCPU2Frequency = 80000000
          McuSPBDivider = 2
          McuClockSPBFrequency = 80000000
          McuFSIDivider = 2
          McuClockFSIFrequency = 80000000
          McuFSI2Divider = 2
          McuClockFSI2Frequency = 80000000
          McuMAXDivider = 1
          McuClockMAXFrequency = 160000000
          McuGTMDivider = 2
          McuClockGTMFrequency = 80000000
          McuSTMDivider = 2
          McuClockSTMFrequency = 80000000
          McuBBBDivider = 2
          McuClockBBBFrequency = 80000000
          McuBAUD1Divider = 2
          McuClockBAUD1Frequency = 80000000
          McuBAUD2Divider = 2
          McuClockBAUD2Frequency = 80000000
          McuCANDivider = 2
          McuClockCANFrequency = 80000000
          McuASCLINFDivider = 2
          McuClockASCLINFFrequency = 80000000
          McuASCLINSDivider = 8
          McuClockASCLINSFrequency = 20000000
          McuErayPllPDivider = 0
          McuErayPllNDivider = 19
          McuErayPllK2Divider = 4
          McuErayPllK3Divider = 4
          McuClockErayPllFrequency = 80000000
          McuClockErayPll2Frequency = 80000000
          McuErayDivider = 1
          McuClockErayFrequency = 80000000
          McuETHDivider = 1
          McuETHFrequency = 20000000
      McuModeSettingConf: McuMode=0, McuIdleReqAckSeqDisable=false
        McuStandbySettingConf
      AscLinConfiguration: AscLin0=USE_FOR_UART_DRIVER, AscLin1=USE_FOR_LIN_DRIVER, AscLin2=USE_FOR_LIN_DRIVER, AscLin3=USE_FOR_UART_DRIVER
      GtmConfiguration
        GtmGeneral: GtmSleepMode=GTM_SLEEP_ENABLE, GtmGlobalClkDivNumerator=1, GtmGlobalClkDivDenominator=1, GtmEnRstAndForceIntFunctionality=false
        GtmAeiInterface:
          GtmAeiTimeOutMode = OBSERVE
          GtmAeiTimeOutValue = 0
          GtmAeiTimeoutExceptionIntEn = false
          GtmAeiUnsupportedAddressIntEn = false
          GtmAeiIllegalModuleAddIntEn = false
          GtmAeiUnsupportedByteEnIntEn = false
          GtmAeiTimeoutExceptionErrIntEn = false
          GtmAeiUnsupportedAddressErrIntEn = false
          GtmAeiIllegalModuleAddErrIntEn = false
          GtmAeiUnsupportedByteEnErrIntEn = false
          GtmAeiInterruptMode = GTM_INTERRUPT_LEVEL_MODE
        3 x Tom:
          Tom_0
            TomTriggersForTgc_0 (TomTriggersForTgc)
              TomTgcTriggerByTimebase: TomTgcTimeBaseTriggerEnable=false, TomTgcTbuTimebaseSelect=TBU_TS0_TIMEBASE, TomTgcTimebaseMatchValue=0
              TomTgcInternalTriggerSelect:
                TomTgcIntTriggerFromChannel{0..7} = false
            TomTriggersForTgc_1 (TomTriggersForTgc)
              TomTgcTriggerByTimebase: TomTgcTimeBaseTriggerEnable=false, TomTgcTbuTimebaseSelect=TBU_TS0_TIMEBASE, TomTgcTimebaseMatchValue=0
              TomTgcInternalTriggerSelect:
                TomTgcIntTriggerFromChannel{0..7} = false
            16 x TomChannel:
              TomChannel_0
                TomChannelUsage: TomChannelUsage=USED_BY_OTHER_DRIVERS_OR_UNUSED
                TomChannelEnable: TomChannelEnable=AT_START, TomChDisableOnTgcTrigger=false
                TomChannelOutput:
                  TomChannelOutputControl = DONT_ENABLE_CHANNEL_OUTPUT
                  TomChOutputDisableOnTgcTrig = false
                  TomChannelOutputSignalLevel = LOW
                  TomChannelPortPinSelect = TOUT18_SELA_PORT0_PIN9
                TomChannelTimerParameters:
                  TomChannelCounterValCn0 = 0
                  TomChannelPeriodCompareValCm0 = 0
                  TomChannelDutyCycleCompareValCm1 = 0
                  TomChPeriodCompareShadowValSr0 = 0
                  TomChDCycCompareShadowValSr1 = 0
                  TomChUpdateEnableOnCn0Reset = false
                  TomChEnableForceUpdate = false
                  TomChResetCn0OnForceUpdate = false
                  TomChannelClockSelect = GTM_FIXED_CLOCK_0
                  TomChannelCounterCn0Reset = ON_COMPARE_MATCH_ON_CHANNEL
                  TomChannelTriggerOutput = TRIG_FROM_PREVIOUS_CHANNEL
                  TomChannelOneShotMode = false
                  TomChannelSpeMode = false
                  TomChannelGatedCounterMode = false
                  TomChannelBitReversalMode = false
                TomChannelInterrupt: TomIntEnableOnPeriodMatchCcu0=false, TomIntEnableOnDutyCycleMatchCcu1=false, TomInterruptMode=GTM_INTERRUPT_LEVEL_MODE, TomNotification=NULL_PTR
              TomChannel_1
                TomChannelUsage: TomChannelUsage=USED_BY_OTHER_DRIVERS_OR_UNUSED
                TomChannelEnable: TomChannelEnable=AT_START, TomChDisableOnTgcTrigger=false
                TomChannelOutput:
                  TomChannelOutputControl = DONT_ENABLE_CHANNEL_OUTPUT
                  TomChOutputDisableOnTgcTrig = false
                  TomChannelOutputSignalLevel = LOW
                  TomChannelPortPinSelect = TOUT19_SELA_PORT0_PIN10
                TomChannelTimerParameters:
                  TomChannelCounterValCn0 = 0
                  TomChannelPeriodCompareValCm0 = 0
                  TomChannelDutyCycleCompareValCm1 = 0
                  TomChPeriodCompareShadowValSr0 = 0
                  TomChDCycCompareShadowValSr1 = 0
                  TomChUpdateEnableOnCn0Reset = false
                  TomChEnableForceUpdate = false
                  TomChResetCn0OnForceUpdate = false
                  TomChannelClockSelect = GTM_FIXED_CLOCK_0
                  TomChannelCounterCn0Reset = ON_COMPARE_MATCH_ON_CHANNEL
                  TomChannelTriggerOutput = TRIG_FROM_PREVIOUS_CHANNEL
                  TomChannelOneShotMode = false
                  TomChannelSpeMode = false
                  TomChannelGatedCounterMode = false
                  TomChannelBitReversalMode = false
                TomChannelInterrupt: TomIntEnableOnPeriodMatchCcu0=false, TomIntEnableOnDutyCycleMatchCcu1=false, TomInterruptMode=GTM_INTERRUPT_LEVEL_MODE, TomNotification=NULL_PTR
              TomChannel_2
                TomChannelUsage: TomChannelUsage=USED_BY_OTHER_DRIVERS_OR_UNUSED
                TomChannelEnable: TomChannelEnable=AT_START, TomChDisableOnTgcTrigger=false
                TomChannelOutput:
                  TomChannelOutputControl = DONT_ENABLE_CHANNEL_OUTPUT
                  TomChOutputDisableOnTgcTrig = false
                  TomChannelOutputSignalLevel = LOW
                  TomChannelPortPinSelect = TOUT20_SELA_PORT0_PIN11
                TomChannelTimerParameters:
                  TomChannelCounterValCn0 = 0
                  TomChannelPeriodCompareValCm0 = 0
                  TomChannelDutyCycleCompareValCm1 = 0
                  TomChPeriodCompareShadowValSr0 = 0
                  TomChDCycCompareShadowValSr1 = 0
                  TomChUpdateEnableOnCn0Reset = false
                  TomChEnableForceUpdate = false
                  TomChResetCn0OnForceUpdate = false
                  TomChannelClockSelect = GTM_FIXED_CLOCK_0
                  TomChannelCounterCn0Reset = ON_COMPARE_MATCH_ON_CHANNEL
                  TomChannelTriggerOutput = TRIG_FROM_PREVIOUS_CHANNEL
                  TomChannelOneShotMode = false
                  TomChannelSpeMode = false
                  TomChannelGatedCounterMode = false
                  TomChannelBitReversalMode = false
                TomChannelInterrupt: TomIntEnableOnPeriodMatchCcu0=false, TomIntEnableOnDutyCycleMatchCcu1=false, TomInterruptMode=GTM_INTERRUPT_LEVEL_MODE, TomNotification=NULL_PTR
              TomChannel_3
                TomChannelUsage: TomChannelUsage=USED_BY_OTHER_DRIVERS_OR_UNUSED
                TomChannelEnable: TomChannelEnable=AT_START, TomChDisableOnTgcTrigger=false
                TomChannelOutput:
                  TomChannelOutputControl = DONT_ENABLE_CHANNEL_OUTPUT
                  TomChOutputDisableOnTgcTrig = false
                  TomChannelOutputSignalLevel = LOW
                  TomChannelPortPinSelect = TOUT21_SELA_PORT0_PIN12
                TomChannelTimerParameters:
                  TomChannelCounterValCn0 = 0
                  TomChannelPeriodCompareValCm0 = 0
                  TomChannelDutyCycleCompareValCm1 = 0
                  TomChPeriodCompareShadowValSr0 = 0
                  TomChDCycCompareShadowValSr1 = 0
                  TomChUpdateEnableOnCn0Reset = false
                  TomChEnableForceUpdate = false
                  TomChResetCn0OnForceUpdate = false
                  TomChannelClockSelect = GTM_FIXED_CLOCK_0
                  TomChannelCounterCn0Reset = ON_COMPARE_MATCH_ON_CHANNEL
                  TomChannelTriggerOutput = TRIG_FROM_PREVIOUS_CHANNEL
                  TomChannelOneShotMode = false
                  TomChannelSpeMode = false
                  TomChannelGatedCounterMode = false
                  TomChannelBitReversalMode = false
                TomChannelInterrupt: TomIntEnableOnPeriodMatchCcu0=false, TomIntEnableOnDutyCycleMatchCcu1=false, TomInterruptMode=GTM_INTERRUPT_LEVEL_MODE, TomNotification=NULL_PTR
              TomChannel_4
                TomChannelUsage: TomChannelUsage=USED_BY_OTHER_DRIVERS_OR_UNUSED
                TomChannelEnable: TomChannelEnable=AT_START, TomChDisableOnTgcTrigger=false
                TomChannelOutput:
                  TomChannelOutputControl = DONT_ENABLE_CHANNEL_OUTPUT
                  TomChOutputDisableOnTgcTrig = false
                  TomChannelOutputSignalLevel = LOW
                  TomChannelPortPinSelect = TOUT102_SELA_PORT10_PIN0
                TomChannelTimerParameters:
                  TomChannelCounterValCn0 = 0
                  TomChannelPeriodCompareValCm0 = 0
                  TomChannelDutyCycleCompareValCm1 = 0
                  TomChPeriodCompareShadowValSr0 = 0
                  TomChDCycCompareShadowValSr1 = 0
                  TomChUpdateEnableOnCn0Reset = false
                  TomChEnableForceUpdate = false
                  TomChResetCn0OnForceUpdate = false
                  TomChannelClockSelect = GTM_FIXED_CLOCK_0
                  TomChannelCounterCn0Reset = ON_COMPARE_MATCH_ON_CHANNEL
                  TomChannelTriggerOutput = TRIG_FROM_PREVIOUS_CHANNEL
                  TomChannelOneShotMode = false
                  TomChannelSpeMode = false
                  TomChannelGatedCounterMode = false
                  TomChannelBitReversalMode = false
                TomChannelInterrupt: TomIntEnableOnPeriodMatchCcu0=false, TomIntEnableOnDutyCycleMatchCcu1=false, TomInterruptMode=GTM_INTERRUPT_LEVEL_MODE, TomNotification=NULL_PTR
              TomChannel_5
                TomChannelUsage: TomChannelUsage=USED_BY_OTHER_DRIVERS_OR_UNUSED
                TomChannelEnable: TomChannelEnable=AT_START, TomChDisableOnTgcTrigger=false
                TomChannelOutput:
                  TomChannelOutputControl = DONT_ENABLE_CHANNEL_OUTPUT
                  TomChOutputDisableOnTgcTrig = false
                  TomChannelOutputSignalLevel = LOW
                  TomChannelPortPinSelect = TOUT110_SELA_PORT10_PIN8
                TomChannelTimerParameters:
                  TomChannelCounterValCn0 = 0
                  TomChannelPeriodCompareValCm0 = 0
                  TomChannelDutyCycleCompareValCm1 = 0
                  TomChPeriodCompareShadowValSr0 = 0
                  TomChDCycCompareShadowValSr1 = 0
                  TomChUpdateEnableOnCn0Reset = false
                  TomChEnableForceUpdate = false
                  TomChResetCn0OnForceUpdate = false
                  TomChannelClockSelect = GTM_FIXED_CLOCK_0
                  TomChannelCounterCn0Reset = ON_COMPARE_MATCH_ON_CHANNEL
                  TomChannelTriggerOutput = TRIG_FROM_PREVIOUS_CHANNEL
                  TomChannelOneShotMode = false
                  TomChannelSpeMode = false
                  TomChannelGatedCounterMode = false
                  TomChannelBitReversalMode = false
                TomChannelInterrupt: TomIntEnableOnPeriodMatchCcu0=false, TomIntEnableOnDutyCycleMatchCcu1=false, TomInterruptMode=GTM_INTERRUPT_LEVEL_MODE, TomNotification=NULL_PTR
              TomChannel_6
                TomChannelUsage: TomChannelUsage=USED_BY_OTHER_DRIVERS_OR_UNUSED
                TomChannelEnable: TomChannelEnable=AT_START, TomChDisableOnTgcTrigger=false
                TomChannelOutput:
                  TomChannelOutputControl = DONT_ENABLE_CHANNEL_OUTPUT
                  TomChOutputDisableOnTgcTrig = false
                  TomChannelOutputSignalLevel = LOW
                  TomChannelPortPinSelect = TOUT106_SELA_PORT10_PIN4
                TomChannelTimerParameters:
                  TomChannelCounterValCn0 = 0
                  TomChannelPeriodCompareValCm0 = 0
                  TomChannelDutyCycleCompareValCm1 = 0
                  TomChPeriodCompareShadowValSr0 = 0
                  TomChDCycCompareShadowValSr1 = 0
                  TomChUpdateEnableOnCn0Reset = false
                  TomChEnableForceUpdate = false
                  TomChResetCn0OnForceUpdate = false
                  TomChannelClockSelect = GTM_FIXED_CLOCK_0
                  TomChannelCounterCn0Reset = ON_COMPARE_MATCH_ON_CHANNEL
                  TomChannelTriggerOutput = TRIG_FROM_PREVIOUS_CHANNEL
                  TomChannelOneShotMode = false
                  TomChannelSpeMode = false
                  TomChannelGatedCounterMode = false
                  TomChannelBitReversalMode = false
                TomChannelInterrupt: TomIntEnableOnPeriodMatchCcu0=false, TomIntEnableOnDutyCycleMatchCcu1=false, TomInterruptMode=GTM_INTERRUPT_LEVEL_MODE, TomNotification=NULL_PTR
              TomChannel_7
                TomChannelUsage: TomChannelUsage=USED_BY_OTHER_DRIVERS_OR_UNUSED
                TomChannelEnable: TomChannelEnable=AT_START, TomChDisableOnTgcTrigger=false
                TomChannelOutput:
                  TomChannelOutputControl = DONT_ENABLE_CHANNEL_OUTPUT
                  TomChOutputDisableOnTgcTrig = false
                  TomChannelOutputSignalLevel = LOW
                  TomChannelPortPinSelect = TOUT93_SELA_PORT13_PIN2
                TomChannelTimerParameters:
                  TomChannelCounterValCn0 = 0
                  TomChannelPeriodCompareValCm0 = 0
                  TomChannelDutyCycleCompareValCm1 = 0
                  TomChPeriodCompareShadowValSr0 = 0
                  TomChDCycCompareShadowValSr1 = 0
                  TomChUpdateEnableOnCn0Reset = false
                  TomChEnableForceUpdate = false
                  TomChResetCn0OnForceUpdate = false
                  TomChannelClockSelect = GTM_FIXED_CLOCK_0
                  TomChannelCounterCn0Reset = ON_COMPARE_MATCH_ON_CHANNEL
                  TomChannelTriggerOutput = TRIG_FROM_PREVIOUS_CHANNEL
                  TomChannelOneShotMode = false
                  TomChannelSpeMode = false
                  TomChannelGatedCounterMode = false
                  TomChannelBitReversalMode = false
                TomChannelInterrupt: TomIntEnableOnPeriodMatchCcu0=false, TomIntEnableOnDutyCycleMatchCcu1=false, TomInterruptMode=GTM_INTERRUPT_LEVEL_MODE, TomNotification=NULL_PTR
              TomChannel_8
                TomChannelUsage: TomChannelUsage=USED_BY_OTHER_DRIVERS_OR_UNUSED
                TomChannelEnable: TomChannelEnable=AT_START, TomChDisableOnTgcTrigger=false
                TomChannelOutput:
                  TomChannelOutputControl = DONT_ENABLE_CHANNEL_OUTPUT
                  TomChOutputDisableOnTgcTrig = false
                  TomChannelOutputSignalLevel = LOW
                  TomChannelPortPinSelect = TOUT9_SELA_PORT0_PIN0
                TomChannelTimerParameters:
                  TomChannelCounterValCn0 = 0
                  TomChannelPeriodCompareValCm0 = 0
                  TomChannelDutyCycleCompareValCm1 = 0
                  TomChPeriodCompareShadowValSr0 = 0
                  TomChDCycCompareShadowValSr1 = 0
                  TomChUpdateEnableOnCn0Reset = false
                  TomChEnableForceUpdate = false
                  TomChResetCn0OnForceUpdate = false
                  TomChannelClockSelect = GTM_FIXED_CLOCK_0
                  TomChannelCounterCn0Reset = ON_COMPARE_MATCH_ON_CHANNEL
                  TomChannelTriggerOutput = TRIG_FROM_PREVIOUS_CHANNEL
                  TomChannelOneShotMode = false
                  TomChannelSpeMode = false
                  TomChannelGatedCounterMode = false
                  TomChannelBitReversalMode = false
                TomChannelInterrupt: TomIntEnableOnPeriodMatchCcu0=false, TomIntEnableOnDutyCycleMatchCcu1=false, TomInterruptMode=GTM_INTERRUPT_LEVEL_MODE, TomNotification=NULL_PTR
              TomChannel_9
                TomChannelUsage: TomChannelUsage=USED_BY_OTHER_DRIVERS_OR_UNUSED
                TomChannelEnable: TomChannelEnable=AT_START, TomChDisableOnTgcTrigger=false
                TomChannelOutput:
                  TomChannelOutputControl = DONT_ENABLE_CHANNEL_OUTPUT
                  TomChOutputDisableOnTgcTrig = false
                  TomChannelOutputSignalLevel = LOW
                  TomChannelPortPinSelect = TOUT10_SELA_PORT0_PIN1
                TomChannelTimerParameters:
                  TomChannelCounterValCn0 = 0
                  TomChannelPeriodCompareValCm0 = 0
                  TomChannelDutyCycleCompareValCm1 = 0
                  TomChPeriodCompareShadowValSr0 = 0
                  TomChDCycCompareShadowValSr1 = 0
                  TomChUpdateEnableOnCn0Reset = false
                  TomChEnableForceUpdate = false
                  TomChResetCn0OnForceUpdate = false
                  TomChannelClockSelect = GTM_FIXED_CLOCK_0
                  TomChannelCounterCn0Reset = ON_COMPARE_MATCH_ON_CHANNEL
                  TomChannelTriggerOutput = TRIG_FROM_PREVIOUS_CHANNEL
                  TomChannelOneShotMode = false
                  TomChannelSpeMode = false
                  TomChannelGatedCounterMode = false
                  TomChannelBitReversalMode = false
                TomChannelInterrupt: TomIntEnableOnPeriodMatchCcu0=false, TomIntEnableOnDutyCycleMatchCcu1=false, TomInterruptMode=GTM_INTERRUPT_LEVEL_MODE, TomNotification=NULL_PTR
              TomChannel_10
                TomChannelUsage: TomChannelUsage=USED_BY_OTHER_DRIVERS_OR_UNUSED
                TomChannelEnable: TomChannelEnable=AT_START, TomChDisableOnTgcTrigger=false
                TomChannelOutput:
                  TomChannelOutputControl = DONT_ENABLE_CHANNEL_OUTPUT
                  TomChOutputDisableOnTgcTrig = false
                  TomChannelOutputSignalLevel = LOW
                  TomChannelPortPinSelect = TOUT12_SELA_PORT0_PIN3
                TomChannelTimerParameters:
                  TomChannelCounterValCn0 = 0
                  TomChannelPeriodCompareValCm0 = 0
                  TomChannelDutyCycleCompareValCm1 = 0
                  TomChPeriodCompareShadowValSr0 = 0
                  TomChDCycCompareShadowValSr1 = 0
                  TomChUpdateEnableOnCn0Reset = false
                  TomChEnableForceUpdate = false
                  TomChResetCn0OnForceUpdate = false
                  TomChannelClockSelect = GTM_FIXED_CLOCK_0
                  TomChannelCounterCn0Reset = ON_COMPARE_MATCH_ON_CHANNEL
                  TomChannelTriggerOutput = TRIG_FROM_PREVIOUS_CHANNEL
                  TomChannelOneShotMode = false
                  TomChannelSpeMode = false
                  TomChannelGatedCounterMode = false
                  TomChannelBitReversalMode = false
                TomChannelInterrupt: TomIntEnableOnPeriodMatchCcu0=false, TomIntEnableOnDutyCycleMatchCcu1=false, TomInterruptMode=GTM_INTERRUPT_LEVEL_MODE, TomNotification=NULL_PTR
              TomChannel_11
                TomChannelUsage: TomChannelUsage=USED_BY_OTHER_DRIVERS_OR_UNUSED
                TomChannelEnable: TomChannelEnable=AT_START, TomChDisableOnTgcTrigger=false
                TomChannelOutput:
                  TomChannelOutputControl = DONT_ENABLE_CHANNEL_OUTPUT
                  TomChOutputDisableOnTgcTrig = false
                  TomChannelOutputSignalLevel = LOW
                  TomChannelPortPinSelect = TOUT13_SELA_PORT0_PIN4
                TomChannelTimerParameters:
                  TomChannelCounterValCn0 = 0
                  TomChannelPeriodCompareValCm0 = 0
                  TomChannelDutyCycleCompareValCm1 = 0
                  TomChPeriodCompareShadowValSr0 = 0
                  TomChDCycCompareShadowValSr1 = 0
                  TomChUpdateEnableOnCn0Reset = false
                  TomChEnableForceUpdate = false
                  TomChResetCn0OnForceUpdate = false
                  TomChannelClockSelect = GTM_FIXED_CLOCK_0
                  TomChannelCounterCn0Reset = ON_COMPARE_MATCH_ON_CHANNEL
                  TomChannelTriggerOutput = TRIG_FROM_PREVIOUS_CHANNEL
                  TomChannelOneShotMode = false
                  TomChannelSpeMode = false
                  TomChannelGatedCounterMode = false
                  TomChannelBitReversalMode = false
                TomChannelInterrupt: TomIntEnableOnPeriodMatchCcu0=false, TomIntEnableOnDutyCycleMatchCcu1=false, TomInterruptMode=GTM_INTERRUPT_LEVEL_MODE, TomNotification=NULL_PTR
              TomChannel_12
                TomChannelUsage: TomChannelUsage=USED_BY_OTHER_DRIVERS_OR_UNUSED
                TomChannelEnable: TomChannelEnable=AT_START, TomChDisableOnTgcTrigger=false
                TomChannelOutput:
                  TomChannelOutputControl = DONT_ENABLE_CHANNEL_OUTPUT
                  TomChOutputDisableOnTgcTrig = false
                  TomChannelOutputSignalLevel = LOW
                  TomChannelPortPinSelect = TOUT14_SELA_PORT0_PIN5
                TomChannelTimerParameters:
                  TomChannelCounterValCn0 = 0
                  TomChannelPeriodCompareValCm0 = 0
                  TomChannelDutyCycleCompareValCm1 = 0
                  TomChPeriodCompareShadowValSr0 = 0
                  TomChDCycCompareShadowValSr1 = 0
                  TomChUpdateEnableOnCn0Reset = false
                  TomChEnableForceUpdate = false
                  TomChResetCn0OnForceUpdate = false
                  TomChannelClockSelect = GTM_FIXED_CLOCK_0
                  TomChannelCounterCn0Reset = ON_COMPARE_MATCH_ON_CHANNEL
                  TomChannelTriggerOutput = TRIG_FROM_PREVIOUS_CHANNEL
                  TomChannelOneShotMode = false
                  TomChannelSpeMode = false
                  TomChannelGatedCounterMode = false
                  TomChannelBitReversalMode = false
                TomChannelInterrupt: TomIntEnableOnPeriodMatchCcu0=false, TomIntEnableOnDutyCycleMatchCcu1=false, TomInterruptMode=GTM_INTERRUPT_LEVEL_MODE, TomNotification=NULL_PTR
              TomChannel_13
                TomChannelUsage: TomChannelUsage=USED_BY_OTHER_DRIVERS_OR_UNUSED
                TomChannelEnable: TomChannelEnable=AT_START, TomChDisableOnTgcTrigger=false
                TomChannelOutput:
                  TomChannelOutputControl = DONT_ENABLE_CHANNEL_OUTPUT
                  TomChOutputDisableOnTgcTrig = false
                  TomChannelOutputSignalLevel = LOW
                  TomChannelPortPinSelect = TOUT15_SELA_PORT0_PIN6
                TomChannelTimerParameters:
                  TomChannelCounterValCn0 = 0
                  TomChannelPeriodCompareValCm0 = 0
                  TomChannelDutyCycleCompareValCm1 = 0
                  TomChPeriodCompareShadowValSr0 = 0
                  TomChDCycCompareShadowValSr1 = 0
                  TomChUpdateEnableOnCn0Reset = false
                  TomChEnableForceUpdate = false
                  TomChResetCn0OnForceUpdate = false
                  TomChannelClockSelect = GTM_FIXED_CLOCK_0
                  TomChannelCounterCn0Reset = ON_COMPARE_MATCH_ON_CHANNEL
                  TomChannelTriggerOutput = TRIG_FROM_PREVIOUS_CHANNEL
                  TomChannelOneShotMode = false
                  TomChannelSpeMode = false
                  TomChannelGatedCounterMode = false
                  TomChannelBitReversalMode = false
                TomChannelInterrupt: TomIntEnableOnPeriodMatchCcu0=false, TomIntEnableOnDutyCycleMatchCcu1=false, TomInterruptMode=GTM_INTERRUPT_LEVEL_MODE, TomNotification=NULL_PTR
              TomChannel_14
                TomChannelUsage: TomChannelUsage=USED_BY_OTHER_DRIVERS_OR_UNUSED
                TomChannelEnable: TomChannelEnable=AT_START, TomChDisableOnTgcTrigger=false
                TomChannelOutput:
                  TomChannelOutputControl = DONT_ENABLE_CHANNEL_OUTPUT
                  TomChOutputDisableOnTgcTrig = false
                  TomChannelOutputSignalLevel = LOW
                  TomChannelPortPinSelect = TOUT16_SELA_PORT0_PIN7
                TomChannelTimerParameters:
                  TomChannelCounterValCn0 = 0
                  TomChannelPeriodCompareValCm0 = 0
                  TomChannelDutyCycleCompareValCm1 = 0
                  TomChPeriodCompareShadowValSr0 = 0
                  TomChDCycCompareShadowValSr1 = 0
                  TomChUpdateEnableOnCn0Reset = false
                  TomChEnableForceUpdate = false
                  TomChResetCn0OnForceUpdate = false
                  TomChannelClockSelect = GTM_FIXED_CLOCK_0
                  TomChannelCounterCn0Reset = ON_COMPARE_MATCH_ON_CHANNEL
                  TomChannelTriggerOutput = TRIG_FROM_PREVIOUS_CHANNEL
                  TomChannelOneShotMode = false
                  TomChannelSpeMode = false
                  TomChannelGatedCounterMode = false
                  TomChannelBitReversalMode = false
                TomChannelInterrupt: TomIntEnableOnPeriodMatchCcu0=false, TomIntEnableOnDutyCycleMatchCcu1=false, TomInterruptMode=GTM_INTERRUPT_LEVEL_MODE, TomNotification=NULL_PTR
              TomChannel_15
                TomChannelUsage: TomChannelUsage=USED_BY_OTHER_DRIVERS_OR_UNUSED
                TomChannelEnable: TomChannelEnable=AT_START, TomChDisableOnTgcTrigger=false
                TomChannelOutput:
                  TomChannelOutputControl = DONT_ENABLE_CHANNEL_OUTPUT
                  TomChOutputDisableOnTgcTrig = false
                  TomChannelOutputSignalLevel = LOW
                  TomChannelPortPinSelect = TOUT17_SELA_PORT0_PIN8
                TomChannelTimerParameters:
                  TomChannelCounterValCn0 = 0
                  TomChannelPeriodCompareValCm0 = 0
                  TomChannelDutyCycleCompareValCm1 = 0
                  TomChPeriodCompareShadowValSr0 = 0
                  TomChDCycCompareShadowValSr1 = 0
                  TomChUpdateEnableOnCn0Reset = false
                  TomChEnableForceUpdate = false
                  TomChResetCn0OnForceUpdate = false
                  TomChannelClockSelect = GTM_FIXED_CLOCK_0
                  TomChannelCounterCn0Reset = ON_COMPARE_MATCH_ON_CHANNEL
                  TomChannelTriggerOutput = TRIG_FROM_PREVIOUS_CHANNEL
                  TomChannelOneShotMode = false
                  TomChannelSpeMode = false
                  TomChannelGatedCounterMode = false
                  TomChannelBitReversalMode = false
                TomChannelInterrupt: TomIntEnableOnPeriodMatchCcu0=false, TomIntEnableOnDutyCycleMatchCcu1=false, TomInterruptMode=GTM_INTERRUPT_LEVEL_MODE, TomNotification=NULL_PTR
          Tom_1
            TomTriggersForTgc_0 (TomTriggersForTgc)
              TomTgcTriggerByTimebase: TomTgcTimeBaseTriggerEnable=false, TomTgcTbuTimebaseSelect=TBU_TS0_TIMEBASE, TomTgcTimebaseMatchValue=0
              TomTgcInternalTriggerSelect:
                TomTgcIntTriggerFromChannel{0..7} = false
            TomTriggersForTgc_1 (TomTriggersForTgc)
              TomTgcTriggerByTimebase: TomTgcTimeBaseTriggerEnable=false, TomTgcTbuTimebaseSelect=TBU_TS0_TIMEBASE, TomTgcTimebaseMatchValue=0
              TomTgcInternalTriggerSelect:
                TomTgcIntTriggerFromChannel{0..7} = false
            16 x TomChannel:
              TomChannel_0
                TomChannelUsage: TomChannelUsage=USED_BY_OTHER_DRIVERS_OR_UNUSED
                TomChannelEnable: TomChannelEnable=AT_START, TomChDisableOnTgcTrigger=false
                TomChannelOutput:
                  TomChannelOutputControl = DONT_ENABLE_CHANNEL_OUTPUT
                  TomChOutputDisableOnTgcTrig = false
                  TomChannelOutputSignalLevel = LOW
                  TomChannelPortPinSelect = TOUT9_SELB_PORT0_PIN0
                TomChannelTimerParameters:
                  TomChannelCounterValCn0 = 0
                  TomChannelPeriodCompareValCm0 = 0
                  TomChannelDutyCycleCompareValCm1 = 0
                  TomChPeriodCompareShadowValSr0 = 0
                  TomChDCycCompareShadowValSr1 = 0
                  TomChUpdateEnableOnCn0Reset = false
                  TomChEnableForceUpdate = false
                  TomChResetCn0OnForceUpdate = false
                  TomChannelClockSelect = GTM_FIXED_CLOCK_0
                  TomChannelCounterCn0Reset = ON_COMPARE_MATCH_ON_CHANNEL
                  TomChannelTriggerOutput = TRIG_FROM_PREVIOUS_CHANNEL
                  TomChannelOneShotMode = false
                  TomChannelSpeMode = false
                  TomChannelGatedCounterMode = false
                  TomChannelBitReversalMode = false
                TomChannelInterrupt: TomIntEnableOnPeriodMatchCcu0=false, TomIntEnableOnDutyCycleMatchCcu1=false, TomInterruptMode=GTM_INTERRUPT_LEVEL_MODE, TomNotification=NULL_PTR
              TomChannel_1
                TomChannelUsage: TomChannelUsage=USED_BY_OTHER_DRIVERS_OR_UNUSED
                TomChannelEnable: TomChannelEnable=AT_START, TomChDisableOnTgcTrigger=false
                TomChannelOutput:
                  TomChannelOutputControl = DONT_ENABLE_CHANNEL_OUTPUT
                  TomChOutputDisableOnTgcTrig = false
                  TomChannelOutputSignalLevel = LOW
                  TomChannelPortPinSelect = TOUT10_SELB_PORT0_PIN1
                TomChannelTimerParameters:
                  TomChannelCounterValCn0 = 0
                  TomChannelPeriodCompareValCm0 = 0
                  TomChannelDutyCycleCompareValCm1 = 0
                  TomChPeriodCompareShadowValSr0 = 0
                  TomChDCycCompareShadowValSr1 = 0
                  TomChUpdateEnableOnCn0Reset = false
                  TomChEnableForceUpdate = false
                  TomChResetCn0OnForceUpdate = false
                  TomChannelClockSelect = GTM_FIXED_CLOCK_0
                  TomChannelCounterCn0Reset = ON_COMPARE_MATCH_ON_CHANNEL
                  TomChannelTriggerOutput = TRIG_FROM_PREVIOUS_CHANNEL
                  TomChannelOneShotMode = false
                  TomChannelSpeMode = false
                  TomChannelGatedCounterMode = false
                  TomChannelBitReversalMode = false
                TomChannelInterrupt: TomIntEnableOnPeriodMatchCcu0=false, TomIntEnableOnDutyCycleMatchCcu1=false, TomInterruptMode=GTM_INTERRUPT_LEVEL_MODE, TomNotification=NULL_PTR
              TomChannel_2
                TomChannelUsage: TomChannelUsage=USED_BY_OTHER_DRIVERS_OR_UNUSED
                TomChannelEnable: TomChannelEnable=AT_START, TomChDisableOnTgcTrigger=false
                TomChannelOutput:
                  TomChannelOutputControl = DONT_ENABLE_CHANNEL_OUTPUT
                  TomChOutputDisableOnTgcTrig = false
                  TomChannelOutputSignalLevel = LOW
                  TomChannelPortPinSelect = TOUT12_SELB_PORT0_PIN3
                TomChannelTimerParameters:
                  TomChannelCounterValCn0 = 0
                  TomChannelPeriodCompareValCm0 = 0
                  TomChannelDutyCycleCompareValCm1 = 0
                  TomChPeriodCompareShadowValSr0 = 0
                  TomChDCycCompareShadowValSr1 = 0
                  TomChUpdateEnableOnCn0Reset = false
                  TomChEnableForceUpdate = false
                  TomChResetCn0OnForceUpdate = false
                  TomChannelClockSelect = GTM_FIXED_CLOCK_0
                  TomChannelCounterCn0Reset = ON_COMPARE_MATCH_ON_CHANNEL
                  TomChannelTriggerOutput = TRIG_FROM_PREVIOUS_CHANNEL
                  TomChannelOneShotMode = false
                  TomChannelSpeMode = false
                  TomChannelGatedCounterMode = false
                  TomChannelBitReversalMode = false
                TomChannelInterrupt: TomIntEnableOnPeriodMatchCcu0=false, TomIntEnableOnDutyCycleMatchCcu1=false, TomInterruptMode=GTM_INTERRUPT_LEVEL_MODE, TomNotification=NULL_PTR
              TomChannel_3
                TomChannelUsage: TomChannelUsage=USED_BY_OTHER_DRIVERS_OR_UNUSED
                TomChannelEnable: TomChannelEnable=AT_START, TomChDisableOnTgcTrigger=false
                TomChannelOutput:
                  TomChannelOutputControl = DONT_ENABLE_CHANNEL_OUTPUT
                  TomChOutputDisableOnTgcTrig = false
                  TomChannelOutputSignalLevel = LOW
                  TomChannelPortPinSelect = TOUT13_SELB_PORT0_PIN4
                TomChannelTimerParameters:
                  TomChannelCounterValCn0 = 0
                  TomChannelPeriodCompareValCm0 = 0
                  TomChannelDutyCycleCompareValCm1 = 0
                  TomChPeriodCompareShadowValSr0 = 0
                  TomChDCycCompareShadowValSr1 = 0
                  TomChUpdateEnableOnCn0Reset = false
                  TomChEnableForceUpdate = false
                  TomChResetCn0OnForceUpdate = false
                  TomChannelClockSelect = GTM_FIXED_CLOCK_0
                  TomChannelCounterCn0Reset = ON_COMPARE_MATCH_ON_CHANNEL
                  TomChannelTriggerOutput = TRIG_FROM_PREVIOUS_CHANNEL
                  TomChannelOneShotMode = false
                  TomChannelSpeMode = false
                  TomChannelGatedCounterMode = false
                  TomChannelBitReversalMode = false
                TomChannelInterrupt: TomIntEnableOnPeriodMatchCcu0=false, TomIntEnableOnDutyCycleMatchCcu1=false, TomInterruptMode=GTM_INTERRUPT_LEVEL_MODE, TomNotification=NULL_PTR
              TomChannel_4
                TomChannelUsage: TomChannelUsage=USED_BY_OTHER_DRIVERS_OR_UNUSED
                TomChannelEnable: TomChannelEnable=AT_START, TomChDisableOnTgcTrigger=false
                TomChannelOutput:
                  TomChannelOutputControl = DONT_ENABLE_CHANNEL_OUTPUT
                  TomChOutputDisableOnTgcTrig = false
                  TomChannelOutputSignalLevel = LOW
                  TomChannelPortPinSelect = TOUT14_SELB_PORT0_PIN5
                TomChannelTimerParameters:
                  TomChannelCounterValCn0 = 0
                  TomChannelPeriodCompareValCm0 = 0
                  TomChannelDutyCycleCompareValCm1 = 0
                  TomChPeriodCompareShadowValSr0 = 0
                  TomChDCycCompareShadowValSr1 = 0
                  TomChUpdateEnableOnCn0Reset = false
                  TomChEnableForceUpdate = false
                  TomChResetCn0OnForceUpdate = false
                  TomChannelClockSelect = GTM_FIXED_CLOCK_0
                  TomChannelCounterCn0Reset = ON_COMPARE_MATCH_ON_CHANNEL
                  TomChannelTriggerOutput = TRIG_FROM_PREVIOUS_CHANNEL
                  TomChannelOneShotMode = false
                  TomChannelSpeMode = false
                  TomChannelGatedCounterMode = false
                  TomChannelBitReversalMode = false
                TomChannelInterrupt: TomIntEnableOnPeriodMatchCcu0=false, TomIntEnableOnDutyCycleMatchCcu1=false, TomInterruptMode=GTM_INTERRUPT_LEVEL_MODE, TomNotification=NULL_PTR
              TomChannel_5
                TomChannelUsage: TomChannelUsage=USED_BY_OTHER_DRIVERS_OR_UNUSED
                TomChannelEnable: TomChannelEnable=AT_START, TomChDisableOnTgcTrigger=false
                TomChannelOutput:
                  TomChannelOutputControl = DONT_ENABLE_CHANNEL_OUTPUT
                  TomChOutputDisableOnTgcTrig = false
                  TomChannelOutputSignalLevel = LOW
                  TomChannelPortPinSelect = TOUT15_SELB_PORT0_PIN6
                TomChannelTimerParameters:
                  TomChannelCounterValCn0 = 0
                  TomChannelPeriodCompareValCm0 = 0
                  TomChannelDutyCycleCompareValCm1 = 0
                  TomChPeriodCompareShadowValSr0 = 0
                  TomChDCycCompareShadowValSr1 = 0
                  TomChUpdateEnableOnCn0Reset = false
                  TomChEnableForceUpdate = false
                  TomChResetCn0OnForceUpdate = false
                  TomChannelClockSelect = GTM_FIXED_CLOCK_0
                  TomChannelCounterCn0Reset = ON_COMPARE_MATCH_ON_CHANNEL
                  TomChannelTriggerOutput = TRIG_FROM_PREVIOUS_CHANNEL
                  TomChannelOneShotMode = false
                  TomChannelSpeMode = false
                  TomChannelGatedCounterMode = false
                  TomChannelBitReversalMode = false
                TomChannelInterrupt: TomIntEnableOnPeriodMatchCcu0=false, TomIntEnableOnDutyCycleMatchCcu1=false, TomInterruptMode=GTM_INTERRUPT_LEVEL_MODE, TomNotification=NULL_PTR
              TomChannel_6
                TomChannelUsage: TomChannelUsage=USED_BY_OTHER_DRIVERS_OR_UNUSED
                TomChannelEnable: TomChannelEnable=AT_START, TomChDisableOnTgcTrigger=false
                TomChannelOutput:
                  TomChannelOutputControl = DONT_ENABLE_CHANNEL_OUTPUT
                  TomChOutputDisableOnTgcTrig = false
                  TomChannelOutputSignalLevel = LOW
                  TomChannelPortPinSelect = TOUT16_SELB_PORT0_PIN7
                TomChannelTimerParameters:
                  TomChannelCounterValCn0 = 0
                  TomChannelPeriodCompareValCm0 = 0
                  TomChannelDutyCycleCompareValCm1 = 0
                  TomChPeriodCompareShadowValSr0 = 0
                  TomChDCycCompareShadowValSr1 = 0
                  TomChUpdateEnableOnCn0Reset = false
                  TomChEnableForceUpdate = false
                  TomChResetCn0OnForceUpdate = false
                  TomChannelClockSelect = GTM_FIXED_CLOCK_0
                  TomChannelCounterCn0Reset = ON_COMPARE_MATCH_ON_CHANNEL
                  TomChannelTriggerOutput = TRIG_FROM_PREVIOUS_CHANNEL
                  TomChannelOneShotMode = false
                  TomChannelSpeMode = false
                  TomChannelGatedCounterMode = false
                  TomChannelBitReversalMode = false
                TomChannelInterrupt: TomIntEnableOnPeriodMatchCcu0=false, TomIntEnableOnDutyCycleMatchCcu1=false, TomInterruptMode=GTM_INTERRUPT_LEVEL_MODE, TomNotification=NULL_PTR
              TomChannel_7
                TomChannelUsage: TomChannelUsage=USED_BY_OTHER_DRIVERS_OR_UNUSED
                TomChannelEnable: TomChannelEnable=AT_START, TomChDisableOnTgcTrigger=false
                TomChannelOutput:
                  TomChannelOutputControl = DONT_ENABLE_CHANNEL_OUTPUT
                  TomChOutputDisableOnTgcTrig = false
                  TomChannelOutputSignalLevel = LOW
                  TomChannelPortPinSelect = TOUT17_SELB_PORT0_PIN8
                TomChannelTimerParameters:
                  TomChannelCounterValCn0 = 0
                  TomChannelPeriodCompareValCm0 = 0
                  TomChannelDutyCycleCompareValCm1 = 0
                  TomChPeriodCompareShadowValSr0 = 0
                  TomChDCycCompareShadowValSr1 = 0
                  TomChUpdateEnableOnCn0Reset = false
                  TomChEnableForceUpdate = false
                  TomChResetCn0OnForceUpdate = false
                  TomChannelClockSelect = GTM_FIXED_CLOCK_0
                  TomChannelCounterCn0Reset = ON_COMPARE_MATCH_ON_CHANNEL
                  TomChannelTriggerOutput = TRIG_FROM_PREVIOUS_CHANNEL
                  TomChannelOneShotMode = false
                  TomChannelSpeMode = false
                  TomChannelGatedCounterMode = false
                  TomChannelBitReversalMode = false
                TomChannelInterrupt: TomIntEnableOnPeriodMatchCcu0=false, TomIntEnableOnDutyCycleMatchCcu1=false, TomInterruptMode=GTM_INTERRUPT_LEVEL_MODE, TomNotification=NULL_PTR
              TomChannel_8
                TomChannelUsage: TomChannelUsage=USED_BY_OTHER_DRIVERS_OR_UNUSED
                TomChannelEnable: TomChannelEnable=AT_START, TomChDisableOnTgcTrigger=false
                TomChannelOutput:
                  TomChannelOutputControl = DONT_ENABLE_CHANNEL_OUTPUT
                  TomChOutputDisableOnTgcTrig = false
                  TomChannelOutputSignalLevel = LOW
                  TomChannelPortPinSelect = TOUT0_SELB_PORT2_PIN0
                TomChannelTimerParameters:
                  TomChannelCounterValCn0 = 0
                  TomChannelPeriodCompareValCm0 = 0
                  TomChannelDutyCycleCompareValCm1 = 0
                  TomChPeriodCompareShadowValSr0 = 0
                  TomChDCycCompareShadowValSr1 = 0
                  TomChUpdateEnableOnCn0Reset = false
                  TomChEnableForceUpdate = false
                  TomChResetCn0OnForceUpdate = false
                  TomChannelClockSelect = GTM_FIXED_CLOCK_0
                  TomChannelCounterCn0Reset = ON_COMPARE_MATCH_ON_CHANNEL
                  TomChannelTriggerOutput = TRIG_FROM_PREVIOUS_CHANNEL
                  TomChannelOneShotMode = false
                  TomChannelSpeMode = false
                  TomChannelGatedCounterMode = false
                  TomChannelBitReversalMode = false
                TomChannelInterrupt: TomIntEnableOnPeriodMatchCcu0=false, TomIntEnableOnDutyCycleMatchCcu1=false, TomInterruptMode=GTM_INTERRUPT_LEVEL_MODE, TomNotification=NULL_PTR
              TomChannel_9
                TomChannelUsage: TomChannelUsage=USED_BY_OTHER_DRIVERS_OR_UNUSED
                TomChannelEnable: TomChannelEnable=AT_START, TomChDisableOnTgcTrigger=false
                TomChannelOutput:
                  TomChannelOutputControl = DONT_ENABLE_CHANNEL_OUTPUT
                  TomChOutputDisableOnTgcTrig = false
                  TomChannelOutputSignalLevel = LOW
                  TomChannelPortPinSelect = TOUT1_SELB_PORT2_PIN1
                TomChannelTimerParameters:
                  TomChannelCounterValCn0 = 0
                  TomChannelPeriodCompareValCm0 = 0
                  TomChannelDutyCycleCompareValCm1 = 0
                  TomChPeriodCompareShadowValSr0 = 0
                  TomChDCycCompareShadowValSr1 = 0
                  TomChUpdateEnableOnCn0Reset = false
                  TomChEnableForceUpdate = false
                  TomChResetCn0OnForceUpdate = false
                  TomChannelClockSelect = GTM_FIXED_CLOCK_0
                  TomChannelCounterCn0Reset = ON_COMPARE_MATCH_ON_CHANNEL
                  TomChannelTriggerOutput = TRIG_FROM_PREVIOUS_CHANNEL
                  TomChannelOneShotMode = false
                  TomChannelSpeMode = false
                  TomChannelGatedCounterMode = false
                  TomChannelBitReversalMode = false
                TomChannelInterrupt: TomIntEnableOnPeriodMatchCcu0=false, TomIntEnableOnDutyCycleMatchCcu1=false, TomInterruptMode=GTM_INTERRUPT_LEVEL_MODE, TomNotification=NULL_PTR
              TomChannel_10
                TomChannelUsage: TomChannelUsage=USED_BY_OTHER_DRIVERS_OR_UNUSED
                TomChannelEnable: TomChannelEnable=AT_START, TomChDisableOnTgcTrigger=false
                TomChannelOutput:
                  TomChannelOutputControl = DONT_ENABLE_CHANNEL_OUTPUT
                  TomChOutputDisableOnTgcTrig = false
                  TomChannelOutputSignalLevel = LOW
                  TomChannelPortPinSelect = TOUT2_SELB_PORT2_PIN2
                TomChannelTimerParameters:
                  TomChannelCounterValCn0 = 0
                  TomChannelPeriodCompareValCm0 = 0
                  TomChannelDutyCycleCompareValCm1 = 0
                  TomChPeriodCompareShadowValSr0 = 0
                  TomChDCycCompareShadowValSr1 = 0
                  TomChUpdateEnableOnCn0Reset = false
                  TomChEnableForceUpdate = false
                  TomChResetCn0OnForceUpdate = false
                  TomChannelClockSelect = GTM_FIXED_CLOCK_0
                  TomChannelCounterCn0Reset = ON_COMPARE_MATCH_ON_CHANNEL
                  TomChannelTriggerOutput = TRIG_FROM_PREVIOUS_CHANNEL
                  TomChannelOneShotMode = false
                  TomChannelSpeMode = false
                  TomChannelGatedCounterMode = false
                  TomChannelBitReversalMode = false
                TomChannelInterrupt: TomIntEnableOnPeriodMatchCcu0=false, TomIntEnableOnDutyCycleMatchCcu1=false, TomInterruptMode=GTM_INTERRUPT_LEVEL_MODE, TomNotification=NULL_PTR
              TomChannel_11
                TomChannelUsage: TomChannelUsage=USED_BY_OTHER_DRIVERS_OR_UNUSED
                TomChannelEnable: TomChannelEnable=AT_START, TomChDisableOnTgcTrigger=false
                TomChannelOutput:
                  TomChannelOutputControl = DONT_ENABLE_CHANNEL_OUTPUT
                  TomChOutputDisableOnTgcTrig = false
                  TomChannelOutputSignalLevel = LOW
                  TomChannelPortPinSelect = TOUT3_SELB_PORT2_PIN3
                TomChannelTimerParameters:
                  TomChannelCounterValCn0 = 0
                  TomChannelPeriodCompareValCm0 = 0
                  TomChannelDutyCycleCompareValCm1 = 0
                  TomChPeriodCompareShadowValSr0 = 0
                  TomChDCycCompareShadowValSr1 = 0
                  TomChUpdateEnableOnCn0Reset = false
                  TomChEnableForceUpdate = false
                  TomChResetCn0OnForceUpdate = false
                  TomChannelClockSelect = GTM_FIXED_CLOCK_0
                  TomChannelCounterCn0Reset = ON_COMPARE_MATCH_ON_CHANNEL
                  TomChannelTriggerOutput = TRIG_FROM_PREVIOUS_CHANNEL
                  TomChannelOneShotMode = false
                  TomChannelSpeMode = false
                  TomChannelGatedCounterMode = false
                  TomChannelBitReversalMode = false
                TomChannelInterrupt: TomIntEnableOnPeriodMatchCcu0=false, TomIntEnableOnDutyCycleMatchCcu1=false, TomInterruptMode=GTM_INTERRUPT_LEVEL_MODE, TomNotification=NULL_PTR
              TomChannel_12
                TomChannelUsage: TomChannelUsage=USED_BY_OTHER_DRIVERS_OR_UNUSED
                TomChannelEnable: TomChannelEnable=AT_START, TomChDisableOnTgcTrigger=false
                TomChannelOutput:
                  TomChannelOutputControl = DONT_ENABLE_CHANNEL_OUTPUT
                  TomChOutputDisableOnTgcTrig = false
                  TomChannelOutputSignalLevel = LOW
                  TomChannelPortPinSelect = TOUT4_SELB_PORT2_PIN4
                TomChannelTimerParameters:
                  TomChannelCounterValCn0 = 0
                  TomChannelPeriodCompareValCm0 = 0
                  TomChannelDutyCycleCompareValCm1 = 0
                  TomChPeriodCompareShadowValSr0 = 0
                  TomChDCycCompareShadowValSr1 = 0
                  TomChUpdateEnableOnCn0Reset = false
                  TomChEnableForceUpdate = false
                  TomChResetCn0OnForceUpdate = false
                  TomChannelClockSelect = GTM_FIXED_CLOCK_0
                  TomChannelCounterCn0Reset = ON_COMPARE_MATCH_ON_CHANNEL
                  TomChannelTriggerOutput = TRIG_FROM_PREVIOUS_CHANNEL
                  TomChannelOneShotMode = false
                  TomChannelSpeMode = false
                  TomChannelGatedCounterMode = false
                  TomChannelBitReversalMode = false
                TomChannelInterrupt: TomIntEnableOnPeriodMatchCcu0=false, TomIntEnableOnDutyCycleMatchCcu1=false, TomInterruptMode=GTM_INTERRUPT_LEVEL_MODE, TomNotification=NULL_PTR
              TomChannel_13
                TomChannelUsage: TomChannelUsage=USED_BY_OTHER_DRIVERS_OR_UNUSED
                TomChannelEnable: TomChannelEnable=AT_START, TomChDisableOnTgcTrigger=false
                TomChannelOutput:
                  TomChannelOutputControl = DONT_ENABLE_CHANNEL_OUTPUT
                  TomChOutputDisableOnTgcTrig = false
                  TomChannelOutputSignalLevel = LOW
                  TomChannelPortPinSelect = TOUT5_SELB_PORT2_PIN5
                TomChannelTimerParameters:
                  TomChannelCounterValCn0 = 0
                  TomChannelPeriodCompareValCm0 = 0
                  TomChannelDutyCycleCompareValCm1 = 0
                  TomChPeriodCompareShadowValSr0 = 0
                  TomChDCycCompareShadowValSr1 = 0
                  TomChUpdateEnableOnCn0Reset = false
                  TomChEnableForceUpdate = false
                  TomChResetCn0OnForceUpdate = false
                  TomChannelClockSelect = GTM_FIXED_CLOCK_0
                  TomChannelCounterCn0Reset = ON_COMPARE_MATCH_ON_CHANNEL
                  TomChannelTriggerOutput = TRIG_FROM_PREVIOUS_CHANNEL
                  TomChannelOneShotMode = false
                  TomChannelSpeMode = false
                  TomChannelGatedCounterMode = false
                  TomChannelBitReversalMode = false
                TomChannelInterrupt: TomIntEnableOnPeriodMatchCcu0=false, TomIntEnableOnDutyCycleMatchCcu1=false, TomInterruptMode=GTM_INTERRUPT_LEVEL_MODE, TomNotification=NULL_PTR
              TomChannel_14
                TomChannelUsage: TomChannelUsage=USED_BY_OTHER_DRIVERS_OR_UNUSED
                TomChannelEnable: TomChannelEnable=AT_START, TomChDisableOnTgcTrigger=false
                TomChannelOutput:
                  TomChannelOutputControl = DONT_ENABLE_CHANNEL_OUTPUT
                  TomChOutputDisableOnTgcTrig = false
                  TomChannelOutputSignalLevel = LOW
                  TomChannelPortPinSelect = TOUT6_SELB_PORT2_PIN6
                TomChannelTimerParameters:
                  TomChannelCounterValCn0 = 0
                  TomChannelPeriodCompareValCm0 = 0
                  TomChannelDutyCycleCompareValCm1 = 0
                  TomChPeriodCompareShadowValSr0 = 0
                  TomChDCycCompareShadowValSr1 = 0
                  TomChUpdateEnableOnCn0Reset = false
                  TomChEnableForceUpdate = false
                  TomChResetCn0OnForceUpdate = false
                  TomChannelClockSelect = GTM_FIXED_CLOCK_0
                  TomChannelCounterCn0Reset = ON_COMPARE_MATCH_ON_CHANNEL
                  TomChannelTriggerOutput = TRIG_FROM_PREVIOUS_CHANNEL
                  TomChannelOneShotMode = false
                  TomChannelSpeMode = false
                  TomChannelGatedCounterMode = false
                  TomChannelBitReversalMode = false
                TomChannelInterrupt: TomIntEnableOnPeriodMatchCcu0=false, TomIntEnableOnDutyCycleMatchCcu1=false, TomInterruptMode=GTM_INTERRUPT_LEVEL_MODE, TomNotification=NULL_PTR
              TomChannel_15
                TomChannelUsage: TomChannelUsage=USED_BY_OTHER_DRIVERS_OR_UNUSED
                TomChannelEnable: TomChannelEnable=AT_START, TomChDisableOnTgcTrigger=false
                TomChannelOutput:
                  TomChannelOutputControl = DONT_ENABLE_CHANNEL_OUTPUT
                  TomChOutputDisableOnTgcTrig = false
                  TomChannelOutputSignalLevel = LOW
                  TomChannelPortPinSelect = TOUT7_SELB_PORT2_PIN7
                TomChannelTimerParameters:
                  TomChannelCounterValCn0 = 0
                  TomChannelPeriodCompareValCm0 = 0
                  TomChannelDutyCycleCompareValCm1 = 0
                  TomChPeriodCompareShadowValSr0 = 0
                  TomChDCycCompareShadowValSr1 = 0
                  TomChUpdateEnableOnCn0Reset = false
                  TomChEnableForceUpdate = false
                  TomChResetCn0OnForceUpdate = false
                  TomChannelClockSelect = GTM_FIXED_CLOCK_0
                  TomChannelCounterCn0Reset = ON_COMPARE_MATCH_ON_CHANNEL
                  TomChannelTriggerOutput = TRIG_FROM_PREVIOUS_CHANNEL
                  TomChannelOneShotMode = false
                  TomChannelSpeMode = false
                  TomChannelGatedCounterMode = false
                  TomChannelBitReversalMode = false
                TomChannelInterrupt: TomIntEnableOnPeriodMatchCcu0=false, TomIntEnableOnDutyCycleMatchCcu1=false, TomInterruptMode=GTM_INTERRUPT_LEVEL_MODE, TomNotification=NULL_PTR
          Tom_2
            TomTriggersForTgc_0 (TomTriggersForTgc)
              TomTgcTriggerByTimebase: TomTgcTimeBaseTriggerEnable=false, TomTgcTbuTimebaseSelect=TBU_TS0_TIMEBASE, TomTgcTimebaseMatchValue=0
              TomTgcInternalTriggerSelect:
                TomTgcIntTriggerFromChannel{0..7} = false
            TomTriggersForTgc_1 (TomTriggersForTgc)
              TomTgcTriggerByTimebase: TomTgcTimeBaseTriggerEnable=false, TomTgcTbuTimebaseSelect=TBU_TS0_TIMEBASE, TomTgcTimebaseMatchValue=0
              TomTgcInternalTriggerSelect:
                TomTgcIntTriggerFromChannel{0..7} = false
            16 x TomChannel:
              TomChannel_0
                TomChannelUsage: TomChannelUsage=USED_BY_OTHER_DRIVERS_OR_UNUSED
                TomChannelEnable: TomChannelEnable=AT_START, TomChDisableOnTgcTrigger=false
                TomChannelOutput:
                  TomChannelOutputControl = DONT_ENABLE_CHANNEL_OUTPUT
                  TomChOutputDisableOnTgcTrig = false
                  TomChannelOutputSignalLevel = LOW
                  TomChannelPortPinSelect = TOUT119_SELA_PORT11_PIN0
                TomChannelTimerParameters:
                  TomChannelCounterValCn0 = 0
                  TomChannelPeriodCompareValCm0 = 0
                  TomChannelDutyCycleCompareValCm1 = 0
                  TomChPeriodCompareShadowValSr0 = 0
                  TomChDCycCompareShadowValSr1 = 0
                  TomChUpdateEnableOnCn0Reset = false
                  TomChEnableForceUpdate = false
                  TomChResetCn0OnForceUpdate = false
                  TomChannelClockSelect = GTM_FIXED_CLOCK_0
                  TomChannelCounterCn0Reset = ON_COMPARE_MATCH_ON_CHANNEL
                  TomChannelTriggerOutput = TRIG_FROM_PREVIOUS_CHANNEL
                  TomChannelOneShotMode = false
                  TomChannelSpeMode = false
                  TomChannelGatedCounterMode = false
                  TomChannelBitReversalMode = false
                TomChannelInterrupt: TomIntEnableOnPeriodMatchCcu0=false, TomIntEnableOnDutyCycleMatchCcu1=false, TomInterruptMode=GTM_INTERRUPT_LEVEL_MODE, TomNotification=NULL_PTR
              TomChannel_1
                TomChannelUsage: TomChannelUsage=USED_BY_OTHER_DRIVERS_OR_UNUSED
                TomChannelEnable: TomChannelEnable=AT_START, TomChDisableOnTgcTrigger=false
                TomChannelOutput:
                  TomChannelOutputControl = DONT_ENABLE_CHANNEL_OUTPUT
                  TomChOutputDisableOnTgcTrig = false
                  TomChannelOutputSignalLevel = LOW
                  TomChannelPortPinSelect = TOUT120_SELA_PORT11_PIN1
                TomChannelTimerParameters:
                  TomChannelCounterValCn0 = 0
                  TomChannelPeriodCompareValCm0 = 0
                  TomChannelDutyCycleCompareValCm1 = 0
                  TomChPeriodCompareShadowValSr0 = 0
                  TomChDCycCompareShadowValSr1 = 0
                  TomChUpdateEnableOnCn0Reset = false
                  TomChEnableForceUpdate = false
                  TomChResetCn0OnForceUpdate = false
                  TomChannelClockSelect = GTM_FIXED_CLOCK_0
                  TomChannelCounterCn0Reset = ON_COMPARE_MATCH_ON_CHANNEL
                  TomChannelTriggerOutput = TRIG_FROM_PREVIOUS_CHANNEL
                  TomChannelOneShotMode = false
                  TomChannelSpeMode = false
                  TomChannelGatedCounterMode = false
                  TomChannelBitReversalMode = false
                TomChannelInterrupt: TomIntEnableOnPeriodMatchCcu0=false, TomIntEnableOnDutyCycleMatchCcu1=false, TomInterruptMode=GTM_INTERRUPT_LEVEL_MODE, TomNotification=NULL_PTR
              TomChannel_2
                TomChannelUsage: TomChannelUsage=USED_BY_OTHER_DRIVERS_OR_UNUSED
                TomChannelEnable: TomChannelEnable=AT_START, TomChDisableOnTgcTrigger=false
                TomChannelOutput:
                  TomChannelOutputControl = DONT_ENABLE_CHANNEL_OUTPUT
                  TomChOutputDisableOnTgcTrig = false
                  TomChannelOutputSignalLevel = LOW
                  TomChannelPortPinSelect = TOUT96_SELB_PORT11_PIN3
                TomChannelTimerParameters:
                  TomChannelCounterValCn0 = 0
                  TomChannelPeriodCompareValCm0 = 0
                  TomChannelDutyCycleCompareValCm1 = 0
                  TomChPeriodCompareShadowValSr0 = 0
                  TomChDCycCompareShadowValSr1 = 0
                  TomChUpdateEnableOnCn0Reset = false
                  TomChEnableForceUpdate = false
                  TomChResetCn0OnForceUpdate = false
                  TomChannelClockSelect = GTM_FIXED_CLOCK_0
                  TomChannelCounterCn0Reset = ON_COMPARE_MATCH_ON_CHANNEL
                  TomChannelTriggerOutput = TRIG_FROM_PREVIOUS_CHANNEL
                  TomChannelOneShotMode = false
                  TomChannelSpeMode = false
                  TomChannelGatedCounterMode = false
                  TomChannelBitReversalMode = false
                TomChannelInterrupt: TomIntEnableOnPeriodMatchCcu0=false, TomIntEnableOnDutyCycleMatchCcu1=false, TomInterruptMode=GTM_INTERRUPT_LEVEL_MODE, TomNotification=NULL_PTR
              TomChannel_3
                TomChannelUsage: TomChannelUsage=USED_BY_OTHER_DRIVERS_OR_UNUSED
                TomChannelEnable: TomChannelEnable=AT_START, TomChDisableOnTgcTrigger=false
                TomChannelOutput:
                  TomChannelOutputControl = DONT_ENABLE_CHANNEL_OUTPUT
                  TomChOutputDisableOnTgcTrig = false
                  TomChannelOutputSignalLevel = LOW
                  TomChannelPortPinSelect = TOUT122_SELA_PORT11_PIN5
                TomChannelTimerParameters:
                  TomChannelCounterValCn0 = 0
                  TomChannelPeriodCompareValCm0 = 0
                  TomChannelDutyCycleCompareValCm1 = 0
                  TomChPeriodCompareShadowValSr0 = 0
                  TomChDCycCompareShadowValSr1 = 0
                  TomChUpdateEnableOnCn0Reset = false
                  TomChEnableForceUpdate = false
                  TomChResetCn0OnForceUpdate = false
                  TomChannelClockSelect = GTM_FIXED_CLOCK_0
                  TomChannelCounterCn0Reset = ON_COMPARE_MATCH_ON_CHANNEL
                  TomChannelTriggerOutput = TRIG_FROM_PREVIOUS_CHANNEL
                  TomChannelOneShotMode = false
                  TomChannelSpeMode = false
                  TomChannelGatedCounterMode = false
                  TomChannelBitReversalMode = false
                TomChannelInterrupt: TomIntEnableOnPeriodMatchCcu0=false, TomIntEnableOnDutyCycleMatchCcu1=false, TomInterruptMode=GTM_INTERRUPT_LEVEL_MODE, TomNotification=NULL_PTR
              TomChannel_4
                TomChannelUsage: TomChannelUsage=USED_BY_OTHER_DRIVERS_OR_UNUSED
                TomChannelEnable: TomChannelEnable=AT_START, TomChDisableOnTgcTrigger=false
                TomChannelOutput:
                  TomChannelOutputControl = DONT_ENABLE_CHANNEL_OUTPUT
                  TomChOutputDisableOnTgcTrig = false
                  TomChannelOutputSignalLevel = LOW
                  TomChannelPortPinSelect = TOUT123_SELA_PORT11_PIN7
                TomChannelTimerParameters:
                  TomChannelCounterValCn0 = 0
                  TomChannelPeriodCompareValCm0 = 0
                  TomChannelDutyCycleCompareValCm1 = 0
                  TomChPeriodCompareShadowValSr0 = 0
                  TomChDCycCompareShadowValSr1 = 0
                  TomChUpdateEnableOnCn0Reset = false
                  TomChEnableForceUpdate = false
                  TomChResetCn0OnForceUpdate = false
                  TomChannelClockSelect = GTM_FIXED_CLOCK_0
                  TomChannelCounterCn0Reset = ON_COMPARE_MATCH_ON_CHANNEL
                  TomChannelTriggerOutput = TRIG_FROM_PREVIOUS_CHANNEL
                  TomChannelOneShotMode = false
                  TomChannelSpeMode = false
                  TomChannelGatedCounterMode = false
                  TomChannelBitReversalMode = false
                TomChannelInterrupt: TomIntEnableOnPeriodMatchCcu0=false, TomIntEnableOnDutyCycleMatchCcu1=false, TomInterruptMode=GTM_INTERRUPT_LEVEL_MODE, TomNotification=NULL_PTR
              TomChannel_5
                TomChannelUsage: TomChannelUsage=USED_BY_OTHER_DRIVERS_OR_UNUSED
                TomChannelEnable: TomChannelEnable=AT_START, TomChDisableOnTgcTrigger=false
                TomChannelOutput:
                  TomChannelOutputControl = DONT_ENABLE_CHANNEL_OUTPUT
                  TomChOutputDisableOnTgcTrig = false
                  TomChannelOutputSignalLevel = LOW
                  TomChannelPortPinSelect = TOUT124_SELA_PORT11_PIN8
                TomChannelTimerParameters:
                  TomChannelCounterValCn0 = 0
                  TomChannelPeriodCompareValCm0 = 0
                  TomChannelDutyCycleCompareValCm1 = 0
                  TomChPeriodCompareShadowValSr0 = 0
                  TomChDCycCompareShadowValSr1 = 0
                  TomChUpdateEnableOnCn0Reset = false
                  TomChEnableForceUpdate = false
                  TomChResetCn0OnForceUpdate = false
                  TomChannelClockSelect = GTM_FIXED_CLOCK_0
                  TomChannelCounterCn0Reset = ON_COMPARE_MATCH_ON_CHANNEL
                  TomChannelTriggerOutput = TRIG_FROM_PREVIOUS_CHANNEL
                  TomChannelOneShotMode = false
                  TomChannelSpeMode = false
                  TomChannelGatedCounterMode = false
                  TomChannelBitReversalMode = false
                TomChannelInterrupt: TomIntEnableOnPeriodMatchCcu0=false, TomIntEnableOnDutyCycleMatchCcu1=false, TomInterruptMode=GTM_INTERRUPT_LEVEL_MODE, TomNotification=NULL_PTR
              TomChannel_6
                TomChannelUsage: TomChannelUsage=USED_BY_OTHER_DRIVERS_OR_UNUSED
                TomChannelEnable: TomChannelEnable=AT_START, TomChDisableOnTgcTrigger=false
                TomChannelOutput:
                  TomChannelOutputControl = DONT_ENABLE_CHANNEL_OUTPUT
                  TomChOutputDisableOnTgcTrig = false
                  TomChannelOutputSignalLevel = LOW
                  TomChannelPortPinSelect = TOUT106_SELB_PORT10_PIN4
                TomChannelTimerParameters:
                  TomChannelCounterValCn0 = 0
                  TomChannelPeriodCompareValCm0 = 0
                  TomChannelDutyCycleCompareValCm1 = 0
                  TomChPeriodCompareShadowValSr0 = 0
                  TomChDCycCompareShadowValSr1 = 0
                  TomChUpdateEnableOnCn0Reset = false
                  TomChEnableForceUpdate = false
                  TomChResetCn0OnForceUpdate = false
                  TomChannelClockSelect = GTM_FIXED_CLOCK_0
                  TomChannelCounterCn0Reset = ON_COMPARE_MATCH_ON_CHANNEL
                  TomChannelTriggerOutput = TRIG_FROM_PREVIOUS_CHANNEL
                  TomChannelOneShotMode = false
                  TomChannelSpeMode = false
                  TomChannelGatedCounterMode = false
                  TomChannelBitReversalMode = false
                TomChannelInterrupt: TomIntEnableOnPeriodMatchCcu0=false, TomIntEnableOnDutyCycleMatchCcu1=false, TomInterruptMode=GTM_INTERRUPT_LEVEL_MODE, TomNotification=NULL_PTR
              TomChannel_7
                TomChannelUsage: TomChannelUsage=USED_BY_OTHER_DRIVERS_OR_UNUSED
                TomChannelEnable: TomChannelEnable=AT_START, TomChDisableOnTgcTrigger=false
                TomChannelOutput:
                  TomChannelOutputControl = DONT_ENABLE_CHANNEL_OUTPUT
                  TomChOutputDisableOnTgcTrig = false
                  TomChannelOutputSignalLevel = LOW
                  TomChannelPortPinSelect = TOUT101_SELB_PORT11_PIN12
                TomChannelTimerParameters:
                  TomChannelCounterValCn0 = 0
                  TomChannelPeriodCompareValCm0 = 0
                  TomChannelDutyCycleCompareValCm1 = 0
                  TomChPeriodCompareShadowValSr0 = 0
                  TomChDCycCompareShadowValSr1 = 0
                  TomChUpdateEnableOnCn0Reset = false
                  TomChEnableForceUpdate = false
                  TomChResetCn0OnForceUpdate = false
                  TomChannelClockSelect = GTM_FIXED_CLOCK_0
                  TomChannelCounterCn0Reset = ON_COMPARE_MATCH_ON_CHANNEL
                  TomChannelTriggerOutput = TRIG_FROM_PREVIOUS_CHANNEL
                  TomChannelOneShotMode = false
                  TomChannelSpeMode = false
                  TomChannelGatedCounterMode = false
                  TomChannelBitReversalMode = false
                TomChannelInterrupt: TomIntEnableOnPeriodMatchCcu0=false, TomIntEnableOnDutyCycleMatchCcu1=false, TomInterruptMode=GTM_INTERRUPT_LEVEL_MODE, TomNotification=NULL_PTR
              TomChannel_8
                TomChannelUsage: TomChannelUsage=USED_BY_OTHER_DRIVERS_OR_UNUSED
                TomChannelEnable: TomChannelEnable=AT_START, TomChDisableOnTgcTrigger=false
                TomChannelOutput:
                  TomChannelOutputControl = DONT_ENABLE_CHANNEL_OUTPUT
                  TomChOutputDisableOnTgcTrig = false
                  TomChannelOutputSignalLevel = LOW
                  TomChannelPortPinSelect = TOUT109_SELB_PORT10_PIN7
                TomChannelTimerParameters:
                  TomChannelCounterValCn0 = 0
                  TomChannelPeriodCompareValCm0 = 0
                  TomChannelDutyCycleCompareValCm1 = 0
                  TomChPeriodCompareShadowValSr0 = 0
                  TomChDCycCompareShadowValSr1 = 0
                  TomChUpdateEnableOnCn0Reset = false
                  TomChEnableForceUpdate = false
                  TomChResetCn0OnForceUpdate = false
                  TomChannelClockSelect = GTM_FIXED_CLOCK_0
                  TomChannelCounterCn0Reset = ON_COMPARE_MATCH_ON_CHANNEL
                  TomChannelTriggerOutput = TRIG_FROM_PREVIOUS_CHANNEL
                  TomChannelOneShotMode = false
                  TomChannelSpeMode = false
                  TomChannelGatedCounterMode = false
                  TomChannelBitReversalMode = false
                TomChannelInterrupt: TomIntEnableOnPeriodMatchCcu0=false, TomIntEnableOnDutyCycleMatchCcu1=false, TomInterruptMode=GTM_INTERRUPT_LEVEL_MODE, TomNotification=NULL_PTR
              TomChannel_9
                TomChannelUsage: TomChannelUsage=USED_BY_OTHER_DRIVERS_OR_UNUSED
                TomChannelEnable: TomChannelEnable=AT_START, TomChDisableOnTgcTrigger=false
                TomChannelOutput:
                  TomChannelOutputControl = DONT_ENABLE_CHANNEL_OUTPUT
                  TomChOutputDisableOnTgcTrig = false
                  TomChannelOutputSignalLevel = LOW
                  TomChannelPortPinSelect = TOUT103_SELB_PORT10_PIN1
                TomChannelTimerParameters:
                  TomChannelCounterValCn0 = 0
                  TomChannelPeriodCompareValCm0 = 0
                  TomChannelDutyCycleCompareValCm1 = 0
                  TomChPeriodCompareShadowValSr0 = 0
                  TomChDCycCompareShadowValSr1 = 0
                  TomChUpdateEnableOnCn0Reset = false
                  TomChEnableForceUpdate = false
                  TomChResetCn0OnForceUpdate = false
                  TomChannelClockSelect = GTM_FIXED_CLOCK_0
                  TomChannelCounterCn0Reset = ON_COMPARE_MATCH_ON_CHANNEL
                  TomChannelTriggerOutput = TRIG_FROM_PREVIOUS_CHANNEL
                  TomChannelOneShotMode = false
                  TomChannelSpeMode = false
                  TomChannelGatedCounterMode = false
                  TomChannelBitReversalMode = false
                TomChannelInterrupt: TomIntEnableOnPeriodMatchCcu0=false, TomIntEnableOnDutyCycleMatchCcu1=false, TomInterruptMode=GTM_INTERRUPT_LEVEL_MODE, TomNotification=NULL_PTR
              TomChannel_10
                TomChannelUsage: TomChannelUsage=USED_BY_OTHER_DRIVERS_OR_UNUSED
                TomChannelEnable: TomChannelEnable=AT_START, TomChDisableOnTgcTrigger=false
                TomChannelOutput:
                  TomChannelOutputControl = DONT_ENABLE_CHANNEL_OUTPUT
                  TomChOutputDisableOnTgcTrig = false
                  TomChannelOutputSignalLevel = LOW
                  TomChannelPortPinSelect = TOUT104_SELB_PORT10_PIN2
                TomChannelTimerParameters:
                  TomChannelCounterValCn0 = 0
                  TomChannelPeriodCompareValCm0 = 0
                  TomChannelDutyCycleCompareValCm1 = 0
                  TomChPeriodCompareShadowValSr0 = 0
                  TomChDCycCompareShadowValSr1 = 0
                  TomChUpdateEnableOnCn0Reset = false
                  TomChEnableForceUpdate = false
                  TomChResetCn0OnForceUpdate = false
                  TomChannelClockSelect = GTM_FIXED_CLOCK_0
                  TomChannelCounterCn0Reset = ON_COMPARE_MATCH_ON_CHANNEL
                  TomChannelTriggerOutput = TRIG_FROM_PREVIOUS_CHANNEL
                  TomChannelOneShotMode = false
                  TomChannelSpeMode = false
                  TomChannelGatedCounterMode = false
                  TomChannelBitReversalMode = false
                TomChannelInterrupt: TomIntEnableOnPeriodMatchCcu0=false, TomIntEnableOnDutyCycleMatchCcu1=false, TomInterruptMode=GTM_INTERRUPT_LEVEL_MODE, TomNotification=NULL_PTR
              TomChannel_11
                TomChannelUsage: TomChannelUsage=USED_BY_OTHER_DRIVERS_OR_UNUSED
                TomChannelEnable: TomChannelEnable=AT_START, TomChDisableOnTgcTrigger=false
                TomChannelOutput:
                  TomChannelOutputControl = DONT_ENABLE_CHANNEL_OUTPUT
                  TomChOutputDisableOnTgcTrig = false
                  TomChannelOutputSignalLevel = LOW
                  TomChannelPortPinSelect = TOUT105_SELB_PORT10_PIN3
                TomChannelTimerParameters:
                  TomChannelCounterValCn0 = 0
                  TomChannelPeriodCompareValCm0 = 0
                  TomChannelDutyCycleCompareValCm1 = 0
                  TomChPeriodCompareShadowValSr0 = 0
                  TomChDCycCompareShadowValSr1 = 0
                  TomChUpdateEnableOnCn0Reset = false
                  TomChEnableForceUpdate = false
                  TomChResetCn0OnForceUpdate = false
                  TomChannelClockSelect = GTM_FIXED_CLOCK_0
                  TomChannelCounterCn0Reset = ON_COMPARE_MATCH_ON_CHANNEL
                  TomChannelTriggerOutput = TRIG_FROM_PREVIOUS_CHANNEL
                  TomChannelOneShotMode = false
                  TomChannelSpeMode = false
                  TomChannelGatedCounterMode = false
                  TomChannelBitReversalMode = false
                TomChannelInterrupt: TomIntEnableOnPeriodMatchCcu0=false, TomIntEnableOnDutyCycleMatchCcu1=false, TomInterruptMode=GTM_INTERRUPT_LEVEL_MODE, TomNotification=NULL_PTR
              TomChannel_12
                TomChannelUsage: TomChannelUsage=USED_BY_OTHER_DRIVERS_OR_UNUSED
                TomChannelEnable: TomChannelEnable=AT_START, TomChDisableOnTgcTrigger=false
                TomChannelOutput:
                  TomChannelOutputControl = DONT_ENABLE_CHANNEL_OUTPUT
                  TomChOutputDisableOnTgcTrig = false
                  TomChannelOutputSignalLevel = LOW
                  TomChannelPortPinSelect = TOUT102_SELB_PORT10_PIN0
                TomChannelTimerParameters:
                  TomChannelCounterValCn0 = 0
                  TomChannelPeriodCompareValCm0 = 0
                  TomChannelDutyCycleCompareValCm1 = 0
                  TomChPeriodCompareShadowValSr0 = 0
                  TomChDCycCompareShadowValSr1 = 0
                  TomChUpdateEnableOnCn0Reset = false
                  TomChEnableForceUpdate = false
                  TomChResetCn0OnForceUpdate = false
                  TomChannelClockSelect = GTM_FIXED_CLOCK_0
                  TomChannelCounterCn0Reset = ON_COMPARE_MATCH_ON_CHANNEL
                  TomChannelTriggerOutput = TRIG_FROM_PREVIOUS_CHANNEL
                  TomChannelOneShotMode = false
                  TomChannelSpeMode = false
                  TomChannelGatedCounterMode = false
                  TomChannelBitReversalMode = false
                TomChannelInterrupt: TomIntEnableOnPeriodMatchCcu0=false, TomIntEnableOnDutyCycleMatchCcu1=false, TomInterruptMode=GTM_INTERRUPT_LEVEL_MODE, TomNotification=NULL_PTR
              TomChannel_13
                TomChannelUsage: TomChannelUsage=USED_BY_OTHER_DRIVERS_OR_UNUSED
                TomChannelEnable: TomChannelEnable=AT_START, TomChDisableOnTgcTrigger=false
                TomChannelOutput:
                  TomChannelOutputControl = DONT_ENABLE_CHANNEL_OUTPUT
                  TomChOutputDisableOnTgcTrig = false
                  TomChannelOutputSignalLevel = LOW
                  TomChannelPortPinSelect = TOUT110_SELB_PORT10_PIN8
                TomChannelTimerParameters:
                  TomChannelCounterValCn0 = 0
                  TomChannelPeriodCompareValCm0 = 0
                  TomChannelDutyCycleCompareValCm1 = 0
                  TomChPeriodCompareShadowValSr0 = 0
                  TomChDCycCompareShadowValSr1 = 0
                  TomChUpdateEnableOnCn0Reset = false
                  TomChEnableForceUpdate = false
                  TomChResetCn0OnForceUpdate = false
                  TomChannelClockSelect = GTM_FIXED_CLOCK_0
                  TomChannelCounterCn0Reset = ON_COMPARE_MATCH_ON_CHANNEL
                  TomChannelTriggerOutput = TRIG_FROM_PREVIOUS_CHANNEL
                  TomChannelOneShotMode = false
                  TomChannelSpeMode = false
                  TomChannelGatedCounterMode = false
                  TomChannelBitReversalMode = false
                TomChannelInterrupt: TomIntEnableOnPeriodMatchCcu0=false, TomIntEnableOnDutyCycleMatchCcu1=false, TomInterruptMode=GTM_INTERRUPT_LEVEL_MODE, TomNotification=NULL_PTR
              TomChannel_14
                TomChannelUsage: TomChannelUsage=USED_BY_OTHER_DRIVERS_OR_UNUSED
                TomChannelEnable: TomChannelEnable=AT_START, TomChDisableOnTgcTrigger=false
                TomChannelOutput:
                  TomChannelOutputControl = DONT_ENABLE_CHANNEL_OUTPUT
                  TomChOutputDisableOnTgcTrig = false
                  TomChannelOutputSignalLevel = LOW
                  TomChannelPortPinSelect = TOUT74_SELB_PORT15_PIN3
                TomChannelTimerParameters:
                  TomChannelCounterValCn0 = 0
                  TomChannelPeriodCompareValCm0 = 0
                  TomChannelDutyCycleCompareValCm1 = 0
                  TomChPeriodCompareShadowValSr0 = 0
                  TomChDCycCompareShadowValSr1 = 0
                  TomChUpdateEnableOnCn0Reset = false
                  TomChEnableForceUpdate = false
                  TomChResetCn0OnForceUpdate = false
                  TomChannelClockSelect = GTM_FIXED_CLOCK_0
                  TomChannelCounterCn0Reset = ON_COMPARE_MATCH_ON_CHANNEL
                  TomChannelTriggerOutput = TRIG_FROM_PREVIOUS_CHANNEL
                  TomChannelOneShotMode = false
                  TomChannelSpeMode = false
                  TomChannelGatedCounterMode = false
                  TomChannelBitReversalMode = false
                TomChannelInterrupt: TomIntEnableOnPeriodMatchCcu0=false, TomIntEnableOnDutyCycleMatchCcu1=false, TomInterruptMode=GTM_INTERRUPT_LEVEL_MODE, TomNotification=NULL_PTR
              TomChannel_15
                TomChannelUsage: TomChannelUsage=USED_BY_OTHER_DRIVERS_OR_UNUSED
                TomChannelEnable: TomChannelEnable=AT_START, TomChDisableOnTgcTrigger=false
                TomChannelOutput:
                  TomChannelOutputControl = DONT_ENABLE_CHANNEL_OUTPUT
                  TomChOutputDisableOnTgcTrig = false
                  TomChannelOutputSignalLevel = LOW
                  TomChannelPortPinSelect = TOUT75_SELB_PORT15_PIN4
                TomChannelTimerParameters:
                  TomChannelCounterValCn0 = 0
                  TomChannelPeriodCompareValCm0 = 0
                  TomChannelDutyCycleCompareValCm1 = 0
                  TomChPeriodCompareShadowValSr0 = 0
                  TomChDCycCompareShadowValSr1 = 0
                  TomChUpdateEnableOnCn0Reset = false
                  TomChEnableForceUpdate = false
                  TomChResetCn0OnForceUpdate = false
                  TomChannelClockSelect = GTM_FIXED_CLOCK_0
                  TomChannelCounterCn0Reset = ON_COMPARE_MATCH_ON_CHANNEL
                  TomChannelTriggerOutput = TRIG_FROM_PREVIOUS_CHANNEL
                  TomChannelOneShotMode = false
                  TomChannelSpeMode = false
                  TomChannelGatedCounterMode = false
                  TomChannelBitReversalMode = false
                TomChannelInterrupt: TomIntEnableOnPeriodMatchCcu0=false, TomIntEnableOnDutyCycleMatchCcu1=false, TomInterruptMode=GTM_INTERRUPT_LEVEL_MODE, TomNotification=NULL_PTR
        5 x Atom:
          Atom_0
            AtomTriggerForAgc
              AtomAgcTriggerByTimebase: AtomAgcTimeBaseTriggerEnable=false, AtomAgcTbuTimebaseSelect=TBU_TS0_TIMEBASE, AtomAgcTimebaseMatchValue=0
              AtomAgcInternalTriggerSelect:
                AtomAgcIntTriggerFromChannel{0..7} = false
            8 x AtomChannel:
              AtomChannel_0
                AtomChannelUsage: AtomChannelUsage=USED_BY_OTHER_DRIVERS_OR_UNUSED
                AtomChannelEnable: AtomChannelEnable=AT_START, AtomChDisableOnAgcTrigger=false
                AtomChannelOutput:
                  AtomChannelOutputControl = DONT_ENABLE_CHANNEL_OUTPUT
                  AtomChOutputDisableOnAgcTrig = false
                  AtomChannelOutputSignalLevel = LOW
                  AtomChannelPortPinSelect = TOUT9_SELC_PORT0_PIN0
                AtomChannelTimerParameters:
                  AtomChannelModeSelect = ATOM_SIG_OUTPUT_MODE_IMMEDIATE
                  AtomChannelCounterValCn0 = 0
                  AtomChannelCompareValueCm0 = 0
                  AtomChannelCompareValueCm1 = 0
                  AtomChShadowCompareValSr0 = 0
                  AtomChShadowCompareValSr1 = 0
                  AtomChUpdateEnableOnCn0Reset = false
                  AtomChEnableForceUpdate = false
                  AtomChResetCn0OnForceUpdate = false
                  AtomChannelClockSelect = GTM_CONFIGURABLE_CLOCK_0
                  AtomChannelCounterCn0Reset = ON_COMPARE_MATCH_ON_CHANNEL
                  AtomChannelTriggerOutput = TRIG_FROM_PREVIOUS_CHANNEL
                  AtomChSomcTimebaseForComparison = TBU_TS1
                  AtomChSomcCompareStrategy = TIMEBASE_GREATER_EQUAL_TO_CMx
                  AtomModeControlBits = 0
                  AtomChannelOneShotMode = false
                  AtomServeLastAruCommStrategy = false
                AtomChannelAruConfiguration:
                  AtomChannelAruEnable = false
                  AtomChannelCpuWriteRequest = false
                  AtomChAruBlockingMode = GTM_ABM_DISABLED
                  AtomChAruReadAddress0 = 510
                  AtomChAruReadAddress1 = 510
                AtomChannelInterrupt:
                  AtomGlobalCcuSel = false
                  AtomIntEnableOnCcu0Trigger = false
                  AtomIntEnableOnCcu1Trigger = false
                  AtomInterruptMode = GTM_INTERRUPT_LEVEL_MODE
                  AtomNotification = NULL_PTR
                  AtomCcu0Notification = NULL_PTR
                  AtomCcu1Notification = NULL_PTR
              AtomChannel_1
                AtomChannelUsage: AtomChannelUsage=USED_BY_OTHER_DRIVERS_OR_UNUSED
                AtomChannelEnable: AtomChannelEnable=AT_START, AtomChDisableOnAgcTrigger=false
                AtomChannelOutput:
                  AtomChannelOutputControl = DONT_ENABLE_CHANNEL_OUTPUT
                  AtomChOutputDisableOnAgcTrig = false
                  AtomChannelOutputSignalLevel = LOW
                  AtomChannelPortPinSelect = TOUT10_SELC_PORT0_PIN1
                AtomChannelTimerParameters:
                  AtomChannelModeSelect = ATOM_SIG_OUTPUT_MODE_IMMEDIATE
                  AtomChannelCounterValCn0 = 0
                  AtomChannelCompareValueCm0 = 0
                  AtomChannelCompareValueCm1 = 0
                  AtomChShadowCompareValSr0 = 0
                  AtomChShadowCompareValSr1 = 0
                  AtomChUpdateEnableOnCn0Reset = false
                  AtomChEnableForceUpdate = false
                  AtomChResetCn0OnForceUpdate = false
                  AtomChannelClockSelect = GTM_CONFIGURABLE_CLOCK_0
                  AtomChannelCounterCn0Reset = ON_COMPARE_MATCH_ON_CHANNEL
                  AtomChannelTriggerOutput = TRIG_FROM_PREVIOUS_CHANNEL
                  AtomChSomcTimebaseForComparison = TBU_TS1
                  AtomChSomcCompareStrategy = TIMEBASE_GREATER_EQUAL_TO_CMx
                  AtomModeControlBits = 0
                  AtomChannelOneShotMode = false
                  AtomServeLastAruCommStrategy = false
                AtomChannelAruConfiguration:
                  AtomChannelAruEnable = false
                  AtomChannelCpuWriteRequest = false
                  AtomChAruBlockingMode = GTM_ABM_DISABLED
                  AtomChAruReadAddress0 = 510
                  AtomChAruReadAddress1 = 510
                AtomChannelInterrupt:
                  AtomGlobalCcuSel = false
                  AtomIntEnableOnCcu0Trigger = false
                  AtomIntEnableOnCcu1Trigger = false
                  AtomInterruptMode = GTM_INTERRUPT_LEVEL_MODE
                  AtomNotification = NULL_PTR
                  AtomCcu0Notification = NULL_PTR
                  AtomCcu1Notification = NULL_PTR
              AtomChannel_2
                AtomChannelUsage: AtomChannelUsage=USED_BY_OTHER_DRIVERS_OR_UNUSED
                AtomChannelEnable: AtomChannelEnable=AT_START, AtomChDisableOnAgcTrigger=false
                AtomChannelOutput:
                  AtomChannelOutputControl = DONT_ENABLE_CHANNEL_OUTPUT
                  AtomChOutputDisableOnAgcTrig = false
                  AtomChannelOutputSignalLevel = LOW
                  AtomChannelPortPinSelect = TOUT12_SELC_PORT0_PIN3
                AtomChannelTimerParameters:
                  AtomChannelModeSelect = ATOM_SIG_OUTPUT_MODE_IMMEDIATE
                  AtomChannelCounterValCn0 = 0
                  AtomChannelCompareValueCm0 = 0
                  AtomChannelCompareValueCm1 = 0
                  AtomChShadowCompareValSr0 = 0
                  AtomChShadowCompareValSr1 = 0
                  AtomChUpdateEnableOnCn0Reset = false
                  AtomChEnableForceUpdate = false
                  AtomChResetCn0OnForceUpdate = false
                  AtomChannelClockSelect = GTM_CONFIGURABLE_CLOCK_0
                  AtomChannelCounterCn0Reset = ON_COMPARE_MATCH_ON_CHANNEL
                  AtomChannelTriggerOutput = TRIG_FROM_PREVIOUS_CHANNEL
                  AtomChSomcTimebaseForComparison = TBU_TS1
                  AtomChSomcCompareStrategy = TIMEBASE_GREATER_EQUAL_TO_CMx
                  AtomModeControlBits = 0
                  AtomChannelOneShotMode = false
                  AtomServeLastAruCommStrategy = false
                AtomChannelAruConfiguration:
                  AtomChannelAruEnable = false
                  AtomChannelCpuWriteRequest = false
                  AtomChAruBlockingMode = GTM_ABM_DISABLED
                  AtomChAruReadAddress0 = 510
                  AtomChAruReadAddress1 = 510
                AtomChannelInterrupt:
                  AtomGlobalCcuSel = false
                  AtomIntEnableOnCcu0Trigger = false
                  AtomIntEnableOnCcu1Trigger = false
                  AtomInterruptMode = GTM_INTERRUPT_LEVEL_MODE
                  AtomNotification = NULL_PTR
                  AtomCcu0Notification = NULL_PTR
                  AtomCcu1Notification = NULL_PTR
              AtomChannel_3
                AtomChannelUsage: AtomChannelUsage=USED_BY_OTHER_DRIVERS_OR_UNUSED
                AtomChannelEnable: AtomChannelEnable=AT_START, AtomChDisableOnAgcTrigger=false
                AtomChannelOutput:
                  AtomChannelOutputControl = DONT_ENABLE_CHANNEL_OUTPUT
                  AtomChOutputDisableOnAgcTrig = false
                  AtomChannelOutputSignalLevel = LOW
                  AtomChannelPortPinSelect = TOUT13_SELC_PORT0_PIN4
                AtomChannelTimerParameters:
                  AtomChannelModeSelect = ATOM_SIG_OUTPUT_MODE_IMMEDIATE
                  AtomChannelCounterValCn0 = 0
                  AtomChannelCompareValueCm0 = 0
                  AtomChannelCompareValueCm1 = 0
                  AtomChShadowCompareValSr0 = 0
                  AtomChShadowCompareValSr1 = 0
                  AtomChUpdateEnableOnCn0Reset = false
                  AtomChEnableForceUpdate = false
                  AtomChResetCn0OnForceUpdate = false
                  AtomChannelClockSelect = GTM_CONFIGURABLE_CLOCK_0
                  AtomChannelCounterCn0Reset = ON_COMPARE_MATCH_ON_CHANNEL
                  AtomChannelTriggerOutput = TRIG_FROM_PREVIOUS_CHANNEL
                  AtomChSomcTimebaseForComparison = TBU_TS1
                  AtomChSomcCompareStrategy = TIMEBASE_GREATER_EQUAL_TO_CMx
                  AtomModeControlBits = 0
                  AtomChannelOneShotMode = false
                  AtomServeLastAruCommStrategy = false
                AtomChannelAruConfiguration:
                  AtomChannelAruEnable = false
                  AtomChannelCpuWriteRequest = false
                  AtomChAruBlockingMode = GTM_ABM_DISABLED
                  AtomChAruReadAddress0 = 510
                  AtomChAruReadAddress1 = 510
                AtomChannelInterrupt:
                  AtomGlobalCcuSel = false
                  AtomIntEnableOnCcu0Trigger = false
                  AtomIntEnableOnCcu1Trigger = false
                  AtomInterruptMode = GTM_INTERRUPT_LEVEL_MODE
                  AtomNotification = NULL_PTR
                  AtomCcu0Notification = NULL_PTR
                  AtomCcu1Notification = NULL_PTR
              AtomChannel_4
                AtomChannelUsage: AtomChannelUsage=USED_BY_OTHER_DRIVERS_OR_UNUSED
                AtomChannelEnable: AtomChannelEnable=AT_START, AtomChDisableOnAgcTrigger=false
                AtomChannelOutput:
                  AtomChannelOutputControl = DONT_ENABLE_CHANNEL_OUTPUT
                  AtomChOutputDisableOnAgcTrig = false
                  AtomChannelOutputSignalLevel = LOW
                  AtomChannelPortPinSelect = TOUT14_SELC_PORT0_PIN5
                AtomChannelTimerParameters:
                  AtomChannelModeSelect = ATOM_SIG_OUTPUT_MODE_IMMEDIATE
                  AtomChannelCounterValCn0 = 0
                  AtomChannelCompareValueCm0 = 0
                  AtomChannelCompareValueCm1 = 0
                  AtomChShadowCompareValSr0 = 0
                  AtomChShadowCompareValSr1 = 0
                  AtomChUpdateEnableOnCn0Reset = false
                  AtomChEnableForceUpdate = false
                  AtomChResetCn0OnForceUpdate = false
                  AtomChannelClockSelect = GTM_CONFIGURABLE_CLOCK_0
                  AtomChannelCounterCn0Reset = ON_COMPARE_MATCH_ON_CHANNEL
                  AtomChannelTriggerOutput = TRIG_FROM_PREVIOUS_CHANNEL
                  AtomChSomcTimebaseForComparison = TBU_TS1
                  AtomChSomcCompareStrategy = TIMEBASE_GREATER_EQUAL_TO_CMx
                  AtomModeControlBits = 0
                  AtomChannelOneShotMode = false
                  AtomServeLastAruCommStrategy = false
                AtomChannelAruConfiguration:
                  AtomChannelAruEnable = false
                  AtomChannelCpuWriteRequest = false
                  AtomChAruBlockingMode = GTM_ABM_DISABLED
                  AtomChAruReadAddress0 = 510
                  AtomChAruReadAddress1 = 510
                AtomChannelInterrupt:
                  AtomGlobalCcuSel = false
                  AtomIntEnableOnCcu0Trigger = false
                  AtomIntEnableOnCcu1Trigger = false
                  AtomInterruptMode = GTM_INTERRUPT_LEVEL_MODE
                  AtomNotification = NULL_PTR
                  AtomCcu0Notification = NULL_PTR
                  AtomCcu1Notification = NULL_PTR
              AtomChannel_5
                AtomChannelUsage: AtomChannelUsage=USED_BY_OTHER_DRIVERS_OR_UNUSED
                AtomChannelEnable: AtomChannelEnable=AT_START, AtomChDisableOnAgcTrigger=false
                AtomChannelOutput:
                  AtomChannelOutputControl = DONT_ENABLE_CHANNEL_OUTPUT
                  AtomChOutputDisableOnAgcTrig = false
                  AtomChannelOutputSignalLevel = LOW
                  AtomChannelPortPinSelect = TOUT15_SELC_PORT0_PIN6
                AtomChannelTimerParameters:
                  AtomChannelModeSelect = ATOM_SIG_OUTPUT_MODE_IMMEDIATE
                  AtomChannelCounterValCn0 = 0
                  AtomChannelCompareValueCm0 = 0
                  AtomChannelCompareValueCm1 = 0
                  AtomChShadowCompareValSr0 = 0
                  AtomChShadowCompareValSr1 = 0
                  AtomChUpdateEnableOnCn0Reset = false
                  AtomChEnableForceUpdate = false
                  AtomChResetCn0OnForceUpdate = false
                  AtomChannelClockSelect = GTM_CONFIGURABLE_CLOCK_0
                  AtomChannelCounterCn0Reset = ON_COMPARE_MATCH_ON_CHANNEL
                  AtomChannelTriggerOutput = TRIG_FROM_PREVIOUS_CHANNEL
                  AtomChSomcTimebaseForComparison = TBU_TS1
                  AtomChSomcCompareStrategy = TIMEBASE_GREATER_EQUAL_TO_CMx
                  AtomModeControlBits = 0
                  AtomChannelOneShotMode = false
                  AtomServeLastAruCommStrategy = false
                AtomChannelAruConfiguration:
                  AtomChannelAruEnable = false
                  AtomChannelCpuWriteRequest = false
                  AtomChAruBlockingMode = GTM_ABM_DISABLED
                  AtomChAruReadAddress0 = 510
                  AtomChAruReadAddress1 = 510
                AtomChannelInterrupt:
                  AtomGlobalCcuSel = false
                  AtomIntEnableOnCcu0Trigger = false
                  AtomIntEnableOnCcu1Trigger = false
                  AtomInterruptMode = GTM_INTERRUPT_LEVEL_MODE
                  AtomNotification = NULL_PTR
                  AtomCcu0Notification = NULL_PTR
                  AtomCcu1Notification = NULL_PTR
              AtomChannel_6
                AtomChannelUsage: AtomChannelUsage=USED_BY_OTHER_DRIVERS_OR_UNUSED
                AtomChannelEnable: AtomChannelEnable=AT_START, AtomChDisableOnAgcTrigger=false
                AtomChannelOutput:
                  AtomChannelOutputControl = DONT_ENABLE_CHANNEL_OUTPUT
                  AtomChOutputDisableOnAgcTrig = false
                  AtomChannelOutputSignalLevel = LOW
                  AtomChannelPortPinSelect = TOUT16_SELC_PORT0_PIN7
                AtomChannelTimerParameters:
                  AtomChannelModeSelect = ATOM_SIG_OUTPUT_MODE_IMMEDIATE
                  AtomChannelCounterValCn0 = 0
                  AtomChannelCompareValueCm0 = 0
                  AtomChannelCompareValueCm1 = 0
                  AtomChShadowCompareValSr0 = 0
                  AtomChShadowCompareValSr1 = 0
                  AtomChUpdateEnableOnCn0Reset = false
                  AtomChEnableForceUpdate = false
                  AtomChResetCn0OnForceUpdate = false
                  AtomChannelClockSelect = GTM_CONFIGURABLE_CLOCK_0
                  AtomChannelCounterCn0Reset = ON_COMPARE_MATCH_ON_CHANNEL
                  AtomChannelTriggerOutput = TRIG_FROM_PREVIOUS_CHANNEL
                  AtomChSomcTimebaseForComparison = TBU_TS1
                  AtomChSomcCompareStrategy = TIMEBASE_GREATER_EQUAL_TO_CMx
                  AtomModeControlBits = 0
                  AtomChannelOneShotMode = false
                  AtomServeLastAruCommStrategy = false
                AtomChannelAruConfiguration:
                  AtomChannelAruEnable = false
                  AtomChannelCpuWriteRequest = false
                  AtomChAruBlockingMode = GTM_ABM_DISABLED
                  AtomChAruReadAddress0 = 510
                  AtomChAruReadAddress1 = 510
                AtomChannelInterrupt:
                  AtomGlobalCcuSel = false
                  AtomIntEnableOnCcu0Trigger = false
                  AtomIntEnableOnCcu1Trigger = false
                  AtomInterruptMode = GTM_INTERRUPT_LEVEL_MODE
                  AtomNotification = NULL_PTR
                  AtomCcu0Notification = NULL_PTR
                  AtomCcu1Notification = NULL_PTR
              AtomChannel_7
                AtomChannelUsage: AtomChannelUsage=USED_BY_OTHER_DRIVERS_OR_UNUSED
                AtomChannelEnable: AtomChannelEnable=AT_START, AtomChDisableOnAgcTrigger=false
                AtomChannelOutput:
                  AtomChannelOutputControl = DONT_ENABLE_CHANNEL_OUTPUT
                  AtomChOutputDisableOnAgcTrig = false
                  AtomChannelOutputSignalLevel = LOW
                  AtomChannelPortPinSelect = TOUT17_SELC_PORT0_PIN8
                AtomChannelTimerParameters:
                  AtomChannelModeSelect = ATOM_SIG_OUTPUT_MODE_IMMEDIATE
                  AtomChannelCounterValCn0 = 0
                  AtomChannelCompareValueCm0 = 0
                  AtomChannelCompareValueCm1 = 0
                  AtomChShadowCompareValSr0 = 0
                  AtomChShadowCompareValSr1 = 0
                  AtomChUpdateEnableOnCn0Reset = false
                  AtomChEnableForceUpdate = false
                  AtomChResetCn0OnForceUpdate = false
                  AtomChannelClockSelect = GTM_CONFIGURABLE_CLOCK_0
                  AtomChannelCounterCn0Reset = ON_COMPARE_MATCH_ON_CHANNEL
                  AtomChannelTriggerOutput = TRIG_FROM_PREVIOUS_CHANNEL
                  AtomChSomcTimebaseForComparison = TBU_TS1
                  AtomChSomcCompareStrategy = TIMEBASE_GREATER_EQUAL_TO_CMx
                  AtomModeControlBits = 0
                  AtomChannelOneShotMode = false
                  AtomServeLastAruCommStrategy = false
                AtomChannelAruConfiguration:
                  AtomChannelAruEnable = false
                  AtomChannelCpuWriteRequest = false
                  AtomChAruBlockingMode = GTM_ABM_DISABLED
                  AtomChAruReadAddress0 = 510
                  AtomChAruReadAddress1 = 510
                AtomChannelInterrupt:
                  AtomGlobalCcuSel = false
                  AtomIntEnableOnCcu0Trigger = false
                  AtomIntEnableOnCcu1Trigger = false
                  AtomInterruptMode = GTM_INTERRUPT_LEVEL_MODE
                  AtomNotification = NULL_PTR
                  AtomCcu0Notification = NULL_PTR
                  AtomCcu1Notification = NULL_PTR
          Atom_1
            AtomTriggerForAgc
              AtomAgcTriggerByTimebase: AtomAgcTimeBaseTriggerEnable=false, AtomAgcTbuTimebaseSelect=TBU_TS0_TIMEBASE, AtomAgcTimebaseMatchValue=0
              AtomAgcInternalTriggerSelect:
                AtomAgcIntTriggerFromChannel{0..7} = false
            8 x AtomChannel:
              AtomChannel_0
                AtomChannelUsage: AtomChannelUsage=USED_BY_OTHER_DRIVERS_OR_UNUSED
                AtomChannelEnable: AtomChannelEnable=AT_START, AtomChDisableOnAgcTrigger=false
                AtomChannelOutput:
                  AtomChannelOutputControl = DONT_ENABLE_CHANNEL_OUTPUT
                  AtomChOutputDisableOnAgcTrig = false
                  AtomChannelOutputSignalLevel = LOW
                  AtomChannelPortPinSelect = TOUT9_SELD_PORT0_PIN0
                AtomChannelTimerParameters:
                  AtomChannelModeSelect = ATOM_SIG_OUTPUT_MODE_IMMEDIATE
                  AtomChannelCounterValCn0 = 0
                  AtomChannelCompareValueCm0 = 0
                  AtomChannelCompareValueCm1 = 0
                  AtomChShadowCompareValSr0 = 0
                  AtomChShadowCompareValSr1 = 0
                  AtomChUpdateEnableOnCn0Reset = false
                  AtomChEnableForceUpdate = false
                  AtomChResetCn0OnForceUpdate = false
                  AtomChannelClockSelect = GTM_CONFIGURABLE_CLOCK_0
                  AtomChannelCounterCn0Reset = ON_COMPARE_MATCH_ON_CHANNEL
                  AtomChannelTriggerOutput = TRIG_FROM_PREVIOUS_CHANNEL
                  AtomChSomcTimebaseForComparison = TBU_TS1
                  AtomChSomcCompareStrategy = TIMEBASE_GREATER_EQUAL_TO_CMx
                  AtomModeControlBits = 0
                  AtomChannelOneShotMode = false
                  AtomServeLastAruCommStrategy = false
                AtomChannelAruConfiguration:
                  AtomChannelAruEnable = false
                  AtomChannelCpuWriteRequest = false
                  AtomChAruBlockingMode = GTM_ABM_DISABLED
                  AtomChAruReadAddress0 = 510
                  AtomChAruReadAddress1 = 510
                AtomChannelInterrupt:
                  AtomGlobalCcuSel = false
                  AtomIntEnableOnCcu0Trigger = false
                  AtomIntEnableOnCcu1Trigger = false
                  AtomInterruptMode = GTM_INTERRUPT_LEVEL_MODE
                  AtomNotification = NULL_PTR
                  AtomCcu0Notification = NULL_PTR
                  AtomCcu1Notification = NULL_PTR
              AtomChannel_1
                AtomChannelUsage: AtomChannelUsage=USED_BY_OTHER_DRIVERS_OR_UNUSED
                AtomChannelEnable: AtomChannelEnable=AT_START, AtomChDisableOnAgcTrigger=false
                AtomChannelOutput:
                  AtomChannelOutputControl = DONT_ENABLE_CHANNEL_OUTPUT
                  AtomChOutputDisableOnAgcTrig = false
                  AtomChannelOutputSignalLevel = LOW
                  AtomChannelPortPinSelect = TOUT10_SELD_PORT0_PIN1
                AtomChannelTimerParameters:
                  AtomChannelModeSelect = ATOM_SIG_OUTPUT_MODE_IMMEDIATE
                  AtomChannelCounterValCn0 = 0
                  AtomChannelCompareValueCm0 = 0
                  AtomChannelCompareValueCm1 = 0
                  AtomChShadowCompareValSr0 = 0
                  AtomChShadowCompareValSr1 = 0
                  AtomChUpdateEnableOnCn0Reset = false
                  AtomChEnableForceUpdate = false
                  AtomChResetCn0OnForceUpdate = false
                  AtomChannelClockSelect = GTM_CONFIGURABLE_CLOCK_0
                  AtomChannelCounterCn0Reset = ON_COMPARE_MATCH_ON_CHANNEL
                  AtomChannelTriggerOutput = TRIG_FROM_PREVIOUS_CHANNEL
                  AtomChSomcTimebaseForComparison = TBU_TS1
                  AtomChSomcCompareStrategy = TIMEBASE_GREATER_EQUAL_TO_CMx
                  AtomModeControlBits = 0
                  AtomChannelOneShotMode = false
                  AtomServeLastAruCommStrategy = false
                AtomChannelAruConfiguration:
                  AtomChannelAruEnable = false
                  AtomChannelCpuWriteRequest = false
                  AtomChAruBlockingMode = GTM_ABM_DISABLED
                  AtomChAruReadAddress0 = 510
                  AtomChAruReadAddress1 = 510
                AtomChannelInterrupt:
                  AtomGlobalCcuSel = false
                  AtomIntEnableOnCcu0Trigger = false
                  AtomIntEnableOnCcu1Trigger = false
                  AtomInterruptMode = GTM_INTERRUPT_LEVEL_MODE
                  AtomNotification = NULL_PTR
                  AtomCcu0Notification = NULL_PTR
                  AtomCcu1Notification = NULL_PTR
              AtomChannel_2
                AtomChannelUsage: AtomChannelUsage=USED_BY_OTHER_DRIVERS_OR_UNUSED
                AtomChannelEnable: AtomChannelEnable=AT_START, AtomChDisableOnAgcTrigger=false
                AtomChannelOutput:
                  AtomChannelOutputControl = DONT_ENABLE_CHANNEL_OUTPUT
                  AtomChOutputDisableOnAgcTrig = false
                  AtomChannelOutputSignalLevel = LOW
                  AtomChannelPortPinSelect = TOUT12_SELD_PORT0_PIN3
                AtomChannelTimerParameters:
                  AtomChannelModeSelect = ATOM_SIG_OUTPUT_MODE_IMMEDIATE
                  AtomChannelCounterValCn0 = 0
                  AtomChannelCompareValueCm0 = 0
                  AtomChannelCompareValueCm1 = 0
                  AtomChShadowCompareValSr0 = 0
                  AtomChShadowCompareValSr1 = 0
                  AtomChUpdateEnableOnCn0Reset = false
                  AtomChEnableForceUpdate = false
                  AtomChResetCn0OnForceUpdate = false
                  AtomChannelClockSelect = GTM_CONFIGURABLE_CLOCK_0
                  AtomChannelCounterCn0Reset = ON_COMPARE_MATCH_ON_CHANNEL
                  AtomChannelTriggerOutput = TRIG_FROM_PREVIOUS_CHANNEL
                  AtomChSomcTimebaseForComparison = TBU_TS1
                  AtomChSomcCompareStrategy = TIMEBASE_GREATER_EQUAL_TO_CMx
                  AtomModeControlBits = 0
                  AtomChannelOneShotMode = false
                  AtomServeLastAruCommStrategy = false
                AtomChannelAruConfiguration:
                  AtomChannelAruEnable = false
                  AtomChannelCpuWriteRequest = false
                  AtomChAruBlockingMode = GTM_ABM_DISABLED
                  AtomChAruReadAddress0 = 510
                  AtomChAruReadAddress1 = 510
                AtomChannelInterrupt:
                  AtomGlobalCcuSel = false
                  AtomIntEnableOnCcu0Trigger = false
                  AtomIntEnableOnCcu1Trigger = false
                  AtomInterruptMode = GTM_INTERRUPT_LEVEL_MODE
                  AtomNotification = NULL_PTR
                  AtomCcu0Notification = NULL_PTR
                  AtomCcu1Notification = NULL_PTR
              AtomChannel_3
                AtomChannelUsage: AtomChannelUsage=USED_BY_OTHER_DRIVERS_OR_UNUSED
                AtomChannelEnable: AtomChannelEnable=AT_START, AtomChDisableOnAgcTrigger=false
                AtomChannelOutput:
                  AtomChannelOutputControl = DONT_ENABLE_CHANNEL_OUTPUT
                  AtomChOutputDisableOnAgcTrig = false
                  AtomChannelOutputSignalLevel = LOW
                  AtomChannelPortPinSelect = TOUT13_SELD_PORT0_PIN4
                AtomChannelTimerParameters:
                  AtomChannelModeSelect = ATOM_SIG_OUTPUT_MODE_IMMEDIATE
                  AtomChannelCounterValCn0 = 0
                  AtomChannelCompareValueCm0 = 0
                  AtomChannelCompareValueCm1 = 0
                  AtomChShadowCompareValSr0 = 0
                  AtomChShadowCompareValSr1 = 0
                  AtomChUpdateEnableOnCn0Reset = false
                  AtomChEnableForceUpdate = false
                  AtomChResetCn0OnForceUpdate = false
                  AtomChannelClockSelect = GTM_CONFIGURABLE_CLOCK_0
                  AtomChannelCounterCn0Reset = ON_COMPARE_MATCH_ON_CHANNEL
                  AtomChannelTriggerOutput = TRIG_FROM_PREVIOUS_CHANNEL
                  AtomChSomcTimebaseForComparison = TBU_TS1
                  AtomChSomcCompareStrategy = TIMEBASE_GREATER_EQUAL_TO_CMx
                  AtomModeControlBits = 0
                  AtomChannelOneShotMode = false
                  AtomServeLastAruCommStrategy = false
                AtomChannelAruConfiguration:
                  AtomChannelAruEnable = false
                  AtomChannelCpuWriteRequest = false
                  AtomChAruBlockingMode = GTM_ABM_DISABLED
                  AtomChAruReadAddress0 = 510
                  AtomChAruReadAddress1 = 510
                AtomChannelInterrupt:
                  AtomGlobalCcuSel = false
                  AtomIntEnableOnCcu0Trigger = false
                  AtomIntEnableOnCcu1Trigger = false
                  AtomInterruptMode = GTM_INTERRUPT_LEVEL_MODE
                  AtomNotification = NULL_PTR
                  AtomCcu0Notification = NULL_PTR
                  AtomCcu1Notification = NULL_PTR
              AtomChannel_4
                AtomChannelUsage: AtomChannelUsage=USED_BY_OTHER_DRIVERS_OR_UNUSED
                AtomChannelEnable: AtomChannelEnable=AT_START, AtomChDisableOnAgcTrigger=false
                AtomChannelOutput:
                  AtomChannelOutputControl = DONT_ENABLE_CHANNEL_OUTPUT
                  AtomChOutputDisableOnAgcTrig = false
                  AtomChannelOutputSignalLevel = LOW
                  AtomChannelPortPinSelect = TOUT14_SELD_PORT0_PIN5
                AtomChannelTimerParameters:
                  AtomChannelModeSelect = ATOM_SIG_OUTPUT_MODE_IMMEDIATE
                  AtomChannelCounterValCn0 = 0
                  AtomChannelCompareValueCm0 = 0
                  AtomChannelCompareValueCm1 = 0
                  AtomChShadowCompareValSr0 = 0
                  AtomChShadowCompareValSr1 = 0
                  AtomChUpdateEnableOnCn0Reset = false
                  AtomChEnableForceUpdate = false
                  AtomChResetCn0OnForceUpdate = false
                  AtomChannelClockSelect = GTM_CONFIGURABLE_CLOCK_0
                  AtomChannelCounterCn0Reset = ON_COMPARE_MATCH_ON_CHANNEL
                  AtomChannelTriggerOutput = TRIG_FROM_PREVIOUS_CHANNEL
                  AtomChSomcTimebaseForComparison = TBU_TS1
                  AtomChSomcCompareStrategy = TIMEBASE_GREATER_EQUAL_TO_CMx
                  AtomModeControlBits = 0
                  AtomChannelOneShotMode = false
                  AtomServeLastAruCommStrategy = false
                AtomChannelAruConfiguration:
                  AtomChannelAruEnable = false
                  AtomChannelCpuWriteRequest = false
                  AtomChAruBlockingMode = GTM_ABM_DISABLED
                  AtomChAruReadAddress0 = 510
                  AtomChAruReadAddress1 = 510
                AtomChannelInterrupt:
                  AtomGlobalCcuSel = false
                  AtomIntEnableOnCcu0Trigger = false
                  AtomIntEnableOnCcu1Trigger = false
                  AtomInterruptMode = GTM_INTERRUPT_LEVEL_MODE
                  AtomNotification = NULL_PTR
                  AtomCcu0Notification = NULL_PTR
                  AtomCcu1Notification = NULL_PTR
              AtomChannel_5
                AtomChannelUsage: AtomChannelUsage=USED_BY_OTHER_DRIVERS_OR_UNUSED
                AtomChannelEnable: AtomChannelEnable=AT_START, AtomChDisableOnAgcTrigger=false
                AtomChannelOutput:
                  AtomChannelOutputControl = DONT_ENABLE_CHANNEL_OUTPUT
                  AtomChOutputDisableOnAgcTrig = false
                  AtomChannelOutputSignalLevel = LOW
                  AtomChannelPortPinSelect = TOUT15_SELD_PORT0_PIN6
                AtomChannelTimerParameters:
                  AtomChannelModeSelect = ATOM_SIG_OUTPUT_MODE_IMMEDIATE
                  AtomChannelCounterValCn0 = 0
                  AtomChannelCompareValueCm0 = 0
                  AtomChannelCompareValueCm1 = 0
                  AtomChShadowCompareValSr0 = 0
                  AtomChShadowCompareValSr1 = 0
                  AtomChUpdateEnableOnCn0Reset = false
                  AtomChEnableForceUpdate = false
                  AtomChResetCn0OnForceUpdate = false
                  AtomChannelClockSelect = GTM_CONFIGURABLE_CLOCK_0
                  AtomChannelCounterCn0Reset = ON_COMPARE_MATCH_ON_CHANNEL
                  AtomChannelTriggerOutput = TRIG_FROM_PREVIOUS_CHANNEL
                  AtomChSomcTimebaseForComparison = TBU_TS1
                  AtomChSomcCompareStrategy = TIMEBASE_GREATER_EQUAL_TO_CMx
                  AtomModeControlBits = 0
                  AtomChannelOneShotMode = false
                  AtomServeLastAruCommStrategy = false
                AtomChannelAruConfiguration:
                  AtomChannelAruEnable = false
                  AtomChannelCpuWriteRequest = false
                  AtomChAruBlockingMode = GTM_ABM_DISABLED
                  AtomChAruReadAddress0 = 510
                  AtomChAruReadAddress1 = 510
                AtomChannelInterrupt:
                  AtomGlobalCcuSel = false
                  AtomIntEnableOnCcu0Trigger = false
                  AtomIntEnableOnCcu1Trigger = false
                  AtomInterruptMode = GTM_INTERRUPT_LEVEL_MODE
                  AtomNotification = NULL_PTR
                  AtomCcu0Notification = NULL_PTR
                  AtomCcu1Notification = NULL_PTR
              AtomChannel_6
                AtomChannelUsage: AtomChannelUsage=USED_BY_OTHER_DRIVERS_OR_UNUSED
                AtomChannelEnable: AtomChannelEnable=AT_START, AtomChDisableOnAgcTrigger=false
                AtomChannelOutput:
                  AtomChannelOutputControl = DONT_ENABLE_CHANNEL_OUTPUT
                  AtomChOutputDisableOnAgcTrig = false
                  AtomChannelOutputSignalLevel = LOW
                  AtomChannelPortPinSelect = TOUT16_SELD_PORT0_PIN7
                AtomChannelTimerParameters:
                  AtomChannelModeSelect = ATOM_SIG_OUTPUT_MODE_IMMEDIATE
                  AtomChannelCounterValCn0 = 0
                  AtomChannelCompareValueCm0 = 0
                  AtomChannelCompareValueCm1 = 0
                  AtomChShadowCompareValSr0 = 0
                  AtomChShadowCompareValSr1 = 0
                  AtomChUpdateEnableOnCn0Reset = false
                  AtomChEnableForceUpdate = false
                  AtomChResetCn0OnForceUpdate = false
                  AtomChannelClockSelect = GTM_CONFIGURABLE_CLOCK_0
                  AtomChannelCounterCn0Reset = ON_COMPARE_MATCH_ON_CHANNEL
                  AtomChannelTriggerOutput = TRIG_FROM_PREVIOUS_CHANNEL
                  AtomChSomcTimebaseForComparison = TBU_TS1
                  AtomChSomcCompareStrategy = TIMEBASE_GREATER_EQUAL_TO_CMx
                  AtomModeControlBits = 0
                  AtomChannelOneShotMode = false
                  AtomServeLastAruCommStrategy = false
                AtomChannelAruConfiguration:
                  AtomChannelAruEnable = false
                  AtomChannelCpuWriteRequest = false
                  AtomChAruBlockingMode = GTM_ABM_DISABLED
                  AtomChAruReadAddress0 = 510
                  AtomChAruReadAddress1 = 510
                AtomChannelInterrupt:
                  AtomGlobalCcuSel = false
                  AtomIntEnableOnCcu0Trigger = false
                  AtomIntEnableOnCcu1Trigger = false
                  AtomInterruptMode = GTM_INTERRUPT_LEVEL_MODE
                  AtomNotification = NULL_PTR
                  AtomCcu0Notification = NULL_PTR
                  AtomCcu1Notification = NULL_PTR
              AtomChannel_7
                AtomChannelUsage: AtomChannelUsage=USED_BY_OTHER_DRIVERS_OR_UNUSED
                AtomChannelEnable: AtomChannelEnable=AT_START, AtomChDisableOnAgcTrigger=false
                AtomChannelOutput:
                  AtomChannelOutputControl = DONT_ENABLE_CHANNEL_OUTPUT
                  AtomChOutputDisableOnAgcTrig = false
                  AtomChannelOutputSignalLevel = LOW
                  AtomChannelPortPinSelect = TOUT17_SELD_PORT0_PIN8
                AtomChannelTimerParameters:
                  AtomChannelModeSelect = ATOM_SIG_OUTPUT_MODE_IMMEDIATE
                  AtomChannelCounterValCn0 = 0
                  AtomChannelCompareValueCm0 = 0
                  AtomChannelCompareValueCm1 = 0
                  AtomChShadowCompareValSr0 = 0
                  AtomChShadowCompareValSr1 = 0
                  AtomChUpdateEnableOnCn0Reset = false
                  AtomChEnableForceUpdate = false
                  AtomChResetCn0OnForceUpdate = false
                  AtomChannelClockSelect = GTM_CONFIGURABLE_CLOCK_0
                  AtomChannelCounterCn0Reset = ON_COMPARE_MATCH_ON_CHANNEL
                  AtomChannelTriggerOutput = TRIG_FROM_PREVIOUS_CHANNEL
                  AtomChSomcTimebaseForComparison = TBU_TS1
                  AtomChSomcCompareStrategy = TIMEBASE_GREATER_EQUAL_TO_CMx
                  AtomModeControlBits = 0
                  AtomChannelOneShotMode = false
                  AtomServeLastAruCommStrategy = false
                AtomChannelAruConfiguration:
                  AtomChannelAruEnable = false
                  AtomChannelCpuWriteRequest = false
                  AtomChAruBlockingMode = GTM_ABM_DISABLED
                  AtomChAruReadAddress0 = 510
                  AtomChAruReadAddress1 = 510
                AtomChannelInterrupt:
                  AtomGlobalCcuSel = false
                  AtomIntEnableOnCcu0Trigger = false
                  AtomIntEnableOnCcu1Trigger = false
                  AtomInterruptMode = GTM_INTERRUPT_LEVEL_MODE
                  AtomNotification = NULL_PTR
                  AtomCcu0Notification = NULL_PTR
                  AtomCcu1Notification = NULL_PTR
          Atom_2
            AtomTriggerForAgc
              AtomAgcTriggerByTimebase: AtomAgcTimeBaseTriggerEnable=false, AtomAgcTbuTimebaseSelect=TBU_TS0_TIMEBASE, AtomAgcTimebaseMatchValue=0
              AtomAgcInternalTriggerSelect:
                AtomAgcIntTriggerFromChannel{0..7} = false
            8 x AtomChannel:
              AtomChannel_0
                AtomChannelUsage: AtomChannelUsage=USED_BY_OTHER_DRIVERS_OR_UNUSED
                AtomChannelEnable: AtomChannelEnable=AT_START, AtomChDisableOnAgcTrigger=false
                AtomChannelOutput:
                  AtomChannelOutputControl = DONT_ENABLE_CHANNEL_OUTPUT
                  AtomChOutputDisableOnAgcTrig = false
                  AtomChannelOutputSignalLevel = LOW
                  AtomChannelPortPinSelect = TOUT18_SELC_PORT0_PIN9
                AtomChannelTimerParameters:
                  AtomChannelModeSelect = ATOM_SIG_OUTPUT_MODE_IMMEDIATE
                  AtomChannelCounterValCn0 = 0
                  AtomChannelCompareValueCm0 = 0
                  AtomChannelCompareValueCm1 = 0
                  AtomChShadowCompareValSr0 = 0
                  AtomChShadowCompareValSr1 = 0
                  AtomChUpdateEnableOnCn0Reset = false
                  AtomChEnableForceUpdate = false
                  AtomChResetCn0OnForceUpdate = false
                  AtomChannelClockSelect = GTM_CONFIGURABLE_CLOCK_0
                  AtomChannelCounterCn0Reset = ON_COMPARE_MATCH_ON_CHANNEL
                  AtomChannelTriggerOutput = TRIG_FROM_PREVIOUS_CHANNEL
                  AtomChSomcTimebaseForComparison = TBU_TS1
                  AtomChSomcCompareStrategy = TIMEBASE_GREATER_EQUAL_TO_CMx
                  AtomModeControlBits = 0
                  AtomChannelOneShotMode = false
                  AtomServeLastAruCommStrategy = false
                AtomChannelAruConfiguration:
                  AtomChannelAruEnable = false
                  AtomChannelCpuWriteRequest = false
                  AtomChAruBlockingMode = GTM_ABM_DISABLED
                  AtomChAruReadAddress0 = 510
                  AtomChAruReadAddress1 = 510
                AtomChannelInterrupt:
                  AtomGlobalCcuSel = false
                  AtomIntEnableOnCcu0Trigger = false
                  AtomIntEnableOnCcu1Trigger = false
                  AtomInterruptMode = GTM_INTERRUPT_LEVEL_MODE
                  AtomNotification = NULL_PTR
                  AtomCcu0Notification = NULL_PTR
                  AtomCcu1Notification = NULL_PTR
              AtomChannel_1
                AtomChannelUsage: AtomChannelUsage=USED_BY_OTHER_DRIVERS_OR_UNUSED
                AtomChannelEnable: AtomChannelEnable=AT_START, AtomChDisableOnAgcTrigger=false
                AtomChannelOutput:
                  AtomChannelOutputControl = DONT_ENABLE_CHANNEL_OUTPUT
                  AtomChOutputDisableOnAgcTrig = false
                  AtomChannelOutputSignalLevel = LOW
                  AtomChannelPortPinSelect = TOUT19_SELC_PORT0_PIN10
                AtomChannelTimerParameters:
                  AtomChannelModeSelect = ATOM_SIG_OUTPUT_MODE_IMMEDIATE
                  AtomChannelCounterValCn0 = 0
                  AtomChannelCompareValueCm0 = 0
                  AtomChannelCompareValueCm1 = 0
                  AtomChShadowCompareValSr0 = 0
                  AtomChShadowCompareValSr1 = 0
                  AtomChUpdateEnableOnCn0Reset = false
                  AtomChEnableForceUpdate = false
                  AtomChResetCn0OnForceUpdate = false
                  AtomChannelClockSelect = GTM_CONFIGURABLE_CLOCK_0
                  AtomChannelCounterCn0Reset = ON_COMPARE_MATCH_ON_CHANNEL
                  AtomChannelTriggerOutput = TRIG_FROM_PREVIOUS_CHANNEL
                  AtomChSomcTimebaseForComparison = TBU_TS1
                  AtomChSomcCompareStrategy = TIMEBASE_GREATER_EQUAL_TO_CMx
                  AtomModeControlBits = 0
                  AtomChannelOneShotMode = false
                  AtomServeLastAruCommStrategy = false
                AtomChannelAruConfiguration:
                  AtomChannelAruEnable = false
                  AtomChannelCpuWriteRequest = false
                  AtomChAruBlockingMode = GTM_ABM_DISABLED
                  AtomChAruReadAddress0 = 510
                  AtomChAruReadAddress1 = 510
                AtomChannelInterrupt:
                  AtomGlobalCcuSel = false
                  AtomIntEnableOnCcu0Trigger = false
                  AtomIntEnableOnCcu1Trigger = false
                  AtomInterruptMode = GTM_INTERRUPT_LEVEL_MODE
                  AtomNotification = NULL_PTR
                  AtomCcu0Notification = NULL_PTR
                  AtomCcu1Notification = NULL_PTR
              AtomChannel_2
                AtomChannelUsage: AtomChannelUsage=USED_BY_OTHER_DRIVERS_OR_UNUSED
                AtomChannelEnable: AtomChannelEnable=AT_START, AtomChDisableOnAgcTrigger=false
                AtomChannelOutput:
                  AtomChannelOutputControl = DONT_ENABLE_CHANNEL_OUTPUT
                  AtomChOutputDisableOnAgcTrig = false
                  AtomChannelOutputSignalLevel = LOW
                  AtomChannelPortPinSelect = TOUT20_SELC_PORT0_PIN11
                AtomChannelTimerParameters:
                  AtomChannelModeSelect = ATOM_SIG_OUTPUT_MODE_IMMEDIATE
                  AtomChannelCounterValCn0 = 0
                  AtomChannelCompareValueCm0 = 0
                  AtomChannelCompareValueCm1 = 0
                  AtomChShadowCompareValSr0 = 0
                  AtomChShadowCompareValSr1 = 0
                  AtomChUpdateEnableOnCn0Reset = false
                  AtomChEnableForceUpdate = false
                  AtomChResetCn0OnForceUpdate = false
                  AtomChannelClockSelect = GTM_CONFIGURABLE_CLOCK_0
                  AtomChannelCounterCn0Reset = ON_COMPARE_MATCH_ON_CHANNEL
                  AtomChannelTriggerOutput = TRIG_FROM_PREVIOUS_CHANNEL
                  AtomChSomcTimebaseForComparison = TBU_TS1
                  AtomChSomcCompareStrategy = TIMEBASE_GREATER_EQUAL_TO_CMx
                  AtomModeControlBits = 0
                  AtomChannelOneShotMode = false
                  AtomServeLastAruCommStrategy = false
                AtomChannelAruConfiguration:
                  AtomChannelAruEnable = false
                  AtomChannelCpuWriteRequest = false
                  AtomChAruBlockingMode = GTM_ABM_DISABLED
                  AtomChAruReadAddress0 = 510
                  AtomChAruReadAddress1 = 510
                AtomChannelInterrupt:
                  AtomGlobalCcuSel = false
                  AtomIntEnableOnCcu0Trigger = false
                  AtomIntEnableOnCcu1Trigger = false
                  AtomInterruptMode = GTM_INTERRUPT_LEVEL_MODE
                  AtomNotification = NULL_PTR
                  AtomCcu0Notification = NULL_PTR
                  AtomCcu1Notification = NULL_PTR
              AtomChannel_3
                AtomChannelUsage: AtomChannelUsage=USED_BY_OTHER_DRIVERS_OR_UNUSED
                AtomChannelEnable: AtomChannelEnable=AT_START, AtomChDisableOnAgcTrigger=false
                AtomChannelOutput:
                  AtomChannelOutputControl = DONT_ENABLE_CHANNEL_OUTPUT
                  AtomChOutputDisableOnAgcTrig = false
                  AtomChannelOutputSignalLevel = LOW
                  AtomChannelPortPinSelect = TOUT21_SELC_PORT0_PIN12
                AtomChannelTimerParameters:
                  AtomChannelModeSelect = ATOM_SIG_OUTPUT_MODE_IMMEDIATE
                  AtomChannelCounterValCn0 = 0
                  AtomChannelCompareValueCm0 = 0
                  AtomChannelCompareValueCm1 = 0
                  AtomChShadowCompareValSr0 = 0
                  AtomChShadowCompareValSr1 = 0
                  AtomChUpdateEnableOnCn0Reset = false
                  AtomChEnableForceUpdate = false
                  AtomChResetCn0OnForceUpdate = false
                  AtomChannelClockSelect = GTM_CONFIGURABLE_CLOCK_0
                  AtomChannelCounterCn0Reset = ON_COMPARE_MATCH_ON_CHANNEL
                  AtomChannelTriggerOutput = TRIG_FROM_PREVIOUS_CHANNEL
                  AtomChSomcTimebaseForComparison = TBU_TS1
                  AtomChSomcCompareStrategy = TIMEBASE_GREATER_EQUAL_TO_CMx
                  AtomModeControlBits = 0
                  AtomChannelOneShotMode = false
                  AtomServeLastAruCommStrategy = false
                AtomChannelAruConfiguration:
                  AtomChannelAruEnable = false
                  AtomChannelCpuWriteRequest = false
                  AtomChAruBlockingMode = GTM_ABM_DISABLED
                  AtomChAruReadAddress0 = 510
                  AtomChAruReadAddress1 = 510
                AtomChannelInterrupt:
                  AtomGlobalCcuSel = false
                  AtomIntEnableOnCcu0Trigger = false
                  AtomIntEnableOnCcu1Trigger = false
                  AtomInterruptMode = GTM_INTERRUPT_LEVEL_MODE
                  AtomNotification = NULL_PTR
                  AtomCcu0Notification = NULL_PTR
                  AtomCcu1Notification = NULL_PTR
              AtomChannel_4
                AtomChannelUsage: AtomChannelUsage=USED_BY_OTHER_DRIVERS_OR_UNUSED
                AtomChannelEnable: AtomChannelEnable=AT_START, AtomChDisableOnAgcTrigger=false
                AtomChannelOutput:
                  AtomChannelOutputControl = DONT_ENABLE_CHANNEL_OUTPUT
                  AtomChOutputDisableOnAgcTrig = false
                  AtomChannelOutputSignalLevel = LOW
                  AtomChannelPortPinSelect = TOUT98_SELC_PORT11_PIN9
                AtomChannelTimerParameters:
                  AtomChannelModeSelect = ATOM_SIG_OUTPUT_MODE_IMMEDIATE
                  AtomChannelCounterValCn0 = 0
                  AtomChannelCompareValueCm0 = 0
                  AtomChannelCompareValueCm1 = 0
                  AtomChShadowCompareValSr0 = 0
                  AtomChShadowCompareValSr1 = 0
                  AtomChUpdateEnableOnCn0Reset = false
                  AtomChEnableForceUpdate = false
                  AtomChResetCn0OnForceUpdate = false
                  AtomChannelClockSelect = GTM_CONFIGURABLE_CLOCK_0
                  AtomChannelCounterCn0Reset = ON_COMPARE_MATCH_ON_CHANNEL
                  AtomChannelTriggerOutput = TRIG_FROM_PREVIOUS_CHANNEL
                  AtomChSomcTimebaseForComparison = TBU_TS1
                  AtomChSomcCompareStrategy = TIMEBASE_GREATER_EQUAL_TO_CMx
                  AtomModeControlBits = 0
                  AtomChannelOneShotMode = false
                  AtomServeLastAruCommStrategy = false
                AtomChannelAruConfiguration:
                  AtomChannelAruEnable = false
                  AtomChannelCpuWriteRequest = false
                  AtomChAruBlockingMode = GTM_ABM_DISABLED
                  AtomChAruReadAddress0 = 510
                  AtomChAruReadAddress1 = 510
                AtomChannelInterrupt:
                  AtomGlobalCcuSel = false
                  AtomIntEnableOnCcu0Trigger = false
                  AtomIntEnableOnCcu1Trigger = false
                  AtomInterruptMode = GTM_INTERRUPT_LEVEL_MODE
                  AtomNotification = NULL_PTR
                  AtomCcu0Notification = NULL_PTR
                  AtomCcu1Notification = NULL_PTR
              AtomChannel_5
                AtomChannelUsage: AtomChannelUsage=USED_BY_OTHER_DRIVERS_OR_UNUSED
                AtomChannelEnable: AtomChannelEnable=AT_START, AtomChDisableOnAgcTrigger=false
                AtomChannelOutput:
                  AtomChannelOutputControl = DONT_ENABLE_CHANNEL_OUTPUT
                  AtomChOutputDisableOnAgcTrig = false
                  AtomChannelOutputSignalLevel = LOW
                  AtomChannelPortPinSelect = TOUT99_SELC_PORT11_PIN10
                AtomChannelTimerParameters:
                  AtomChannelModeSelect = ATOM_SIG_OUTPUT_MODE_IMMEDIATE
                  AtomChannelCounterValCn0 = 0
                  AtomChannelCompareValueCm0 = 0
                  AtomChannelCompareValueCm1 = 0
                  AtomChShadowCompareValSr0 = 0
                  AtomChShadowCompareValSr1 = 0
                  AtomChUpdateEnableOnCn0Reset = false
                  AtomChEnableForceUpdate = false
                  AtomChResetCn0OnForceUpdate = false
                  AtomChannelClockSelect = GTM_CONFIGURABLE_CLOCK_0
                  AtomChannelCounterCn0Reset = ON_COMPARE_MATCH_ON_CHANNEL
                  AtomChannelTriggerOutput = TRIG_FROM_PREVIOUS_CHANNEL
                  AtomChSomcTimebaseForComparison = TBU_TS1
                  AtomChSomcCompareStrategy = TIMEBASE_GREATER_EQUAL_TO_CMx
                  AtomModeControlBits = 0
                  AtomChannelOneShotMode = false
                  AtomServeLastAruCommStrategy = false
                AtomChannelAruConfiguration:
                  AtomChannelAruEnable = false
                  AtomChannelCpuWriteRequest = false
                  AtomChAruBlockingMode = GTM_ABM_DISABLED
                  AtomChAruReadAddress0 = 510
                  AtomChAruReadAddress1 = 510
                AtomChannelInterrupt:
                  AtomGlobalCcuSel = false
                  AtomIntEnableOnCcu0Trigger = false
                  AtomIntEnableOnCcu1Trigger = false
                  AtomInterruptMode = GTM_INTERRUPT_LEVEL_MODE
                  AtomNotification = NULL_PTR
                  AtomCcu0Notification = NULL_PTR
                  AtomCcu1Notification = NULL_PTR
              AtomChannel_6
                AtomChannelUsage: AtomChannelUsage=USED_BY_OTHER_DRIVERS_OR_UNUSED
                AtomChannelEnable: AtomChannelEnable=AT_START, AtomChDisableOnAgcTrigger=false
                AtomChannelOutput:
                  AtomChannelOutputControl = DONT_ENABLE_CHANNEL_OUTPUT
                  AtomChOutputDisableOnAgcTrig = false
                  AtomChannelOutputSignalLevel = LOW
                  AtomChannelPortPinSelect = TOUT100_SELC_PORT11_PIN11
                AtomChannelTimerParameters:
                  AtomChannelModeSelect = ATOM_SIG_OUTPUT_MODE_IMMEDIATE
                  AtomChannelCounterValCn0 = 0
                  AtomChannelCompareValueCm0 = 0
                  AtomChannelCompareValueCm1 = 0
                  AtomChShadowCompareValSr0 = 0
                  AtomChShadowCompareValSr1 = 0
                  AtomChUpdateEnableOnCn0Reset = false
                  AtomChEnableForceUpdate = false
                  AtomChResetCn0OnForceUpdate = false
                  AtomChannelClockSelect = GTM_CONFIGURABLE_CLOCK_0
                  AtomChannelCounterCn0Reset = ON_COMPARE_MATCH_ON_CHANNEL
                  AtomChannelTriggerOutput = TRIG_FROM_PREVIOUS_CHANNEL
                  AtomChSomcTimebaseForComparison = TBU_TS1
                  AtomChSomcCompareStrategy = TIMEBASE_GREATER_EQUAL_TO_CMx
                  AtomModeControlBits = 0
                  AtomChannelOneShotMode = false
                  AtomServeLastAruCommStrategy = false
                AtomChannelAruConfiguration:
                  AtomChannelAruEnable = false
                  AtomChannelCpuWriteRequest = false
                  AtomChAruBlockingMode = GTM_ABM_DISABLED
                  AtomChAruReadAddress0 = 510
                  AtomChAruReadAddress1 = 510
                AtomChannelInterrupt:
                  AtomGlobalCcuSel = false
                  AtomIntEnableOnCcu0Trigger = false
                  AtomIntEnableOnCcu1Trigger = false
                  AtomInterruptMode = GTM_INTERRUPT_LEVEL_MODE
                  AtomNotification = NULL_PTR
                  AtomCcu0Notification = NULL_PTR
                  AtomCcu1Notification = NULL_PTR
              AtomChannel_7
                AtomChannelUsage: AtomChannelUsage=USED_BY_OTHER_DRIVERS_OR_UNUSED
                AtomChannelEnable: AtomChannelEnable=AT_START, AtomChDisableOnAgcTrigger=false
                AtomChannelOutput:
                  AtomChannelOutputControl = DONT_ENABLE_CHANNEL_OUTPUT
                  AtomChOutputDisableOnAgcTrig = false
                  AtomChannelOutputSignalLevel = LOW
                  AtomChannelPortPinSelect = TOUT101_SELC_PORT11_PIN12
                AtomChannelTimerParameters:
                  AtomChannelModeSelect = ATOM_SIG_OUTPUT_MODE_IMMEDIATE
                  AtomChannelCounterValCn0 = 0
                  AtomChannelCompareValueCm0 = 0
                  AtomChannelCompareValueCm1 = 0
                  AtomChShadowCompareValSr0 = 0
                  AtomChShadowCompareValSr1 = 0
                  AtomChUpdateEnableOnCn0Reset = false
                  AtomChEnableForceUpdate = false
                  AtomChResetCn0OnForceUpdate = false
                  AtomChannelClockSelect = GTM_CONFIGURABLE_CLOCK_0
                  AtomChannelCounterCn0Reset = ON_COMPARE_MATCH_ON_CHANNEL
                  AtomChannelTriggerOutput = TRIG_FROM_PREVIOUS_CHANNEL
                  AtomChSomcTimebaseForComparison = TBU_TS1
                  AtomChSomcCompareStrategy = TIMEBASE_GREATER_EQUAL_TO_CMx
                  AtomModeControlBits = 0
                  AtomChannelOneShotMode = false
                  AtomServeLastAruCommStrategy = false
                AtomChannelAruConfiguration:
                  AtomChannelAruEnable = false
                  AtomChannelCpuWriteRequest = false
                  AtomChAruBlockingMode = GTM_ABM_DISABLED
                  AtomChAruReadAddress0 = 510
                  AtomChAruReadAddress1 = 510
                AtomChannelInterrupt:
                  AtomGlobalCcuSel = false
                  AtomIntEnableOnCcu0Trigger = false
                  AtomIntEnableOnCcu1Trigger = false
                  AtomInterruptMode = GTM_INTERRUPT_LEVEL_MODE
                  AtomNotification = NULL_PTR
                  AtomCcu0Notification = NULL_PTR
                  AtomCcu1Notification = NULL_PTR
          Atom_3
            AtomTriggerForAgc
              AtomAgcTriggerByTimebase: AtomAgcTimeBaseTriggerEnable=false, AtomAgcTbuTimebaseSelect=TBU_TS0_TIMEBASE, AtomAgcTimebaseMatchValue=0
              AtomAgcInternalTriggerSelect:
                AtomAgcIntTriggerFromChannel{0..7} = false
            8 x AtomChannel:
              AtomChannel_0
                AtomChannelUsage: AtomChannelUsage=USED_BY_OTHER_DRIVERS_OR_UNUSED
                AtomChannelEnable: AtomChannelEnable=AT_START, AtomChDisableOnAgcTrigger=false
                AtomChannelOutput:
                  AtomChannelOutputControl = DONT_ENABLE_CHANNEL_OUTPUT
                  AtomChOutputDisableOnAgcTrig = false
                  AtomChannelOutputSignalLevel = LOW
                  AtomChannelPortPinSelect = TOUT18_SELD_PORT0_PIN9
                AtomChannelTimerParameters:
                  AtomChannelModeSelect = ATOM_SIG_OUTPUT_MODE_IMMEDIATE
                  AtomChannelCounterValCn0 = 0
                  AtomChannelCompareValueCm0 = 0
                  AtomChannelCompareValueCm1 = 0
                  AtomChShadowCompareValSr0 = 0
                  AtomChShadowCompareValSr1 = 0
                  AtomChUpdateEnableOnCn0Reset = false
                  AtomChEnableForceUpdate = false
                  AtomChResetCn0OnForceUpdate = false
                  AtomChannelClockSelect = GTM_CONFIGURABLE_CLOCK_0
                  AtomChannelCounterCn0Reset = ON_COMPARE_MATCH_ON_CHANNEL
                  AtomChannelTriggerOutput = TRIG_FROM_PREVIOUS_CHANNEL
                  AtomChSomcTimebaseForComparison = TBU_TS1
                  AtomChSomcCompareStrategy = TIMEBASE_GREATER_EQUAL_TO_CMx
                  AtomModeControlBits = 0
                  AtomChannelOneShotMode = false
                  AtomServeLastAruCommStrategy = false
                AtomChannelAruConfiguration:
                  AtomChannelAruEnable = false
                  AtomChannelCpuWriteRequest = false
                  AtomChAruBlockingMode = GTM_ABM_DISABLED
                  AtomChAruReadAddress0 = 510
                  AtomChAruReadAddress1 = 510
                AtomChannelInterrupt:
                  AtomGlobalCcuSel = false
                  AtomIntEnableOnCcu0Trigger = false
                  AtomIntEnableOnCcu1Trigger = false
                  AtomInterruptMode = GTM_INTERRUPT_LEVEL_MODE
                  AtomNotification = NULL_PTR
                  AtomCcu0Notification = NULL_PTR
                  AtomCcu1Notification = NULL_PTR
              AtomChannel_1
                AtomChannelUsage: AtomChannelUsage=USED_BY_OTHER_DRIVERS_OR_UNUSED
                AtomChannelEnable: AtomChannelEnable=AT_START, AtomChDisableOnAgcTrigger=false
                AtomChannelOutput:
                  AtomChannelOutputControl = DONT_ENABLE_CHANNEL_OUTPUT
                  AtomChOutputDisableOnAgcTrig = false
                  AtomChannelOutputSignalLevel = LOW
                  AtomChannelPortPinSelect = TOUT19_SELD_PORT0_PIN10
                AtomChannelTimerParameters:
                  AtomChannelModeSelect = ATOM_SIG_OUTPUT_MODE_IMMEDIATE
                  AtomChannelCounterValCn0 = 0
                  AtomChannelCompareValueCm0 = 0
                  AtomChannelCompareValueCm1 = 0
                  AtomChShadowCompareValSr0 = 0
                  AtomChShadowCompareValSr1 = 0
                  AtomChUpdateEnableOnCn0Reset = false
                  AtomChEnableForceUpdate = false
                  AtomChResetCn0OnForceUpdate = false
                  AtomChannelClockSelect = GTM_CONFIGURABLE_CLOCK_0
                  AtomChannelCounterCn0Reset = ON_COMPARE_MATCH_ON_CHANNEL
                  AtomChannelTriggerOutput = TRIG_FROM_PREVIOUS_CHANNEL
                  AtomChSomcTimebaseForComparison = TBU_TS1
                  AtomChSomcCompareStrategy = TIMEBASE_GREATER_EQUAL_TO_CMx
                  AtomModeControlBits = 0
                  AtomChannelOneShotMode = false
                  AtomServeLastAruCommStrategy = false
                AtomChannelAruConfiguration:
                  AtomChannelAruEnable = false
                  AtomChannelCpuWriteRequest = false
                  AtomChAruBlockingMode = GTM_ABM_DISABLED
                  AtomChAruReadAddress0 = 510
                  AtomChAruReadAddress1 = 510
                AtomChannelInterrupt:
                  AtomGlobalCcuSel = false
                  AtomIntEnableOnCcu0Trigger = false
                  AtomIntEnableOnCcu1Trigger = false
                  AtomInterruptMode = GTM_INTERRUPT_LEVEL_MODE
                  AtomNotification = NULL_PTR
                  AtomCcu0Notification = NULL_PTR
                  AtomCcu1Notification = NULL_PTR
              AtomChannel_2
                AtomChannelUsage: AtomChannelUsage=USED_BY_OTHER_DRIVERS_OR_UNUSED
                AtomChannelEnable: AtomChannelEnable=AT_START, AtomChDisableOnAgcTrigger=false
                AtomChannelOutput:
                  AtomChannelOutputControl = DONT_ENABLE_CHANNEL_OUTPUT
                  AtomChOutputDisableOnAgcTrig = false
                  AtomChannelOutputSignalLevel = LOW
                  AtomChannelPortPinSelect = TOUT20_SELD_PORT0_PIN11
                AtomChannelTimerParameters:
                  AtomChannelModeSelect = ATOM_SIG_OUTPUT_MODE_IMMEDIATE
                  AtomChannelCounterValCn0 = 0
                  AtomChannelCompareValueCm0 = 0
                  AtomChannelCompareValueCm1 = 0
                  AtomChShadowCompareValSr0 = 0
                  AtomChShadowCompareValSr1 = 0
                  AtomChUpdateEnableOnCn0Reset = false
                  AtomChEnableForceUpdate = false
                  AtomChResetCn0OnForceUpdate = false
                  AtomChannelClockSelect = GTM_CONFIGURABLE_CLOCK_0
                  AtomChannelCounterCn0Reset = ON_COMPARE_MATCH_ON_CHANNEL
                  AtomChannelTriggerOutput = TRIG_FROM_PREVIOUS_CHANNEL
                  AtomChSomcTimebaseForComparison = TBU_TS1
                  AtomChSomcCompareStrategy = TIMEBASE_GREATER_EQUAL_TO_CMx
                  AtomModeControlBits = 0
                  AtomChannelOneShotMode = false
                  AtomServeLastAruCommStrategy = false
                AtomChannelAruConfiguration:
                  AtomChannelAruEnable = false
                  AtomChannelCpuWriteRequest = false
                  AtomChAruBlockingMode = GTM_ABM_DISABLED
                  AtomChAruReadAddress0 = 510
                  AtomChAruReadAddress1 = 510
                AtomChannelInterrupt:
                  AtomGlobalCcuSel = false
                  AtomIntEnableOnCcu0Trigger = false
                  AtomIntEnableOnCcu1Trigger = false
                  AtomInterruptMode = GTM_INTERRUPT_LEVEL_MODE
                  AtomNotification = NULL_PTR
                  AtomCcu0Notification = NULL_PTR
                  AtomCcu1Notification = NULL_PTR
              AtomChannel_3
                AtomChannelUsage: AtomChannelUsage=USED_BY_OTHER_DRIVERS_OR_UNUSED
                AtomChannelEnable: AtomChannelEnable=AT_START, AtomChDisableOnAgcTrigger=false
                AtomChannelOutput:
                  AtomChannelOutputControl = DONT_ENABLE_CHANNEL_OUTPUT
                  AtomChOutputDisableOnAgcTrig = false
                  AtomChannelOutputSignalLevel = LOW
                  AtomChannelPortPinSelect = TOUT21_SELD_PORT0_PIN12
                AtomChannelTimerParameters:
                  AtomChannelModeSelect = ATOM_SIG_OUTPUT_MODE_IMMEDIATE
                  AtomChannelCounterValCn0 = 0
                  AtomChannelCompareValueCm0 = 0
                  AtomChannelCompareValueCm1 = 0
                  AtomChShadowCompareValSr0 = 0
                  AtomChShadowCompareValSr1 = 0
                  AtomChUpdateEnableOnCn0Reset = false
                  AtomChEnableForceUpdate = false
                  AtomChResetCn0OnForceUpdate = false
                  AtomChannelClockSelect = GTM_CONFIGURABLE_CLOCK_0
                  AtomChannelCounterCn0Reset = ON_COMPARE_MATCH_ON_CHANNEL
                  AtomChannelTriggerOutput = TRIG_FROM_PREVIOUS_CHANNEL
                  AtomChSomcTimebaseForComparison = TBU_TS1
                  AtomChSomcCompareStrategy = TIMEBASE_GREATER_EQUAL_TO_CMx
                  AtomModeControlBits = 0
                  AtomChannelOneShotMode = false
                  AtomServeLastAruCommStrategy = false
                AtomChannelAruConfiguration:
                  AtomChannelAruEnable = false
                  AtomChannelCpuWriteRequest = false
                  AtomChAruBlockingMode = GTM_ABM_DISABLED
                  AtomChAruReadAddress0 = 510
                  AtomChAruReadAddress1 = 510
                AtomChannelInterrupt:
                  AtomGlobalCcuSel = false
                  AtomIntEnableOnCcu0Trigger = false
                  AtomIntEnableOnCcu1Trigger = false
                  AtomInterruptMode = GTM_INTERRUPT_LEVEL_MODE
                  AtomNotification = NULL_PTR
                  AtomCcu0Notification = NULL_PTR
                  AtomCcu1Notification = NULL_PTR
              AtomChannel_4
                AtomChannelUsage: AtomChannelUsage=USED_BY_OTHER_DRIVERS_OR_UNUSED
                AtomChannelEnable: AtomChannelEnable=AT_START, AtomChDisableOnAgcTrigger=false
                AtomChannelOutput:
                  AtomChannelOutputControl = DONT_ENABLE_CHANNEL_OUTPUT
                  AtomChOutputDisableOnAgcTrig = false
                  AtomChannelOutputSignalLevel = LOW
                  AtomChannelPortPinSelect = TOUT114_SELA_PORT1_PIN6
                AtomChannelTimerParameters:
                  AtomChannelModeSelect = ATOM_SIG_OUTPUT_MODE_IMMEDIATE
                  AtomChannelCounterValCn0 = 0
                  AtomChannelCompareValueCm0 = 0
                  AtomChannelCompareValueCm1 = 0
                  AtomChShadowCompareValSr0 = 0
                  AtomChShadowCompareValSr1 = 0
                  AtomChUpdateEnableOnCn0Reset = false
                  AtomChEnableForceUpdate = false
                  AtomChResetCn0OnForceUpdate = false
                  AtomChannelClockSelect = GTM_CONFIGURABLE_CLOCK_0
                  AtomChannelCounterCn0Reset = ON_COMPARE_MATCH_ON_CHANNEL
                  AtomChannelTriggerOutput = TRIG_FROM_PREVIOUS_CHANNEL
                  AtomChSomcTimebaseForComparison = TBU_TS1
                  AtomChSomcCompareStrategy = TIMEBASE_GREATER_EQUAL_TO_CMx
                  AtomModeControlBits = 0
                  AtomChannelOneShotMode = false
                  AtomServeLastAruCommStrategy = false
                AtomChannelAruConfiguration:
                  AtomChannelAruEnable = false
                  AtomChannelCpuWriteRequest = false
                  AtomChAruBlockingMode = GTM_ABM_DISABLED
                  AtomChAruReadAddress0 = 510
                  AtomChAruReadAddress1 = 510
                AtomChannelInterrupt:
                  AtomGlobalCcuSel = false
                  AtomIntEnableOnCcu0Trigger = false
                  AtomIntEnableOnCcu1Trigger = false
                  AtomInterruptMode = GTM_INTERRUPT_LEVEL_MODE
                  AtomNotification = NULL_PTR
                  AtomCcu0Notification = NULL_PTR
                  AtomCcu1Notification = NULL_PTR
              AtomChannel_5
                AtomChannelUsage: AtomChannelUsage=USED_BY_OTHER_DRIVERS_OR_UNUSED
                AtomChannelEnable: AtomChannelEnable=AT_START, AtomChDisableOnAgcTrigger=false
                AtomChannelOutput:
                  AtomChannelOutputControl = DONT_ENABLE_CHANNEL_OUTPUT
                  AtomChOutputDisableOnAgcTrig = false
                  AtomChannelOutputSignalLevel = LOW
                  AtomChannelPortPinSelect = TOUT115_SELA_PORT1_PIN7
                AtomChannelTimerParameters:
                  AtomChannelModeSelect = ATOM_SIG_OUTPUT_MODE_IMMEDIATE
                  AtomChannelCounterValCn0 = 0
                  AtomChannelCompareValueCm0 = 0
                  AtomChannelCompareValueCm1 = 0
                  AtomChShadowCompareValSr0 = 0
                  AtomChShadowCompareValSr1 = 0
                  AtomChUpdateEnableOnCn0Reset = false
                  AtomChEnableForceUpdate = false
                  AtomChResetCn0OnForceUpdate = false
                  AtomChannelClockSelect = GTM_CONFIGURABLE_CLOCK_0
                  AtomChannelCounterCn0Reset = ON_COMPARE_MATCH_ON_CHANNEL
                  AtomChannelTriggerOutput = TRIG_FROM_PREVIOUS_CHANNEL
                  AtomChSomcTimebaseForComparison = TBU_TS1
                  AtomChSomcCompareStrategy = TIMEBASE_GREATER_EQUAL_TO_CMx
                  AtomModeControlBits = 0
                  AtomChannelOneShotMode = false
                  AtomServeLastAruCommStrategy = false
                AtomChannelAruConfiguration:
                  AtomChannelAruEnable = false
                  AtomChannelCpuWriteRequest = false
                  AtomChAruBlockingMode = GTM_ABM_DISABLED
                  AtomChAruReadAddress0 = 510
                  AtomChAruReadAddress1 = 510
                AtomChannelInterrupt:
                  AtomGlobalCcuSel = false
                  AtomIntEnableOnCcu0Trigger = false
                  AtomIntEnableOnCcu1Trigger = false
                  AtomInterruptMode = GTM_INTERRUPT_LEVEL_MODE
                  AtomNotification = NULL_PTR
                  AtomCcu0Notification = NULL_PTR
                  AtomCcu1Notification = NULL_PTR
              AtomChannel_6
                AtomChannelUsage: AtomChannelUsage=USED_BY_OTHER_DRIVERS_OR_UNUSED
                AtomChannelEnable: AtomChannelEnable=AT_START, AtomChDisableOnAgcTrigger=false
                AtomChannelOutput:
                  AtomChannelOutputControl = DONT_ENABLE_CHANNEL_OUTPUT
                  AtomChOutputDisableOnAgcTrig = false
                  AtomChannelOutputSignalLevel = LOW
                  AtomChannelPortPinSelect = TOUT100_SELD_PORT11_PIN11
                AtomChannelTimerParameters:
                  AtomChannelModeSelect = ATOM_SIG_OUTPUT_MODE_IMMEDIATE
                  AtomChannelCounterValCn0 = 0
                  AtomChannelCompareValueCm0 = 0
                  AtomChannelCompareValueCm1 = 0
                  AtomChShadowCompareValSr0 = 0
                  AtomChShadowCompareValSr1 = 0
                  AtomChUpdateEnableOnCn0Reset = false
                  AtomChEnableForceUpdate = false
                  AtomChResetCn0OnForceUpdate = false
                  AtomChannelClockSelect = GTM_CONFIGURABLE_CLOCK_0
                  AtomChannelCounterCn0Reset = ON_COMPARE_MATCH_ON_CHANNEL
                  AtomChannelTriggerOutput = TRIG_FROM_PREVIOUS_CHANNEL
                  AtomChSomcTimebaseForComparison = TBU_TS1
                  AtomChSomcCompareStrategy = TIMEBASE_GREATER_EQUAL_TO_CMx
                  AtomModeControlBits = 0
                  AtomChannelOneShotMode = false
                  AtomServeLastAruCommStrategy = false
                AtomChannelAruConfiguration:
                  AtomChannelAruEnable = false
                  AtomChannelCpuWriteRequest = false
                  AtomChAruBlockingMode = GTM_ABM_DISABLED
                  AtomChAruReadAddress0 = 510
                  AtomChAruReadAddress1 = 510
                AtomChannelInterrupt:
                  AtomGlobalCcuSel = false
                  AtomIntEnableOnCcu0Trigger = false
                  AtomIntEnableOnCcu1Trigger = false
                  AtomInterruptMode = GTM_INTERRUPT_LEVEL_MODE
                  AtomNotification = NULL_PTR
                  AtomCcu0Notification = NULL_PTR
                  AtomCcu1Notification = NULL_PTR
              AtomChannel_7
                AtomChannelUsage: AtomChannelUsage=USED_BY_OTHER_DRIVERS_OR_UNUSED
                AtomChannelEnable: AtomChannelEnable=AT_START, AtomChDisableOnAgcTrigger=false
                AtomChannelOutput:
                  AtomChannelOutputControl = DONT_ENABLE_CHANNEL_OUTPUT
                  AtomChOutputDisableOnAgcTrig = false
                  AtomChannelOutputSignalLevel = LOW
                  AtomChannelPortPinSelect = TOUT101_SELD_PORT11_PIN12
                AtomChannelTimerParameters:
                  AtomChannelModeSelect = ATOM_SIG_OUTPUT_MODE_IMMEDIATE
                  AtomChannelCounterValCn0 = 0
                  AtomChannelCompareValueCm0 = 0
                  AtomChannelCompareValueCm1 = 0
                  AtomChShadowCompareValSr0 = 0
                  AtomChShadowCompareValSr1 = 0
                  AtomChUpdateEnableOnCn0Reset = false
                  AtomChEnableForceUpdate = false
                  AtomChResetCn0OnForceUpdate = false
                  AtomChannelClockSelect = GTM_CONFIGURABLE_CLOCK_0
                  AtomChannelCounterCn0Reset = ON_COMPARE_MATCH_ON_CHANNEL
                  AtomChannelTriggerOutput = TRIG_FROM_PREVIOUS_CHANNEL
                  AtomChSomcTimebaseForComparison = TBU_TS1
                  AtomChSomcCompareStrategy = TIMEBASE_GREATER_EQUAL_TO_CMx
                  AtomModeControlBits = 0
                  AtomChannelOneShotMode = false
                  AtomServeLastAruCommStrategy = false
                AtomChannelAruConfiguration:
                  AtomChannelAruEnable = false
                  AtomChannelCpuWriteRequest = false
                  AtomChAruBlockingMode = GTM_ABM_DISABLED
                  AtomChAruReadAddress0 = 510
                  AtomChAruReadAddress1 = 510
                AtomChannelInterrupt:
                  AtomGlobalCcuSel = false
                  AtomIntEnableOnCcu0Trigger = false
                  AtomIntEnableOnCcu1Trigger = false
                  AtomInterruptMode = GTM_INTERRUPT_LEVEL_MODE
                  AtomNotification = NULL_PTR
                  AtomCcu0Notification = NULL_PTR
                  AtomCcu1Notification = NULL_PTR
          Atom_4
            AtomTriggerForAgc
              AtomAgcTriggerByTimebase: AtomAgcTimeBaseTriggerEnable=false, AtomAgcTbuTimebaseSelect=TBU_TS0_TIMEBASE, AtomAgcTimebaseMatchValue=0
              AtomAgcInternalTriggerSelect:
                AtomAgcIntTriggerFromChannel{0..7} = false
            8 x AtomChannel:
              AtomChannel_0
                AtomChannelUsage: AtomChannelUsage=USED_BY_OTHER_DRIVERS_OR_UNUSED
                AtomChannelEnable: AtomChannelEnable=AT_START, AtomChDisableOnAgcTrigger=false
                AtomChannelOutput:
                  AtomChannelOutputControl = DONT_ENABLE_CHANNEL_OUTPUT
                  AtomChOutputDisableOnAgcTrig = false
                  AtomChannelOutputSignalLevel = LOW
                  AtomChannelPortPinSelect = TOUT109_SELD_PORT10_PIN7
                AtomChannelTimerParameters:
                  AtomChannelModeSelect = ATOM_SIG_OUTPUT_MODE_IMMEDIATE
                  AtomChannelCounterValCn0 = 0
                  AtomChannelCompareValueCm0 = 0
                  AtomChannelCompareValueCm1 = 0
                  AtomChShadowCompareValSr0 = 0
                  AtomChShadowCompareValSr1 = 0
                  AtomChUpdateEnableOnCn0Reset = false
                  AtomChEnableForceUpdate = false
                  AtomChResetCn0OnForceUpdate = false
                  AtomChannelClockSelect = GTM_CONFIGURABLE_CLOCK_0
                  AtomChannelCounterCn0Reset = ON_COMPARE_MATCH_ON_CHANNEL
                  AtomChannelTriggerOutput = TRIG_FROM_PREVIOUS_CHANNEL
                  AtomChSomcTimebaseForComparison = TBU_TS1
                  AtomChSomcCompareStrategy = TIMEBASE_GREATER_EQUAL_TO_CMx
                  AtomModeControlBits = 0
                  AtomChannelOneShotMode = false
                  AtomServeLastAruCommStrategy = false
                AtomChannelAruConfiguration:
                  AtomChannelAruEnable = false
                  AtomChannelCpuWriteRequest = false
                  AtomChAruBlockingMode = GTM_ABM_DISABLED
                  AtomChAruReadAddress0 = 510
                  AtomChAruReadAddress1 = 510
                AtomChannelInterrupt:
                  AtomGlobalCcuSel = false
                  AtomIntEnableOnCcu0Trigger = false
                  AtomIntEnableOnCcu1Trigger = false
                  AtomInterruptMode = GTM_INTERRUPT_LEVEL_MODE
                  AtomNotification = NULL_PTR
                  AtomCcu0Notification = NULL_PTR
                  AtomCcu1Notification = NULL_PTR
              AtomChannel_1
                AtomChannelUsage: AtomChannelUsage=USED_BY_OTHER_DRIVERS_OR_UNUSED
                AtomChannelEnable: AtomChannelEnable=AT_START, AtomChDisableOnAgcTrigger=false
                AtomChannelOutput:
                  AtomChannelOutputControl = DONT_ENABLE_CHANNEL_OUTPUT
                  AtomChOutputDisableOnAgcTrig = false
                  AtomChannelOutputSignalLevel = LOW
                  AtomChannelPortPinSelect = TOUT103_SELD_PORT10_PIN1
                AtomChannelTimerParameters:
                  AtomChannelModeSelect = ATOM_SIG_OUTPUT_MODE_IMMEDIATE
                  AtomChannelCounterValCn0 = 0
                  AtomChannelCompareValueCm0 = 0
                  AtomChannelCompareValueCm1 = 0
                  AtomChShadowCompareValSr0 = 0
                  AtomChShadowCompareValSr1 = 0
                  AtomChUpdateEnableOnCn0Reset = false
                  AtomChEnableForceUpdate = false
                  AtomChResetCn0OnForceUpdate = false
                  AtomChannelClockSelect = GTM_CONFIGURABLE_CLOCK_0
                  AtomChannelCounterCn0Reset = ON_COMPARE_MATCH_ON_CHANNEL
                  AtomChannelTriggerOutput = TRIG_FROM_PREVIOUS_CHANNEL
                  AtomChSomcTimebaseForComparison = TBU_TS1
                  AtomChSomcCompareStrategy = TIMEBASE_GREATER_EQUAL_TO_CMx
                  AtomModeControlBits = 0
                  AtomChannelOneShotMode = false
                  AtomServeLastAruCommStrategy = false
                AtomChannelAruConfiguration:
                  AtomChannelAruEnable = false
                  AtomChannelCpuWriteRequest = false
                  AtomChAruBlockingMode = GTM_ABM_DISABLED
                  AtomChAruReadAddress0 = 510
                  AtomChAruReadAddress1 = 510
                AtomChannelInterrupt:
                  AtomGlobalCcuSel = false
                  AtomIntEnableOnCcu0Trigger = false
                  AtomIntEnableOnCcu1Trigger = false
                  AtomInterruptMode = GTM_INTERRUPT_LEVEL_MODE
                  AtomNotification = NULL_PTR
                  AtomCcu0Notification = NULL_PTR
                  AtomCcu1Notification = NULL_PTR
              AtomChannel_2
                AtomChannelUsage: AtomChannelUsage=USED_BY_OTHER_DRIVERS_OR_UNUSED
                AtomChannelEnable: AtomChannelEnable=AT_START, AtomChDisableOnAgcTrigger=false
                AtomChannelOutput:
                  AtomChannelOutputControl = DONT_ENABLE_CHANNEL_OUTPUT
                  AtomChOutputDisableOnAgcTrig = false
                  AtomChannelOutputSignalLevel = LOW
                  AtomChannelPortPinSelect = TOUT104_SELD_PORT10_PIN2
                AtomChannelTimerParameters:
                  AtomChannelModeSelect = ATOM_SIG_OUTPUT_MODE_IMMEDIATE
                  AtomChannelCounterValCn0 = 0
                  AtomChannelCompareValueCm0 = 0
                  AtomChannelCompareValueCm1 = 0
                  AtomChShadowCompareValSr0 = 0
                  AtomChShadowCompareValSr1 = 0
                  AtomChUpdateEnableOnCn0Reset = false
                  AtomChEnableForceUpdate = false
                  AtomChResetCn0OnForceUpdate = false
                  AtomChannelClockSelect = GTM_CONFIGURABLE_CLOCK_0
                  AtomChannelCounterCn0Reset = ON_COMPARE_MATCH_ON_CHANNEL
                  AtomChannelTriggerOutput = TRIG_FROM_PREVIOUS_CHANNEL
                  AtomChSomcTimebaseForComparison = TBU_TS1
                  AtomChSomcCompareStrategy = TIMEBASE_GREATER_EQUAL_TO_CMx
                  AtomModeControlBits = 0
                  AtomChannelOneShotMode = false
                  AtomServeLastAruCommStrategy = false
                AtomChannelAruConfiguration:
                  AtomChannelAruEnable = false
                  AtomChannelCpuWriteRequest = false
                  AtomChAruBlockingMode = GTM_ABM_DISABLED
                  AtomChAruReadAddress0 = 510
                  AtomChAruReadAddress1 = 510
                AtomChannelInterrupt:
                  AtomGlobalCcuSel = false
                  AtomIntEnableOnCcu0Trigger = false
                  AtomIntEnableOnCcu1Trigger = false
                  AtomInterruptMode = GTM_INTERRUPT_LEVEL_MODE
                  AtomNotification = NULL_PTR
                  AtomCcu0Notification = NULL_PTR
                  AtomCcu1Notification = NULL_PTR
              AtomChannel_3
                AtomChannelUsage: AtomChannelUsage=USED_BY_OTHER_DRIVERS_OR_UNUSED
                AtomChannelEnable: AtomChannelEnable=AT_START, AtomChDisableOnAgcTrigger=false
                AtomChannelOutput:
                  AtomChannelOutputControl = DONT_ENABLE_CHANNEL_OUTPUT
                  AtomChOutputDisableOnAgcTrig = false
                  AtomChannelOutputSignalLevel = LOW
                  AtomChannelPortPinSelect = TOUT105_SELD_PORT10_PIN3
                AtomChannelTimerParameters:
                  AtomChannelModeSelect = ATOM_SIG_OUTPUT_MODE_IMMEDIATE
                  AtomChannelCounterValCn0 = 0
                  AtomChannelCompareValueCm0 = 0
                  AtomChannelCompareValueCm1 = 0
                  AtomChShadowCompareValSr0 = 0
                  AtomChShadowCompareValSr1 = 0
                  AtomChUpdateEnableOnCn0Reset = false
                  AtomChEnableForceUpdate = false
                  AtomChResetCn0OnForceUpdate = false
                  AtomChannelClockSelect = GTM_CONFIGURABLE_CLOCK_0
                  AtomChannelCounterCn0Reset = ON_COMPARE_MATCH_ON_CHANNEL
                  AtomChannelTriggerOutput = TRIG_FROM_PREVIOUS_CHANNEL
                  AtomChSomcTimebaseForComparison = TBU_TS1
                  AtomChSomcCompareStrategy = TIMEBASE_GREATER_EQUAL_TO_CMx
                  AtomModeControlBits = 0
                  AtomChannelOneShotMode = false
                  AtomServeLastAruCommStrategy = false
                AtomChannelAruConfiguration:
                  AtomChannelAruEnable = false
                  AtomChannelCpuWriteRequest = false
                  AtomChAruBlockingMode = GTM_ABM_DISABLED
                  AtomChAruReadAddress0 = 510
                  AtomChAruReadAddress1 = 510
                AtomChannelInterrupt:
                  AtomGlobalCcuSel = false
                  AtomIntEnableOnCcu0Trigger = false
                  AtomIntEnableOnCcu1Trigger = false
                  AtomInterruptMode = GTM_INTERRUPT_LEVEL_MODE
                  AtomNotification = NULL_PTR
                  AtomCcu0Notification = NULL_PTR
                  AtomCcu1Notification = NULL_PTR
              AtomChannel_4
                AtomChannelUsage: AtomChannelUsage=USED_BY_OTHER_DRIVERS_OR_UNUSED
                AtomChannelEnable: AtomChannelEnable=AT_START, AtomChDisableOnAgcTrigger=false
                AtomChannelOutput:
                  AtomChannelOutputControl = DONT_ENABLE_CHANNEL_OUTPUT
                  AtomChOutputDisableOnAgcTrig = false
                  AtomChannelOutputSignalLevel = LOW
                  AtomChannelPortPinSelect = TOUT102_SELD_PORT10_PIN0
                AtomChannelTimerParameters:
                  AtomChannelModeSelect = ATOM_SIG_OUTPUT_MODE_IMMEDIATE
                  AtomChannelCounterValCn0 = 0
                  AtomChannelCompareValueCm0 = 0
                  AtomChannelCompareValueCm1 = 0
                  AtomChShadowCompareValSr0 = 0
                  AtomChShadowCompareValSr1 = 0
                  AtomChUpdateEnableOnCn0Reset = false
                  AtomChEnableForceUpdate = false
                  AtomChResetCn0OnForceUpdate = false
                  AtomChannelClockSelect = GTM_CONFIGURABLE_CLOCK_0
                  AtomChannelCounterCn0Reset = ON_COMPARE_MATCH_ON_CHANNEL
                  AtomChannelTriggerOutput = TRIG_FROM_PREVIOUS_CHANNEL
                  AtomChSomcTimebaseForComparison = TBU_TS1
                  AtomChSomcCompareStrategy = TIMEBASE_GREATER_EQUAL_TO_CMx
                  AtomModeControlBits = 0
                  AtomChannelOneShotMode = false
                  AtomServeLastAruCommStrategy = false
                AtomChannelAruConfiguration:
                  AtomChannelAruEnable = false
                  AtomChannelCpuWriteRequest = false
                  AtomChAruBlockingMode = GTM_ABM_DISABLED
                  AtomChAruReadAddress0 = 510
                  AtomChAruReadAddress1 = 510
                AtomChannelInterrupt:
                  AtomGlobalCcuSel = false
                  AtomIntEnableOnCcu0Trigger = false
                  AtomIntEnableOnCcu1Trigger = false
                  AtomInterruptMode = GTM_INTERRUPT_LEVEL_MODE
                  AtomNotification = NULL_PTR
                  AtomCcu0Notification = NULL_PTR
                  AtomCcu1Notification = NULL_PTR
              AtomChannel_5
                AtomChannelUsage: AtomChannelUsage=USED_BY_OTHER_DRIVERS_OR_UNUSED
                AtomChannelEnable: AtomChannelEnable=AT_START, AtomChDisableOnAgcTrigger=false
                AtomChannelOutput:
                  AtomChannelOutputControl = DONT_ENABLE_CHANNEL_OUTPUT
                  AtomChOutputDisableOnAgcTrig = false
                  AtomChannelOutputSignalLevel = LOW
                  AtomChannelPortPinSelect = TOUT116_SELA_PORT2_PIN9
                AtomChannelTimerParameters:
                  AtomChannelModeSelect = ATOM_SIG_OUTPUT_MODE_IMMEDIATE
                  AtomChannelCounterValCn0 = 0
                  AtomChannelCompareValueCm0 = 0
                  AtomChannelCompareValueCm1 = 0
                  AtomChShadowCompareValSr0 = 0
                  AtomChShadowCompareValSr1 = 0
                  AtomChUpdateEnableOnCn0Reset = false
                  AtomChEnableForceUpdate = false
                  AtomChResetCn0OnForceUpdate = false
                  AtomChannelClockSelect = GTM_CONFIGURABLE_CLOCK_0
                  AtomChannelCounterCn0Reset = ON_COMPARE_MATCH_ON_CHANNEL
                  AtomChannelTriggerOutput = TRIG_FROM_PREVIOUS_CHANNEL
                  AtomChSomcTimebaseForComparison = TBU_TS1
                  AtomChSomcCompareStrategy = TIMEBASE_GREATER_EQUAL_TO_CMx
                  AtomModeControlBits = 0
                  AtomChannelOneShotMode = false
                  AtomServeLastAruCommStrategy = false
                AtomChannelAruConfiguration:
                  AtomChannelAruEnable = false
                  AtomChannelCpuWriteRequest = false
                  AtomChAruBlockingMode = GTM_ABM_DISABLED
                  AtomChAruReadAddress0 = 510
                  AtomChAruReadAddress1 = 510
                AtomChannelInterrupt:
                  AtomGlobalCcuSel = false
                  AtomIntEnableOnCcu0Trigger = false
                  AtomIntEnableOnCcu1Trigger = false
                  AtomInterruptMode = GTM_INTERRUPT_LEVEL_MODE
                  AtomNotification = NULL_PTR
                  AtomCcu0Notification = NULL_PTR
                  AtomCcu1Notification = NULL_PTR
              AtomChannel_6
                AtomChannelUsage: AtomChannelUsage=USED_BY_OTHER_DRIVERS_OR_UNUSED
                AtomChannelEnable: AtomChannelEnable=AT_START, AtomChDisableOnAgcTrigger=false
                AtomChannelOutput:
                  AtomChannelOutputControl = DONT_ENABLE_CHANNEL_OUTPUT
                  AtomChOutputDisableOnAgcTrig = false
                  AtomChannelOutputSignalLevel = LOW
                  AtomChannelPortPinSelect = TOUT117_SELA_PORT2_PIN10
                AtomChannelTimerParameters:
                  AtomChannelModeSelect = ATOM_SIG_OUTPUT_MODE_IMMEDIATE
                  AtomChannelCounterValCn0 = 0
                  AtomChannelCompareValueCm0 = 0
                  AtomChannelCompareValueCm1 = 0
                  AtomChShadowCompareValSr0 = 0
                  AtomChShadowCompareValSr1 = 0
                  AtomChUpdateEnableOnCn0Reset = false
                  AtomChEnableForceUpdate = false
                  AtomChResetCn0OnForceUpdate = false
                  AtomChannelClockSelect = GTM_CONFIGURABLE_CLOCK_0
                  AtomChannelCounterCn0Reset = ON_COMPARE_MATCH_ON_CHANNEL
                  AtomChannelTriggerOutput = TRIG_FROM_PREVIOUS_CHANNEL
                  AtomChSomcTimebaseForComparison = TBU_TS1
                  AtomChSomcCompareStrategy = TIMEBASE_GREATER_EQUAL_TO_CMx
                  AtomModeControlBits = 0
                  AtomChannelOneShotMode = false
                  AtomServeLastAruCommStrategy = false
                AtomChannelAruConfiguration:
                  AtomChannelAruEnable = false
                  AtomChannelCpuWriteRequest = false
                  AtomChAruBlockingMode = GTM_ABM_DISABLED
                  AtomChAruReadAddress0 = 510
                  AtomChAruReadAddress1 = 510
                AtomChannelInterrupt:
                  AtomGlobalCcuSel = false
                  AtomIntEnableOnCcu0Trigger = false
                  AtomIntEnableOnCcu1Trigger = false
                  AtomInterruptMode = GTM_INTERRUPT_LEVEL_MODE
                  AtomNotification = NULL_PTR
                  AtomCcu0Notification = NULL_PTR
                  AtomCcu1Notification = NULL_PTR
              AtomChannel_7
                AtomChannelUsage: AtomChannelUsage=USED_BY_OTHER_DRIVERS_OR_UNUSED
                AtomChannelEnable: AtomChannelEnable=AT_START, AtomChDisableOnAgcTrigger=false
                AtomChannelOutput:
                  AtomChannelOutputControl = DONT_ENABLE_CHANNEL_OUTPUT
                  AtomChOutputDisableOnAgcTrig = false
                  AtomChannelOutputSignalLevel = LOW
                  AtomChannelPortPinSelect = TOUT118_SELA_PORT2_PIN11
                AtomChannelTimerParameters:
                  AtomChannelModeSelect = ATOM_SIG_OUTPUT_MODE_IMMEDIATE
                  AtomChannelCounterValCn0 = 0
                  AtomChannelCompareValueCm0 = 0
                  AtomChannelCompareValueCm1 = 0
                  AtomChShadowCompareValSr0 = 0
                  AtomChShadowCompareValSr1 = 0
                  AtomChUpdateEnableOnCn0Reset = false
                  AtomChEnableForceUpdate = false
                  AtomChResetCn0OnForceUpdate = false
                  AtomChannelClockSelect = GTM_CONFIGURABLE_CLOCK_0
                  AtomChannelCounterCn0Reset = ON_COMPARE_MATCH_ON_CHANNEL
                  AtomChannelTriggerOutput = TRIG_FROM_PREVIOUS_CHANNEL
                  AtomChSomcTimebaseForComparison = TBU_TS1
                  AtomChSomcCompareStrategy = TIMEBASE_GREATER_EQUAL_TO_CMx
                  AtomModeControlBits = 0
                  AtomChannelOneShotMode = false
                  AtomServeLastAruCommStrategy = false
                AtomChannelAruConfiguration:
                  AtomChannelAruEnable = false
                  AtomChannelCpuWriteRequest = false
                  AtomChAruBlockingMode = GTM_ABM_DISABLED
                  AtomChAruReadAddress0 = 510
                  AtomChAruReadAddress1 = 510
                AtomChannelInterrupt:
                  AtomGlobalCcuSel = false
                  AtomIntEnableOnCcu0Trigger = false
                  AtomIntEnableOnCcu1Trigger = false
                  AtomInterruptMode = GTM_INTERRUPT_LEVEL_MODE
                  AtomNotification = NULL_PTR
                  AtomCcu0Notification = NULL_PTR
                  AtomCcu1Notification = NULL_PTR
