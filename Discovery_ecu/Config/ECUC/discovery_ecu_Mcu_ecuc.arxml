[part 2 of 2: package /ActiveEcuC]
AUTOSAR XML (schema 4-2-1)
package /ActiveEcuC  (continued)
  module config Mcu: implementation-config-variant=VARIANT-POST-BUILD-LOADABLE, module-description=Mcu_Impl  (continued)
    McuModuleConfiguration:  (continued)
      GtmConfiguration  (continued)
        4 x Tim:
          Tim_0
            8 x TimChannel:
              TimChannel_0
                TimChannelGeneral:
                  TimChannelUsage = USED_BY_OTHER_DRIVERS_OR_UNUSED
                  TimChannelEnable = false
                  TimChannelInputSelect = INPUT_OF_CURRENT_TIM_CHANNEL
                  TimChannelPortPinSelect = NONE_SEL0
                  TimChannelValInitSignal = VAL_LOW
                  TimChannelSignalEdgeSelect = FALLING_EDGE
                  TimChannelClockSelect = GTM_CONFIGURABLE_CLOCK_0
                  TimChannelGpr0InputSelect = TIMEBASE_TBU_TS0
                  TimChannelGpr1InputSelect = TIMEBASE_TBU_TS0
                  TimChannelCntsInputSelect = CNT_VALUE
                  TimChannelCntsValue = 0
                  TimChannelTbu0Ts0BitsSelect = BITS_0_TO_23
                  TimChannelModeSelect = PWM_MEASUREMENT_MODE_TPWM
                  TimChannelOneShotMode = false
                  TimChannelAruEnable = false
                  TimChannelExtCaptureModeEnable = false
                  TimChannelExtCaptureSrc = SEL0_NEW_VAL_IRQ
                  TimChannelEcntResetSetting = SEL0_ECNT_IN_WRAP_AROUND_MODE
                  TimChannelEcntOvflwSetting = SEL0_OVRFLOW_SIG_ON_ECNT_BITWIDTH_8
                TimChannelFilterConfig:
                  TimChannelFilterEnable = false
                  TimChFilterCounterFreqSelect = GTM_CONFIGURABLE_CLOCK_0
                  TimChFilterModeForRisingEdge = IMMEDIATE_EDGE_PROPAGATION_MODE
                  TimChFilterModeForFallingEdge = IMMEDIATE_EDGE_PROPAGATION_MODE
                  TimChFilterTimeForRisingEdge = 0
                  TimChFilterTimeForFallingEdge = 0
                TimChannelTimeoutDetection: TimChTimeoutDetectionEnable=SEL0_TIMOUT_DISABLED, TimChTimeoutClockSelect=GTM_CONFIGURABLE_CLOCK_0, TimChTimeoutDuration=0
                TimChannelInterrupt:
                  TimInterruptEnableOnNewVal = false
                  TimInterruptEnableOnEcntOfl = false
                  TimInterruptEnableOnCntOfl = false
                  TimInterruptEnableOnGprxOfl = false
                  TimInterruptEnableOnToDet = false
                  TimInterruptEnableOnGlitchDet = false
                  TimInterruptMode = GTM_INTERRUPT_LEVEL_MODE
                  TimNotification = NULL_PTR
                TimChannelErrorInterrupt:
                  TimInterruptEnableOnNewValErr = false
                  TimInterruptEnableOnEcntOflErr = false
                  TimInterruptEnableOnCntOflErr = false
                  TimInterruptEnableOnGprxOflErr = false
                  TimInterruptEnableOnToDetErr = false
                  TimInterruptEnableOnGlitchDetErr = false
              TimChannel_1
                TimChannelGeneral:
                  TimChannelUsage = USED_BY_OTHER_DRIVERS_OR_UNUSED
                  TimChannelEnable = false
                  TimChannelInputSelect = INPUT_OF_CURRENT_TIM_CHANNEL
                  TimChannelPortPinSelect = NONE_SEL0
                  TimChannelValInitSignal = VAL_LOW
                  TimChannelSignalEdgeSelect = FALLING_EDGE
                  TimChannelClockSelect = GTM_CONFIGURABLE_CLOCK_0
                  TimChannelGpr0InputSelect = TIMEBASE_TBU_TS0
                  TimChannelGpr1InputSelect = TIMEBASE_TBU_TS0
                  TimChannelCntsInputSelect = CNT_VALUE
                  TimChannelCntsValue = 0
                  TimChannelTbu0Ts0BitsSelect = BITS_0_TO_23
                  TimChannelModeSelect = PWM_MEASUREMENT_MODE_TPWM
                  TimChannelOneShotMode = false
                  TimChannelAruEnable = false
                  TimChannelExtCaptureModeEnable = false
                  TimChannelExtCaptureSrc = SEL0_NEW_VAL_IRQ
                  TimChannelEcntResetSetting = SEL0_ECNT_IN_WRAP_AROUND_MODE
                  TimChannelEcntOvflwSetting = SEL0_OVRFLOW_SIG_ON_ECNT_BITWIDTH_8
                TimChannelFilterConfig:
                  TimChannelFilterEnable = false
                  TimChFilterCounterFreqSelect = GTM_CONFIGURABLE_CLOCK_0
                  TimChFilterModeForRisingEdge = IMMEDIATE_EDGE_PROPAGATION_MODE
                  TimChFilterModeForFallingEdge = IMMEDIATE_EDGE_PROPAGATION_MODE
                  TimChFilterTimeForRisingEdge = 0
                  TimChFilterTimeForFallingEdge = 0
                TimChannelTimeoutDetection: TimChTimeoutDetectionEnable=SEL0_TIMOUT_DISABLED, TimChTimeoutClockSelect=GTM_CONFIGURABLE_CLOCK_0, TimChTimeoutDuration=0
                TimChannelInterrupt:
                  TimInterruptEnableOnNewVal = false
                  TimInterruptEnableOnEcntOfl = false
                  TimInterruptEnableOnCntOfl = false
                  TimInterruptEnableOnGprxOfl = false
                  TimInterruptEnableOnToDet = false
                  TimInterruptEnableOnGlitchDet = false
                  TimInterruptMode = GTM_INTERRUPT_LEVEL_MODE
                  TimNotification = NULL_PTR
                TimChannelErrorInterrupt:
                  TimInterruptEnableOnNewValErr = false
                  TimInterruptEnableOnEcntOflErr = false
                  TimInterruptEnableOnCntOflErr = false
                  TimInterruptEnableOnGprxOflErr = false
                  TimInterruptEnableOnToDetErr = false
                  TimInterruptEnableOnGlitchDetErr = false
              TimChannel_2
                TimChannelGeneral:
                  TimChannelUsage = USED_BY_OTHER_DRIVERS_OR_UNUSED
                  TimChannelEnable = false
                  TimChannelInputSelect = INPUT_OF_CURRENT_TIM_CHANNEL
                  TimChannelPortPinSelect = NONE_SEL0
                  TimChannelValInitSignal = VAL_LOW
                  TimChannelSignalEdgeSelect = FALLING_EDGE
                  TimChannelClockSelect = GTM_CONFIGURABLE_CLOCK_0
                  TimChannelGpr0InputSelect = TIMEBASE_TBU_TS0
                  TimChannelGpr1InputSelect = TIMEBASE_TBU_TS0
                  TimChannelCntsInputSelect = CNT_VALUE
                  TimChannelCntsValue = 0
                  TimChannelTbu0Ts0BitsSelect = BITS_0_TO_23
                  TimChannelModeSelect = PWM_MEASUREMENT_MODE_TPWM
                  TimChannelOneShotMode = false
                  TimChannelAruEnable = false
                  TimChannelExtCaptureModeEnable = false
                  TimChannelExtCaptureSrc = SEL0_NEW_VAL_IRQ
                  TimChannelEcntResetSetting = SEL0_ECNT_IN_WRAP_AROUND_MODE
                  TimChannelEcntOvflwSetting = SEL0_OVRFLOW_SIG_ON_ECNT_BITWIDTH_8
                TimChannelFilterConfig:
                  TimChannelFilterEnable = false
                  TimChFilterCounterFreqSelect = GTM_CONFIGURABLE_CLOCK_0
                  TimChFilterModeForRisingEdge = IMMEDIATE_EDGE_PROPAGATION_MODE
                  TimChFilterModeForFallingEdge = IMMEDIATE_EDGE_PROPAGATION_MODE
                  TimChFilterTimeForRisingEdge = 0
                  TimChFilterTimeForFallingEdge = 0
                TimChannelTimeoutDetection: TimChTimeoutDetectionEnable=SEL0_TIMOUT_DISABLED, TimChTimeoutClockSelect=GTM_CONFIGURABLE_CLOCK_0, TimChTimeoutDuration=0
                TimChannelInterrupt:
                  TimInterruptEnableOnNewVal = false
                  TimInterruptEnableOnEcntOfl = false
                  TimInterruptEnableOnCntOfl = false
                  TimInterruptEnableOnGprxOfl = false
                  TimInterruptEnableOnToDet = false
                  TimInterruptEnableOnGlitchDet = false
                  TimInterruptMode = GTM_INTERRUPT_LEVEL_MODE
                  TimNotification = NULL_PTR
                TimChannelErrorInterrupt:
                  TimInterruptEnableOnNewValErr = false
                  TimInterruptEnableOnEcntOflErr = false
                  TimInterruptEnableOnCntOflErr = false
                  TimInterruptEnableOnGprxOflErr = false
                  TimInterruptEnableOnToDetErr = false
                  TimInterruptEnableOnGlitchDetErr = false
              TimChannel_3
                TimChannelGeneral:
                  TimChannelUsage = USED_BY_OTHER_DRIVERS_OR_UNUSED
                  TimChannelEnable = false
                  TimChannelInputSelect = INPUT_OF_CURRENT_TIM_CHANNEL
                  TimChannelPortPinSelect = NONE_SEL0
                  TimChannelValInitSignal = VAL_LOW
                  TimChannelSignalEdgeSelect = FALLING_EDGE
                  TimChannelClockSelect = GTM_CONFIGURABLE_CLOCK_0
                  TimChannelGpr0InputSelect = TIMEBASE_TBU_TS0
                  TimChannelGpr1InputSelect = TIMEBASE_TBU_TS0
                  TimChannelCntsInputSelect = CNT_VALUE
                  TimChannelCntsValue = 0
                  TimChannelTbu0Ts0BitsSelect = BITS_0_TO_23
                  TimChannelModeSelect = PWM_MEASUREMENT_MODE_TPWM
                  TimChannelOneShotMode = false
                  TimChannelAruEnable = false
                  TimChannelExtCaptureModeEnable = false
                  TimChannelExtCaptureSrc = SEL0_NEW_VAL_IRQ
                  TimChannelEcntResetSetting = SEL0_ECNT_IN_WRAP_AROUND_MODE
                  TimChannelEcntOvflwSetting = SEL0_OVRFLOW_SIG_ON_ECNT_BITWIDTH_8
                TimChannelFilterConfig:
                  TimChannelFilterEnable = false
                  TimChFilterCounterFreqSelect = GTM_CONFIGURABLE_CLOCK_0
                  TimChFilterModeForRisingEdge = IMMEDIATE_EDGE_PROPAGATION_MODE
                  TimChFilterModeForFallingEdge = IMMEDIATE_EDGE_PROPAGATION_MODE
                  TimChFilterTimeForRisingEdge = 0
                  TimChFilterTimeForFallingEdge = 0
                TimChannelTimeoutDetection: TimChTimeoutDetectionEnable=SEL0_TIMOUT_DISABLED, TimChTimeoutClockSelect=GTM_CONFIGURABLE_CLOCK_0, TimChTimeoutDuration=0
                TimChannelInterrupt:
                  TimInterruptEnableOnNewVal = false
                  TimInterruptEnableOnEcntOfl = false
                  TimInterruptEnableOnCntOfl = false
                  TimInterruptEnableOnGprxOfl = false
                  TimInterruptEnableOnToDet = false
                  TimInterruptEnableOnGlitchDet = false
                  TimInterruptMode = GTM_INTERRUPT_LEVEL_MODE
                  TimNotification = NULL_PTR
                TimChannelErrorInterrupt:
                  TimInterruptEnableOnNewValErr = false
                  TimInterruptEnableOnEcntOflErr = false
                  TimInterruptEnableOnCntOflErr = false
                  TimInterruptEnableOnGprxOflErr = false
                  TimInterruptEnableOnToDetErr = false
                  TimInterruptEnableOnGlitchDetErr = false
              TimChannel_4
                TimChannelGeneral:
                  TimChannelUsage = USED_BY_OTHER_DRIVERS_OR_UNUSED
                  TimChannelEnable = false
                  TimChannelInputSelect = INPUT_OF_CURRENT_TIM_CHANNEL
                  TimChannelPortPinSelect = NONE_SEL0
                  TimChannelValInitSignal = VAL_LOW
                  TimChannelSignalEdgeSelect = FALLING_EDGE
                  TimChannelClockSelect = GTM_CONFIGURABLE_CLOCK_0
                  TimChannelGpr0InputSelect = TIMEBASE_TBU_TS0
                  TimChannelGpr1InputSelect = TIMEBASE_TBU_TS0
                  TimChannelCntsInputSelect = CNT_VALUE
                  TimChannelCntsValue = 0
                  TimChannelTbu0Ts0BitsSelect = BITS_0_TO_23
                  TimChannelModeSelect = PWM_MEASUREMENT_MODE_TPWM
                  TimChannelOneShotMode = false
                  TimChannelAruEnable = false
                  TimChannelExtCaptureModeEnable = false
                  TimChannelExtCaptureSrc = SEL0_NEW_VAL_IRQ
                  TimChannelEcntResetSetting = SEL0_ECNT_IN_WRAP_AROUND_MODE
                  TimChannelEcntOvflwSetting = SEL0_OVRFLOW_SIG_ON_ECNT_BITWIDTH_8
                TimChannelFilterConfig:
                  TimChannelFilterEnable = false
                  TimChFilterCounterFreqSelect = GTM_CONFIGURABLE_CLOCK_0
                  TimChFilterModeForRisingEdge = IMMEDIATE_EDGE_PROPAGATION_MODE
                  TimChFilterModeForFallingEdge = IMMEDIATE_EDGE_PROPAGATION_MODE
                  TimChFilterTimeForRisingEdge = 0
                  TimChFilterTimeForFallingEdge = 0
                TimChannelTimeoutDetection: TimChTimeoutDetectionEnable=SEL0_TIMOUT_DISABLED, TimChTimeoutClockSelect=GTM_CONFIGURABLE_CLOCK_0, TimChTimeoutDuration=0
                TimChannelInterrupt:
                  TimInterruptEnableOnNewVal = false
                  TimInterruptEnableOnEcntOfl = false
                  TimInterruptEnableOnCntOfl = false
                  TimInterruptEnableOnGprxOfl = false
                  TimInterruptEnableOnToDet = false
                  TimInterruptEnableOnGlitchDet = false
                  TimInterruptMode = GTM_INTERRUPT_LEVEL_MODE
                  TimNotification = NULL_PTR
                TimChannelErrorInterrupt:
                  TimInterruptEnableOnNewValErr = false
                  TimInterruptEnableOnEcntOflErr = false
                  TimInterruptEnableOnCntOflErr = false
                  TimInterruptEnableOnGprxOflErr = false
                  TimInterruptEnableOnToDetErr = false
                  TimInterruptEnableOnGlitchDetErr = false
              TimChannel_5
                TimChannelGeneral:
                  TimChannelUsage = USED_BY_OTHER_DRIVERS_OR_UNUSED
                  TimChannelEnable = false
                  TimChannelInputSelect = INPUT_OF_CURRENT_TIM_CHANNEL
                  TimChannelPortPinSelect = NONE_SEL0
                  TimChannelValInitSignal = VAL_LOW
                  TimChannelSignalEdgeSelect = FALLING_EDGE
                  TimChannelClockSelect = GTM_CONFIGURABLE_CLOCK_0
                  TimChannelGpr0InputSelect = TIMEBASE_TBU_TS0
                  TimChannelGpr1InputSelect = TIMEBASE_TBU_TS0
                  TimChannelCntsInputSelect = CNT_VALUE
                  TimChannelCntsValue = 0
                  TimChannelTbu0Ts0BitsSelect = BITS_0_TO_23
                  TimChannelModeSelect = PWM_MEASUREMENT_MODE_TPWM
                  TimChannelOneShotMode = false
                  TimChannelAruEnable = false
                  TimChannelExtCaptureModeEnable = false
                  TimChannelExtCaptureSrc = SEL0_NEW_VAL_IRQ
                  TimChannelEcntResetSetting = SEL0_ECNT_IN_WRAP_AROUND_MODE
                  TimChannelEcntOvflwSetting = SEL0_OVRFLOW_SIG_ON_ECNT_BITWIDTH_8
                TimChannelFilterConfig:
                  TimChannelFilterEnable = false
                  TimChFilterCounterFreqSelect = GTM_CONFIGURABLE_CLOCK_0
                  TimChFilterModeForRisingEdge = IMMEDIATE_EDGE_PROPAGATION_MODE
                  TimChFilterModeForFallingEdge = IMMEDIATE_EDGE_PROPAGATION_MODE
                  TimChFilterTimeForRisingEdge = 0
                  TimChFilterTimeForFallingEdge = 0
                TimChannelTimeoutDetection: TimChTimeoutDetectionEnable=SEL0_TIMOUT_DISABLED, TimChTimeoutClockSelect=GTM_CONFIGURABLE_CLOCK_0, TimChTimeoutDuration=0
                TimChannelInterrupt:
                  TimInterruptEnableOnNewVal = false
                  TimInterruptEnableOnEcntOfl = false
                  TimInterruptEnableOnCntOfl = false
                  TimInterruptEnableOnGprxOfl = false
                  TimInterruptEnableOnToDet = false
                  TimInterruptEnableOnGlitchDet = false
                  TimInterruptMode = GTM_INTERRUPT_LEVEL_MODE
                  TimNotification = NULL_PTR
                TimChannelErrorInterrupt:
                  TimInterruptEnableOnNewValErr = false
                  TimInterruptEnableOnEcntOflErr = false
                  TimInterruptEnableOnCntOflErr = false
                  TimInterruptEnableOnGprxOflErr = false
                  TimInterruptEnableOnToDetErr = false
                  TimInterruptEnableOnGlitchDetErr = false
              TimChannel_6
                TimChannelGeneral:
                  TimChannelUsage = USED_BY_OTHER_DRIVERS_OR_UNUSED
                  TimChannelEnable = false
                  TimChannelInputSelect = INPUT_OF_CURRENT_TIM_CHANNEL
                  TimChannelPortPinSelect = NONE_SEL0
                  TimChannelValInitSignal = VAL_LOW
                  TimChannelSignalEdgeSelect = FALLING_EDGE
                  TimChannelClockSelect = GTM_CONFIGURABLE_CLOCK_0
                  TimChannelGpr0InputSelect = TIMEBASE_TBU_TS0
                  TimChannelGpr1InputSelect = TIMEBASE_TBU_TS0
                  TimChannelCntsInputSelect = CNT_VALUE
                  TimChannelCntsValue = 0
                  TimChannelTbu0Ts0BitsSelect = BITS_0_TO_23
                  TimChannelModeSelect = PWM_MEASUREMENT_MODE_TPWM
                  TimChannelOneShotMode = false
                  TimChannelAruEnable = false
                  TimChannelExtCaptureModeEnable = false
                  TimChannelExtCaptureSrc = SEL0_NEW_VAL_IRQ
                  TimChannelEcntResetSetting = SEL0_ECNT_IN_WRAP_AROUND_MODE
                  TimChannelEcntOvflwSetting = SEL0_OVRFLOW_SIG_ON_ECNT_BITWIDTH_8
                TimChannelFilterConfig:
                  TimChannelFilterEnable = false
                  TimChFilterCounterFreqSelect = GTM_CONFIGURABLE_CLOCK_0
                  TimChFilterModeForRisingEdge = IMMEDIATE_EDGE_PROPAGATION_MODE
                  TimChFilterModeForFallingEdge = IMMEDIATE_EDGE_PROPAGATION_MODE
                  TimChFilterTimeForRisingEdge = 0
                  TimChFilterTimeForFallingEdge = 0
                TimChannelTimeoutDetection: TimChTimeoutDetectionEnable=SEL0_TIMOUT_DISABLED, TimChTimeoutClockSelect=GTM_CONFIGURABLE_CLOCK_0, TimChTimeoutDuration=0
                TimChannelInterrupt:
                  TimInterruptEnableOnNewVal = false
                  TimInterruptEnableOnEcntOfl = false
                  TimInterruptEnableOnCntOfl = false
                  TimInterruptEnableOnGprxOfl = false
                  TimInterruptEnableOnToDet = false
                  TimInterruptEnableOnGlitchDet = false
                  TimInterruptMode = GTM_INTERRUPT_LEVEL_MODE
                  TimNotification = NULL_PTR
                TimChannelErrorInterrupt:
                  TimInterruptEnableOnNewValErr = false
                  TimInterruptEnableOnEcntOflErr = false
                  TimInterruptEnableOnCntOflErr = false
                  TimInterruptEnableOnGprxOflErr = false
                  TimInterruptEnableOnToDetErr = false
                  TimInterruptEnableOnGlitchDetErr = false
              TimChannel_7
                TimChannelGeneral:
                  TimChannelUsage = USED_BY_OTHER_DRIVERS_OR_UNUSED
                  TimChannelEnable = false
                  TimChannelInputSelect = INPUT_OF_CURRENT_TIM_CHANNEL
                  TimChannelPortPinSelect = NONE_SEL0
                  TimChannelValInitSignal = VAL_LOW
                  TimChannelSignalEdgeSelect = FALLING_EDGE
                  TimChannelClockSelect = GTM_CONFIGURABLE_CLOCK_0
                  TimChannelGpr0InputSelect = TIMEBASE_TBU_TS0
                  TimChannelGpr1InputSelect = TIMEBASE_TBU_TS0
                  TimChannelCntsInputSelect = CNT_VALUE
                  TimChannelCntsValue = 0
                  TimChannelTbu0Ts0BitsSelect = BITS_0_TO_23
                  TimChannelModeSelect = PWM_MEASUREMENT_MODE_TPWM
                  TimChannelOneShotMode = false
                  TimChannelAruEnable = false
                  TimChannelExtCaptureModeEnable = false
                  TimChannelExtCaptureSrc = SEL0_NEW_VAL_IRQ
                  TimChannelEcntResetSetting = SEL0_ECNT_IN_WRAP_AROUND_MODE
                  TimChannelEcntOvflwSetting = SEL0_OVRFLOW_SIG_ON_ECNT_BITWIDTH_8
                TimChannelFilterConfig:
                  TimChannelFilterEnable = false
                  TimChFilterCounterFreqSelect = GTM_CONFIGURABLE_CLOCK_0
                  TimChFilterModeForRisingEdge = IMMEDIATE_EDGE_PROPAGATION_MODE
                  TimChFilterModeForFallingEdge = IMMEDIATE_EDGE_PROPAGATION_MODE
                  TimChFilterTimeForRisingEdge = 0
                  TimChFilterTimeForFallingEdge = 0
                TimChannelTimeoutDetection: TimChTimeoutDetectionEnable=SEL0_TIMOUT_DISABLED, TimChTimeoutClockSelect=GTM_CONFIGURABLE_CLOCK_0, TimChTimeoutDuration=0
                TimChannelInterrupt:
                  TimInterruptEnableOnNewVal = false
                  TimInterruptEnableOnEcntOfl = false
                  TimInterruptEnableOnCntOfl = false
                  TimInterruptEnableOnGprxOfl = false
                  TimInterruptEnableOnToDet = false
                  TimInterruptEnableOnGlitchDet = false
                  TimInterruptMode = GTM_INTERRUPT_LEVEL_MODE
                  TimNotification = NULL_PTR
                TimChannelErrorInterrupt:
                  TimInterruptEnableOnNewValErr = false
                  TimInterruptEnableOnEcntOflErr = false
                  TimInterruptEnableOnCntOflErr = false
                  TimInterruptEnableOnGprxOflErr = false
                  TimInterruptEnableOnToDetErr = false
                  TimInterruptEnableOnGlitchDetErr = false
          Tim_1
            8 x TimChannel:
              TimChannel_0
                TimChannelGeneral:
                  TimChannelUsage = USED_BY_OTHER_DRIVERS_OR_UNUSED
                  TimChannelEnable = false
                  TimChannelInputSelect = INPUT_OF_CURRENT_TIM_CHANNEL
                  TimChannelPortPinSelect = NONE_SEL0
                  TimChannelValInitSignal = VAL_LOW
                  TimChannelSignalEdgeSelect = FALLING_EDGE
                  TimChannelClockSelect = GTM_CONFIGURABLE_CLOCK_0
                  TimChannelGpr0InputSelect = TIMEBASE_TBU_TS0
                  TimChannelGpr1InputSelect = TIMEBASE_TBU_TS0
                  TimChannelCntsInputSelect = CNT_VALUE
                  TimChannelCntsValue = 0
                  TimChannelTbu0Ts0BitsSelect = BITS_0_TO_23
                  TimChannelModeSelect = PWM_MEASUREMENT_MODE_TPWM
                  TimChannelOneShotMode = false
                  TimChannelAruEnable = false
                  TimChannelExtCaptureModeEnable = false
                  TimChannelExtCaptureSrc = SEL0_NEW_VAL_IRQ
                  TimChannelEcntResetSetting = SEL0_ECNT_IN_WRAP_AROUND_MODE
                  TimChannelEcntOvflwSetting = SEL0_OVRFLOW_SIG_ON_ECNT_BITWIDTH_8
                TimChannelFilterConfig:
                  TimChannelFilterEnable = false
                  TimChFilterCounterFreqSelect = GTM_CONFIGURABLE_CLOCK_0
                  TimChFilterModeForRisingEdge = IMMEDIATE_EDGE_PROPAGATION_MODE
                  TimChFilterModeForFallingEdge = IMMEDIATE_EDGE_PROPAGATION_MODE
                  TimChFilterTimeForRisingEdge = 0
                  TimChFilterTimeForFallingEdge = 0
                TimChannelTimeoutDetection: TimChTimeoutDetectionEnable=SEL0_TIMOUT_DISABLED, TimChTimeoutClockSelect=GTM_CONFIGURABLE_CLOCK_0, TimChTimeoutDuration=0
                TimChannelInterrupt:
                  TimInterruptEnableOnNewVal = false
                  TimInterruptEnableOnEcntOfl = false
                  TimInterruptEnableOnCntOfl = false
                  TimInterruptEnableOnGprxOfl = false
                  TimInterruptEnableOnToDet = false
                  TimInterruptEnableOnGlitchDet = false
                  TimInterruptMode = GTM_INTERRUPT_LEVEL_MODE
                  TimNotification = NULL_PTR
                TimChannelErrorInterrupt:
                  TimInterruptEnableOnNewValErr = false
                  TimInterruptEnableOnEcntOflErr = false
                  TimInterruptEnableOnCntOflErr = false
                  TimInterruptEnableOnGprxOflErr = false
                  TimInterruptEnableOnToDetErr = false
                  TimInterruptEnableOnGlitchDetErr = false
              TimChannel_1
                TimChannelGeneral:
                  TimChannelUsage = USED_BY_OTHER_DRIVERS_OR_UNUSED
                  TimChannelEnable = false
                  TimChannelInputSelect = INPUT_OF_CURRENT_TIM_CHANNEL
                  TimChannelPortPinSelect = NONE_SEL0
                  TimChannelValInitSignal = VAL_LOW
                  TimChannelSignalEdgeSelect = FALLING_EDGE
                  TimChannelClockSelect = GTM_CONFIGURABLE_CLOCK_0
                  TimChannelGpr0InputSelect = TIMEBASE_TBU_TS0
                  TimChannelGpr1InputSelect = TIMEBASE_TBU_TS0
                  TimChannelCntsInputSelect = CNT_VALUE
                  TimChannelCntsValue = 0
                  TimChannelTbu0Ts0BitsSelect = BITS_0_TO_23
                  TimChannelModeSelect = PWM_MEASUREMENT_MODE_TPWM
                  TimChannelOneShotMode = false
                  TimChannelAruEnable = false
                  TimChannelExtCaptureModeEnable = false
                  TimChannelExtCaptureSrc = SEL0_NEW_VAL_IRQ
                  TimChannelEcntResetSetting = SEL0_ECNT_IN_WRAP_AROUND_MODE
                  TimChannelEcntOvflwSetting = SEL0_OVRFLOW_SIG_ON_ECNT_BITWIDTH_8
                TimChannelFilterConfig:
                  TimChannelFilterEnable = false
                  TimChFilterCounterFreqSelect = GTM_CONFIGURABLE_CLOCK_0
                  TimChFilterModeForRisingEdge = IMMEDIATE_EDGE_PROPAGATION_MODE
                  TimChFilterModeForFallingEdge = IMMEDIATE_EDGE_PROPAGATION_MODE
                  TimChFilterTimeForRisingEdge = 0
                  TimChFilterTimeForFallingEdge = 0
                TimChannelTimeoutDetection: TimChTimeoutDetectionEnable=SEL0_TIMOUT_DISABLED, TimChTimeoutClockSelect=GTM_CONFIGURABLE_CLOCK_0, TimChTimeoutDuration=0
                TimChannelInterrupt:
                  TimInterruptEnableOnNewVal = false
                  TimInterruptEnableOnEcntOfl = false
                  TimInterruptEnableOnCntOfl = false
                  TimInterruptEnableOnGprxOfl = false
                  TimInterruptEnableOnToDet = false
                  TimInterruptEnableOnGlitchDet = false
                  TimInterruptMode = GTM_INTERRUPT_LEVEL_MODE
                  TimNotification = NULL_PTR
                TimChannelErrorInterrupt:
                  TimInterruptEnableOnNewValErr = false
                  TimInterruptEnableOnEcntOflErr = false
                  TimInterruptEnableOnCntOflErr = false
                  TimInterruptEnableOnGprxOflErr = false
                  TimInterruptEnableOnToDetErr = false
                  TimInterruptEnableOnGlitchDetErr = false
              TimChannel_2
                TimChannelGeneral:
                  TimChannelUsage = USED_BY_OTHER_DRIVERS_OR_UNUSED
                  TimChannelEnable = false
                  TimChannelInputSelect = INPUT_OF_CURRENT_TIM_CHANNEL
                  TimChannelPortPinSelect = NONE_SEL0
                  TimChannelValInitSignal = VAL_LOW
                  TimChannelSignalEdgeSelect = FALLING_EDGE
                  TimChannelClockSelect = GTM_CONFIGURABLE_CLOCK_0
                  TimChannelGpr0InputSelect = TIMEBASE_TBU_TS0
                  TimChannelGpr1InputSelect = TIMEBASE_TBU_TS0
                  TimChannelCntsInputSelect = CNT_VALUE
                  TimChannelCntsValue = 0
                  TimChannelTbu0Ts0BitsSelect = BITS_0_TO_23
                  TimChannelModeSelect = PWM_MEASUREMENT_MODE_TPWM
                  TimChannelOneShotMode = false
                  TimChannelAruEnable = false
                  TimChannelExtCaptureModeEnable = false
                  TimChannelExtCaptureSrc = SEL0_NEW_VAL_IRQ
                  TimChannelEcntResetSetting = SEL0_ECNT_IN_WRAP_AROUND_MODE
                  TimChannelEcntOvflwSetting = SEL0_OVRFLOW_SIG_ON_ECNT_BITWIDTH_8
                TimChannelFilterConfig:
                  TimChannelFilterEnable = false
                  TimChFilterCounterFreqSelect = GTM_CONFIGURABLE_CLOCK_0
                  TimChFilterModeForRisingEdge = IMMEDIATE_EDGE_PROPAGATION_MODE
                  TimChFilterModeForFallingEdge = IMMEDIATE_EDGE_PROPAGATION_MODE
                  TimChFilterTimeForRisingEdge = 0
                  TimChFilterTimeForFallingEdge = 0
                TimChannelTimeoutDetection: TimChTimeoutDetectionEnable=SEL0_TIMOUT_DISABLED, TimChTimeoutClockSelect=GTM_CONFIGURABLE_CLOCK_0, TimChTimeoutDuration=0
                TimChannelInterrupt:
                  TimInterruptEnableOnNewVal = false
                  TimInterruptEnableOnEcntOfl = false
                  TimInterruptEnableOnCntOfl = false
                  TimInterruptEnableOnGprxOfl = false
                  TimInterruptEnableOnToDet = false
                  TimInterruptEnableOnGlitchDet = false
                  TimInterruptMode = GTM_INTERRUPT_LEVEL_MODE
                  TimNotification = NULL_PTR
                TimChannelErrorInterrupt:
                  TimInterruptEnableOnNewValErr = false
                  TimInterruptEnableOnEcntOflErr = false
                  TimInterruptEnableOnCntOflErr = false
                  TimInterruptEnableOnGprxOflErr = false
                  TimInterruptEnableOnToDetErr = false
                  TimInterruptEnableOnGlitchDetErr = false
              TimChannel_3
                TimChannelGeneral:
                  TimChannelUsage = USED_BY_OTHER_DRIVERS_OR_UNUSED
                  TimChannelEnable = false
                  TimChannelInputSelect = INPUT_OF_CURRENT_TIM_CHANNEL
                  TimChannelPortPinSelect = NONE_SEL0
                  TimChannelValInitSignal = VAL_LOW
                  TimChannelSignalEdgeSelect = FALLING_EDGE
                  TimChannelClockSelect = GTM_CONFIGURABLE_CLOCK_0
                  TimChannelGpr0InputSelect = TIMEBASE_TBU_TS0
                  TimChannelGpr1InputSelect = TIMEBASE_TBU_TS0
                  TimChannelCntsInputSelect = CNT_VALUE
                  TimChannelCntsValue = 0
                  TimChannelTbu0Ts0BitsSelect = BITS_0_TO_23
                  TimChannelModeSelect = PWM_MEASUREMENT_MODE_TPWM
                  TimChannelOneShotMode = false
                  TimChannelAruEnable = false
                  TimChannelExtCaptureModeEnable = false
                  TimChannelExtCaptureSrc = SEL0_NEW_VAL_IRQ
                  TimChannelEcntResetSetting = SEL0_ECNT_IN_WRAP_AROUND_MODE
                  TimChannelEcntOvflwSetting = SEL0_OVRFLOW_SIG_ON_ECNT_BITWIDTH_8
                TimChannelFilterConfig:
                  TimChannelFilterEnable = false
                  TimChFilterCounterFreqSelect = GTM_CONFIGURABLE_CLOCK_0
                  TimChFilterModeForRisingEdge = IMMEDIATE_EDGE_PROPAGATION_MODE
                  TimChFilterModeForFallingEdge = IMMEDIATE_EDGE_PROPAGATION_MODE
                  TimChFilterTimeForRisingEdge = 0
                  TimChFilterTimeForFallingEdge = 0
                TimChannelTimeoutDetection: TimChTimeoutDetectionEnable=SEL0_TIMOUT_DISABLED, TimChTimeoutClockSelect=GTM_CONFIGURABLE_CLOCK_0, TimChTimeoutDuration=0
                TimChannelInterrupt:
                  TimInterruptEnableOnNewVal = false
                  TimInterruptEnableOnEcntOfl = false
                  TimInterruptEnableOnCntOfl = false
                  TimInterruptEnableOnGprxOfl = false
                  TimInterruptEnableOnToDet = false
                  TimInterruptEnableOnGlitchDet = false
                  TimInterruptMode = GTM_INTERRUPT_LEVEL_MODE
                  TimNotification = NULL_PTR
                TimChannelErrorInterrupt:
                  TimInterruptEnableOnNewValErr = false
                  TimInterruptEnableOnEcntOflErr = false
                  TimInterruptEnableOnCntOflErr = false
                  TimInterruptEnableOnGprxOflErr = false
                  TimInterruptEnableOnToDetErr = false
                  TimInterruptEnableOnGlitchDetErr = false
              TimChannel_4
                TimChannelGeneral:
                  TimChannelUsage = USED_BY_OTHER_DRIVERS_OR_UNUSED
                  TimChannelEnable = false
                  TimChannelInputSelect = INPUT_OF_CURRENT_TIM_CHANNEL
                  TimChannelPortPinSelect = NONE_SEL0
                  TimChannelValInitSignal = VAL_LOW
                  TimChannelSignalEdgeSelect = FALLING_EDGE
                  TimChannelClockSelect = GTM_CONFIGURABLE_CLOCK_0
                  TimChannelGpr0InputSelect = TIMEBASE_TBU_TS0
                  TimChannelGpr1InputSelect = TIMEBASE_TBU_TS0
                  TimChannelCntsInputSelect = CNT_VALUE
                  TimChannelCntsValue = 0
                  TimChannelTbu0Ts0BitsSelect = BITS_0_TO_23
                  TimChannelModeSelect = PWM_MEASUREMENT_MODE_TPWM
                  TimChannelOneShotMode = false
                  TimChannelAruEnable = false
                  TimChannelExtCaptureModeEnable = false
                  TimChannelExtCaptureSrc = SEL0_NEW_VAL_IRQ
                  TimChannelEcntResetSetting = SEL0_ECNT_IN_WRAP_AROUND_MODE
                  TimChannelEcntOvflwSetting = SEL0_OVRFLOW_SIG_ON_ECNT_BITWIDTH_8
                TimChannelFilterConfig:
                  TimChannelFilterEnable = false
                  TimChFilterCounterFreqSelect = GTM_CONFIGURABLE_CLOCK_0
                  TimChFilterModeForRisingEdge = IMMEDIATE_EDGE_PROPAGATION_MODE
                  TimChFilterModeForFallingEdge = IMMEDIATE_EDGE_PROPAGATION_MODE
                  TimChFilterTimeForRisingEdge = 0
                  TimChFilterTimeForFallingEdge = 0
                TimChannelTimeoutDetection: TimChTimeoutDetectionEnable=SEL0_TIMOUT_DISABLED, TimChTimeoutClockSelect=GTM_CONFIGURABLE_CLOCK_0, TimChTimeoutDuration=0
                TimChannelInterrupt:
                  TimInterruptEnableOnNewVal = false
                  TimInterruptEnableOnEcntOfl = false
                  TimInterruptEnableOnCntOfl = false
                  TimInterruptEnableOnGprxOfl = false
                  TimInterruptEnableOnToDet = false
                  TimInterruptEnableOnGlitchDet = false
                  TimInterruptMode = GTM_INTERRUPT_LEVEL_MODE
                  TimNotification = NULL_PTR
                TimChannelErrorInterrupt:
                  TimInterruptEnableOnNewValErr = false
                  TimInterruptEnableOnEcntOflErr = false
                  TimInterruptEnableOnCntOflErr = false
                  TimInterruptEnableOnGprxOflErr = false
                  TimInterruptEnableOnToDetErr = false
                  TimInterruptEnableOnGlitchDetErr = false
              TimChannel_5
                TimChannelGeneral:
                  TimChannelUsage = USED_BY_OTHER_DRIVERS_OR_UNUSED
                  TimChannelEnable = false
                  TimChannelInputSelect = INPUT_OF_CURRENT_TIM_CHANNEL
                  TimChannelPortPinSelect = NONE_SEL0
                  TimChannelValInitSignal = VAL_LOW
                  TimChannelSignalEdgeSelect = FALLING_EDGE
                  TimChannelClockSelect = GTM_CONFIGURABLE_CLOCK_0
                  TimChannelGpr0InputSelect = TIMEBASE_TBU_TS0
                  TimChannelGpr1InputSelect = TIMEBASE_TBU_TS0
                  TimChannelCntsInputSelect = CNT_VALUE
                  TimChannelCntsValue = 0
                  TimChannelTbu0Ts0BitsSelect = BITS_0_TO_23
                  TimChannelModeSelect = PWM_MEASUREMENT_MODE_TPWM
                  TimChannelOneShotMode = false
                  TimChannelAruEnable = false
                  TimChannelExtCaptureModeEnable = false
                  TimChannelExtCaptureSrc = SEL0_NEW_VAL_IRQ
                  TimChannelEcntResetSetting = SEL0_ECNT_IN_WRAP_AROUND_MODE
                  TimChannelEcntOvflwSetting = SEL0_OVRFLOW_SIG_ON_ECNT_BITWIDTH_8
                TimChannelFilterConfig:
                  TimChannelFilterEnable = false
                  TimChFilterCounterFreqSelect = GTM_CONFIGURABLE_CLOCK_0
                  TimChFilterModeForRisingEdge = IMMEDIATE_EDGE_PROPAGATION_MODE
                  TimChFilterModeForFallingEdge = IMMEDIATE_EDGE_PROPAGATION_MODE
                  TimChFilterTimeForRisingEdge = 0
                  TimChFilterTimeForFallingEdge = 0
                TimChannelTimeoutDetection: TimChTimeoutDetectionEnable=SEL0_TIMOUT_DISABLED, TimChTimeoutClockSelect=GTM_CONFIGURABLE_CLOCK_0, TimChTimeoutDuration=0
                TimChannelInterrupt:
                  TimInterruptEnableOnNewVal = false
                  TimInterruptEnableOnEcntOfl = false
                  TimInterruptEnableOnCntOfl = false
                  TimInterruptEnableOnGprxOfl = false
                  TimInterruptEnableOnToDet = false
                  TimInterruptEnableOnGlitchDet = false
                  TimInterruptMode = GTM_INTERRUPT_LEVEL_MODE
                  TimNotification = NULL_PTR
                TimChannelErrorInterrupt:
                  TimInterruptEnableOnNewValErr = false
                  TimInterruptEnableOnEcntOflErr = false
                  TimInterruptEnableOnCntOflErr = false
                  TimInterruptEnableOnGprxOflErr = false
                  TimInterruptEnableOnToDetErr = false
                  TimInterruptEnableOnGlitchDetErr = false
              TimChannel_6
                TimChannelGeneral:
                  TimChannelUsage = USED_BY_OTHER_DRIVERS_OR_UNUSED
                  TimChannelEnable = false
                  TimChannelInputSelect = INPUT_OF_CURRENT_TIM_CHANNEL
                  TimChannelPortPinSelect = NONE_SEL0
                  TimChannelValInitSignal = VAL_LOW
                  TimChannelSignalEdgeSelect = FALLING_EDGE
                  TimChannelClockSelect = GTM_CONFIGURABLE_CLOCK_0
                  TimChannelGpr0InputSelect = TIMEBASE_TBU_TS0
                  TimChannelGpr1InputSelect = TIMEBASE_TBU_TS0
                  TimChannelCntsInputSelect = CNT_VALUE
                  TimChannelCntsValue = 0
                  TimChannelTbu0Ts0BitsSelect = BITS_0_TO_23
                  TimChannelModeSelect = PWM_MEASUREMENT_MODE_TPWM
                  TimChannelOneShotMode = false
                  TimChannelAruEnable = false
                  TimChannelExtCaptureModeEnable = false
                  TimChannelExtCaptureSrc = SEL0_NEW_VAL_IRQ
                  TimChannelEcntResetSetting = SEL0_ECNT_IN_WRAP_AROUND_MODE
                  TimChannelEcntOvflwSetting = SEL0_OVRFLOW_SIG_ON_ECNT_BITWIDTH_8
                TimChannelFilterConfig:
                  TimChannelFilterEnable = false
                  TimChFilterCounterFreqSelect = GTM_CONFIGURABLE_CLOCK_0
                  TimChFilterModeForRisingEdge = IMMEDIATE_EDGE_PROPAGATION_MODE
                  TimChFilterModeForFallingEdge = IMMEDIATE_EDGE_PROPAGATION_MODE
                  TimChFilterTimeForRisingEdge = 0
                  TimChFilterTimeForFallingEdge = 0
                TimChannelTimeoutDetection: TimChTimeoutDetectionEnable=SEL0_TIMOUT_DISABLED, TimChTimeoutClockSelect=GTM_CONFIGURABLE_CLOCK_0, TimChTimeoutDuration=0
                TimChannelInterrupt:
                  TimInterruptEnableOnNewVal = false
                  TimInterruptEnableOnEcntOfl = false
                  TimInterruptEnableOnCntOfl = false
                  TimInterruptEnableOnGprxOfl = false
                  TimInterruptEnableOnToDet = false
                  TimInterruptEnableOnGlitchDet = false
                  TimInterruptMode = GTM_INTERRUPT_LEVEL_MODE
                  TimNotification = NULL_PTR
                TimChannelErrorInterrupt:
                  TimInterruptEnableOnNewValErr = false
                  TimInterruptEnableOnEcntOflErr = false
                  TimInterruptEnableOnCntOflErr = false
                  TimInterruptEnableOnGprxOflErr = false
                  TimInterruptEnableOnToDetErr = false
                  TimInterruptEnableOnGlitchDetErr = false
              TimChannel_7
                TimChannelGeneral:
                  TimChannelUsage = USED_BY_OTHER_DRIVERS_OR_UNUSED
                  TimChannelEnable = false
                  TimChannelInputSelect = INPUT_OF_CURRENT_TIM_CHANNEL
                  TimChannelPortPinSelect = NONE_SEL0
                  TimChannelValInitSignal = VAL_LOW
                  TimChannelSignalEdgeSelect = FALLING_EDGE
                  TimChannelClockSelect = GTM_CONFIGURABLE_CLOCK_0
                  TimChannelGpr0InputSelect = TIMEBASE_TBU_TS0
                  TimChannelGpr1InputSelect = TIMEBASE_TBU_TS0
                  TimChannelCntsInputSelect = CNT_VALUE
                  TimChannelCntsValue = 0
                  TimChannelTbu0Ts0BitsSelect = BITS_0_TO_23
                  TimChannelModeSelect = PWM_MEASUREMENT_MODE_TPWM
                  TimChannelOneShotMode = false
                  TimChannelAruEnable = false
                  TimChannelExtCaptureModeEnable = false
                  TimChannelExtCaptureSrc = SEL0_NEW_VAL_IRQ
                  TimChannelEcntResetSetting = SEL0_ECNT_IN_WRAP_AROUND_MODE
                  TimChannelEcntOvflwSetting = SEL0_OVRFLOW_SIG_ON_ECNT_BITWIDTH_8
                TimChannelFilterConfig:
                  TimChannelFilterEnable = false
                  TimChFilterCounterFreqSelect = GTM_CONFIGURABLE_CLOCK_0
                  TimChFilterModeForRisingEdge = IMMEDIATE_EDGE_PROPAGATION_MODE
                  TimChFilterModeForFallingEdge = IMMEDIATE_EDGE_PROPAGATION_MODE
                  TimChFilterTimeForRisingEdge = 0
                  TimChFilterTimeForFallingEdge = 0
                TimChannelTimeoutDetection: TimChTimeoutDetectionEnable=SEL0_TIMOUT_DISABLED, TimChTimeoutClockSelect=GTM_CONFIGURABLE_CLOCK_0, TimChTimeoutDuration=0
                TimChannelInterrupt:
                  TimInterruptEnableOnNewVal = false
                  TimInterruptEnableOnEcntOfl = false
                  TimInterruptEnableOnCntOfl = false
                  TimInterruptEnableOnGprxOfl = false
                  TimInterruptEnableOnToDet = false
                  TimInterruptEnableOnGlitchDet = false
                  TimInterruptMode = GTM_INTERRUPT_LEVEL_MODE
                  TimNotification = NULL_PTR
                TimChannelErrorInterrupt:
                  TimInterruptEnableOnNewValErr = false
                  TimInterruptEnableOnEcntOflErr = false
                  TimInterruptEnableOnCntOflErr = false
                  TimInterruptEnableOnGprxOflErr = false
                  TimInterruptEnableOnToDetErr = false
                  TimInterruptEnableOnGlitchDetErr = false
          Tim_2
            8 x TimChannel:
              TimChannel_0
                TimChannelGeneral:
                  TimChannelUsage = USED_BY_OTHER_DRIVERS_OR_UNUSED
                  TimChannelEnable = false
                  TimChannelInputSelect = INPUT_OF_CURRENT_TIM_CHANNEL
                  TimChannelPortPinSelect = NONE_SEL0
                  TimChannelValInitSignal = VAL_LOW
                  TimChannelSignalEdgeSelect = FALLING_EDGE
                  TimChannelClockSelect = GTM_CONFIGURABLE_CLOCK_0
                  TimChannelGpr0InputSelect = TIMEBASE_TBU_TS0
                  TimChannelGpr1InputSelect = TIMEBASE_TBU_TS0
                  TimChannelCntsInputSelect = CNT_VALUE
                  TimChannelCntsValue = 0
                  TimChannelTbu0Ts0BitsSelect = BITS_0_TO_23
                  TimChannelModeSelect = PWM_MEASUREMENT_MODE_TPWM
                  TimChannelOneShotMode = false
                  TimChannelAruEnable = false
                  TimChannelExtCaptureModeEnable = false
                  TimChannelExtCaptureSrc = SEL0_NEW_VAL_IRQ
                  TimChannelEcntResetSetting = SEL0_ECNT_IN_WRAP_AROUND_MODE
                  TimChannelEcntOvflwSetting = SEL0_OVRFLOW_SIG_ON_ECNT_BITWIDTH_8
                TimChannelFilterConfig:
                  TimChannelFilterEnable = false
                  TimChFilterCounterFreqSelect = GTM_CONFIGURABLE_CLOCK_0
                  TimChFilterModeForRisingEdge = IMMEDIATE_EDGE_PROPAGATION_MODE
                  TimChFilterModeForFallingEdge = IMMEDIATE_EDGE_PROPAGATION_MODE
                  TimChFilterTimeForRisingEdge = 0
                  TimChFilterTimeForFallingEdge = 0
                TimChannelTimeoutDetection: TimChTimeoutDetectionEnable=SEL0_TIMOUT_DISABLED, TimChTimeoutClockSelect=GTM_CONFIGURABLE_CLOCK_0, TimChTimeoutDuration=0
                TimChannelInterrupt:
                  TimInterruptEnableOnNewVal = false
                  TimInterruptEnableOnEcntOfl = false
                  TimInterruptEnableOnCntOfl = false
                  TimInterruptEnableOnGprxOfl = false
                  TimInterruptEnableOnToDet = false
                  TimInterruptEnableOnGlitchDet = false
                  TimInterruptMode = GTM_INTERRUPT_LEVEL_MODE
                  TimNotification = NULL_PTR
                TimChannelErrorInterrupt:
                  TimInterruptEnableOnNewValErr = false
                  TimInterruptEnableOnEcntOflErr = false
                  TimInterruptEnableOnCntOflErr = false
                  TimInterruptEnableOnGprxOflErr = false
                  TimInterruptEnableOnToDetErr = false
                  TimInterruptEnableOnGlitchDetErr = false
              TimChannel_1
                TimChannelGeneral:
                  TimChannelUsage = USED_BY_OTHER_DRIVERS_OR_UNUSED
                  TimChannelEnable = false
                  TimChannelInputSelect = INPUT_OF_CURRENT_TIM_CHANNEL
                  TimChannelPortPinSelect = NONE_SEL0
                  TimChannelValInitSignal = VAL_LOW
                  TimChannelSignalEdgeSelect = FALLING_EDGE
                  TimChannelClockSelect = GTM_CONFIGURABLE_CLOCK_0
                  TimChannelGpr0InputSelect = TIMEBASE_TBU_TS0
                  TimChannelGpr1InputSelect = TIMEBASE_TBU_TS0
                  TimChannelCntsInputSelect = CNT_VALUE
                  TimChannelCntsValue = 0
                  TimChannelTbu0Ts0BitsSelect = BITS_0_TO_23
                  TimChannelModeSelect = PWM_MEASUREMENT_MODE_TPWM
                  TimChannelOneShotMode = false
                  TimChannelAruEnable = false
                  TimChannelExtCaptureModeEnable = false
                  TimChannelExtCaptureSrc = SEL0_NEW_VAL_IRQ
                  TimChannelEcntResetSetting = SEL0_ECNT_IN_WRAP_AROUND_MODE
                  TimChannelEcntOvflwSetting = SEL0_OVRFLOW_SIG_ON_ECNT_BITWIDTH_8
                TimChannelFilterConfig:
                  TimChannelFilterEnable = false
                  TimChFilterCounterFreqSelect = GTM_CONFIGURABLE_CLOCK_0
                  TimChFilterModeForRisingEdge = IMMEDIATE_EDGE_PROPAGATION_MODE
                  TimChFilterModeForFallingEdge = IMMEDIATE_EDGE_PROPAGATION_MODE
                  TimChFilterTimeForRisingEdge = 0
                  TimChFilterTimeForFallingEdge = 0
                TimChannelTimeoutDetection: TimChTimeoutDetectionEnable=SEL0_TIMOUT_DISABLED, TimChTimeoutClockSelect=GTM_CONFIGURABLE_CLOCK_0, TimChTimeoutDuration=0
                TimChannelInterrupt:
                  TimInterruptEnableOnNewVal = false
                  TimInterruptEnableOnEcntOfl = false
                  TimInterruptEnableOnCntOfl = false
                  TimInterruptEnableOnGprxOfl = false
                  TimInterruptEnableOnToDet = false
                  TimInterruptEnableOnGlitchDet = false
                  TimInterruptMode = GTM_INTERRUPT_LEVEL_MODE
                  TimNotification = NULL_PTR
                TimChannelErrorInterrupt:
                  TimInterruptEnableOnNewValErr = false
                  TimInterruptEnableOnEcntOflErr = false
                  TimInterruptEnableOnCntOflErr = false
                  TimInterruptEnableOnGprxOflErr = false
                  TimInterruptEnableOnToDetErr = false
                  TimInterruptEnableOnGlitchDetErr = false
              TimChannel_2
                TimChannelGeneral:
                  TimChannelUsage = USED_BY_OTHER_DRIVERS_OR_UNUSED
                  TimChannelEnable = false
                  TimChannelInputSelect = INPUT_OF_CURRENT_TIM_CHANNEL
                  TimChannelPortPinSelect = NONE_SEL0
                  TimChannelValInitSignal = VAL_LOW
                  TimChannelSignalEdgeSelect = FALLING_EDGE
                  TimChannelClockSelect = GTM_CONFIGURABLE_CLOCK_0
                  TimChannelGpr0InputSelect = TIMEBASE_TBU_TS0
                  TimChannelGpr1InputSelect = TIMEBASE_TBU_TS0
                  TimChannelCntsInputSelect = CNT_VALUE
                  TimChannelCntsValue = 0
                  TimChannelTbu0Ts0BitsSelect = BITS_0_TO_23
                  TimChannelModeSelect = PWM_MEASUREMENT_MODE_TPWM
                  TimChannelOneShotMode = false
                  TimChannelAruEnable = false
                  TimChannelExtCaptureModeEnable = false
                  TimChannelExtCaptureSrc = SEL0_NEW_VAL_IRQ
                  TimChannelEcntResetSetting = SEL0_ECNT_IN_WRAP_AROUND_MODE
                  TimChannelEcntOvflwSetting = SEL0_OVRFLOW_SIG_ON_ECNT_BITWIDTH_8
                TimChannelFilterConfig:
                  TimChannelFilterEnable = false
                  TimChFilterCounterFreqSelect = GTM_CONFIGURABLE_CLOCK_0
                  TimChFilterModeForRisingEdge = IMMEDIATE_EDGE_PROPAGATION_MODE
                  TimChFilterModeForFallingEdge = IMMEDIATE_EDGE_PROPAGATION_MODE
                  TimChFilterTimeForRisingEdge = 0
                  TimChFilterTimeForFallingEdge = 0
                TimChannelTimeoutDetection: TimChTimeoutDetectionEnable=SEL0_TIMOUT_DISABLED, TimChTimeoutClockSelect=GTM_CONFIGURABLE_CLOCK_0, TimChTimeoutDuration=0
                TimChannelInterrupt:
                  TimInterruptEnableOnNewVal = false
                  TimInterruptEnableOnEcntOfl = false
                  TimInterruptEnableOnCntOfl = false
                  TimInterruptEnableOnGprxOfl = false
                  TimInterruptEnableOnToDet = false
                  TimInterruptEnableOnGlitchDet = false
                  TimInterruptMode = GTM_INTERRUPT_LEVEL_MODE
                  TimNotification = NULL_PTR
                TimChannelErrorInterrupt:
                  TimInterruptEnableOnNewValErr = false
                  TimInterruptEnableOnEcntOflErr = false
                  TimInterruptEnableOnCntOflErr = false
                  TimInterruptEnableOnGprxOflErr = false
                  TimInterruptEnableOnToDetErr = false
                  TimInterruptEnableOnGlitchDetErr = false
              TimChannel_3
                TimChannelGeneral:
                  TimChannelUsage = USED_BY_OTHER_DRIVERS_OR_UNUSED
                  TimChannelEnable = false
                  TimChannelInputSelect = INPUT_OF_CURRENT_TIM_CHANNEL
                  TimChannelPortPinSelect = NONE_SEL0
                  TimChannelValInitSignal = VAL_LOW
                  TimChannelSignalEdgeSelect = FALLING_EDGE
                  TimChannelClockSelect = GTM_CONFIGURABLE_CLOCK_0
                  TimChannelGpr0InputSelect = TIMEBASE_TBU_TS0
                  TimChannelGpr1InputSelect = TIMEBASE_TBU_TS0
                  TimChannelCntsInputSelect = CNT_VALUE
                  TimChannelCntsValue = 0
                  TimChannelTbu0Ts0BitsSelect = BITS_0_TO_23
                  TimChannelModeSelect = PWM_MEASUREMENT_MODE_TPWM
                  TimChannelOneShotMode = false
                  TimChannelAruEnable = false
                  TimChannelExtCaptureModeEnable = false
                  TimChannelExtCaptureSrc = SEL0_NEW_VAL_IRQ
                  TimChannelEcntResetSetting = SEL0_ECNT_IN_WRAP_AROUND_MODE
                  TimChannelEcntOvflwSetting = SEL0_OVRFLOW_SIG_ON_ECNT_BITWIDTH_8
                TimChannelFilterConfig:
                  TimChannelFilterEnable = false
                  TimChFilterCounterFreqSelect = GTM_CONFIGURABLE_CLOCK_0
                  TimChFilterModeForRisingEdge = IMMEDIATE_EDGE_PROPAGATION_MODE
                  TimChFilterModeForFallingEdge = IMMEDIATE_EDGE_PROPAGATION_MODE
                  TimChFilterTimeForRisingEdge = 0
                  TimChFilterTimeForFallingEdge = 0
                TimChannelTimeoutDetection: TimChTimeoutDetectionEnable=SEL0_TIMOUT_DISABLED, TimChTimeoutClockSelect=GTM_CONFIGURABLE_CLOCK_0, TimChTimeoutDuration=0
                TimChannelInterrupt:
                  TimInterruptEnableOnNewVal = false
                  TimInterruptEnableOnEcntOfl = false
                  TimInterruptEnableOnCntOfl = false
                  TimInterruptEnableOnGprxOfl = false
                  TimInterruptEnableOnToDet = false
                  TimInterruptEnableOnGlitchDet = false
                  TimInterruptMode = GTM_INTERRUPT_LEVEL_MODE
                  TimNotification = NULL_PTR
                TimChannelErrorInterrupt:
                  TimInterruptEnableOnNewValErr = false
                  TimInterruptEnableOnEcntOflErr = false
                  TimInterruptEnableOnCntOflErr = false
                  TimInterruptEnableOnGprxOflErr = false
                  TimInterruptEnableOnToDetErr = false
                  TimInterruptEnableOnGlitchDetErr = false
              TimChannel_4
                TimChannelGeneral:
                  TimChannelUsage = USED_BY_OTHER_DRIVERS_OR_UNUSED
                  TimChannelEnable = false
                  TimChannelInputSelect = INPUT_OF_CURRENT_TIM_CHANNEL
                  TimChannelPortPinSelect = NONE_SEL0
                  TimChannelValInitSignal = VAL_LOW
                  TimChannelSignalEdgeSelect = FALLING_EDGE
                  TimChannelClockSelect = GTM_CONFIGURABLE_CLOCK_0
                  TimChannelGpr0InputSelect = TIMEBASE_TBU_TS0
                  TimChannelGpr1InputSelect = TIMEBASE_TBU_TS0
                  TimChannelCntsInputSelect = CNT_VALUE
                  TimChannelCntsValue = 0
                  TimChannelTbu0Ts0BitsSelect = BITS_0_TO_23
                  TimChannelModeSelect = PWM_MEASUREMENT_MODE_TPWM
                  TimChannelOneShotMode = false
                  TimChannelAruEnable = false
                  TimChannelExtCaptureModeEnable = false
                  TimChannelExtCaptureSrc = SEL0_NEW_VAL_IRQ
                  TimChannelEcntResetSetting = SEL0_ECNT_IN_WRAP_AROUND_MODE
                  TimChannelEcntOvflwSetting = SEL0_OVRFLOW_SIG_ON_ECNT_BITWIDTH_8
                TimChannelFilterConfig:
                  TimChannelFilterEnable = false
                  TimChFilterCounterFreqSelect = GTM_CONFIGURABLE_CLOCK_0
                  TimChFilterModeForRisingEdge = IMMEDIATE_EDGE_PROPAGATION_MODE
                  TimChFilterModeForFallingEdge = IMMEDIATE_EDGE_PROPAGATION_MODE
                  TimChFilterTimeForRisingEdge = 0
                  TimChFilterTimeForFallingEdge = 0
                TimChannelTimeoutDetection: TimChTimeoutDetectionEnable=SEL0_TIMOUT_DISABLED, TimChTimeoutClockSelect=GTM_CONFIGURABLE_CLOCK_0, TimChTimeoutDuration=0
                TimChannelInterrupt:
                  TimInterruptEnableOnNewVal = false
                  TimInterruptEnableOnEcntOfl = false
                  TimInterruptEnableOnCntOfl = false
                  TimInterruptEnableOnGprxOfl = false
                  TimInterruptEnableOnToDet = false
                  TimInterruptEnableOnGlitchDet = false
                  TimInterruptMode = GTM_INTERRUPT_LEVEL_MODE
                  TimNotification = NULL_PTR
                TimChannelErrorInterrupt:
                  TimInterruptEnableOnNewValErr = false
                  TimInterruptEnableOnEcntOflErr = false
                  TimInterruptEnableOnCntOflErr = false
                  TimInterruptEnableOnGprxOflErr = false
                  TimInterruptEnableOnToDetErr = false
                  TimInterruptEnableOnGlitchDetErr = false
              TimChannel_5
                TimChannelGeneral:
                  TimChannelUsage = USED_BY_OTHER_DRIVERS_OR_UNUSED
                  TimChannelEnable = false
                  TimChannelInputSelect = INPUT_OF_CURRENT_TIM_CHANNEL
                  TimChannelPortPinSelect = NONE_SEL0
                  TimChannelValInitSignal = VAL_LOW
                  TimChannelSignalEdgeSelect = FALLING_EDGE
                  TimChannelClockSelect = GTM_CONFIGURABLE_CLOCK_0
                  TimChannelGpr0InputSelect = TIMEBASE_TBU_TS0
                  TimChannelGpr1InputSelect = TIMEBASE_TBU_TS0
                  TimChannelCntsInputSelect = CNT_VALUE
                  TimChannelCntsValue = 0
                  TimChannelTbu0Ts0BitsSelect = BITS_0_TO_23
                  TimChannelModeSelect = PWM_MEASUREMENT_MODE_TPWM
                  TimChannelOneShotMode = false
                  TimChannelAruEnable = false
                  TimChannelExtCaptureModeEnable = false
                  TimChannelExtCaptureSrc = SEL0_NEW_VAL_IRQ
                  TimChannelEcntResetSetting = SEL0_ECNT_IN_WRAP_AROUND_MODE
                  TimChannelEcntOvflwSetting = SEL0_OVRFLOW_SIG_ON_ECNT_BITWIDTH_8
                TimChannelFilterConfig:
                  TimChannelFilterEnable = false
                  TimChFilterCounterFreqSelect = GTM_CONFIGURABLE_CLOCK_0
                  TimChFilterModeForRisingEdge = IMMEDIATE_EDGE_PROPAGATION_MODE
                  TimChFilterModeForFallingEdge = IMMEDIATE_EDGE_PROPAGATION_MODE
                  TimChFilterTimeForRisingEdge = 0
                  TimChFilterTimeForFallingEdge = 0
                TimChannelTimeoutDetection: TimChTimeoutDetectionEnable=SEL0_TIMOUT_DISABLED, TimChTimeoutClockSelect=GTM_CONFIGURABLE_CLOCK_0, TimChTimeoutDuration=0
                TimChannelInterrupt:
                  TimInterruptEnableOnNewVal = false
                  TimInterruptEnableOnEcntOfl = false
                  TimInterruptEnableOnCntOfl = false
                  TimInterruptEnableOnGprxOfl = false
                  TimInterruptEnableOnToDet = false
                  TimInterruptEnableOnGlitchDet = false
                  TimInterruptMode = GTM_INTERRUPT_LEVEL_MODE
                  TimNotification = NULL_PTR
                TimChannelErrorInterrupt:
                  TimInterruptEnableOnNewValErr = false
                  TimInterruptEnableOnEcntOflErr = false
                  TimInterruptEnableOnCntOflErr = false
                  TimInterruptEnableOnGprxOflErr = false
                  TimInterruptEnableOnToDetErr = false
                  TimInterruptEnableOnGlitchDetErr = false
              TimChannel_6
                TimChannelGeneral:
                  TimChannelUsage = USED_BY_OTHER_DRIVERS_OR_UNUSED
                  TimChannelEnable = false
                  TimChannelInputSelect = INPUT_OF_CURRENT_TIM_CHANNEL
                  TimChannelPortPinSelect = NONE_SEL0
                  TimChannelValInitSignal = VAL_LOW
                  TimChannelSignalEdgeSelect = FALLING_EDGE
                  TimChannelClockSelect = GTM_CONFIGURABLE_CLOCK_0
                  TimChannelGpr0InputSelect = TIMEBASE_TBU_TS0
                  TimChannelGpr1InputSelect = TIMEBASE_TBU_TS0
                  TimChannelCntsInputSelect = CNT_VALUE
                  TimChannelCntsValue = 0
                  TimChannelTbu0Ts0BitsSelect = BITS_0_TO_23
                  TimChannelModeSelect = PWM_MEASUREMENT_MODE_TPWM
                  TimChannelOneShotMode = false
                  TimChannelAruEnable = false
                  TimChannelExtCaptureModeEnable = false
                  TimChannelExtCaptureSrc = SEL0_NEW_VAL_IRQ
                  TimChannelEcntResetSetting = SEL0_ECNT_IN_WRAP_AROUND_MODE
                  TimChannelEcntOvflwSetting = SEL0_OVRFLOW_SIG_ON_ECNT_BITWIDTH_8
                TimChannelFilterConfig:
                  TimChannelFilterEnable = false
                  TimChFilterCounterFreqSelect = GTM_CONFIGURABLE_CLOCK_0
                  TimChFilterModeForRisingEdge = IMMEDIATE_EDGE_PROPAGATION_MODE
                  TimChFilterModeForFallingEdge = IMMEDIATE_EDGE_PROPAGATION_MODE
                  TimChFilterTimeForRisingEdge = 0
                  TimChFilterTimeForFallingEdge = 0
                TimChannelTimeoutDetection: TimChTimeoutDetectionEnable=SEL0_TIMOUT_DISABLED, TimChTimeoutClockSelect=GTM_CONFIGURABLE_CLOCK_0, TimChTimeoutDuration=0
                TimChannelInterrupt:
                  TimInterruptEnableOnNewVal = false
                  TimInterruptEnableOnEcntOfl = false
                  TimInterruptEnableOnCntOfl = false
                  TimInterruptEnableOnGprxOfl = false
                  TimInterruptEnableOnToDet = false
                  TimInterruptEnableOnGlitchDet = false
                  TimInterruptMode = GTM_INTERRUPT_LEVEL_MODE
                  TimNotification = NULL_PTR
                TimChannelErrorInterrupt:
                  TimInterruptEnableOnNewValErr = false
                  TimInterruptEnableOnEcntOflErr = false
                  TimInterruptEnableOnCntOflErr = false
                  TimInterruptEnableOnGprxOflErr = false
                  TimInterruptEnableOnToDetErr = false
                  TimInterruptEnableOnGlitchDetErr = false
              TimChannel_7
                TimChannelGeneral:
                  TimChannelUsage = USED_BY_OTHER_DRIVERS_OR_UNUSED
                  TimChannelEnable = false
                  TimChannelInputSelect = INPUT_OF_CURRENT_TIM_CHANNEL
                  TimChannelPortPinSelect = NONE_SEL0
                  TimChannelValInitSignal = VAL_LOW
                  TimChannelSignalEdgeSelect = FALLING_EDGE
                  TimChannelClockSelect = GTM_CONFIGURABLE_CLOCK_0
                  TimChannelGpr0InputSelect = TIMEBASE_TBU_TS0
                  TimChannelGpr1InputSelect = TIMEBASE_TBU_TS0
                  TimChannelCntsInputSelect = CNT_VALUE
                  TimChannelCntsValue = 0
                  TimChannelTbu0Ts0BitsSelect = BITS_0_TO_23
                  TimChannelModeSelect = PWM_MEASUREMENT_MODE_TPWM
                  TimChannelOneShotMode = false
                  TimChannelAruEnable = false
                  TimChannelExtCaptureModeEnable = false
                  TimChannelExtCaptureSrc = SEL0_NEW_VAL_IRQ
                  TimChannelEcntResetSetting = SEL0_ECNT_IN_WRAP_AROUND_MODE
                  TimChannelEcntOvflwSetting = SEL0_OVRFLOW_SIG_ON_ECNT_BITWIDTH_8
                TimChannelFilterConfig:
                  TimChannelFilterEnable = false
                  TimChFilterCounterFreqSelect = GTM_CONFIGURABLE_CLOCK_0
                  TimChFilterModeForRisingEdge = IMMEDIATE_EDGE_PROPAGATION_MODE
                  TimChFilterModeForFallingEdge = IMMEDIATE_EDGE_PROPAGATION_MODE
                  TimChFilterTimeForRisingEdge = 0
                  TimChFilterTimeForFallingEdge = 0
                TimChannelTimeoutDetection: TimChTimeoutDetectionEnable=SEL0_TIMOUT_DISABLED, TimChTimeoutClockSelect=GTM_CONFIGURABLE_CLOCK_0, TimChTimeoutDuration=0
                TimChannelInterrupt:
                  TimInterruptEnableOnNewVal = false
                  TimInterruptEnableOnEcntOfl = false
                  TimInterruptEnableOnCntOfl = false
                  TimInterruptEnableOnGprxOfl = false
                  TimInterruptEnableOnToDet = false
                  TimInterruptEnableOnGlitchDet = false
                  TimInterruptMode = GTM_INTERRUPT_LEVEL_MODE
                  TimNotification = NULL_PTR
                TimChannelErrorInterrupt:
                  TimInterruptEnableOnNewValErr = false
                  TimInterruptEnableOnEcntOflErr = false
                  TimInterruptEnableOnCntOflErr = false
                  TimInterruptEnableOnGprxOflErr = false
                  TimInterruptEnableOnToDetErr = false
                  TimInterruptEnableOnGlitchDetErr = false
          Tim_3
            8 x TimChannel:
              TimChannel_0
                TimChannelGeneral:
                  TimChannelUsage = USED_BY_OTHER_DRIVERS_OR_UNUSED
                  TimChannelEnable = false
                  TimChannelInputSelect = INPUT_OF_CURRENT_TIM_CHANNEL
                  TimChannelPortPinSelect = NONE_SEL0
                  TimChannelValInitSignal = VAL_LOW
                  TimChannelSignalEdgeSelect = FALLING_EDGE
                  TimChannelClockSelect = GTM_CONFIGURABLE_CLOCK_0
                  TimChannelGpr0InputSelect = TIMEBASE_TBU_TS0
                  TimChannelGpr1InputSelect = TIMEBASE_TBU_TS0
                  TimChannelCntsInputSelect = CNT_VALUE
                  TimChannelCntsValue = 0
                  TimChannelTbu0Ts0BitsSelect = BITS_0_TO_23
                  TimChannelModeSelect = PWM_MEASUREMENT_MODE_TPWM
                  TimChannelOneShotMode = false
                  TimChannelAruEnable = false
                  TimChannelExtCaptureModeEnable = false
                  TimChannelExtCaptureSrc = SEL0_NEW_VAL_IRQ
                  TimChannelEcntResetSetting = SEL0_ECNT_IN_WRAP_AROUND_MODE
                  TimChannelEcntOvflwSetting = SEL0_OVRFLOW_SIG_ON_ECNT_BITWIDTH_8
                TimChannelFilterConfig:
                  TimChannelFilterEnable = false
                  TimChFilterCounterFreqSelect = GTM_CONFIGURABLE_CLOCK_0
                  TimChFilterModeForRisingEdge = IMMEDIATE_EDGE_PROPAGATION_MODE
                  TimChFilterModeForFallingEdge = IMMEDIATE_EDGE_PROPAGATION_MODE
                  TimChFilterTimeForRisingEdge = 0
                  TimChFilterTimeForFallingEdge = 0
                TimChannelTimeoutDetection: TimChTimeoutDetectionEnable=SEL0_TIMOUT_DISABLED, TimChTimeoutClockSelect=GTM_CONFIGURABLE_CLOCK_0, TimChTimeoutDuration=0
                TimChannelInterrupt:
                  TimInterruptEnableOnNewVal = false
                  TimInterruptEnableOnEcntOfl = false
                  TimInterruptEnableOnCntOfl = false
                  TimInterruptEnableOnGprxOfl = false
                  TimInterruptEnableOnToDet = false
                  TimInterruptEnableOnGlitchDet = false
                  TimInterruptMode = GTM_INTERRUPT_LEVEL_MODE
                  TimNotification = NULL_PTR
                TimChannelErrorInterrupt:
                  TimInterruptEnableOnNewValErr = false
                  TimInterruptEnableOnEcntOflErr = false
                  TimInterruptEnableOnCntOflErr = false
                  TimInterruptEnableOnGprxOflErr = false
                  TimInterruptEnableOnToDetErr = false
                  TimInterruptEnableOnGlitchDetErr = false
              TimChannel_1
                TimChannelGeneral:
                  TimChannelUsage = USED_BY_OTHER_DRIVERS_OR_UNUSED
                  TimChannelEnable = false
                  TimChannelInputSelect = INPUT_OF_CURRENT_TIM_CHANNEL
                  TimChannelPortPinSelect = NONE_SEL0
                  TimChannelValInitSignal = VAL_LOW
                  TimChannelSignalEdgeSelect = FALLING_EDGE
                  TimChannelClockSelect = GTM_CONFIGURABLE_CLOCK_0
                  TimChannelGpr0InputSelect = TIMEBASE_TBU_TS0
                  TimChannelGpr1InputSelect = TIMEBASE_TBU_TS0
                  TimChannelCntsInputSelect = CNT_VALUE
                  TimChannelCntsValue = 0
                  TimChannelTbu0Ts0BitsSelect = BITS_0_TO_23
                  TimChannelModeSelect = PWM_MEASUREMENT_MODE_TPWM
                  TimChannelOneShotMode = false
                  TimChannelAruEnable = false
                  TimChannelExtCaptureModeEnable = false
                  TimChannelExtCaptureSrc = SEL0_NEW_VAL_IRQ
                  TimChannelEcntResetSetting = SEL0_ECNT_IN_WRAP_AROUND_MODE
                  TimChannelEcntOvflwSetting = SEL0_OVRFLOW_SIG_ON_ECNT_BITWIDTH_8
                TimChannelFilterConfig:
                  TimChannelFilterEnable = false
                  TimChFilterCounterFreqSelect = GTM_CONFIGURABLE_CLOCK_0
                  TimChFilterModeForRisingEdge = IMMEDIATE_EDGE_PROPAGATION_MODE
                  TimChFilterModeForFallingEdge = IMMEDIATE_EDGE_PROPAGATION_MODE
                  TimChFilterTimeForRisingEdge = 0
                  TimChFilterTimeForFallingEdge = 0
                TimChannelTimeoutDetection: TimChTimeoutDetectionEnable=SEL0_TIMOUT_DISABLED, TimChTimeoutClockSelect=GTM_CONFIGURABLE_CLOCK_0, TimChTimeoutDuration=0
                TimChannelInterrupt:
                  TimInterruptEnableOnNewVal = false
                  TimInterruptEnableOnEcntOfl = false
                  TimInterruptEnableOnCntOfl = false
                  TimInterruptEnableOnGprxOfl = false
                  TimInterruptEnableOnToDet = false
                  TimInterruptEnableOnGlitchDet = false
                  TimInterruptMode = GTM_INTERRUPT_LEVEL_MODE
                  TimNotification = NULL_PTR
                TimChannelErrorInterrupt:
                  TimInterruptEnableOnNewValErr = false
                  TimInterruptEnableOnEcntOflErr = false
                  TimInterruptEnableOnCntOflErr = false
                  TimInterruptEnableOnGprxOflErr = false
                  TimInterruptEnableOnToDetErr = false
                  TimInterruptEnableOnGlitchDetErr = false
              TimChannel_2
                TimChannelGeneral:
                  TimChannelUsage = USED_BY_OTHER_DRIVERS_OR_UNUSED
                  TimChannelEnable = false
                  TimChannelInputSelect = INPUT_OF_CURRENT_TIM_CHANNEL
                  TimChannelPortPinSelect = NONE_SEL0
                  TimChannelValInitSignal = VAL_LOW
                  TimChannelSignalEdgeSelect = FALLING_EDGE
                  TimChannelClockSelect = GTM_CONFIGURABLE_CLOCK_0
                  TimChannelGpr0InputSelect = TIMEBASE_TBU_TS0
                  TimChannelGpr1InputSelect = TIMEBASE_TBU_TS0
                  TimChannelCntsInputSelect = CNT_VALUE
                  TimChannelCntsValue = 0
                  TimChannelTbu0Ts0BitsSelect = BITS_0_TO_23
                  TimChannelModeSelect = PWM_MEASUREMENT_MODE_TPWM
                  TimChannelOneShotMode = false
                  TimChannelAruEnable = false
                  TimChannelExtCaptureModeEnable = false
                  TimChannelExtCaptureSrc = SEL0_NEW_VAL_IRQ
                  TimChannelEcntResetSetting = SEL0_ECNT_IN_WRAP_AROUND_MODE
                  TimChannelEcntOvflwSetting = SEL0_OVRFLOW_SIG_ON_ECNT_BITWIDTH_8
                TimChannelFilterConfig:
                  TimChannelFilterEnable = false
                  TimChFilterCounterFreqSelect = GTM_CONFIGURABLE_CLOCK_0
                  TimChFilterModeForRisingEdge = IMMEDIATE_EDGE_PROPAGATION_MODE
                  TimChFilterModeForFallingEdge = IMMEDIATE_EDGE_PROPAGATION_MODE
                  TimChFilterTimeForRisingEdge = 0
                  TimChFilterTimeForFallingEdge = 0
                TimChannelTimeoutDetection: TimChTimeoutDetectionEnable=SEL0_TIMOUT_DISABLED, TimChTimeoutClockSelect=GTM_CONFIGURABLE_CLOCK_0, TimChTimeoutDuration=0
                TimChannelInterrupt:
                  TimInterruptEnableOnNewVal = false
                  TimInterruptEnableOnEcntOfl = false
                  TimInterruptEnableOnCntOfl = false
                  TimInterruptEnableOnGprxOfl = false
                  TimInterruptEnableOnToDet = false
                  TimInterruptEnableOnGlitchDet = false
                  TimInterruptMode = GTM_INTERRUPT_LEVEL_MODE
                  TimNotification = NULL_PTR
                TimChannelErrorInterrupt:
                  TimInterruptEnableOnNewValErr = false
                  TimInterruptEnableOnEcntOflErr = false
                  TimInterruptEnableOnCntOflErr = false
                  TimInterruptEnableOnGprxOflErr = false
                  TimInterruptEnableOnToDetErr = false
                  TimInterruptEnableOnGlitchDetErr = false
              TimChannel_3
                TimChannelGeneral:
                  TimChannelUsage = USED_BY_OTHER_DRIVERS_OR_UNUSED
                  TimChannelEnable = false
                  TimChannelInputSelect = INPUT_OF_CURRENT_TIM_CHANNEL
                  TimChannelPortPinSelect = NONE_SEL0
                  TimChannelValInitSignal = VAL_LOW
                  TimChannelSignalEdgeSelect = FALLING_EDGE
                  TimChannelClockSelect = GTM_CONFIGURABLE_CLOCK_0
                  TimChannelGpr0InputSelect = TIMEBASE_TBU_TS0
                  TimChannelGpr1InputSelect = TIMEBASE_TBU_TS0
                  TimChannelCntsInputSelect = CNT_VALUE
                  TimChannelCntsValue = 0
                  TimChannelTbu0Ts0BitsSelect = BITS_0_TO_23
                  TimChannelModeSelect = PWM_MEASUREMENT_MODE_TPWM
                  TimChannelOneShotMode = false
                  TimChannelAruEnable = false
                  TimChannelExtCaptureModeEnable = false
                  TimChannelExtCaptureSrc = SEL0_NEW_VAL_IRQ
                  TimChannelEcntResetSetting = SEL0_ECNT_IN_WRAP_AROUND_MODE
                  TimChannelEcntOvflwSetting = SEL0_OVRFLOW_SIG_ON_ECNT_BITWIDTH_8
                TimChannelFilterConfig:
                  TimChannelFilterEnable = false
                  TimChFilterCounterFreqSelect = GTM_CONFIGURABLE_CLOCK_0
                  TimChFilterModeForRisingEdge = IMMEDIATE_EDGE_PROPAGATION_MODE
                  TimChFilterModeForFallingEdge = IMMEDIATE_EDGE_PROPAGATION_MODE
                  TimChFilterTimeForRisingEdge = 0
                  TimChFilterTimeForFallingEdge = 0
                TimChannelTimeoutDetection: TimChTimeoutDetectionEnable=SEL0_TIMOUT_DISABLED, TimChTimeoutClockSelect=GTM_CONFIGURABLE_CLOCK_0, TimChTimeoutDuration=0
                TimChannelInterrupt:
                  TimInterruptEnableOnNewVal = false
                  TimInterruptEnableOnEcntOfl = false
                  TimInterruptEnableOnCntOfl = false
                  TimInterruptEnableOnGprxOfl = false
                  TimInterruptEnableOnToDet = false
                  TimInterruptEnableOnGlitchDet = false
                  TimInterruptMode = GTM_INTERRUPT_LEVEL_MODE
                  TimNotification = NULL_PTR
                TimChannelErrorInterrupt:
                  TimInterruptEnableOnNewValErr = false
                  TimInterruptEnableOnEcntOflErr = false
                  TimInterruptEnableOnCntOflErr = false
                  TimInterruptEnableOnGprxOflErr = false
                  TimInterruptEnableOnToDetErr = false
                  TimInterruptEnableOnGlitchDetErr = false
              TimChannel_4
                TimChannelGeneral:
                  TimChannelUsage = USED_BY_OTHER_DRIVERS_OR_UNUSED
                  TimChannelEnable = false
                  TimChannelInputSelect = INPUT_OF_CURRENT_TIM_CHANNEL
                  TimChannelPortPinSelect = NONE_SEL0
                  TimChannelValInitSignal = VAL_LOW
                  TimChannelSignalEdgeSelect = FALLING_EDGE
                  TimChannelClockSelect = GTM_CONFIGURABLE_CLOCK_0
                  TimChannelGpr0InputSelect = TIMEBASE_TBU_TS0
                  TimChannelGpr1InputSelect = TIMEBASE_TBU_TS0
                  TimChannelCntsInputSelect = CNT_VALUE
                  TimChannelCntsValue = 0
                  TimChannelTbu0Ts0BitsSelect = BITS_0_TO_23
                  TimChannelModeSelect = PWM_MEASUREMENT_MODE_TPWM
                  TimChannelOneShotMode = false
                  TimChannelAruEnable = false
                  TimChannelExtCaptureModeEnable = false
                  TimChannelExtCaptureSrc = SEL0_NEW_VAL_IRQ
                  TimChannelEcntResetSetting = SEL0_ECNT_IN_WRAP_AROUND_MODE
                  TimChannelEcntOvflwSetting = SEL0_OVRFLOW_SIG_ON_ECNT_BITWIDTH_8
                TimChannelFilterConfig:
                  TimChannelFilterEnable = false
                  TimChFilterCounterFreqSelect = GTM_CONFIGURABLE_CLOCK_0
                  TimChFilterModeForRisingEdge = IMMEDIATE_EDGE_PROPAGATION_MODE
                  TimChFilterModeForFallingEdge = IMMEDIATE_EDGE_PROPAGATION_MODE
                  TimChFilterTimeForRisingEdge = 0
                  TimChFilterTimeForFallingEdge = 0
                TimChannelTimeoutDetection: TimChTimeoutDetectionEnable=SEL0_TIMOUT_DISABLED, TimChTimeoutClockSelect=GTM_CONFIGURABLE_CLOCK_0, TimChTimeoutDuration=0
                TimChannelInterrupt:
                  TimInterruptEnableOnNewVal = false
                  TimInterruptEnableOnEcntOfl = false
                  TimInterruptEnableOnCntOfl = false
                  TimInterruptEnableOnGprxOfl = false
                  TimInterruptEnableOnToDet = false
                  TimInterruptEnableOnGlitchDet = false
                  TimInterruptMode = GTM_INTERRUPT_LEVEL_MODE
                  TimNotification = NULL_PTR
                TimChannelErrorInterrupt:
                  TimInterruptEnableOnNewValErr = false
                  TimInterruptEnableOnEcntOflErr = false
                  TimInterruptEnableOnCntOflErr = false
                  TimInterruptEnableOnGprxOflErr = false
                  TimInterruptEnableOnToDetErr = false
                  TimInterruptEnableOnGlitchDetErr = false
              TimChannel_5
                TimChannelGeneral:
                  TimChannelUsage = USED_BY_OTHER_DRIVERS_OR_UNUSED
                  TimChannelEnable = false
                  TimChannelInputSelect = INPUT_OF_CURRENT_TIM_CHANNEL
                  TimChannelPortPinSelect = NONE_SEL0
                  TimChannelValInitSignal = VAL_LOW
                  TimChannelSignalEdgeSelect = FALLING_EDGE
                  TimChannelClockSelect = GTM_CONFIGURABLE_CLOCK_0
                  TimChannelGpr0InputSelect = TIMEBASE_TBU_TS0
                  TimChannelGpr1InputSelect = TIMEBASE_TBU_TS0
                  TimChannelCntsInputSelect = CNT_VALUE
                  TimChannelCntsValue = 0
                  TimChannelTbu0Ts0BitsSelect = BITS_0_TO_23
                  TimChannelModeSelect = PWM_MEASUREMENT_MODE_TPWM
                  TimChannelOneShotMode = false
                  TimChannelAruEnable = false
                  TimChannelExtCaptureModeEnable = false
                  TimChannelExtCaptureSrc = SEL0_NEW_VAL_IRQ
                  TimChannelEcntResetSetting = SEL0_ECNT_IN_WRAP_AROUND_MODE
                  TimChannelEcntOvflwSetting = SEL0_OVRFLOW_SIG_ON_ECNT_BITWIDTH_8
                TimChannelFilterConfig:
                  TimChannelFilterEnable = false
                  TimChFilterCounterFreqSelect = GTM_CONFIGURABLE_CLOCK_0
                  TimChFilterModeForRisingEdge = IMMEDIATE_EDGE_PROPAGATION_MODE
                  TimChFilterModeForFallingEdge = IMMEDIATE_EDGE_PROPAGATION_MODE
                  TimChFilterTimeForRisingEdge = 0
                  TimChFilterTimeForFallingEdge = 0
                TimChannelTimeoutDetection: TimChTimeoutDetectionEnable=SEL0_TIMOUT_DISABLED, TimChTimeoutClockSelect=GTM_CONFIGURABLE_CLOCK_0, TimChTimeoutDuration=0
                TimChannelInterrupt:
                  TimInterruptEnableOnNewVal = false
                  TimInterruptEnableOnEcntOfl = false
                  TimInterruptEnableOnCntOfl = false
                  TimInterruptEnableOnGprxOfl = false
                  TimInterruptEnableOnToDet = false
                  TimInterruptEnableOnGlitchDet = false
                  TimInterruptMode = GTM_INTERRUPT_LEVEL_MODE
                  TimNotification = NULL_PTR
                TimChannelErrorInterrupt:
                  TimInterruptEnableOnNewValErr = false
                  TimInterruptEnableOnEcntOflErr = false
                  TimInterruptEnableOnCntOflErr = false
                  TimInterruptEnableOnGprxOflErr = false
                  TimInterruptEnableOnToDetErr = false
                  TimInterruptEnableOnGlitchDetErr = false
              TimChannel_6
                TimChannelGeneral:
                  TimChannelUsage = USED_BY_OTHER_DRIVERS_OR_UNUSED
                  TimChannelEnable = false
                  TimChannelInputSelect = INPUT_OF_CURRENT_TIM_CHANNEL
                  TimChannelPortPinSelect = NONE_SEL0
                  TimChannelValInitSignal = VAL_LOW
                  TimChannelSignalEdgeSelect = FALLING_EDGE
                  TimChannelClockSelect = GTM_CONFIGURABLE_CLOCK_0
                  TimChannelGpr0InputSelect = TIMEBASE_TBU_TS0
                  TimChannelGpr1InputSelect = TIMEBASE_TBU_TS0
                  TimChannelCntsInputSelect = CNT_VALUE
                  TimChannelCntsValue = 0
                  TimChannelTbu0Ts0BitsSelect = BITS_0_TO_23
                  TimChannelModeSelect = PWM_MEASUREMENT_MODE_TPWM
                  TimChannelOneShotMode = false
                  TimChannelAruEnable = false
                  TimChannelExtCaptureModeEnable = false
                  TimChannelExtCaptureSrc = SEL0_NEW_VAL_IRQ
                  TimChannelEcntResetSetting = SEL0_ECNT_IN_WRAP_AROUND_MODE
                  TimChannelEcntOvflwSetting = SEL0_OVRFLOW_SIG_ON_ECNT_BITWIDTH_8
                TimChannelFilterConfig:
                  TimChannelFilterEnable = false
                  TimChFilterCounterFreqSelect = GTM_CONFIGURABLE_CLOCK_0
                  TimChFilterModeForRisingEdge = IMMEDIATE_EDGE_PROPAGATION_MODE
                  TimChFilterModeForFallingEdge = IMMEDIATE_EDGE_PROPAGATION_MODE
                  TimChFilterTimeForRisingEdge = 0
                  TimChFilterTimeForFallingEdge = 0
                TimChannelTimeoutDetection: TimChTimeoutDetectionEnable=SEL0_TIMOUT_DISABLED, TimChTimeoutClockSelect=GTM_CONFIGURABLE_CLOCK_0, TimChTimeoutDuration=0
                TimChannelInterrupt:
                  TimInterruptEnableOnNewVal = false
                  TimInterruptEnableOnEcntOfl = false
                  TimInterruptEnableOnCntOfl = false
                  TimInterruptEnableOnGprxOfl = false
                  TimInterruptEnableOnToDet = false
                  TimInterruptEnableOnGlitchDet = false
                  TimInterruptMode = GTM_INTERRUPT_LEVEL_MODE
                  TimNotification = NULL_PTR
                TimChannelErrorInterrupt:
                  TimInterruptEnableOnNewValErr = false
                  TimInterruptEnableOnEcntOflErr = false
                  TimInterruptEnableOnCntOflErr = false
                  TimInterruptEnableOnGprxOflErr = false
                  TimInterruptEnableOnToDetErr = false
                  TimInterruptEnableOnGlitchDetErr = false
              TimChannel_7
                TimChannelGeneral:
                  TimChannelUsage = USED_BY_OTHER_DRIVERS_OR_UNUSED
                  TimChannelEnable = false
                  TimChannelInputSelect = INPUT_OF_CURRENT_TIM_CHANNEL
                  TimChannelPortPinSelect = NONE_SEL0
                  TimChannelValInitSignal = VAL_LOW
                  TimChannelSignalEdgeSelect = FALLING_EDGE
                  TimChannelClockSelect = GTM_CONFIGURABLE_CLOCK_0
                  TimChannelGpr0InputSelect = TIMEBASE_TBU_TS0
                  TimChannelGpr1InputSelect = TIMEBASE_TBU_TS0
                  TimChannelCntsInputSelect = CNT_VALUE
                  TimChannelCntsValue = 0
                  TimChannelTbu0Ts0BitsSelect = BITS_0_TO_23
                  TimChannelModeSelect = PWM_MEASUREMENT_MODE_TPWM
                  TimChannelOneShotMode = false
                  TimChannelAruEnable = false
                  TimChannelExtCaptureModeEnable = false
                  TimChannelExtCaptureSrc = SEL0_NEW_VAL_IRQ
                  TimChannelEcntResetSetting = SEL0_ECNT_IN_WRAP_AROUND_MODE
                  TimChannelEcntOvflwSetting = SEL0_OVRFLOW_SIG_ON_ECNT_BITWIDTH_8
                TimChannelFilterConfig:
                  TimChannelFilterEnable = false
                  TimChFilterCounterFreqSelect = GTM_CONFIGURABLE_CLOCK_0
                  TimChFilterModeForRisingEdge = IMMEDIATE_EDGE_PROPAGATION_MODE
                  TimChFilterModeForFallingEdge = IMMEDIATE_EDGE_PROPAGATION_MODE
                  TimChFilterTimeForRisingEdge = 0
                  TimChFilterTimeForFallingEdge = 0
                TimChannelTimeoutDetection: TimChTimeoutDetectionEnable=SEL0_TIMOUT_DISABLED, TimChTimeoutClockSelect=GTM_CONFIGURABLE_CLOCK_0, TimChTimeoutDuration=0
                TimChannelInterrupt:
                  TimInterruptEnableOnNewVal = false
                  TimInterruptEnableOnEcntOfl = false
                  TimInterruptEnableOnCntOfl = false
                  TimInterruptEnableOnGprxOfl = false
                  TimInterruptEnableOnToDet = false
                  TimInterruptEnableOnGlitchDet = false
                  TimInterruptMode = GTM_INTERRUPT_LEVEL_MODE
                  TimNotification = NULL_PTR
                TimChannelErrorInterrupt:
                  TimInterruptEnableOnNewValErr = false
                  TimInterruptEnableOnEcntOflErr = false
                  TimInterruptEnableOnCntOflErr = false
                  TimInterruptEnableOnGprxOflErr = false
                  TimInterruptEnableOnToDetErr = false
                  TimInterruptEnableOnGlitchDetErr = false
        4 x Mcs:
          Mcs_0
            McsGeneral: McsUsage=UNUSED, McsSchedulingScheme=ACCELERATED_SCHEDULING_SCHEME, McsHaltOnStackPointerOverflow=false
            8 x McsChannel, all with McsChannelEnable=false, McsChannelInterruptEnable=false, McsChStackErrorInterruptEnable=false, McsChMemoryErrorInterruptEnable=false, McsChannelInterruptEnableErr=false, McsChStackErrorInterruptEnableErr=false, McsChMemoryErrorInterruptEnableErr=false, McsChannelInterruptMode=GTM_INTERRUPT_LEVEL_MODE:
              McsChannel_{0..7}
          Mcs_1
            McsGeneral: McsUsage=UNUSED, McsSchedulingScheme=ACCELERATED_SCHEDULING_SCHEME, McsHaltOnStackPointerOverflow=false
            8 x McsChannel, all with McsChannelEnable=false, McsChannelInterruptEnable=false, McsChStackErrorInterruptEnable=false, McsChMemoryErrorInterruptEnable=false, McsChannelInterruptEnableErr=false, McsChStackErrorInterruptEnableErr=false, McsChMemoryErrorInterruptEnableErr=false, McsChannelInterruptMode=GTM_INTERRUPT_LEVEL_MODE:
              McsChannel_{0..7}
          Mcs_2
            McsGeneral: McsUsage=UNUSED, McsSchedulingScheme=ACCELERATED_SCHEDULING_SCHEME, McsHaltOnStackPointerOverflow=false
            8 x McsChannel, all with McsChannelEnable=false, McsChannelInterruptEnable=false, McsChStackErrorInterruptEnable=false, McsChMemoryErrorInterruptEnable=false, McsChannelInterruptEnableErr=false, McsChStackErrorInterruptEnableErr=false, McsChMemoryErrorInterruptEnableErr=false, McsChannelInterruptMode=GTM_INTERRUPT_LEVEL_MODE:
              McsChannel_{0..7}
          Mcs_3
            McsGeneral: McsUsage=UNUSED, McsSchedulingScheme=ACCELERATED_SCHEDULING_SCHEME, McsHaltOnStackPointerOverflow=false
            8 x McsChannel, all with McsChannelEnable=false, McsChannelInterruptEnable=false, McsChStackErrorInterruptEnable=false, McsChMemoryErrorInterruptEnable=false, McsChannelInterruptEnableErr=false, McsChStackErrorInterruptEnableErr=false, McsChMemoryErrorInterruptEnableErr=false, McsChannelInterruptMode=GTM_INTERRUPT_LEVEL_MODE:
              McsChannel_{0..7}
        Spe_0 (Spe)
          SpeGeneral:
            SpeUsage = UNUSED
            SpeEnableModule = false
            SpeTimChannelsSelect = SEL0_TIM0_CH0_TO_2
            SpeEnableInput{0..2} = false
            SpeTriggerInputSelect = SPE_NIPD
            SpeEnableFastShutOff = false
            SpeInputSigRevCntr = 60
            SpeInputSigRevCntrCmpVal = 60
          8 x SpeInputPattern, all with SpeIsPatternValid=false, SpeInputPattern=0:
            SpeInputPattern_{0..7}
          8 x SpeOutputConfig, all with SpeOutputSelect=TOM_CH0_SOUR, SpeFastShutoffLevel=LOW_LEVEL:
            SpeOutputConfig_{0..7}
          SpeInterrupt:
            SpeEnableIntOnNewPatternDetect = false
            SpeEnableIntOnSpeDirBitChange = false
            SpeEnableIntOnWrongPattern = false
            SpeEnableIntOnBouncingInput = false
            SpeEnableIntOnRegComp = false
            SpeInterruptMode = GTM_INTERRUPT_LEVEL_MODE
          SpeErrorInterrupt:
            SpeEnableIntOnNewPatternDetectErr = false
            SpeEnableIntOnSpeDirBitChangeErr = false
            SpeEnableIntOnWrongPatternErr = false
            SpeEnableIntOnBouncingInputErr = false
            SpeEnableIntOnRegCompErr = false
        Spe_1 (Spe)
          SpeGeneral:
            SpeUsage = UNUSED
            SpeEnableModule = false
            SpeTimChannelsSelect = SEL0_TIM0_CH3_TO_5
            SpeEnableInput{0..2} = false
            SpeTriggerInputSelect = SPE_NIPD
            SpeEnableFastShutOff = false
            SpeInputSigRevCntr = 60
            SpeInputSigRevCntrCmpVal = 60
          8 x SpeInputPattern, all with SpeIsPatternValid=false, SpeInputPattern=0:
            SpeInputPattern_{0..7}
          8 x SpeOutputConfig, all with SpeOutputSelect=TOM_CH0_SOUR, SpeFastShutoffLevel=LOW_LEVEL:
            SpeOutputConfig_{0..7}
          SpeInterrupt:
            SpeEnableIntOnNewPatternDetect = false
            SpeEnableIntOnSpeDirBitChange = false
            SpeEnableIntOnWrongPattern = false
            SpeEnableIntOnBouncingInput = false
            SpeEnableIntOnRegComp = false
            SpeInterruptMode = GTM_INTERRUPT_LEVEL_MODE
          SpeErrorInterrupt:
            SpeEnableIntOnNewPatternDetectErr = false
            SpeEnableIntOnSpeDirBitChangeErr = false
            SpeEnableIntOnWrongPatternErr = false
            SpeEnableIntOnBouncingInputErr = false
            SpeEnableIntOnRegCompErr = false
        Cmu
          CmuFixedClock: CmuEnableAllFixedClocks=false, CmuFxdClkSourceSelect=GTM_GLOBAL_CLOCK
          CmuConfigurableClock:
            CmuEnableConfigurableClk0 = true
            CmuConfigurableClk0Div = 0
            CmuEnableConfigurableClk1 = true
            CmuConfigurableClk1Div = 0
            CmuEnableConfigurableClk2 = true
            CmuConfigurableClk2Div = 0
            CmuEnableConfigurableClk3 = false
            CmuConfigurableClk3Div = 0
            CmuEnableConfigurableClk4 = false
            CmuConfigurableClk4Div = 0
            CmuEnableConfigurableClk5 = false
            CmuConfigurableClk5Div = 0
            CmuEnableConfigurableClk6 = false
            CmuClk6SourceSelect = CMU_CLK_6_DIVIDER
            CmuConfigurableClk6Div = 0
            CmuEnableConfigurableClk7 = false
            CmuClk7SourceSelect = CMU_CLK_7_DIVIDER
            CmuConfigurableClk7Div = 0
          CmuExternalClock:
            CmuEnableExternalClk0 = false
            CmuExternalClk0Numerator = 1
            CmuExternalClk0Denominator = 1
            CmuEnableExternalClk1 = false
            CmuExternalClk1Numerator = 1
            CmuExternalClk1Denominator = 1
            CmuEnableExternalClk2 = false
            CmuExternalClk2Numerator = 1
            CmuExternalClk2Denominator = 1
      CcuConfiguration
        Ccu60 (Ccu6)
          General: Ccu6ModuleUsage=USED_BY_ICU_DRIVER
          T12
            General: T12ClkSelection=0, T12PrescalerEnabled=false
            3 x Cc6:
              Cc60: CCChannelInputSelection=CCINA_PORT2_PIN0
              Cc61: CCChannelInputSelection=CCINA_PORT2_PIN2
              Cc62: CCChannelInputSelection=CCINA_PORT2_PIN4
          T13
            General: T13ClkSelection=0, T13PrescalerEnabled=false
        Ccu61 (Ccu6)
          General: Ccu6ModuleUsage=UNUSED
          T12
            General: T12ClkSelection=0, T12PrescalerEnabled=false
            3 x Cc6:
              Cc60: CCChannelInputSelection=CCINA_PORT0_PIN1
              Cc61: CCChannelInputSelection=CCINA_PORT0_PIN3
              Cc62: CCChannelInputSelection=CCINA_PORT0_PIN5
          T13
            General: T13ClkSelection=0, T13PrescalerEnabled=false
      DmaConfiguration
        64 x DmaChannel:
          DmaChannel_{0..7}: ChannelId={0..7}, ChannelUsed=USE_FOR_SPI_DRIVER
          DmaChannel_{8..63}: ChannelId={8..63}, ChannelUsed=USE_FOR_NONE
      EruConfiguration
        ERU{0..4}: EruChannelUsage=UNUSED
        ERU5: EruChannelUsage=USED_BY_ICU_DRIVER, EruInputLine=ERU_INPUT50_PORT15_PIN8, EruOutputUnit=ERU_OUTPUT_GATING_UNIT0
        ERU6: EruChannelUsage=UNUSED
        ERU7: EruChannelUsage=UNUSED
    McuPublishedInformation
      18 x McuResetReasonConf:
        MCU_ESR0_RESET: McuResetReason=0
        MCU_ESR1_RESET: McuResetReason=1
        MCU_SMU_RESET: McuResetReason=2
        MCU_SW_RESET: McuResetReason=3
        MCU_STM0_RESET: McuResetReason=4
        MCU_STM1_RESET: McuResetReason=5
        MCU_STM2_RESET: McuResetReason=6
        MCU_POWER_ON_RESET: McuResetReason=7
        MCU_CB0_RESET: McuResetReason=8
        MCU_CB1_RESET: McuResetReason=9
        MCU_CB3_RESET: McuResetReason=10
        MCU_TP_RESET: McuResetReason=11
        MCU_EVR13_RESET: McuResetReason=12
        MCU_EVR33_RESET: McuResetReason=13
        MCU_SUPPLY_WDOG_RESET: McuResetReason=14
        MCU_STBYR_RESET: McuResetReason=15
        MCU_RESET_MULTIPLE: McuResetReason=254
        MCU_RESET_UNDEFINED: McuResetReason=255
    McuSafety: McuSafetyEnable=false, McuInitCheckApi=true, McuGetModeApi=true, McuClockMonitoringEnable=true
    CommonPublishedInformation:
      ArMajorVersion = 3
      ArMinorVersion = 2
      ArPatchVersion = 0
      SwMajorVersion = 4
      SwMinorVersion = 6
      SwPatchVersion = 1
      ModuleId = 101
      VendorId = 17
      Release = _TRICORE_TC277
