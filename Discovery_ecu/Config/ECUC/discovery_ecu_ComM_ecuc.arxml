AUTOSAR XML (schema 4-2-1)
package /ActiveEcuC
  module config ComM: implementation-config-variant=VARIANT-PRE-COMPILE, module-description=ComM_Impl
    ComMConfigSet: ComMPncEnabled=false
      CAN00_f26020e5 (ComMChannel):  # CN_CAN00
        ComMBusType = COMM_BUS_TYPE_CAN
        ComMChannelId = 0
        ComMFullCommRequestNotificationEnabled = false
        ComMMainFunctionPeriod = 0.02
        ComMNoCom = false
        ComMNoWakeup = false
        ComMNetworkManagement: ComMNmVariant=NONE, ComMPncNmRequest=false
        CHNL_f276589c (ComMUserPerChannel): ComMUserChannel=USR_CHNL_f276589c  # CN_CAN00
      USR_CHNL_f276589c (ComMUser): ComMUserIdentifier=0, ComMUserModeNotification=false  # CN_CAN00
      USR_CHNL_8571680a (ComMUser): ComMUserIdentifier=1, ComMUserModeNotification=false  # CN_CAN01
      CAN01_f26020e5 (ComMChannel):  # CN_CAN01
        ComMBusType = COMM_BUS_TYPE_CAN
        ComMChannelId = 1
        ComMFullCommRequestNotificationEnabled = false
        ComMMainFunctionPeriod = 0.02
        ComMNoCom = false
        ComMNoWakeup = false
        ComMNetworkManagement: ComMNmVariant=NONE, ComMPncNmRequest=false
        CHNL_8571680a (ComMUserPerChannel): ComMUserChannel=USR_CHNL_8571680a  # CN_CAN01
      CAN02_f26020e5 (ComMChannel):  # CN_CAN02
        ComMBusType = COMM_BUS_TYPE_CAN
        ComMChannelId = 2
        ComMFullCommRequestNotificationEnabled = false
        ComMMainFunctionPeriod = 0.02
        ComMNoCom = false
        ComMNoWakeup = false
        ComMNetworkManagement: ComMNmVariant=NONE, ComMPncNmRequest=false
        CHNL_1c7839b0 (ComMUserPerChannel): ComMUserChannel=USR_CHNL_1c7839b0  # CN_CAN02
      USR_CHNL_1c7839b0 (ComMUser): ComMUserIdentifier=2, ComMUserModeNotification=false  # CN_CAN02
      ComMUser_LIN (ComMUser): ComMUserIdentifier=3, ComMUserModeNotification=false, ComMUserEcucPartitionRef=EcucPartition_Core0_QM
      LIN00_f26020e5 (ComMChannel):  # CN_LIN00
        ComMBusType = COMM_BUS_TYPE_LIN
        ComMChannelId = 3
        ComMFullCommRequestNotificationEnabled = false
        ComMMainFunctionPeriod = 0.02
        ComMNoCom = false
        ComMNoWakeup = false
        ComMNetworkManagement: ComMNmVariant=NONE, ComMPncNmRequest=false
        CHNL_b592e7a2 (ComMUserPerChannel): ComMUserChannel=USR_CHNL_b592e7a2  # CN_LIN00
      USR_CHNL_b592e7a2 (ComMUser): ComMUserIdentifier=4, ComMUserModeNotification=false  # CN_LIN00
    ComMGeneral:
      ComMPncIdCounting = COMM_PNC_ID_COUNT_FROM_NM_MESSAGE
      ComMPncSupport = false
      ComMDevErrorDetect = false
      ComMEcuGroupClassification = 3
      ComMModeLimitationEnabled = false
      ComMSynchronousWakeUp = true
      ComMTMinFullComModeDuration = 5
      ComMVersionInfoApi = false
      ComMWakeupInhibitionEnabled = false
      ComMSafeBswChecks = false
      ComMExtendedRamCheck = false
      ComMGeneration: ComMOutOfBoundsWriteSanitizer=false, ComMOutOfBoundsReadSanitizer=false
