AUTOSAR XML (schema 4-2-1)
package /ActiveEcuC
  module config CanTp: implementation-config-variant=VARIANT-PRE-COMPILE, module-description=CanTp_Impl
    CanTpConfig: CanTpMainFunctionPeriod=0.01
      CanTpChannel_physical (CanTpChannel): CanTpChannelMode=CANTP_MODE_FULL_DUPLEX
        CanTpRxNSdu_002 (CanTpRxNSdu):
          CanTpNbr = 0.1
          CanTpRxAddressingFormat = CANTP_STANDARD
          CanTpRxNSduId = 1
          CanTpRxPaddingActivation = CANTP_ON
          CanTpRxTaType = CANTP_PHYSICAL
          CanTpRxWftMax = 10
          CanTpSTmin = 0.01
          CanTpBs = 8
          CanTpRxDl = 8
          CanTpNar = 0.1
          CanTpNcr = 0.5
          CanTpRxNSduRef = PT_DIAG_PhysReq_P2P_PP_DIAG_PhysReq_P2P_Rx_0fb271d2_c07658fd
          CanTpRxNPdu_1 (CanTpRxNPdu): CanTpRxNPduId=0, CanTpRxNPduRef=diag_request_tp_rx_physical_address
          CanTpTxFcNPdu: CanTpTxFcNPduConfirmationPduId=0, CanTpTxFcNPduRef=diag_response_tp_tx
        CanTpTxNSdu:
          CanTpNas = 0.1
          CanTpNcs = 0.5
          CanTpTc = false
          CanTpTxAddressingFormat = CANTP_STANDARD
          CanTpTxNSduId = 0
          CanTpTxPaddingActivation = CANTP_ON
          CanTpTxTaType = CANTP_PHYSICAL
          CanTpNbs = 0.1
          CanTpTxNSduRef = PT_DIAG_PhysResp_P2P_PP_DIAG_PhysResp_P2P_Tx_0fb271d2_c07658fd
          CanTpTxNPdu: CanTpTxNPduConfirmationPduId=0, CanTpTxNPduRef=diag_response_tp_tx
          CanTpRxFcNPdu: CanTpRxFcNPduId=0, CanTpRxFcNPduRef=diag_request_tp_rx_physical_address
      CanTpChannel_Func (CanTpChannel): CanTpChannelMode=CANTP_MODE_FULL_DUPLEX
        CanTpRxNSdu:
          CanTpNbr = 0.1
          CanTpRxAddressingFormat = CANTP_STANDARD
          CanTpRxNSduId = 0
          CanTpRxPaddingActivation = CANTP_ON
          CanTpRxTaType = CANTP_FUNCTIONAL
          CanTpRxNSduRef = PT_DIAG_FuncReq_HSC2_PP_DIAG_FuncReq_HSC2_Rx_0fb271d2_c07658fd
          CanTpRxNPdu: CanTpRxNPduId=1, CanTpRxNPduRef=diag_request_tp_rx_functional_address
    CanTpGeneral:
      CanTpChangeParameterApi = false
      CanTpDevErrorDetect = false
      CanTpPaddingByte = 204
      CanTpReadParameterApi = false
      CanTpVersionInfoApi = false
      CanTpPaddingActive = true
      CanTpHavePaddingByte = false
      CanTpNumRxChannels = 0
      CanTpNumTxChannels = 0
      CanTpEnableSplitMainFunction = false
      CanTpSupportStandardAddressing = true
      CanTpSupportExtendedAddressing = true
      CanTpSupportMixed11Addressing = true
      CanTpOnlyNotifyInformedAppl = true
      CanTpRc = false
      CanTpTc = false
      CanTpSafeBswChecks = false
      CanTpEnableSynchronousTransmit = true
