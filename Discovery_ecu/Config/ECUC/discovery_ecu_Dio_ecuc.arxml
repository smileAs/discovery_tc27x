AUTOSAR XML (schema 4-2-1)
package /ActiveEcuC
  module config Dio: implementation-config-variant=VARIANT-POST-BUILD-LOADABLE, module-description=Dio_Impl
    DioConfig
      DioPort_1 (DioPort): DioPortId=2
        3 x DioChannel:
          CAN_Enable: DioChannelId=0
          CAN_Err: DioChannelId=1
          CAN_Stb: DioChannelId=2
      DioPort_0 (DioPort): DioPortId=0
    DioGeneral:
      DioDevErrorDetect = false
      DioFlipChannelApi = true
      DioPBFixedAddress = false
      DioVersionInfoApi = true
      DioRunningInUser0Mode = false
      DioUserModeInitApiEnable = true
      DioUserModeRuntimeApiEnable = true
    DioSafety: DioSafetyEnable=false, DioInitCheckApi=false
    CommonPublishedInformation:
      ArMajorVersion = 2
      ArMinorVersion = 5
      ArPatchVersion = 0
      SwMajorVersion = 3
      SwMinorVersion = 1
      SwPatchVersion = 0
      ModuleId = 120
      VendorId = 17
      Release = _TRICORE_TC277
