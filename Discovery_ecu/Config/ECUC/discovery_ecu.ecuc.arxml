AUTOSAR XML (schema 4-2-1)
package /ActiveEcuC
  ecuc value collection ActiveEcuC: ecu-extract=SYSTEM
    ecuc-values:
      Dio
      Mcu
      EcuC
      Os
      Resource
      BswM
      EcuM
      Rte
      Irq
      Gpt
      Port
      Spi
      Pwm
      Uart
      Icu
      I2c
      Can
      CanIf
      Com
      PduR
      CanTrcv
      CanSM
      ComM
      CanTp
      Dcm
      Lin
      LinSM
      LinIf
