AUTOSAR XML (schema 4-2-1)
package /ActiveEcuC
  module config Dcm: implementation-config-variant=VARIANT-PRE-COMPILE, module-description=Dcm_Impl
    DcmConfigSet
      DcmDsd
        DcmDsdServiceTable
          3 x DcmDsdService, all with DcmDsdSidTabSubfuncAvail=true:
            DiagSessionControl: DcmDsdSidTabServiceId=16
              3 x DcmDsdSubService:
                Default: DcmDsdSubServiceId=1
                Extended: DcmDsdSubServiceId=2
                Programming: DcmDsdSubServiceId=3
            CommunicationControl: DcmDsdSidTabServiceId=40
              4 x DcmDsdSubService:
                EnableRxAndTx: DcmDsdSubServiceId=0
                EnableRxAndDisableTx: DcmDsdSubServiceId=1
                DisableRxAndTx: DcmDsdSubServiceId=3
                DisableRxAndEnableTx: DcmDsdSubServiceId=2
            TesterPresent: DcmDsdSidTabServiceId=62
              TesterPresent (DcmDsdSubService): DcmDsdSubServiceId=0
      DcmDsl
        DcmDslBuffer: DcmDslBufferSize=50
        DcmDslDiagResp: DcmDslDiagRespOnSecondDeclinedRequest=false, DcmDslDiagRespMaxNumOfDeclinedRequests=3
        DcmDslProtocol
          DcmDslProtocolRow:
            DcmDslProtocolID = DCM_UDS_ON_CAN
            DcmDslProtocolPriority = 0
            DcmSendRespPendOnTransToBoot = true
            DcmTimStrP2ServerAdjust = 0
            DcmTimStrP2StarServerAdjust = 0
            DcmDslProtocolMaximumResponseSize = 4095
            DcmDslProtocolRxBufferID = DcmDslBuffer
            DcmDslProtocolSIDTable = DcmDsdServiceTable
            DcmDslProtocolTxBufferID = DcmDslBuffer
            DcmDslConnection
              DcmDslMainConnection: DcmDslProtocolRxTesterSourceAddr=0
                DcmDslProtocolRx_Physical_Address (DcmDslProtocolRx):
                  DcmDslProtocolRxAddrType = DCM_PHYSICAL_TYPE
                  DcmDslProtocolRxPduId = 0
                  DcmDslProtocolRxComMChannelRef = CAN00_f26020e5
                  DcmDslProtocolRxPduRef = diag_PUDR_Physical_request
                DcmDslProtocolRx_Functional_Address (DcmDslProtocolRx):
                  DcmDslProtocolRxAddrType = DCM_FUNCTIONAL_TYPE
                  DcmDslProtocolRxPduId = 1
                  DcmDslProtocolRxComMChannelRef = CAN00_f26020e5
                  DcmDslProtocolRxPduRef = diag_PUDR_Functional_request
                DcmDslProtocolTx: DcmDslTxConfirmationPduId=0, DcmDslProtocolTxPduRef=diag_PDUR_response
      DcmDsp: DcmDspReadDIDReportsNODIByte=false
        DcmDspSession
          3 x DcmDspSessionRow, all with DcmDspSessionForBoot=DCM_NO_BOOT, DcmDspSessionP2ServerMax=0.05, DcmDspSessionP2StarServerMax=5:
            Default: DcmDspSessionLevel=1
            Programming: DcmDspSessionLevel=2
            Extended: DcmDspSessionLevel=3
      DcmGeneral:
        DcmDevErrorDetect = false
        DcmRequestManufacturerNotificationEnabled = false
        DcmRequestSupplierNotificationEnabled = false
        DcmRespondAllRequest = true
        DcmTaskTime = 0.01
        DcmVersionInfoApi = false
        DcmDspDataDefaultEndianness = LITTLE_ENDIAN
        DcmSupportedIDCalculationSuppressionEnabled = false
        DcmDtrDataProvisionViaDemEnabled = true
        DcmForeignDiagnosticRequestDetectionEnabled = false
        DcmSuppressResponseOnCanTpFuncMixedAddrRequests = false
      DcmPageBufferCfg: DcmPagedBufferEnabled=true
