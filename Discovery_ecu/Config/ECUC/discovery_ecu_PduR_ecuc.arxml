AUTOSAR XML (schema 4-2-1)
package /ActiveEcuC
  module config PduR: implementation-config-variant=VARIANT-PRE-COMPILE, module-description=PduR_Impl
    CanIf (PduRBswModules):
      PduRCancelReceive = false
      PduRCancelTransmit = false
      PduRChangeParameterRequestApi = false
      PduRCommunicationInterface = true
      PduRLowerModule = true
      PduRTransportProtocol = false
      PduRTriggertransmit = false
      PduRTxConfirmation = false
      PduRUpperModule = false
      PduRUseTag = false
      PduRBswModuleRef = CanIf
    PduRGeneral: PduRDevErrorDetect=false, PduRVersionInfoApi=false, PduRMetaDataSupport=false, PduRPduCallback=false, PduRSwitching=false, PduRSafeBswChecks=false
      PduRGeneration:
        PduROutOfBoundsWriteProtectionStrategy = NONE
        PduROutOfBoundsWriteSanitizer = false
        PduROutOfBoundsReadSanitizer = false
        PduRNumericalDataTypeMinimizationStrategy = WITH_CAST
        PduRReduceConstantData2Define = false
        PduRBoolDataInArrayOfStructStrategy = BITMASKING
        PduRDeduplicateIndirectedData = true
        PduRDataDeduplicationStrategy = WITH_CAST
        PduRReduceBoolDataByNegationThreshold = 2
        PduRReduceBoolDataByNumericalComparisonThreshold = 2
        PduRReduceBoolDataByNumericalRelationThreshold = 2
        PduRReduceBoolDataByNumericalOperandStrategy = WITH_ANY_VALUE
        PduRReduceNumericalDataByOffsetThreshold = 2
        PduRReduceNumericalDataByArraySubtractionThreshold = 2
        PduRReduceDataByStreaming = false
        PduRShortSymbols = false
        PduRInterfacesForDeactivatedData = false
        PduRReferringKeysInComments = false
    PduRRoutingTables: PduRConfigurationId=0
      PduRRoutingTable
        118 x PduRRoutingPath:
          Can_PT_GW_HSC2_ECM_FrP04_0fb271d2: PduRRoutingPathCommunicationType=COMMUNICATION_INTERFACE  # GW_HSC2_ECM_FrP04_oCAN00
            DST_Can_PT_GW_HSC2_ECM_FrP04_0fb271d2 (PduRDestPdu):
              PduRDestPduHandleId = 20
              PduRDestPduDirection = RECEIVE
              PduRDestPduRoutingType = API_FORWARDING
              PduRTransmissionConfirmation = false
              PduRDestPduRef = PT_GW_HSC2_ECM_FrP04_PP_GW_HSC2_ECM_FrP04_Rx_0fb271d2_c07658fd
              PduRDestPduPduRBswModulesRef = Com
            SRC_Can_PT_GW_HSC2_ECM_FrP04_0fb271d2 (PduRSrcPdu):
              PduRSourcePduHandleId = 20
              PduRSrcPduDirection = RECEIVE
              PduRSrcPduRef = PT_GW_HSC2_ECM_FrP04_PP_GW_HSC2_ECM_FrP04_Rx_0fb271d2_c07658fd
              PduRSrcPduPduRBswModulesRef = CanIf
          Can_PT_GW_HSC2_BCM_FrP06_0fb271d2: PduRRoutingPathCommunicationType=COMMUNICATION_INTERFACE  # GW_HSC2_BCM_FrP06_oCAN00
            DST_Can_PT_GW_HSC2_BCM_FrP06_0fb271d2 (PduRDestPdu):
              PduRDestPduHandleId = 17
              PduRDestPduDirection = RECEIVE
              PduRDestPduRoutingType = API_FORWARDING
              PduRTransmissionConfirmation = false
              PduRDestPduRef = PT_GW_HSC2_BCM_FrP06_PP_GW_HSC2_BCM_FrP06_Rx_0fb271d2_c07658fd
              PduRDestPduPduRBswModulesRef = Com
            SRC_Can_PT_GW_HSC2_BCM_FrP06_0fb271d2 (PduRSrcPdu):
              PduRSourcePduHandleId = 17
              PduRSrcPduDirection = RECEIVE
              PduRSrcPduRef = PT_GW_HSC2_BCM_FrP06_PP_GW_HSC2_BCM_FrP06_Rx_0fb271d2_c07658fd
              PduRSrcPduPduRBswModulesRef = CanIf
          Can_PT_P2P_HSC2_FrP04_0fb271d2: PduRRoutingPathCommunicationType=COMMUNICATION_INTERFACE  # P2P_HSC2_FrP04_oCAN00
            SRC_Can_PT_P2P_HSC2_FrP04_0fb271d2 (PduRSrcPdu):
              PduRSourcePduHandleId = 6
              PduRSrcPduDirection = TRANSMIT
              PduRSrcPduRef = PT_P2P_HSC2_FrP04_PP_P2P_HSC2_FrP04_Tx_0fb271d2_c07658fd
              PduRSrcPduPduRBswModulesRef = Com
            DST_Can_PT_P2P_HSC2_FrP04_0fb271d2 (PduRDestPdu):
              PduRDestPduHandleId = 8
              PduRDestPduDirection = TRANSMIT
              PduRDestPduRoutingType = API_FORWARDING
              PduRDestPduDataProvision = PDUR_DIRECT
              PduRTransmissionConfirmation = false
              PduRDestPduRef = PT_P2P_HSC2_FrP04_PP_P2P_HSC2_FrP04_Tx_0fb271d2_c07658fd
              PduRDestPduPduRBswModulesRef = CanIf
          Can_PT_EPB_HSC2_FrP00_0fb271d2: PduRRoutingPathCommunicationType=COMMUNICATION_INTERFACE  # EPB_HSC2_FrP00_oCAN00
            SRC_Can_PT_EPB_HSC2_FrP00_0fb271d2 (PduRSrcPdu):
              PduRSourcePduHandleId = 7
              PduRSrcPduDirection = RECEIVE
              PduRSrcPduRef = PT_EPB_HSC2_FrP00_PP_EPB_HSC2_FrP00_Rx_0fb271d2_c07658fd
              PduRSrcPduPduRBswModulesRef = CanIf
            DST_Can_PT_EPB_HSC2_FrP00_0fb271d2 (PduRDestPdu):
              PduRDestPduHandleId = 7
              PduRDestPduDirection = RECEIVE
              PduRDestPduRoutingType = API_FORWARDING
              PduRTransmissionConfirmation = false
              PduRDestPduRef = PT_EPB_HSC2_FrP00_PP_EPB_HSC2_FrP00_Rx_0fb271d2_c07658fd
              PduRDestPduPduRBswModulesRef = Com
          Can_PT_SCS_HSC2_FrP00_0fb271d2: PduRRoutingPathCommunicationType=COMMUNICATION_INTERFACE  # SCS_HSC2_FrP00_oCAN00
            SRC_Can_PT_SCS_HSC2_FrP00_0fb271d2 (PduRSrcPdu):
              PduRSourcePduHandleId = 50
              PduRSrcPduDirection = RECEIVE
              PduRSrcPduRef = PT_SCS_HSC2_FrP00_PP_SCS_HSC2_FrP00_Rx_0fb271d2_c07658fd
              PduRSrcPduPduRBswModulesRef = CanIf
            DST_Can_PT_SCS_HSC2_FrP00_0fb271d2 (PduRDestPdu):
              PduRDestPduHandleId = 52
              PduRDestPduDirection = RECEIVE
              PduRDestPduRoutingType = API_FORWARDING
              PduRTransmissionConfirmation = false
              PduRDestPduRef = PT_SCS_HSC2_FrP00_PP_SCS_HSC2_FrP00_Rx_0fb271d2_c07658fd
              PduRDestPduPduRBswModulesRef = Com
          Can_PT_SCS_HSC2_FrP15_0fb271d2: PduRRoutingPathCommunicationType=COMMUNICATION_INTERFACE  # SCS_HSC2_FrP15_oCAN00
            SRC_Can_PT_SCS_HSC2_FrP15_0fb271d2 (PduRSrcPdu):
              PduRSourcePduHandleId = 57
              PduRSrcPduDirection = RECEIVE
              PduRSrcPduRef = PT_SCS_HSC2_FrP15_PP_SCS_HSC2_FrP15_Rx_0fb271d2_c07658fd
              PduRSrcPduPduRBswModulesRef = CanIf
            DST_Can_PT_SCS_HSC2_FrP15_0fb271d2 (PduRDestPdu):
              PduRDestPduHandleId = 59
              PduRDestPduDirection = RECEIVE
              PduRDestPduRoutingType = API_FORWARDING
              PduRTransmissionConfirmation = false
              PduRDestPduRef = PT_SCS_HSC2_FrP15_PP_SCS_HSC2_FrP15_Rx_0fb271d2_c07658fd
              PduRDestPduPduRBswModulesRef = Com
          Can_PT_SCS_HSC2_FrP03_0fb271d2: PduRRoutingPathCommunicationType=COMMUNICATION_INTERFACE  # SCS_HSC2_FrP03_oCAN00
            DST_Can_PT_SCS_HSC2_FrP03_0fb271d2 (PduRDestPdu):
              PduRDestPduHandleId = 55
              PduRDestPduDirection = RECEIVE
              PduRDestPduRoutingType = API_FORWARDING
              PduRTransmissionConfirmation = false
              PduRDestPduRef = PT_SCS_HSC2_FrP03_PP_SCS_HSC2_FrP03_Rx_0fb271d2_c07658fd
              PduRDestPduPduRBswModulesRef = Com
            SRC_Can_PT_SCS_HSC2_FrP03_0fb271d2 (PduRSrcPdu):
              PduRSourcePduHandleId = 53
              PduRSrcPduDirection = RECEIVE
              PduRSrcPduRef = PT_SCS_HSC2_FrP03_PP_SCS_HSC2_FrP03_Rx_0fb271d2_c07658fd
              PduRSrcPduPduRBswModulesRef = CanIf
          Can_PT_DIAG_DTCInfo_P2P_0fb271d2: PduRRoutingPathCommunicationType=COMMUNICATION_INTERFACE  # DIAG_DTCInfo_P2P_oCAN00
            SRC_Can_PT_DIAG_DTCInfo_P2P_0fb271d2 (PduRSrcPdu):
              PduRSourcePduHandleId = 0
              PduRSrcPduDirection = TRANSMIT
              PduRSrcPduRef = PT_DIAG_DTCInfo_P2P_PP_DIAG_DTCInfo_P2P_Tx_0fb271d2_c07658fd
              PduRSrcPduPduRBswModulesRef = Com
            DST_Can_PT_DIAG_DTCInfo_P2P_0fb271d2 (PduRDestPdu):
              PduRDestPduHandleId = 0
              PduRDestPduDirection = TRANSMIT
              PduRDestPduRoutingType = API_FORWARDING
              PduRDestPduDataProvision = PDUR_DIRECT
              PduRTransmissionConfirmation = false
              PduRDestPduRef = PT_DIAG_DTCInfo_P2P_PP_DIAG_DTCInfo_P2P_Tx_0fb271d2_c07658fd
              PduRDestPduPduRBswModulesRef = CanIf
          Can_PT_P2P_HSC2_FrP01_0fb271d2: PduRRoutingPathCommunicationType=COMMUNICATION_INTERFACE  # P2P_HSC2_FrP01_oCAN00
            DST_Can_PT_P2P_HSC2_FrP01_0fb271d2 (PduRDestPdu):
              PduRDestPduHandleId = 5
              PduRDestPduDirection = TRANSMIT
              PduRDestPduRoutingType = API_FORWARDING
              PduRDestPduDataProvision = PDUR_DIRECT
              PduRTransmissionConfirmation = false
              PduRDestPduRef = PT_P2P_HSC2_FrP01_PP_P2P_HSC2_FrP01_Tx_0fb271d2_c07658fd
              PduRDestPduPduRBswModulesRef = CanIf
            SRC_Can_PT_P2P_HSC2_FrP01_0fb271d2 (PduRSrcPdu):
              PduRSourcePduHandleId = 3
              PduRSrcPduDirection = TRANSMIT
              PduRSrcPduRef = PT_P2P_HSC2_FrP01_PP_P2P_HSC2_FrP01_Tx_0fb271d2_c07658fd
              PduRSrcPduPduRBswModulesRef = Com
          Can_PT_SAS_HSC2_FrP00_0fb271d2: PduRRoutingPathCommunicationType=COMMUNICATION_INTERFACE  # SAS_HSC2_FrP00_oCAN00
            DST_Can_PT_SAS_HSC2_FrP00_0fb271d2 (PduRDestPdu):
              PduRDestPduHandleId = 51
              PduRDestPduDirection = RECEIVE
              PduRDestPduRoutingType = API_FORWARDING
              PduRTransmissionConfirmation = false
              PduRDestPduRef = PT_SAS_HSC2_FrP00_PP_SAS_HSC2_FrP00_Rx_0fb271d2_c07658fd
              PduRDestPduPduRBswModulesRef = Com
            SRC_Can_PT_SAS_HSC2_FrP00_0fb271d2 (PduRSrcPdu):
              PduRSourcePduHandleId = 49
              PduRSrcPduDirection = RECEIVE
              PduRSrcPduRef = PT_SAS_HSC2_FrP00_PP_SAS_HSC2_FrP00_Rx_0fb271d2_c07658fd
              PduRSrcPduPduRBswModulesRef = CanIf
          Can_PT_SCS_HSC2_FrP12_0fb271d2: PduRRoutingPathCommunicationType=COMMUNICATION_INTERFACE  # SCS_HSC2_FrP12_oCAN00
            SRC_Can_PT_SCS_HSC2_FrP12_0fb271d2 (PduRSrcPdu):
              PduRSourcePduHandleId = 56
              PduRSrcPduDirection = RECEIVE
              PduRSrcPduRef = PT_SCS_HSC2_FrP12_PP_SCS_HSC2_FrP12_Rx_0fb271d2_c07658fd
              PduRSrcPduPduRBswModulesRef = CanIf
            DST_Can_PT_SCS_HSC2_FrP12_0fb271d2 (PduRDestPdu):
              PduRDestPduHandleId = 58
              PduRDestPduDirection = RECEIVE
              PduRDestPduRoutingType = API_FORWARDING
              PduRTransmissionConfirmation = false
              PduRDestPduRef = PT_SCS_HSC2_FrP12_PP_SCS_HSC2_FrP12_Rx_0fb271d2_c07658fd
              PduRDestPduPduRBswModulesRef = Com
          Can_PT_GW_HSC2_FrP10_0fb271d2: PduRRoutingPathCommunicationType=COMMUNICATION_INTERFACE  # GW_HSC2_FrP10_oCAN00
            SRC_Can_PT_GW_HSC2_FrP10_0fb271d2 (PduRSrcPdu):
              PduRSourcePduHandleId = 26
              PduRSrcPduDirection = RECEIVE
              PduRSrcPduRef = PT_GW_HSC2_FrP10_PP_GW_HSC2_FrP10_Rx_0fb271d2_c07658fd
              PduRSrcPduPduRBswModulesRef = CanIf
            DST_Can_PT_GW_HSC2_FrP10_0fb271d2 (PduRDestPdu):
              PduRDestPduHandleId = 26
              PduRDestPduDirection = RECEIVE
              PduRDestPduRoutingType = API_FORWARDING
              PduRTransmissionConfirmation = false
              PduRDestPduRef = PT_GW_HSC2_FrP10_PP_GW_HSC2_FrP10_Rx_0fb271d2_c07658fd
              PduRDestPduPduRBswModulesRef = Com
          Can_PT_GW_HSC2_FrP13_0fb271d2: PduRRoutingPathCommunicationType=COMMUNICATION_INTERFACE  # GW_HSC2_FrP13_oCAN00
            SRC_Can_PT_GW_HSC2_FrP13_0fb271d2 (PduRSrcPdu):
              PduRSourcePduHandleId = 27
              PduRSrcPduDirection = RECEIVE
              PduRSrcPduRef = PT_GW_HSC2_FrP13_PP_GW_HSC2_FrP13_Rx_0fb271d2_c07658fd
              PduRSrcPduPduRBswModulesRef = CanIf
            DST_Can_PT_GW_HSC2_FrP13_0fb271d2 (PduRDestPdu):
              PduRDestPduHandleId = 27
              PduRDestPduDirection = RECEIVE
              PduRDestPduRoutingType = API_FORWARDING
              PduRTransmissionConfirmation = false
              PduRDestPduRef = PT_GW_HSC2_FrP13_PP_GW_HSC2_FrP13_Rx_0fb271d2_c07658fd
              PduRDestPduPduRBswModulesRef = Com
          Can_PT_Tester_HSC2_ECM_FrP00_0fb271d2: PduRRoutingPathCommunicationType=COMMUNICATION_INTERFACE  # Tester_HSC2_ECM_FrP00_oCAN00
            DST_Can_PT_Tester_HSC2_ECM_FrP00_0fb271d2 (PduRDestPdu):
              PduRDestPduHandleId = 62
              PduRDestPduDirection = RECEIVE
              PduRDestPduRoutingType = API_FORWARDING
              PduRTransmissionConfirmation = false
              PduRDestPduRef = PT_Tester_HSC2_ECM_FrP00_PP_Tester_HSC2_ECM_FrP00_Rx_0fb271d2_c07658fd
              PduRDestPduPduRBswModulesRef = Com
            SRC_Can_PT_Tester_HSC2_ECM_FrP00_0fb271d2 (PduRSrcPdu):
              PduRSourcePduHandleId = 60
              PduRSrcPduDirection = RECEIVE
              PduRSrcPduRef = PT_Tester_HSC2_ECM_FrP00_PP_Tester_HSC2_ECM_FrP00_Rx_0fb271d2_c07658fd
              PduRSrcPduPduRBswModulesRef = CanIf
          Can_PT_P2P_HSC2_FrP02_0fb271d2: PduRRoutingPathCommunicationType=COMMUNICATION_INTERFACE  # P2P_HSC2_FrP02_oCAN00
            DST_Can_PT_P2P_HSC2_FrP02_0fb271d2 (PduRDestPdu):
              PduRDestPduHandleId = 6
              PduRDestPduDirection = TRANSMIT
              PduRDestPduRoutingType = API_FORWARDING
              PduRDestPduDataProvision = PDUR_DIRECT
              PduRTransmissionConfirmation = false
              PduRDestPduRef = PT_P2P_HSC2_FrP02_PP_P2P_HSC2_FrP02_Tx_0fb271d2_c07658fd
              PduRDestPduPduRBswModulesRef = CanIf
            SRC_Can_PT_P2P_HSC2_FrP02_0fb271d2 (PduRSrcPdu):
              PduRSourcePduHandleId = 4
              PduRSrcPduDirection = TRANSMIT
              PduRSrcPduRef = PT_P2P_HSC2_FrP02_PP_P2P_HSC2_FrP02_Tx_0fb271d2_c07658fd
              PduRSrcPduPduRBswModulesRef = Com
          Can_PT_SCS_HSC2_FrP11_0fb271d2: PduRRoutingPathCommunicationType=COMMUNICATION_INTERFACE  # SCS_HSC2_FrP11_oCAN00
            SRC_Can_PT_SCS_HSC2_FrP11_0fb271d2 (PduRSrcPdu):
              PduRSourcePduHandleId = 55
              PduRSrcPduDirection = RECEIVE
              PduRSrcPduRef = PT_SCS_HSC2_FrP11_PP_SCS_HSC2_FrP11_Rx_0fb271d2_c07658fd
              PduRSrcPduPduRBswModulesRef = CanIf
            DST_Can_PT_SCS_HSC2_FrP11_0fb271d2 (PduRDestPdu):
              PduRDestPduHandleId = 57
              PduRDestPduDirection = RECEIVE
              PduRDestPduRoutingType = API_FORWARDING
              PduRTransmissionConfirmation = false
              PduRDestPduRef = PT_SCS_HSC2_FrP11_PP_SCS_HSC2_FrP11_Rx_0fb271d2_c07658fd
              PduRDestPduPduRBswModulesRef = Com
          Can_PT_EPB_HSC2_FrP01_0fb271d2: PduRRoutingPathCommunicationType=COMMUNICATION_INTERFACE  # EPB_HSC2_FrP01_oCAN00
            SRC_Can_PT_EPB_HSC2_FrP01_0fb271d2 (PduRSrcPdu):
              PduRSourcePduHandleId = 8
              PduRSrcPduDirection = RECEIVE
              PduRSrcPduRef = PT_EPB_HSC2_FrP01_PP_EPB_HSC2_FrP01_Rx_0fb271d2_c07658fd
              PduRSrcPduPduRBswModulesRef = CanIf
            DST_Can_PT_EPB_HSC2_FrP01_0fb271d2 (PduRDestPdu):
              PduRDestPduHandleId = 8
              PduRDestPduDirection = RECEIVE
              PduRDestPduRoutingType = API_FORWARDING
              PduRTransmissionConfirmation = false
              PduRDestPduRef = PT_EPB_HSC2_FrP01_PP_EPB_HSC2_FrP01_Rx_0fb271d2_c07658fd
              PduRDestPduPduRBswModulesRef = Com
          Can_PT_GW_HSC2_SDM_FrP00_0fb271d2: PduRRoutingPathCommunicationType=COMMUNICATION_INTERFACE  # GW_HSC2_SDM_FrP00_oCAN00
            DST_Can_PT_GW_HSC2_SDM_FrP00_0fb271d2 (PduRDestPdu):
              PduRDestPduHandleId = 34
              PduRDestPduDirection = RECEIVE
              PduRDestPduRoutingType = API_FORWARDING
              PduRTransmissionConfirmation = false
              PduRDestPduRef = PT_GW_HSC2_SDM_FrP00_PP_GW_HSC2_SDM_FrP00_Rx_0fb271d2_c07658fd
              PduRDestPduPduRBswModulesRef = Com
            SRC_Can_PT_GW_HSC2_SDM_FrP00_0fb271d2 (PduRSrcPdu):
              PduRSourcePduHandleId = 34
              PduRSrcPduDirection = RECEIVE
              PduRSrcPduRef = PT_GW_HSC2_SDM_FrP00_PP_GW_HSC2_SDM_FrP00_Rx_0fb271d2_c07658fd
              PduRSrcPduPduRBswModulesRef = CanIf
          Can_PT_GW_HSC2_FrP01_0fb271d2: PduRRoutingPathCommunicationType=COMMUNICATION_INTERFACE  # GW_HSC2_FrP01_oCAN00
            SRC_Can_PT_GW_HSC2_FrP01_0fb271d2 (PduRSrcPdu):
              PduRSourcePduHandleId = 24
              PduRSrcPduDirection = RECEIVE
              PduRSrcPduRef = PT_GW_HSC2_FrP01_PP_GW_HSC2_FrP01_Rx_0fb271d2_c07658fd
              PduRSrcPduPduRBswModulesRef = CanIf
            DST_Can_PT_GW_HSC2_FrP01_0fb271d2 (PduRDestPdu):
              PduRDestPduHandleId = 24
              PduRDestPduDirection = RECEIVE
              PduRDestPduRoutingType = API_FORWARDING
              PduRTransmissionConfirmation = false
              PduRDestPduRef = PT_GW_HSC2_FrP01_PP_GW_HSC2_FrP01_Rx_0fb271d2_c07658fd
              PduRDestPduPduRBswModulesRef = Com
          Can_PT_SCS_HSC2_FrP05_0fb271d2: PduRRoutingPathCommunicationType=COMMUNICATION_INTERFACE  # SCS_HSC2_FrP05_oCAN00
            SRC_Can_PT_SCS_HSC2_FrP05_0fb271d2 (PduRSrcPdu):
              PduRSourcePduHandleId = 54
              PduRSrcPduDirection = RECEIVE
              PduRSrcPduRef = PT_SCS_HSC2_FrP05_PP_SCS_HSC2_FrP05_Rx_0fb271d2_c07658fd
              PduRSrcPduPduRBswModulesRef = CanIf
            DST_Can_PT_SCS_HSC2_FrP05_0fb271d2 (PduRDestPdu):
              PduRDestPduHandleId = 56
              PduRDestPduDirection = RECEIVE
              PduRDestPduRoutingType = API_FORWARDING
              PduRTransmissionConfirmation = false
              PduRDestPduRef = PT_SCS_HSC2_FrP05_PP_SCS_HSC2_FrP05_Rx_0fb271d2_c07658fd
              PduRDestPduPduRBswModulesRef = Com
          Can_PT_P2P_HSC2_FrS01_0fb271d2: PduRRoutingPathCommunicationType=COMMUNICATION_INTERFACE  # P2P_HSC2_FrS01_oCAN00
            SRC_Can_PT_P2P_HSC2_FrS01_0fb271d2 (PduRSrcPdu):
              PduRSourcePduHandleId = 7
              PduRSrcPduDirection = TRANSMIT
              PduRSrcPduRef = PT_P2P_HSC2_FrS01_PP_P2P_HSC2_FrS01_Tx_0fb271d2_c07658fd
              PduRSrcPduPduRBswModulesRef = Com
            DST_Can_PT_P2P_HSC2_FrS01_0fb271d2 (PduRDestPdu):
              PduRDestPduHandleId = 9
              PduRDestPduDirection = TRANSMIT
              PduRDestPduRoutingType = API_FORWARDING
              PduRDestPduDataProvision = PDUR_DIRECT
              PduRTransmissionConfirmation = false
              PduRDestPduRef = PT_P2P_HSC2_FrS01_PP_P2P_HSC2_FrS01_Tx_0fb271d2_c07658fd
              PduRDestPduPduRBswModulesRef = CanIf
          Can_PT_Tester_HSC2_GW_FrP14_0fb271d2: PduRRoutingPathCommunicationType=COMMUNICATION_INTERFACE  # Tester_HSC2_GW_FrP14_oCAN00
            SRC_Can_PT_Tester_HSC2_GW_FrP14_0fb271d2 (PduRSrcPdu):
              PduRSourcePduHandleId = 61
              PduRSrcPduDirection = RECEIVE
              PduRSrcPduRef = PT_Tester_HSC2_GW_FrP14_PP_Tester_HSC2_GW_FrP14_Rx_0fb271d2_c07658fd
              PduRSrcPduPduRBswModulesRef = CanIf
            DST_Can_PT_Tester_HSC2_GW_FrP14_0fb271d2 (PduRDestPdu):
              PduRDestPduHandleId = 63
              PduRDestPduDirection = RECEIVE
              PduRDestPduRoutingType = API_FORWARDING
              PduRTransmissionConfirmation = false
              PduRDestPduRef = PT_Tester_HSC2_GW_FrP14_PP_Tester_HSC2_GW_FrP14_Rx_0fb271d2_c07658fd
              PduRDestPduPduRBswModulesRef = Com
          Can_PT_EHBS_HSC2_FrP00_0fb271d2: PduRRoutingPathCommunicationType=COMMUNICATION_INTERFACE  # EHBS_HSC2_FrP00_oCAN00
            SRC_Can_PT_EHBS_HSC2_FrP00_0fb271d2 (PduRSrcPdu):
              PduRSourcePduHandleId = 6
              PduRSrcPduDirection = RECEIVE
              PduRSrcPduRef = PT_EHBS_HSC2_FrP00_PP_EHBS_HSC2_FrP00_Rx_0fb271d2_c07658fd
              PduRSrcPduPduRBswModulesRef = CanIf
            DST_Can_PT_EHBS_HSC2_FrP00_0fb271d2 (PduRDestPdu):
              PduRDestPduHandleId = 6
              PduRDestPduDirection = RECEIVE
              PduRDestPduRoutingType = API_FORWARDING
              PduRTransmissionConfirmation = false
              PduRDestPduRef = PT_EHBS_HSC2_FrP00_PP_EHBS_HSC2_FrP00_Rx_0fb271d2_c07658fd
              PduRDestPduPduRBswModulesRef = Com
          Can_PT_GW_HSC2_HCU_FrP00_0fb271d2: PduRRoutingPathCommunicationType=COMMUNICATION_INTERFACE  # GW_HSC2_HCU_FrP00_oCAN00
            SRC_Can_PT_GW_HSC2_HCU_FrP00_0fb271d2 (PduRSrcPdu):
              PduRSourcePduHandleId = 29
              PduRSrcPduDirection = RECEIVE
              PduRSrcPduRef = PT_GW_HSC2_HCU_FrP00_PP_GW_HSC2_HCU_FrP00_Rx_0fb271d2_c07658fd
              PduRSrcPduPduRBswModulesRef = CanIf
            DST_Can_PT_GW_HSC2_HCU_FrP00_0fb271d2 (PduRDestPdu):
              PduRDestPduHandleId = 29
              PduRDestPduDirection = RECEIVE
              PduRDestPduRoutingType = API_FORWARDING
              PduRTransmissionConfirmation = false
              PduRDestPduRef = PT_GW_HSC2_HCU_FrP00_PP_GW_HSC2_HCU_FrP00_Rx_0fb271d2_c07658fd
              PduRDestPduPduRBswModulesRef = Com
          Can_PT_GW_HSC2_FICM_FrP02_0fb271d2: PduRRoutingPathCommunicationType=COMMUNICATION_INTERFACE  # GW_HSC2_FICM_FrP02_oCAN00
            SRC_Can_PT_GW_HSC2_FICM_FrP02_0fb271d2 (PduRSrcPdu):
              PduRSourcePduHandleId = 21
              PduRSrcPduDirection = RECEIVE
              PduRSrcPduRef = PT_GW_HSC2_FICM_FrP02_PP_GW_HSC2_FICM_FrP02_Rx_0fb271d2_c07658fd
              PduRSrcPduPduRBswModulesRef = CanIf
            DST_Can_PT_GW_HSC2_FICM_FrP02_0fb271d2 (PduRDestPdu):
              PduRDestPduHandleId = 21
              PduRDestPduDirection = RECEIVE
              PduRDestPduRoutingType = API_FORWARDING
              PduRTransmissionConfirmation = false
              PduRDestPduRef = PT_GW_HSC2_FICM_FrP02_PP_GW_HSC2_FICM_FrP02_Rx_0fb271d2_c07658fd
              PduRDestPduPduRBswModulesRef = Com
          Can_PT_SCS_HSC2_FrP02_0fb271d2: PduRRoutingPathCommunicationType=COMMUNICATION_INTERFACE  # SCS_HSC2_FrP02_oCAN00
            DST_Can_PT_SCS_HSC2_FrP02_0fb271d2 (PduRDestPdu):
              PduRDestPduHandleId = 54
              PduRDestPduDirection = RECEIVE
              PduRDestPduRoutingType = API_FORWARDING
              PduRTransmissionConfirmation = false
              PduRDestPduRef = PT_SCS_HSC2_FrP02_PP_SCS_HSC2_FrP02_Rx_0fb271d2_c07658fd
              PduRDestPduPduRBswModulesRef = Com
            SRC_Can_PT_SCS_HSC2_FrP02_0fb271d2 (PduRSrcPdu):
              PduRSourcePduHandleId = 52
              PduRSrcPduDirection = RECEIVE
              PduRSrcPduRef = PT_SCS_HSC2_FrP02_PP_SCS_HSC2_FrP02_Rx_0fb271d2_c07658fd
              PduRSrcPduPduRBswModulesRef = CanIf
          Can_PT_GW_HSC2_FICM_FrP08_0fb271d2: PduRRoutingPathCommunicationType=COMMUNICATION_INTERFACE  # GW_HSC2_FICM_FrP08_oCAN00
            SRC_Can_PT_GW_HSC2_FICM_FrP08_0fb271d2 (PduRSrcPdu):
              PduRSourcePduHandleId = 22
              PduRSrcPduDirection = RECEIVE
              PduRSrcPduRef = PT_GW_HSC2_FICM_FrP08_PP_GW_HSC2_FICM_FrP08_Rx_0fb271d2_c07658fd
              PduRSrcPduPduRBswModulesRef = CanIf
            DST_Can_PT_GW_HSC2_FICM_FrP08_0fb271d2 (PduRDestPdu):
              PduRDestPduHandleId = 22
              PduRDestPduDirection = RECEIVE
              PduRDestPduRoutingType = API_FORWARDING
              PduRTransmissionConfirmation = false
              PduRDestPduRef = PT_GW_HSC2_FICM_FrP08_PP_GW_HSC2_FICM_FrP08_Rx_0fb271d2_c07658fd
              PduRDestPduPduRBswModulesRef = Com
          Can_PT_P2P_DIAG_DTCInfo_APA_0fb271d2: PduRRoutingPathCommunicationType=COMMUNICATION_INTERFACE  # P2P_DIAG_DTCInfo_APA_oCAN00
            SRC_Can_PT_P2P_DIAG_DTCInfo_APA_0fb271d2 (PduRSrcPdu):
              PduRSourcePduHandleId = 1
              PduRSrcPduDirection = TRANSMIT
              PduRSrcPduRef = PT_P2P_DIAG_DTCInfo_APA_PP_P2P_DIAG_DTCInfo_APA_Tx_0fb271d2_c07658fd
              PduRSrcPduPduRBswModulesRef = Com
            DST_Can_PT_P2P_DIAG_DTCInfo_APA_0fb271d2 (PduRDestPdu):
              PduRDestPduHandleId = 3
              PduRDestPduDirection = TRANSMIT
              PduRDestPduRoutingType = API_FORWARDING
              PduRDestPduDataProvision = PDUR_DIRECT
              PduRTransmissionConfirmation = false
              PduRDestPduRef = PT_P2P_DIAG_DTCInfo_APA_PP_P2P_DIAG_DTCInfo_APA_Tx_0fb271d2_c07658fd
              PduRDestPduPduRBswModulesRef = CanIf
          Can_PT_GW_HSC2_BCM_FrP04_0fb271d2: PduRRoutingPathCommunicationType=COMMUNICATION_INTERFACE  # GW_HSC2_BCM_FrP04_oCAN00
            DST_Can_PT_GW_HSC2_BCM_FrP04_0fb271d2 (PduRDestPdu):
              PduRDestPduHandleId = 16
              PduRDestPduDirection = RECEIVE
              PduRDestPduRoutingType = API_FORWARDING
              PduRTransmissionConfirmation = false
              PduRDestPduRef = PT_GW_HSC2_BCM_FrP04_PP_GW_HSC2_BCM_FrP04_Rx_0fb271d2_c07658fd
              PduRDestPduPduRBswModulesRef = Com
            SRC_Can_PT_GW_HSC2_BCM_FrP04_0fb271d2 (PduRSrcPdu):
              PduRSourcePduHandleId = 16
              PduRSrcPduDirection = RECEIVE
              PduRSrcPduRef = PT_GW_HSC2_BCM_FrP04_PP_GW_HSC2_BCM_FrP04_Rx_0fb271d2_c07658fd
              PduRSrcPduPduRBswModulesRef = CanIf
          Can_PT_GW_HSC2_FrS00_0fb271d2: PduRRoutingPathCommunicationType=COMMUNICATION_INTERFACE  # GW_HSC2_FrS00_oCAN00
            SRC_Can_PT_GW_HSC2_FrS00_0fb271d2 (PduRSrcPdu):
              PduRSourcePduHandleId = 28
              PduRSrcPduDirection = RECEIVE
              PduRSrcPduRef = PT_GW_HSC2_FrS00_PP_GW_HSC2_FrS00_Rx_0fb271d2_c07658fd
              PduRSrcPduPduRBswModulesRef = CanIf
            DST_Can_PT_GW_HSC2_FrS00_0fb271d2 (PduRDestPdu):
              PduRDestPduHandleId = 28
              PduRDestPduDirection = RECEIVE
              PduRDestPduRoutingType = API_FORWARDING
              PduRTransmissionConfirmation = false
              PduRDestPduRef = PT_GW_HSC2_FrS00_PP_GW_HSC2_FrS00_Rx_0fb271d2_c07658fd
              PduRDestPduPduRBswModulesRef = Com
          Can_PT_GW_HSC2_BCM_FrP07_0fb271d2: PduRRoutingPathCommunicationType=COMMUNICATION_INTERFACE  # GW_HSC2_BCM_FrP07_oCAN00
            SRC_Can_PT_GW_HSC2_BCM_FrP07_0fb271d2 (PduRSrcPdu):
              PduRSourcePduHandleId = 18
              PduRSrcPduDirection = RECEIVE
              PduRSrcPduRef = PT_GW_HSC2_BCM_FrP07_PP_GW_HSC2_BCM_FrP07_Rx_0fb271d2_c07658fd
              PduRSrcPduPduRBswModulesRef = CanIf
            DST_Can_PT_GW_HSC2_BCM_FrP07_0fb271d2 (PduRDestPdu):
              PduRDestPduHandleId = 18
              PduRDestPduDirection = RECEIVE
              PduRDestPduRoutingType = API_FORWARDING
              PduRTransmissionConfirmation = false
              PduRDestPduRef = PT_GW_HSC2_BCM_FrP07_PP_GW_HSC2_BCM_FrP07_Rx_0fb271d2_c07658fd
              PduRDestPduPduRBswModulesRef = Com
          Can_PT_GW_HSC2_HCU_FrP01_0fb271d2: PduRRoutingPathCommunicationType=COMMUNICATION_INTERFACE  # GW_HSC2_HCU_FrP01_oCAN00
            DST_Can_PT_GW_HSC2_HCU_FrP01_0fb271d2 (PduRDestPdu):
              PduRDestPduHandleId = 30
              PduRDestPduDirection = RECEIVE
              PduRDestPduRoutingType = API_FORWARDING
              PduRTransmissionConfirmation = false
              PduRDestPduRef = PT_GW_HSC2_HCU_FrP01_PP_GW_HSC2_HCU_FrP01_Rx_0fb271d2_c07658fd
              PduRDestPduPduRBswModulesRef = Com
            SRC_Can_PT_GW_HSC2_HCU_FrP01_0fb271d2 (PduRSrcPdu):
              PduRSourcePduHandleId = 30
              PduRSrcPduDirection = RECEIVE
              PduRSrcPduRef = PT_GW_HSC2_HCU_FrP01_PP_GW_HSC2_HCU_FrP01_Rx_0fb271d2_c07658fd
              PduRSrcPduPduRBswModulesRef = CanIf
          Can_PT_SCS_HSC2_FrP01_0fb271d2: PduRRoutingPathCommunicationType=COMMUNICATION_INTERFACE  # SCS_HSC2_FrP01_oCAN00
            DST_Can_PT_SCS_HSC2_FrP01_0fb271d2 (PduRDestPdu):
              PduRDestPduHandleId = 53
              PduRDestPduDirection = RECEIVE
              PduRDestPduRoutingType = API_FORWARDING
              PduRTransmissionConfirmation = false
              PduRDestPduRef = PT_SCS_HSC2_FrP01_PP_SCS_HSC2_FrP01_Rx_0fb271d2_c07658fd
              PduRDestPduPduRBswModulesRef = Com
            SRC_Can_PT_SCS_HSC2_FrP01_0fb271d2 (PduRSrcPdu):
              PduRSourcePduHandleId = 51
              PduRSrcPduDirection = RECEIVE
              PduRSrcPduRef = PT_SCS_HSC2_FrP01_PP_SCS_HSC2_FrP01_Rx_0fb271d2_c07658fd
              PduRSrcPduPduRBswModulesRef = CanIf
          Can_PT_GW_HSC2_SCU_FrP00_0fb271d2: PduRRoutingPathCommunicationType=COMMUNICATION_INTERFACE  # GW_HSC2_SCU_FrP00_oCAN00
            DST_Can_PT_GW_HSC2_SCU_FrP00_0fb271d2 (PduRDestPdu):
              PduRDestPduHandleId = 33
              PduRDestPduDirection = RECEIVE
              PduRDestPduRoutingType = API_FORWARDING
              PduRTransmissionConfirmation = false
              PduRDestPduRef = PT_GW_HSC2_SCU_FrP00_PP_GW_HSC2_SCU_FrP00_Rx_0fb271d2_c07658fd
              PduRDestPduPduRBswModulesRef = Com
            SRC_Can_PT_GW_HSC2_SCU_FrP00_0fb271d2 (PduRSrcPdu):
              PduRSourcePduHandleId = 33
              PduRSrcPduDirection = RECEIVE
              PduRSrcPduRef = PT_GW_HSC2_SCU_FrP00_PP_GW_HSC2_SCU_FrP00_Rx_0fb271d2_c07658fd
              PduRSrcPduPduRBswModulesRef = CanIf
          Can_PT_GW_HSC2_IPK_FrP06_0fb271d2: PduRRoutingPathCommunicationType=COMMUNICATION_INTERFACE  # GW_HSC2_IPK_FrP06_oCAN00
            DST_Can_PT_GW_HSC2_IPK_FrP06_0fb271d2 (PduRDestPdu):
              PduRDestPduHandleId = 32
              PduRDestPduDirection = RECEIVE
              PduRDestPduRoutingType = API_FORWARDING
              PduRTransmissionConfirmation = false
              PduRDestPduRef = PT_GW_HSC2_IPK_FrP06_PP_GW_HSC2_IPK_FrP06_Rx_0fb271d2_c07658fd
              PduRDestPduPduRBswModulesRef = Com
            SRC_Can_PT_GW_HSC2_IPK_FrP06_0fb271d2 (PduRSrcPdu):
              PduRSourcePduHandleId = 32
              PduRSrcPduDirection = RECEIVE
              PduRSrcPduRef = PT_GW_HSC2_IPK_FrP06_PP_GW_HSC2_IPK_FrP06_Rx_0fb271d2_c07658fd
              PduRSrcPduPduRBswModulesRef = CanIf
          Can_PT_GW_HSC2_HCU_FrP13_0fb271d2: PduRRoutingPathCommunicationType=COMMUNICATION_INTERFACE  # GW_HSC2_HCU_FrP13_oCAN00
            SRC_Can_PT_GW_HSC2_HCU_FrP13_0fb271d2 (PduRSrcPdu):
              PduRSourcePduHandleId = 31
              PduRSrcPduDirection = RECEIVE
              PduRSrcPduRef = PT_GW_HSC2_HCU_FrP13_PP_GW_HSC2_HCU_FrP13_Rx_0fb271d2_c07658fd
              PduRSrcPduPduRBswModulesRef = CanIf
            DST_Can_PT_GW_HSC2_HCU_FrP13_0fb271d2 (PduRDestPdu):
              PduRDestPduHandleId = 31
              PduRDestPduDirection = RECEIVE
              PduRDestPduRoutingType = API_FORWARDING
              PduRTransmissionConfirmation = false
              PduRDestPduRef = PT_GW_HSC2_HCU_FrP13_PP_GW_HSC2_HCU_FrP13_Rx_0fb271d2_c07658fd
              PduRDestPduPduRBswModulesRef = Com
          Can_PT_GW_HSC2_BCM_FrS16_0fb271d2: PduRRoutingPathCommunicationType=COMMUNICATION_INTERFACE  # GW_HSC2_BCM_FrS16_oCAN00
            DST_Can_PT_GW_HSC2_BCM_FrS16_0fb271d2 (PduRDestPdu):
              PduRDestPduHandleId = 19
              PduRDestPduDirection = RECEIVE
              PduRDestPduRoutingType = API_FORWARDING
              PduRTransmissionConfirmation = false
              PduRDestPduRef = PT_GW_HSC2_BCM_FrS16_PP_GW_HSC2_BCM_FrS16_Rx_0fb271d2_c07658fd
              PduRDestPduPduRBswModulesRef = Com
            SRC_Can_PT_GW_HSC2_BCM_FrS16_0fb271d2 (PduRSrcPdu):
              PduRSourcePduHandleId = 19
              PduRSrcPduDirection = RECEIVE
              PduRSrcPduRef = PT_GW_HSC2_BCM_FrS16_PP_GW_HSC2_BCM_FrS16_Rx_0fb271d2_c07658fd
              PduRSrcPduPduRBswModulesRef = CanIf
          Can_PT_EPS_HSC2_FrP02_0fb271d2: PduRRoutingPathCommunicationType=COMMUNICATION_INTERFACE  # EPS_HSC2_FrP02_oCAN00
            SRC_Can_PT_EPS_HSC2_FrP02_0fb271d2 (PduRSrcPdu):
              PduRSourcePduHandleId = 9
              PduRSrcPduDirection = RECEIVE
              PduRSrcPduRef = PT_EPS_HSC2_FrP02_PP_EPS_HSC2_FrP02_Rx_0fb271d2_c07658fd
              PduRSrcPduPduRBswModulesRef = CanIf
            DST_Can_PT_EPS_HSC2_FrP02_0fb271d2 (PduRDestPdu):
              PduRDestPduHandleId = 9
              PduRDestPduDirection = RECEIVE
              PduRDestPduRoutingType = API_FORWARDING
              PduRTransmissionConfirmation = false
              PduRDestPduRef = PT_EPS_HSC2_FrP02_PP_EPS_HSC2_FrP02_Rx_0fb271d2_c07658fd
              PduRDestPduPduRBswModulesRef = Com
          Can_PT_P2P_HSC2_FrP00_0fb271d2: PduRRoutingPathCommunicationType=COMMUNICATION_INTERFACE  # P2P_HSC2_FrP00_oCAN00
            SRC_Can_PT_P2P_HSC2_FrP00_0fb271d2 (PduRSrcPdu):
              PduRSourcePduHandleId = 2
              PduRSrcPduDirection = TRANSMIT
              PduRSrcPduRef = PT_P2P_HSC2_FrP00_PP_P2P_HSC2_FrP00_Tx_0fb271d2_c07658fd
              PduRSrcPduPduRBswModulesRef = Com
            DST_Can_PT_P2P_HSC2_FrP00_0fb271d2 (PduRDestPdu):
              PduRDestPduHandleId = 4
              PduRDestPduDirection = TRANSMIT
              PduRDestPduRoutingType = API_FORWARDING
              PduRDestPduDataProvision = PDUR_DIRECT
              PduRTransmissionConfirmation = false
              PduRDestPduRef = PT_P2P_HSC2_FrP00_PP_P2P_HSC2_FrP00_Tx_0fb271d2_c07658fd
              PduRDestPduPduRBswModulesRef = CanIf
          Can_PT_GW_HSC2_FrP00_0fb271d2: PduRRoutingPathCommunicationType=COMMUNICATION_INTERFACE  # GW_HSC2_FrP00_oCAN00
            DST_Can_PT_GW_HSC2_FrP00_0fb271d2 (PduRDestPdu):
              PduRDestPduHandleId = 23
              PduRDestPduDirection = RECEIVE
              PduRDestPduRoutingType = API_FORWARDING
              PduRTransmissionConfirmation = false
              PduRDestPduRef = PT_GW_HSC2_FrP00_PP_GW_HSC2_FrP00_Rx_0fb271d2_c07658fd
              PduRDestPduPduRBswModulesRef = Com
            SRC_Can_PT_GW_HSC2_FrP00_0fb271d2 (PduRSrcPdu):
              PduRSourcePduHandleId = 23
              PduRSrcPduDirection = RECEIVE
              PduRSrcPduRef = PT_GW_HSC2_FrP00_PP_GW_HSC2_FrP00_Rx_0fb271d2_c07658fd
              PduRSrcPduPduRBswModulesRef = CanIf
          Can_PT_P2P_HSC2_FrP03_0fb271d2: PduRRoutingPathCommunicationType=COMMUNICATION_INTERFACE  # P2P_HSC2_FrP03_oCAN00
            DST_Can_PT_P2P_HSC2_FrP03_0fb271d2 (PduRDestPdu):
              PduRDestPduHandleId = 7
              PduRDestPduDirection = TRANSMIT
              PduRDestPduRoutingType = API_FORWARDING
              PduRDestPduDataProvision = PDUR_DIRECT
              PduRTransmissionConfirmation = false
              PduRDestPduRef = PT_P2P_HSC2_FrP03_PP_P2P_HSC2_FrP03_Tx_0fb271d2_c07658fd
              PduRDestPduPduRBswModulesRef = CanIf
            SRC_Can_PT_P2P_HSC2_FrP03_0fb271d2 (PduRSrcPdu):
              PduRSourcePduHandleId = 5
              PduRSrcPduDirection = TRANSMIT
              PduRSrcPduRef = PT_P2P_HSC2_FrP03_PP_P2P_HSC2_FrP03_Tx_0fb271d2_c07658fd
              PduRSrcPduPduRBswModulesRef = Com
          Can_PT_GW_HSC2_FrP08_0fb271d2: PduRRoutingPathCommunicationType=COMMUNICATION_INTERFACE  # GW_HSC2_FrP08_oCAN00
            SRC_Can_PT_GW_HSC2_FrP08_0fb271d2 (PduRSrcPdu):
              PduRSourcePduHandleId = 25
              PduRSrcPduDirection = RECEIVE
              PduRSrcPduRef = PT_GW_HSC2_FrP08_PP_GW_HSC2_FrP08_Rx_0fb271d2_c07658fd
              PduRSrcPduPduRBswModulesRef = CanIf
            DST_Can_PT_GW_HSC2_FrP08_0fb271d2 (PduRDestPdu):
              PduRDestPduHandleId = 25
              PduRDestPduDirection = RECEIVE
              PduRDestPduRoutingType = API_FORWARDING
              PduRTransmissionConfirmation = false
              PduRDestPduRef = PT_GW_HSC2_FrP08_PP_GW_HSC2_FrP08_Rx_0fb271d2_c07658fd
              PduRDestPduPduRBswModulesRef = Com
          Can_diag_Functional_request: PduRRoutingPathCommunicationType=TRANSPORT_PROTOCOL
            PduRDestPdu:
              PduRDestPduHandleId = 0
              PduRDestPduDirection = RECEIVE
              PduRDestPduRoutingType = API_FORWARDING
              PduRDestPduPduRBswModulesRef = Dcm
              PduRDestPduRef = diag_PUDR_Functional_request
            PduRSrcPdu:
              PduRSourcePduHandleId = 0
              PduRSrcPduDirection = RECEIVE
              PduRSrcPduPduRBswModulesRef = CanTp
              PduRSrcPduRef = PT_DIAG_FuncReq_HSC2_PP_DIAG_FuncReq_HSC2_Rx_0fb271d2_c07658fd
          Can_diag_physical_request: PduRRoutingPathCommunicationType=TRANSPORT_PROTOCOL
            PduRDestPdu_1 (PduRDestPdu):
              PduRDestPduHandleId = 1
              PduRDestPduDirection = RECEIVE
              PduRDestPduRoutingType = API_FORWARDING
              PduRDestPduRef = diag_PUDR_Physical_request
              PduRDestPduPduRBswModulesRef = Dcm
            PduRSrcPdu_1 (PduRSrcPdu):
              PduRSourcePduHandleId = 1
              PduRSrcPduDirection = RECEIVE
              PduRSrcPduRef = PT_DIAG_PhysReq_P2P_PP_DIAG_PhysReq_P2P_Rx_0fb271d2_c07658fd
              PduRSrcPduPduRBswModulesRef = CanTp
          Can_diag_response: PduRRoutingPathCommunicationType=TRANSPORT_PROTOCOL
            PduRDestPdu_2 (PduRDestPdu):
              PduRDestPduHandleId = 0
              PduRDestPduDirection = TRANSMIT
              PduRDestPduRoutingType = API_FORWARDING
              PduRDestPduRef = PT_DIAG_PhysResp_P2P_PP_DIAG_PhysResp_P2P_Tx_0fb271d2_c07658fd
              PduRDestPduPduRBswModulesRef = CanTp
            PduRSrcPdu_2 (PduRSrcPdu): PduRSourcePduHandleId=46, PduRSrcPduDirection=TRANSMIT, PduRSrcPduRef=diag_PDUR_response, PduRSrcPduPduRBswModulesRef=Dcm
          Can_PT_RDA_HSC4_P02_c4eea277: PduRRoutingPathCommunicationType=COMMUNICATION_INTERFACE  # RDA_HSC4_P02_oCAN01
            DST_Can_PT_RDA_HSC4_P02_c4eea277 (PduRDestPdu):
              PduRDestPduHandleId = 48
              PduRDestPduDirection = RECEIVE
              PduRDestPduRoutingType = API_FORWARDING
              PduRTransmissionConfirmation = false
              PduRDestPduRef = PT_RDA_HSC4_P02_PP_RDA_HSC4_P02_Rx_c4eea277_b771686b
              PduRDestPduPduRBswModulesRef = Com
            SRC_Can_PT_RDA_HSC4_P02_c4eea277 (PduRSrcPdu):
              PduRSourcePduHandleId = 48
              PduRSrcPduDirection = RECEIVE
              PduRSrcPduRef = PT_RDA_HSC4_P02_PP_RDA_HSC4_P02_Rx_c4eea277_b771686b
              PduRSrcPduPduRBswModulesRef = CanIf
          Can_PT_FICM_HSC4_FrP32_c4eea277: PduRRoutingPathCommunicationType=COMMUNICATION_INTERFACE  # FICM_HSC4_FrP32_oCAN01
            DST_Can_PT_FICM_HSC4_FrP32_c4eea277 (PduRDestPdu):
              PduRDestPduHandleId = 14
              PduRDestPduDirection = RECEIVE
              PduRDestPduRoutingType = API_FORWARDING
              PduRTransmissionConfirmation = false
              PduRDestPduRef = PT_FICM_HSC4_FrP32_PP_FICM_HSC4_FrP32_Rx_c4eea277_b771686b
              PduRDestPduPduRBswModulesRef = Com
            SRC_Can_PT_FICM_HSC4_FrP32_c4eea277 (PduRSrcPdu):
              PduRSourcePduHandleId = 14
              PduRSrcPduDirection = RECEIVE
              PduRSrcPduRef = PT_FICM_HSC4_FrP32_PP_FICM_HSC4_FrP32_Rx_c4eea277_b771686b
              PduRSrcPduPduRBswModulesRef = CanIf
          Can_PT_GW_HSC4_BCM_FrS10_c4eea277: PduRRoutingPathCommunicationType=COMMUNICATION_INTERFACE  # GW_HSC4_BCM_FrS10_oCAN01
            DST_Can_PT_GW_HSC4_BCM_FrS10_c4eea277 (PduRDestPdu):
              PduRDestPduHandleId = 37
              PduRDestPduDirection = RECEIVE
              PduRDestPduRoutingType = API_FORWARDING
              PduRTransmissionConfirmation = false
              PduRDestPduRef = PT_GW_HSC4_BCM_FrS10_PP_GW_HSC4_BCM_FrS10_Rx_c4eea277_b771686b
              PduRDestPduPduRBswModulesRef = Com
            SRC_Can_PT_GW_HSC4_BCM_FrS10_c4eea277 (PduRSrcPdu):
              PduRSourcePduHandleId = 37
              PduRSrcPduDirection = RECEIVE
              PduRSrcPduRef = PT_GW_HSC4_BCM_FrS10_PP_GW_HSC4_BCM_FrS10_Rx_c4eea277_b771686b
              PduRSrcPduPduRBswModulesRef = CanIf
          Can_PT_IPK_HSC4_FrP06_c4eea277: PduRRoutingPathCommunicationType=COMMUNICATION_INTERFACE  # IPK_HSC4_FrP06_oCAN01
            SRC_Can_PT_IPK_HSC4_FrP06_c4eea277 (PduRSrcPdu):
              PduRSourcePduHandleId = 45
              PduRSrcPduDirection = RECEIVE
              PduRSrcPduRef = PT_IPK_HSC4_FrP06_PP_IPK_HSC4_FrP06_Rx_c4eea277_b771686b
              PduRSrcPduPduRBswModulesRef = CanIf
            DST_Can_PT_IPK_HSC4_FrP06_c4eea277 (PduRDestPdu):
              PduRDestPduHandleId = 45
              PduRDestPduDirection = RECEIVE
              PduRDestPduRoutingType = API_FORWARDING
              PduRTransmissionConfirmation = false
              PduRDestPduRef = PT_IPK_HSC4_FrP06_PP_IPK_HSC4_FrP06_Rx_c4eea277_b771686b
              PduRDestPduPduRBswModulesRef = Com
          Can_PT_P2P_HSC4_FrS01_c4eea277: PduRRoutingPathCommunicationType=COMMUNICATION_INTERFACE  # P2P_HSC4_FrS01_oCAN01
            DST_Can_PT_P2P_HSC4_FrS01_c4eea277 (PduRDestPdu):
              PduRDestPduHandleId = 11
              PduRDestPduDirection = TRANSMIT
              PduRDestPduRoutingType = API_FORWARDING
              PduRTransmissionConfirmation = false
              PduRDestPduDataProvision = PDUR_DIRECT
              PduRDestPduRef = PT_P2P_HSC4_FrS01_PP_P2P_HSC4_FrS01_Tx_c4eea277_b771686b
              PduRDestPduPduRBswModulesRef = CanIf
            SRC_Can_PT_P2P_HSC4_FrS01_c4eea277 (PduRSrcPdu):
              PduRSourcePduHandleId = 9
              PduRSrcPduDirection = TRANSMIT
              PduRSrcPduRef = PT_P2P_HSC4_FrS01_PP_P2P_HSC4_FrS01_Tx_c4eea277_b771686b
              PduRSrcPduPduRBswModulesRef = Com
          Can_PT_FICM_HSC4_FrP02_c4eea277: PduRRoutingPathCommunicationType=COMMUNICATION_INTERFACE  # FICM_HSC4_FrP02_oCAN01
            SRC_Can_PT_FICM_HSC4_FrP02_c4eea277 (PduRSrcPdu):
              PduRSourcePduHandleId = 10
              PduRSrcPduDirection = RECEIVE
              PduRSrcPduRef = PT_FICM_HSC4_FrP02_PP_FICM_HSC4_FrP02_Rx_c4eea277_b771686b
              PduRSrcPduPduRBswModulesRef = CanIf
            DST_Can_PT_FICM_HSC4_FrP02_c4eea277 (PduRDestPdu):
              PduRDestPduHandleId = 10
              PduRDestPduDirection = RECEIVE
              PduRDestPduRoutingType = API_FORWARDING
              PduRTransmissionConfirmation = false
              PduRDestPduRef = PT_FICM_HSC4_FrP02_PP_FICM_HSC4_FrP02_Rx_c4eea277_b771686b
              PduRDestPduPduRBswModulesRef = Com
          Can_PT_FICM_HSC4_FrP08_c4eea277: PduRRoutingPathCommunicationType=COMMUNICATION_INTERFACE  # FICM_HSC4_FrP08_oCAN01
            SRC_Can_PT_FICM_HSC4_FrP08_c4eea277 (PduRSrcPdu):
              PduRSourcePduHandleId = 11
              PduRSrcPduDirection = RECEIVE
              PduRSrcPduRef = PT_FICM_HSC4_FrP08_PP_FICM_HSC4_FrP08_Rx_c4eea277_b771686b
              PduRSrcPduPduRBswModulesRef = CanIf
            DST_Can_PT_FICM_HSC4_FrP08_c4eea277 (PduRDestPdu):
              PduRDestPduHandleId = 11
              PduRDestPduDirection = RECEIVE
              PduRDestPduRoutingType = API_FORWARDING
              PduRTransmissionConfirmation = false
              PduRDestPduRef = PT_FICM_HSC4_FrP08_PP_FICM_HSC4_FrP08_Rx_c4eea277_b771686b
              PduRDestPduPduRBswModulesRef = Com
          Can_PT_FICM_HSC4_FrP13_c4eea277: PduRRoutingPathCommunicationType=COMMUNICATION_INTERFACE  # FICM_HSC4_FrP13_oCAN01
            DST_Can_PT_FICM_HSC4_FrP13_c4eea277 (PduRDestPdu):
              PduRDestPduHandleId = 12
              PduRDestPduDirection = RECEIVE
              PduRDestPduRoutingType = API_FORWARDING
              PduRTransmissionConfirmation = false
              PduRDestPduRef = PT_FICM_HSC4_FrP13_PP_FICM_HSC4_FrP13_Rx_c4eea277_b771686b
              PduRDestPduPduRBswModulesRef = Com
            SRC_Can_PT_FICM_HSC4_FrP13_c4eea277 (PduRSrcPdu):
              PduRSourcePduHandleId = 12
              PduRSrcPduDirection = RECEIVE
              PduRSrcPduRef = PT_FICM_HSC4_FrP13_PP_FICM_HSC4_FrP13_Rx_c4eea277_b771686b
              PduRSrcPduPduRBswModulesRef = CanIf
          Can_PT_GW_HSC4_BCM_FrP04_c4eea277: PduRRoutingPathCommunicationType=COMMUNICATION_INTERFACE  # GW_HSC4_BCM_FrP04_oCAN01
            DST_Can_PT_GW_HSC4_BCM_FrP04_c4eea277 (PduRDestPdu):
              PduRDestPduHandleId = 35
              PduRDestPduDirection = RECEIVE
              PduRDestPduRoutingType = API_FORWARDING
              PduRTransmissionConfirmation = false
              PduRDestPduRef = PT_GW_HSC4_BCM_FrP04_PP_GW_HSC4_BCM_FrP04_Rx_c4eea277_b771686b
              PduRDestPduPduRBswModulesRef = Com
            SRC_Can_PT_GW_HSC4_BCM_FrP04_c4eea277 (PduRSrcPdu):
              PduRSourcePduHandleId = 35
              PduRSrcPduDirection = RECEIVE
              PduRSrcPduRef = PT_GW_HSC4_BCM_FrP04_PP_GW_HSC4_BCM_FrP04_Rx_c4eea277_b771686b
              PduRSrcPduPduRBswModulesRef = CanIf
          Can_PT_P2P_IECU_HSC4_FrP02_c4eea277: PduRRoutingPathCommunicationType=COMMUNICATION_INTERFACE  # P2P_IECU_HSC4_FrP02_oCAN01
            DST_Can_PT_P2P_IECU_HSC4_FrP02_c4eea277 (PduRDestPdu):
              PduRDestPduHandleId = 13
              PduRDestPduDirection = TRANSMIT
              PduRDestPduRoutingType = API_FORWARDING
              PduRTransmissionConfirmation = false
              PduRDestPduDataProvision = PDUR_DIRECT
              PduRDestPduRef = PT_P2P_IECU_HSC4_FrP02_PP_P2P_IECU_HSC4_FrP02_Tx_c4eea277_b771686b
              PduRDestPduPduRBswModulesRef = CanIf
            SRC_Can_PT_P2P_IECU_HSC4_FrP02_c4eea277 (PduRSrcPdu):
              PduRSourcePduHandleId = 11
              PduRSrcPduDirection = TRANSMIT
              PduRSrcPduRef = PT_P2P_IECU_HSC4_FrP02_PP_P2P_IECU_HSC4_FrP02_Tx_c4eea277_b771686b
              PduRSrcPduPduRBswModulesRef = Com
          Can_PT_TPMS_HSC3_FrP02_c4eea277: PduRRoutingPathCommunicationType=COMMUNICATION_INTERFACE  # TPMS_HSC3_FrP02_oCAN01
            DST_Can_PT_TPMS_HSC3_FrP02_c4eea277 (PduRDestPdu):
              PduRDestPduHandleId = 61
              PduRDestPduDirection = RECEIVE
              PduRDestPduRoutingType = API_FORWARDING
              PduRTransmissionConfirmation = false
              PduRDestPduRef = PT_TPMS_HSC3_FrP02_PP_TPMS_HSC3_FrP02_Rx_c4eea277_b771686b
              PduRDestPduPduRBswModulesRef = Com
            SRC_Can_PT_TPMS_HSC3_FrP02_c4eea277 (PduRSrcPdu):
              PduRSourcePduHandleId = 59
              PduRSrcPduDirection = RECEIVE
              PduRSrcPduRef = PT_TPMS_HSC3_FrP02_PP_TPMS_HSC3_FrP02_Rx_c4eea277_b771686b
              PduRSrcPduPduRBswModulesRef = CanIf
          Can_PT_GW_HSC4_PEPS_FrP01_c4eea277: PduRRoutingPathCommunicationType=COMMUNICATION_INTERFACE  # GW_HSC4_PEPS_FrP01_oCAN01
            DST_Can_PT_GW_HSC4_PEPS_FrP01_c4eea277 (PduRDestPdu):
              PduRDestPduHandleId = 39
              PduRDestPduDirection = RECEIVE
              PduRDestPduRoutingType = API_FORWARDING
              PduRTransmissionConfirmation = false
              PduRDestPduRef = PT_GW_HSC4_PEPS_FrP01_PP_GW_HSC4_PEPS_FrP01_Rx_c4eea277_b771686b
              PduRDestPduPduRBswModulesRef = Com
            SRC_Can_PT_GW_HSC4_PEPS_FrP01_c4eea277 (PduRSrcPdu):
              PduRSourcePduHandleId = 39
              PduRSrcPduDirection = RECEIVE
              PduRSrcPduRef = PT_GW_HSC4_PEPS_FrP01_PP_GW_HSC4_PEPS_FrP01_Rx_c4eea277_b771686b
              PduRSrcPduPduRBswModulesRef = CanIf
          Can_PT_GW_HSC4_BMS_FrP07_c4eea277: PduRRoutingPathCommunicationType=COMMUNICATION_INTERFACE  # GW_HSC4_BMS_FrP07_oCAN01
            DST_Can_PT_GW_HSC4_BMS_FrP07_c4eea277 (PduRDestPdu):
              PduRDestPduHandleId = 38
              PduRDestPduDirection = RECEIVE
              PduRDestPduRoutingType = API_FORWARDING
              PduRTransmissionConfirmation = false
              PduRDestPduRef = PT_GW_HSC4_BMS_FrP07_PP_GW_HSC4_BMS_FrP07_Rx_c4eea277_b771686b
              PduRDestPduPduRBswModulesRef = Com
            SRC_Can_PT_GW_HSC4_BMS_FrP07_c4eea277 (PduRSrcPdu):
              PduRSourcePduHandleId = 38
              PduRSrcPduDirection = RECEIVE
              PduRSrcPduRef = PT_GW_HSC4_BMS_FrP07_PP_GW_HSC4_BMS_FrP07_Rx_c4eea277_b771686b
              PduRSrcPduPduRBswModulesRef = CanIf
          Can_PT_GW_HSC4_TC_FrP01_c4eea277: PduRRoutingPathCommunicationType=COMMUNICATION_INTERFACE  # GW_HSC4_TC_FrP01_oCAN01
            DST_Can_PT_GW_HSC4_TC_FrP01_c4eea277 (PduRDestPdu):
              PduRDestPduHandleId = 44
              PduRDestPduDirection = RECEIVE
              PduRDestPduRoutingType = API_FORWARDING
              PduRTransmissionConfirmation = false
              PduRDestPduRef = PT_GW_HSC4_TC_FrP01_PP_GW_HSC4_TC_FrP01_Rx_c4eea277_b771686b
              PduRDestPduPduRBswModulesRef = Com
            SRC_Can_PT_GW_HSC4_TC_FrP01_c4eea277 (PduRSrcPdu):
              PduRSourcePduHandleId = 44
              PduRSrcPduDirection = RECEIVE
              PduRSrcPduRef = PT_GW_HSC4_TC_FrP01_PP_GW_HSC4_TC_FrP01_Rx_c4eea277_b771686b
              PduRSrcPduPduRBswModulesRef = CanIf
          Can_PT_GW_HSC4_TBOX_FrS10_c4eea277: PduRRoutingPathCommunicationType=COMMUNICATION_INTERFACE  # GW_HSC4_TBOX_FrS10_oCAN01
            DST_Can_PT_GW_HSC4_TBOX_FrS10_c4eea277 (PduRDestPdu):
              PduRDestPduHandleId = 43
              PduRDestPduDirection = RECEIVE
              PduRDestPduRoutingType = API_FORWARDING
              PduRTransmissionConfirmation = false
              PduRDestPduRef = PT_GW_HSC4_TBOX_FrS10_PP_GW_HSC4_TBOX_FrS10_Rx_c4eea277_b771686b
              PduRDestPduPduRBswModulesRef = Com
            SRC_Can_PT_GW_HSC4_TBOX_FrS10_c4eea277 (PduRSrcPdu):
              PduRSourcePduHandleId = 43
              PduRSrcPduDirection = RECEIVE
              PduRSrcPduRef = PT_GW_HSC4_TBOX_FrS10_PP_GW_HSC4_TBOX_FrS10_Rx_c4eea277_b771686b
              PduRSrcPduPduRBswModulesRef = CanIf
          Can_PT_P2P_IECU_HSC4_FrP01_c4eea277: PduRRoutingPathCommunicationType=COMMUNICATION_INTERFACE  # P2P_IECU_HSC4_FrP01_oCAN01
            DST_Can_PT_P2P_IECU_HSC4_FrP01_c4eea277 (PduRDestPdu):
              PduRDestPduHandleId = 12
              PduRDestPduDirection = TRANSMIT
              PduRDestPduRoutingType = API_FORWARDING
              PduRTransmissionConfirmation = false
              PduRDestPduDataProvision = PDUR_DIRECT
              PduRDestPduRef = PT_P2P_IECU_HSC4_FrP01_PP_P2P_IECU_HSC4_FrP01_Tx_c4eea277_b771686b
              PduRDestPduPduRBswModulesRef = CanIf
            SRC_Can_PT_P2P_IECU_HSC4_FrP01_c4eea277 (PduRSrcPdu):
              PduRSourcePduHandleId = 10
              PduRSrcPduDirection = TRANSMIT
              PduRSrcPduRef = PT_P2P_IECU_HSC4_FrP01_PP_P2P_IECU_HSC4_FrP01_Tx_c4eea277_b771686b
              PduRSrcPduPduRBswModulesRef = Com
          Can_PT_GW_HSC4_TBOX_FrP01_c4eea277: PduRRoutingPathCommunicationType=COMMUNICATION_INTERFACE  # GW_HSC4_TBOX_FrP01_oCAN01
            DST_Can_PT_GW_HSC4_TBOX_FrP01_c4eea277 (PduRDestPdu):
              PduRDestPduHandleId = 41
              PduRDestPduDirection = RECEIVE
              PduRDestPduRoutingType = API_FORWARDING
              PduRTransmissionConfirmation = false
              PduRDestPduRef = PT_GW_HSC4_TBOX_FrP01_PP_GW_HSC4_TBOX_FrP01_Rx_c4eea277_b771686b
              PduRDestPduPduRBswModulesRef = Com
            SRC_Can_PT_GW_HSC4_TBOX_FrP01_c4eea277 (PduRSrcPdu):
              PduRSourcePduHandleId = 41
              PduRSrcPduDirection = RECEIVE
              PduRSrcPduRef = PT_GW_HSC4_TBOX_FrP01_PP_GW_HSC4_TBOX_FrP01_Rx_c4eea277_b771686b
              PduRSrcPduPduRBswModulesRef = CanIf
          Can_PT_GW_HSC4_PEPS_FrP02_c4eea277: PduRRoutingPathCommunicationType=COMMUNICATION_INTERFACE  # GW_HSC4_PEPS_FrP02_oCAN01
            DST_Can_PT_GW_HSC4_PEPS_FrP02_c4eea277 (PduRDestPdu):
              PduRDestPduHandleId = 40
              PduRDestPduDirection = RECEIVE
              PduRDestPduRoutingType = API_FORWARDING
              PduRTransmissionConfirmation = false
              PduRDestPduRef = PT_GW_HSC4_PEPS_FrP02_PP_GW_HSC4_PEPS_FrP02_Rx_c4eea277_b771686b
              PduRDestPduPduRBswModulesRef = Com
            SRC_Can_PT_GW_HSC4_PEPS_FrP02_c4eea277 (PduRSrcPdu):
              PduRSourcePduHandleId = 40
              PduRSrcPduDirection = RECEIVE
              PduRSrcPduRef = PT_GW_HSC4_PEPS_FrP02_PP_GW_HSC4_PEPS_FrP02_Rx_c4eea277_b771686b
              PduRSrcPduPduRBswModulesRef = CanIf
          Can_PT_TPMS_HSC3_FrP01_c4eea277: PduRRoutingPathCommunicationType=COMMUNICATION_INTERFACE  # TPMS_HSC3_FrP01_oCAN01
            DST_Can_PT_TPMS_HSC3_FrP01_c4eea277 (PduRDestPdu):
              PduRDestPduHandleId = 60
              PduRDestPduDirection = RECEIVE
              PduRDestPduRoutingType = API_FORWARDING
              PduRTransmissionConfirmation = false
              PduRDestPduRef = PT_TPMS_HSC3_FrP01_PP_TPMS_HSC3_FrP01_Rx_c4eea277_b771686b
              PduRDestPduPduRBswModulesRef = Com
            SRC_Can_PT_TPMS_HSC3_FrP01_c4eea277 (PduRSrcPdu):
              PduRSourcePduHandleId = 58
              PduRSrcPduDirection = RECEIVE
              PduRSrcPduRef = PT_TPMS_HSC3_FrP01_PP_TPMS_HSC3_FrP01_Rx_c4eea277_b771686b
              PduRSrcPduPduRBswModulesRef = CanIf
          Can_PT_FICM_HSC4_FrP33_c4eea277: PduRRoutingPathCommunicationType=COMMUNICATION_INTERFACE  # FICM_HSC4_FrP33_oCAN01
            SRC_Can_PT_FICM_HSC4_FrP33_c4eea277 (PduRSrcPdu):
              PduRSourcePduHandleId = 15
              PduRSrcPduDirection = RECEIVE
              PduRSrcPduRef = PT_FICM_HSC4_FrP33_PP_FICM_HSC4_FrP33_Rx_c4eea277_b771686b
              PduRSrcPduPduRBswModulesRef = CanIf
            DST_Can_PT_FICM_HSC4_FrP33_c4eea277 (PduRDestPdu):
              PduRDestPduHandleId = 15
              PduRDestPduDirection = RECEIVE
              PduRDestPduRoutingType = API_FORWARDING
              PduRTransmissionConfirmation = false
              PduRDestPduRef = PT_FICM_HSC4_FrP33_PP_FICM_HSC4_FrP33_Rx_c4eea277_b771686b
              PduRDestPduPduRBswModulesRef = Com
          Can_PT_FICM_HSC4_FrP18_c4eea277: PduRRoutingPathCommunicationType=COMMUNICATION_INTERFACE  # FICM_HSC4_FrP18_oCAN01
            SRC_Can_PT_FICM_HSC4_FrP18_c4eea277 (PduRSrcPdu):
              PduRSourcePduHandleId = 13
              PduRSrcPduDirection = RECEIVE
              PduRSrcPduRef = PT_FICM_HSC4_FrP18_PP_FICM_HSC4_FrP18_Rx_c4eea277_b771686b
              PduRSrcPduPduRBswModulesRef = CanIf
            DST_Can_PT_FICM_HSC4_FrP18_c4eea277 (PduRDestPdu):
              PduRDestPduHandleId = 13
              PduRDestPduDirection = RECEIVE
              PduRDestPduRoutingType = API_FORWARDING
              PduRTransmissionConfirmation = false
              PduRDestPduRef = PT_FICM_HSC4_FrP18_PP_FICM_HSC4_FrP18_Rx_c4eea277_b771686b
              PduRDestPduPduRBswModulesRef = Com
          Can_PT_GW_HSC4_BCM_FrS09_c4eea277: PduRRoutingPathCommunicationType=COMMUNICATION_INTERFACE  # GW_HSC4_BCM_FrS09_oCAN01
            DST_Can_PT_GW_HSC4_BCM_FrS09_c4eea277 (PduRDestPdu):
              PduRDestPduHandleId = 36
              PduRDestPduDirection = RECEIVE
              PduRDestPduRoutingType = API_FORWARDING
              PduRTransmissionConfirmation = false
              PduRDestPduRef = PT_GW_HSC4_BCM_FrS09_PP_GW_HSC4_BCM_FrS09_Rx_c4eea277_b771686b
              PduRDestPduPduRBswModulesRef = Com
            SRC_Can_PT_GW_HSC4_BCM_FrS09_c4eea277 (PduRSrcPdu):
              PduRSourcePduHandleId = 36
              PduRSrcPduDirection = RECEIVE
              PduRSrcPduRef = PT_GW_HSC4_BCM_FrS09_PP_GW_HSC4_BCM_FrS09_Rx_c4eea277_b771686b
              PduRSrcPduPduRBswModulesRef = CanIf
          Can_PT_P2P_HSC4_FrP03_c4eea277: PduRRoutingPathCommunicationType=COMMUNICATION_INTERFACE  # P2P_HSC4_FrP03_oCAN01
            SRC_Can_PT_P2P_HSC4_FrP03_c4eea277 (PduRSrcPdu):
              PduRSourcePduHandleId = 8
              PduRSrcPduDirection = TRANSMIT
              PduRSrcPduRef = PT_P2P_HSC4_FrP03_PP_P2P_HSC4_FrP03_Tx_c4eea277_b771686b
              PduRSrcPduPduRBswModulesRef = Com
            DST_Can_PT_P2P_HSC4_FrP03_c4eea277 (PduRDestPdu):
              PduRDestPduHandleId = 10
              PduRDestPduDirection = TRANSMIT
              PduRDestPduRoutingType = API_FORWARDING
              PduRTransmissionConfirmation = false
              PduRDestPduDataProvision = PDUR_DIRECT
              PduRDestPduRef = PT_P2P_HSC4_FrP03_PP_P2P_HSC4_FrP03_Tx_c4eea277_b771686b
              PduRDestPduPduRBswModulesRef = CanIf
          Can_PT_GW_HSC4_TBOX_FrP05_c4eea277: PduRRoutingPathCommunicationType=COMMUNICATION_INTERFACE  # GW_HSC4_TBOX_FrP05_oCAN01
            SRC_Can_PT_GW_HSC4_TBOX_FrP05_c4eea277 (PduRSrcPdu):
              PduRSourcePduHandleId = 42
              PduRSrcPduDirection = RECEIVE
              PduRSrcPduRef = PT_GW_HSC4_TBOX_FrP05_PP_GW_HSC4_TBOX_FrP05_Rx_c4eea277_b771686b
              PduRSrcPduPduRBswModulesRef = CanIf
            DST_Can_PT_GW_HSC4_TBOX_FrP05_c4eea277 (PduRDestPdu):
              PduRDestPduHandleId = 42
              PduRDestPduDirection = RECEIVE
              PduRDestPduRoutingType = API_FORWARDING
              PduRTransmissionConfirmation = false
              PduRDestPduRef = PT_GW_HSC4_TBOX_FrP05_PP_GW_HSC4_TBOX_FrP05_Rx_c4eea277_b771686b
              PduRDestPduPduRBswModulesRef = Com
          Can_PT_P2P_SecCH_EPB_FrP01_427ad0d9: PduRRoutingPathCommunicationType=COMMUNICATION_INTERFACE  # P2P_SecCH_EPB_FrP01_oCAN02
            DST_Can_PT_P2P_SecCH_EPB_FrP01_427ad0d9 (PduRDestPdu):
              PduRDestPduHandleId = 19
              PduRDestPduDirection = TRANSMIT
              PduRDestPduRoutingType = API_FORWARDING
              PduRDestPduDataProvision = PDUR_DIRECT
              PduRTransmissionConfirmation = false
              PduRDestPduRef = PT_P2P_SecCH_EPB_FrP01_PP_P2P_SecCH_EPB_FrP01_Tx_427ad0d9_2e7839d1
              PduRDestPduPduRBswModulesRef = CanIf
            SRC_Can_PT_P2P_SecCH_EPB_FrP01_427ad0d9 (PduRSrcPdu):
              PduRSourcePduHandleId = 17
              PduRSrcPduDirection = TRANSMIT
              PduRSrcPduRef = PT_P2P_SecCH_EPB_FrP01_PP_P2P_SecCH_EPB_FrP01_Tx_427ad0d9_2e7839d1
              PduRSrcPduPduRBswModulesRef = Com
          Can_PT_P2P_SecCH_IPK_FrP06_427ad0d9: PduRRoutingPathCommunicationType=COMMUNICATION_INTERFACE  # P2P_SecCH_IPK_FrP06_oCAN02
            SRC_Can_PT_P2P_SecCH_IPK_FrP06_427ad0d9 (PduRSrcPdu):
              PduRSourcePduHandleId = 32
              PduRSrcPduDirection = TRANSMIT
              PduRSrcPduRef = PT_P2P_SecCH_IPK_FrP06_PP_P2P_SecCH_IPK_FrP06_Tx_427ad0d9_2e7839d1
              PduRSrcPduPduRBswModulesRef = Com
            DST_Can_PT_P2P_SecCH_IPK_FrP06_427ad0d9 (PduRDestPdu):
              PduRDestPduHandleId = 34
              PduRDestPduDirection = TRANSMIT
              PduRDestPduRoutingType = API_FORWARDING
              PduRDestPduDataProvision = PDUR_DIRECT
              PduRTransmissionConfirmation = false
              PduRDestPduRef = PT_P2P_SecCH_IPK_FrP06_PP_P2P_SecCH_IPK_FrP06_Tx_427ad0d9_2e7839d1
              PduRDestPduPduRBswModulesRef = CanIf
          Can_PT_P2P_SecCH_SAS_FrP00_427ad0d9: PduRRoutingPathCommunicationType=COMMUNICATION_INTERFACE  # P2P_SecCH_SAS_FrP00_oCAN02
            SRC_Can_PT_P2P_SecCH_SAS_FrP00_427ad0d9 (PduRSrcPdu):
              PduRSourcePduHandleId = 33
              PduRSrcPduDirection = TRANSMIT
              PduRSrcPduRef = PT_P2P_SecCH_SAS_FrP00_PP_P2P_SecCH_SAS_FrP00_Tx_427ad0d9_2e7839d1
              PduRSrcPduPduRBswModulesRef = Com
            DST_Can_PT_P2P_SecCH_SAS_FrP00_427ad0d9 (PduRDestPdu):
              PduRDestPduHandleId = 35
              PduRDestPduDirection = TRANSMIT
              PduRDestPduRoutingType = API_FORWARDING
              PduRDestPduDataProvision = PDUR_DIRECT
              PduRTransmissionConfirmation = false
              PduRDestPduRef = PT_P2P_SecCH_SAS_FrP00_PP_P2P_SecCH_SAS_FrP00_Tx_427ad0d9_2e7839d1
              PduRDestPduPduRBswModulesRef = CanIf
          Can_PT_P2P_SecCH_GW_FrS00_427ad0d9: PduRRoutingPathCommunicationType=COMMUNICATION_INTERFACE  # P2P_SecCH_GW_FrS00_oCAN02
            SRC_Can_PT_P2P_SecCH_GW_FrS00_427ad0d9 (PduRSrcPdu):
              PduRSourcePduHandleId = 27
              PduRSrcPduDirection = TRANSMIT
              PduRSrcPduRef = PT_P2P_SecCH_GW_FrS00_PP_P2P_SecCH_GW_FrS00_Tx_427ad0d9_2e7839d1
              PduRSrcPduPduRBswModulesRef = Com
            DST_Can_PT_P2P_SecCH_GW_FrS00_427ad0d9 (PduRDestPdu):
              PduRDestPduHandleId = 29
              PduRDestPduDirection = TRANSMIT
              PduRDestPduRoutingType = API_FORWARDING
              PduRDestPduDataProvision = PDUR_DIRECT
              PduRTransmissionConfirmation = false
              PduRDestPduRef = PT_P2P_SecCH_GW_FrS00_PP_P2P_SecCH_GW_FrS00_Tx_427ad0d9_2e7839d1
              PduRDestPduPduRBswModulesRef = CanIf
          Can_PT_P2P_SecCH_HCU_FrP01_427ad0d9: PduRRoutingPathCommunicationType=COMMUNICATION_INTERFACE  # P2P_SecCH_HCU_FrP01_oCAN02
            SRC_Can_PT_P2P_SecCH_HCU_FrP01_427ad0d9 (PduRSrcPdu):
              PduRSourcePduHandleId = 30
              PduRSrcPduDirection = TRANSMIT
              PduRSrcPduRef = PT_P2P_SecCH_HCU_FrP01_PP_P2P_SecCH_HCU_FrP01_Tx_427ad0d9_2e7839d1
              PduRSrcPduPduRBswModulesRef = Com
            DST_Can_PT_P2P_SecCH_HCU_FrP01_427ad0d9 (PduRDestPdu):
              PduRDestPduHandleId = 32
              PduRDestPduDirection = TRANSMIT
              PduRDestPduRoutingType = API_FORWARDING
              PduRDestPduDataProvision = PDUR_DIRECT
              PduRTransmissionConfirmation = false
              PduRDestPduRef = PT_P2P_SecCH_HCU_FrP01_PP_P2P_SecCH_HCU_FrP01_Tx_427ad0d9_2e7839d1
              PduRDestPduPduRBswModulesRef = CanIf
          Can_PT_P2P_SecCH_ECM_FrP00_427ad0d9: PduRRoutingPathCommunicationType=COMMUNICATION_INTERFACE  # P2P_SecCH_ECM_FrP00_oCAN02
            SRC_Can_PT_P2P_SecCH_ECM_FrP00_427ad0d9 (PduRSrcPdu):
              PduRSourcePduHandleId = 15
              PduRSrcPduDirection = TRANSMIT
              PduRSrcPduRef = PT_P2P_SecCH_ECM_FrP00_PP_P2P_SecCH_ECM_FrP00_Tx_427ad0d9_2e7839d1
              PduRSrcPduPduRBswModulesRef = Com
            DST_Can_PT_P2P_SecCH_ECM_FrP00_427ad0d9 (PduRDestPdu):
              PduRDestPduHandleId = 17
              PduRDestPduDirection = TRANSMIT
              PduRDestPduRoutingType = API_FORWARDING
              PduRDestPduDataProvision = PDUR_DIRECT
              PduRTransmissionConfirmation = false
              PduRDestPduRef = PT_P2P_SecCH_ECM_FrP00_PP_P2P_SecCH_ECM_FrP00_Tx_427ad0d9_2e7839d1
              PduRDestPduPduRBswModulesRef = CanIf
          Can_PT_P2P_SecCH_SCS_FrP12_427ad0d9: PduRRoutingPathCommunicationType=COMMUNICATION_INTERFACE  # P2P_SecCH_SCS_FrP12_oCAN02
            SRC_Can_PT_P2P_SecCH_SCS_FrP12_427ad0d9 (PduRSrcPdu):
              PduRSourcePduHandleId = 40
              PduRSrcPduDirection = TRANSMIT
              PduRSrcPduRef = PT_P2P_SecCH_SCS_FrP12_PP_P2P_SecCH_SCS_FrP12_Tx_427ad0d9_2e7839d1
              PduRSrcPduPduRBswModulesRef = Com
            DST_Can_PT_P2P_SecCH_SCS_FrP12_427ad0d9 (PduRDestPdu):
              PduRDestPduHandleId = 42
              PduRDestPduDirection = TRANSMIT
              PduRDestPduRoutingType = API_FORWARDING
              PduRTransmissionConfirmation = false
              PduRDestPduDataProvision = PDUR_DIRECT
              PduRDestPduRef = PT_P2P_SecCH_SCS_FrP12_PP_P2P_SecCH_SCS_FrP12_Tx_427ad0d9_2e7839d1
              PduRDestPduPduRBswModulesRef = CanIf
          Can_PT_APA_SecCH_FrP03_427ad0d9: PduRRoutingPathCommunicationType=COMMUNICATION_INTERFACE  # APA_SecCH_FrP03_oCAN02
            SRC_Can_PT_APA_SecCH_FrP03_427ad0d9 (PduRSrcPdu):
              PduRSourcePduHandleId = 3
              PduRSrcPduDirection = RECEIVE
              PduRSrcPduRef = PT_APA_SecCH_FrP03_PP_APA_SecCH_FrP03_Rx_427ad0d9_2e7839d1
              PduRSrcPduPduRBswModulesRef = CanIf
            DST_Can_PT_APA_SecCH_FrP03_427ad0d9 (PduRDestPdu):
              PduRDestPduHandleId = 3
              PduRDestPduDirection = RECEIVE
              PduRDestPduRoutingType = API_FORWARDING
              PduRTransmissionConfirmation = false
              PduRDestPduRef = PT_APA_SecCH_FrP03_PP_APA_SecCH_FrP03_Rx_427ad0d9_2e7839d1
              PduRDestPduPduRBswModulesRef = Com
          Can_PT_P2P_SecCH_SDM_FrP00_427ad0d9: PduRRoutingPathCommunicationType=COMMUNICATION_INTERFACE  # P2P_SecCH_SDM_FrP00_oCAN02
            DST_Can_PT_P2P_SecCH_SDM_FrP00_427ad0d9 (PduRDestPdu):
              PduRDestPduHandleId = 45
              PduRDestPduDirection = TRANSMIT
              PduRDestPduRoutingType = API_FORWARDING
              PduRDestPduDataProvision = PDUR_DIRECT
              PduRTransmissionConfirmation = false
              PduRDestPduRef = PT_P2P_SecCH_SDM_FrP00_PP_P2P_SecCH_SDM_FrP00_Tx_427ad0d9_2e7839d1
              PduRDestPduPduRBswModulesRef = CanIf
            SRC_Can_PT_P2P_SecCH_SDM_FrP00_427ad0d9 (PduRSrcPdu):
              PduRSourcePduHandleId = 43
              PduRSrcPduDirection = TRANSMIT
              PduRSrcPduRef = PT_P2P_SecCH_SDM_FrP00_PP_P2P_SecCH_SDM_FrP00_Tx_427ad0d9_2e7839d1
              PduRSrcPduPduRBswModulesRef = Com
          Can_PT_P2P_SecCH_EPB_FrP00_427ad0d9: PduRRoutingPathCommunicationType=COMMUNICATION_INTERFACE  # P2P_SecCH_EPB_FrP00_oCAN02
            DST_Can_PT_P2P_SecCH_EPB_FrP00_427ad0d9 (PduRDestPdu):
              PduRDestPduHandleId = 18
              PduRDestPduDirection = TRANSMIT
              PduRDestPduRoutingType = API_FORWARDING
              PduRDestPduDataProvision = PDUR_DIRECT
              PduRTransmissionConfirmation = false
              PduRDestPduRef = PT_P2P_SecCH_EPB_FrP00_PP_P2P_SecCH_EPB_FrP00_Tx_427ad0d9_2e7839d1
              PduRDestPduPduRBswModulesRef = CanIf
            SRC_Can_PT_P2P_SecCH_EPB_FrP00_427ad0d9 (PduRSrcPdu):
              PduRSourcePduHandleId = 16
              PduRSrcPduDirection = TRANSMIT
              PduRSrcPduRef = PT_P2P_SecCH_EPB_FrP00_PP_P2P_SecCH_EPB_FrP00_Tx_427ad0d9_2e7839d1
              PduRSrcPduPduRBswModulesRef = Com
          Can_PT_APA_SecCH_FrP02_427ad0d9: PduRRoutingPathCommunicationType=COMMUNICATION_INTERFACE  # APA_SecCH_FrP02_oCAN02
            DST_Can_PT_APA_SecCH_FrP02_427ad0d9 (PduRDestPdu):
              PduRDestPduHandleId = 2
              PduRDestPduDirection = RECEIVE
              PduRDestPduRoutingType = API_FORWARDING
              PduRTransmissionConfirmation = false
              PduRDestPduRef = PT_APA_SecCH_FrP02_PP_APA_SecCH_FrP02_Rx_427ad0d9_2e7839d1
              PduRDestPduPduRBswModulesRef = Com
            SRC_Can_PT_APA_SecCH_FrP02_427ad0d9 (PduRSrcPdu):
              PduRSourcePduHandleId = 2
              PduRSrcPduDirection = RECEIVE
              PduRSrcPduRef = PT_APA_SecCH_FrP02_PP_APA_SecCH_FrP02_Rx_427ad0d9_2e7839d1
              PduRSrcPduPduRBswModulesRef = CanIf
          Can_PT_P2P_SecCH_GW_FrP01_427ad0d9: PduRRoutingPathCommunicationType=COMMUNICATION_INTERFACE  # P2P_SecCH_GW_FrP01_oCAN02
            DST_Can_PT_P2P_SecCH_GW_FrP01_427ad0d9 (PduRDestPdu):
              PduRDestPduHandleId = 25
              PduRDestPduDirection = TRANSMIT
              PduRDestPduRoutingType = API_FORWARDING
              PduRDestPduDataProvision = PDUR_DIRECT
              PduRTransmissionConfirmation = false
              PduRDestPduRef = PT_P2P_SecCH_GW_FrP01_PP_P2P_SecCH_GW_FrP01_Tx_427ad0d9_2e7839d1
              PduRDestPduPduRBswModulesRef = CanIf
            SRC_Can_PT_P2P_SecCH_GW_FrP01_427ad0d9 (PduRSrcPdu):
              PduRSourcePduHandleId = 23
              PduRSrcPduDirection = TRANSMIT
              PduRSrcPduRef = PT_P2P_SecCH_GW_FrP01_PP_P2P_SecCH_GW_FrP01_Tx_427ad0d9_2e7839d1
              PduRSrcPduPduRBswModulesRef = Com
          Can_PT_P2P_SecCH_BCM_FrP07_427ad0d9: PduRRoutingPathCommunicationType=COMMUNICATION_INTERFACE  # P2P_SecCH_BCM_FrP07_oCAN02
            DST_Can_PT_P2P_SecCH_BCM_FrP07_427ad0d9 (PduRDestPdu):
              PduRDestPduHandleId = 16
              PduRDestPduDirection = TRANSMIT
              PduRDestPduRoutingType = API_FORWARDING
              PduRTransmissionConfirmation = false
              PduRDestPduDataProvision = PDUR_DIRECT
              PduRDestPduRef = PT_P2P_SecCH_BCM_FrP07_PP_P2P_SecCH_BCM_FrP07_Tx_427ad0d9_2e7839d1
              PduRDestPduPduRBswModulesRef = CanIf
            SRC_Can_PT_P2P_SecCH_BCM_FrP07_427ad0d9 (PduRSrcPdu):
              PduRSourcePduHandleId = 14
              PduRSrcPduDirection = TRANSMIT
              PduRSrcPduRef = PT_P2P_SecCH_BCM_FrP07_PP_P2P_SecCH_BCM_FrP07_Tx_427ad0d9_2e7839d1
              PduRSrcPduPduRBswModulesRef = Com
          Can_PT_P2P_SecCH_BCM_FrP04_427ad0d9: PduRRoutingPathCommunicationType=COMMUNICATION_INTERFACE  # P2P_SecCH_BCM_FrP04_oCAN02
            DST_Can_PT_P2P_SecCH_BCM_FrP04_427ad0d9 (PduRDestPdu):
              PduRDestPduHandleId = 15
              PduRDestPduDirection = TRANSMIT
              PduRDestPduRoutingType = API_FORWARDING
              PduRTransmissionConfirmation = false
              PduRDestPduDataProvision = PDUR_DIRECT
              PduRDestPduRef = PT_P2P_SecCH_BCM_FrP04_PP_P2P_SecCH_BCM_FrP04_Tx_427ad0d9_2e7839d1
              PduRDestPduPduRBswModulesRef = CanIf
            SRC_Can_PT_P2P_SecCH_BCM_FrP04_427ad0d9 (PduRSrcPdu):
              PduRSourcePduHandleId = 13
              PduRSrcPduDirection = TRANSMIT
              PduRSrcPduRef = PT_P2P_SecCH_BCM_FrP04_PP_P2P_SecCH_BCM_FrP04_Tx_427ad0d9_2e7839d1
              PduRSrcPduPduRBswModulesRef = Com
          Can_PT_P2P_SecCH_GW_FrP10_427ad0d9: PduRRoutingPathCommunicationType=COMMUNICATION_INTERFACE  # P2P_SecCH_GW_FrP10_oCAN02
            SRC_Can_PT_P2P_SecCH_GW_FrP10_427ad0d9 (PduRSrcPdu):
              PduRSourcePduHandleId = 25
              PduRSrcPduDirection = TRANSMIT
              PduRSrcPduRef = PT_P2P_SecCH_GW_FrP10_PP_P2P_SecCH_GW_FrP10_Tx_427ad0d9_2e7839d1
              PduRSrcPduPduRBswModulesRef = Com
            DST_Can_PT_P2P_SecCH_GW_FrP10_427ad0d9 (PduRDestPdu):
              PduRDestPduHandleId = 27
              PduRDestPduDirection = TRANSMIT
              PduRDestPduRoutingType = API_FORWARDING
              PduRDestPduDataProvision = PDUR_DIRECT
              PduRTransmissionConfirmation = false
              PduRDestPduRef = PT_P2P_SecCH_GW_FrP10_PP_P2P_SecCH_GW_FrP10_Tx_427ad0d9_2e7839d1
              PduRDestPduPduRBswModulesRef = CanIf
          Can_PT_P2P_SecCH_TC_FrP07_427ad0d9: PduRRoutingPathCommunicationType=COMMUNICATION_INTERFACE  # P2P_SecCH_TC_FrP07_oCAN02
            SRC_Can_PT_P2P_SecCH_TC_FrP07_427ad0d9 (PduRSrcPdu):
              PduRSourcePduHandleId = 44
              PduRSrcPduDirection = TRANSMIT
              PduRSrcPduRef = PT_P2P_SecCH_TC_FrP07_PP_P2P_SecCH_TC_FrP07_Tx_427ad0d9_2e7839d1
              PduRSrcPduPduRBswModulesRef = Com
            DST_Can_PT_P2P_SecCH_TC_FrP07_427ad0d9 (PduRDestPdu):
              PduRDestPduHandleId = 46
              PduRDestPduDirection = TRANSMIT
              PduRDestPduRoutingType = API_FORWARDING
              PduRDestPduDataProvision = PDUR_DIRECT
              PduRTransmissionConfirmation = false
              PduRDestPduRef = PT_P2P_SecCH_TC_FrP07_PP_P2P_SecCH_TC_FrP07_Tx_427ad0d9_2e7839d1
              PduRDestPduPduRBswModulesRef = CanIf
          Can_PT_P2P_SecCH_FICM_FrP18_427ad0d9: PduRRoutingPathCommunicationType=COMMUNICATION_INTERFACE  # P2P_SecCH_FICM_FrP18_oCAN02
            DST_Can_PT_P2P_SecCH_FICM_FrP18_427ad0d9 (PduRDestPdu):
              PduRDestPduHandleId = 23
              PduRDestPduDirection = TRANSMIT
              PduRDestPduRoutingType = API_FORWARDING
              PduRDestPduDataProvision = PDUR_DIRECT
              PduRTransmissionConfirmation = false
              PduRDestPduRef = PT_P2P_SecCH_FICM_FrP18_PP_P2P_SecCH_FICM_FrP18_Tx_427ad0d9_2e7839d1
              PduRDestPduPduRBswModulesRef = CanIf
            SRC_Can_PT_P2P_SecCH_FICM_FrP18_427ad0d9 (PduRSrcPdu):
              PduRSourcePduHandleId = 21
              PduRSrcPduDirection = TRANSMIT
              PduRSrcPduRef = PT_P2P_SecCH_FICM_FrP18_PP_P2P_SecCH_FICM_FrP18_Tx_427ad0d9_2e7839d1
              PduRSrcPduPduRBswModulesRef = Com
          Can_PT_DIAG_DTCInfo_APA_427ad0d9: PduRRoutingPathCommunicationType=COMMUNICATION_INTERFACE  # DIAG_DTCInfo_APA_oCAN02
            DST_Can_PT_DIAG_DTCInfo_APA_427ad0d9 (PduRDestPdu):
              PduRDestPduHandleId = 5
              PduRDestPduDirection = RECEIVE
              PduRDestPduRoutingType = API_FORWARDING
              PduRTransmissionConfirmation = false
              PduRDestPduRef = PT_DIAG_DTCInfo_APA_PP_DIAG_DTCInfo_APA_Rx_427ad0d9_2e7839d1
              PduRDestPduPduRBswModulesRef = Com
            SRC_Can_PT_DIAG_DTCInfo_APA_427ad0d9 (PduRSrcPdu):
              PduRSourcePduHandleId = 5
              PduRSrcPduDirection = RECEIVE
              PduRSrcPduRef = PT_DIAG_DTCInfo_APA_PP_DIAG_DTCInfo_APA_Rx_427ad0d9_2e7839d1
              PduRSrcPduPduRBswModulesRef = CanIf
          Can_PT_P2P_SecCH_HCU_FrP00_427ad0d9: PduRRoutingPathCommunicationType=COMMUNICATION_INTERFACE  # P2P_SecCH_HCU_FrP00_oCAN02
            DST_Can_PT_P2P_SecCH_HCU_FrP00_427ad0d9 (PduRDestPdu):
              PduRDestPduHandleId = 31
              PduRDestPduDirection = TRANSMIT
              PduRDestPduRoutingType = API_FORWARDING
              PduRDestPduDataProvision = PDUR_DIRECT
              PduRTransmissionConfirmation = false
              PduRDestPduRef = PT_P2P_SecCH_HCU_FrP00_PP_P2P_SecCH_HCU_FrP00_Tx_427ad0d9_2e7839d1
              PduRDestPduPduRBswModulesRef = CanIf
            SRC_Can_PT_P2P_SecCH_HCU_FrP00_427ad0d9 (PduRSrcPdu):
              PduRSourcePduHandleId = 29
              PduRSrcPduDirection = TRANSMIT
              PduRSrcPduRef = PT_P2P_SecCH_HCU_FrP00_PP_P2P_SecCH_HCU_FrP00_Tx_427ad0d9_2e7839d1
              PduRSrcPduPduRBswModulesRef = Com
          Can_PT_APA_SecCH_FrP00_427ad0d9: PduRRoutingPathCommunicationType=COMMUNICATION_INTERFACE  # APA_SecCH_FrP00_oCAN02
            DST_Can_PT_APA_SecCH_FrP00_427ad0d9 (PduRDestPdu):
              PduRDestPduHandleId = 0
              PduRDestPduDirection = RECEIVE
              PduRDestPduRoutingType = API_FORWARDING
              PduRTransmissionConfirmation = false
              PduRDestPduRef = PT_APA_SecCH_FrP00_PP_APA_SecCH_FrP00_Rx_427ad0d9_2e7839d1
              PduRDestPduPduRBswModulesRef = Com
            SRC_Can_PT_APA_SecCH_FrP00_427ad0d9 (PduRSrcPdu):
              PduRSourcePduHandleId = 0
              PduRSrcPduDirection = RECEIVE
              PduRSrcPduRef = PT_APA_SecCH_FrP00_PP_APA_SecCH_FrP00_Rx_427ad0d9_2e7839d1
              PduRSrcPduPduRBswModulesRef = CanIf
          Can_PT_P2P_SecCH_SCS_FrP03_427ad0d9: PduRRoutingPathCommunicationType=COMMUNICATION_INTERFACE  # P2P_SecCH_SCS_FrP03_oCAN02
            DST_Can_PT_P2P_SecCH_SCS_FrP03_427ad0d9 (PduRDestPdu):
              PduRDestPduHandleId = 39
              PduRDestPduDirection = TRANSMIT
              PduRDestPduRoutingType = API_FORWARDING
              PduRDestPduDataProvision = PDUR_DIRECT
              PduRTransmissionConfirmation = false
              PduRDestPduRef = PT_P2P_SecCH_SCS_FrP03_PP_P2P_SecCH_SCS_FrP03_Tx_427ad0d9_2e7839d1
              PduRDestPduPduRBswModulesRef = CanIf
            SRC_Can_PT_P2P_SecCH_SCS_FrP03_427ad0d9 (PduRSrcPdu):
              PduRSourcePduHandleId = 37
              PduRSrcPduDirection = TRANSMIT
              PduRSrcPduRef = PT_P2P_SecCH_SCS_FrP03_PP_P2P_SecCH_SCS_FrP03_Tx_427ad0d9_2e7839d1
              PduRSrcPduPduRBswModulesRef = Com
          Can_PT_PDC_SecCH_FrP00_427ad0d9: PduRRoutingPathCommunicationType=COMMUNICATION_INTERFACE  # PDC_SecCH_FrP00_oCAN02
            SRC_Can_PT_PDC_SecCH_FrP00_427ad0d9 (PduRSrcPdu):
              PduRSourcePduHandleId = 46
              PduRSrcPduDirection = RECEIVE
              PduRSrcPduRef = PT_PDC_SecCH_FrP00_PP_PDC_SecCH_FrP00_Rx_427ad0d9_2e7839d1
              PduRSrcPduPduRBswModulesRef = CanIf
            DST_Can_PT_PDC_SecCH_FrP00_427ad0d9 (PduRDestPdu):
              PduRDestPduHandleId = 46
              PduRDestPduDirection = RECEIVE
              PduRDestPduRoutingType = API_FORWARDING
              PduRTransmissionConfirmation = false
              PduRDestPduRef = PT_PDC_SecCH_FrP00_PP_PDC_SecCH_FrP00_Rx_427ad0d9_2e7839d1
              PduRDestPduPduRBswModulesRef = Com
          Can_PT_P2P_SecCH_HCU_FrP13_427ad0d9: PduRRoutingPathCommunicationType=COMMUNICATION_INTERFACE  # P2P_SecCH_HCU_FrP13_oCAN02
            SRC_Can_PT_P2P_SecCH_HCU_FrP13_427ad0d9 (PduRSrcPdu):
              PduRSourcePduHandleId = 31
              PduRSrcPduDirection = TRANSMIT
              PduRSrcPduRef = PT_P2P_SecCH_HCU_FrP13_PP_P2P_SecCH_HCU_FrP13_Tx_427ad0d9_2e7839d1
              PduRSrcPduPduRBswModulesRef = Com
            DST_Can_PT_P2P_SecCH_HCU_FrP13_427ad0d9 (PduRDestPdu):
              PduRDestPduHandleId = 33
              PduRDestPduDirection = TRANSMIT
              PduRDestPduRoutingType = API_FORWARDING
              PduRDestPduDataProvision = PDUR_DIRECT
              PduRTransmissionConfirmation = false
              PduRDestPduRef = PT_P2P_SecCH_HCU_FrP13_PP_P2P_SecCH_HCU_FrP13_Tx_427ad0d9_2e7839d1
              PduRDestPduPduRBswModulesRef = CanIf
          Can_PT_P2P_SecCH_SCS_FrP01_427ad0d9: PduRRoutingPathCommunicationType=COMMUNICATION_INTERFACE  # P2P_SecCH_SCS_FrP01_oCAN02
            DST_Can_PT_P2P_SecCH_SCS_FrP01_427ad0d9 (PduRDestPdu):
              PduRDestPduHandleId = 37
              PduRDestPduDirection = TRANSMIT
              PduRDestPduRoutingType = API_FORWARDING
              PduRDestPduDataProvision = PDUR_DIRECT
              PduRTransmissionConfirmation = false
              PduRDestPduRef = PT_P2P_SecCH_SCS_FrP01_PP_P2P_SecCH_SCS_FrP01_Tx_427ad0d9_2e7839d1
              PduRDestPduPduRBswModulesRef = CanIf
            SRC_Can_PT_P2P_SecCH_SCS_FrP01_427ad0d9 (PduRSrcPdu):
              PduRSourcePduHandleId = 35
              PduRSrcPduDirection = TRANSMIT
              PduRSrcPduRef = PT_P2P_SecCH_SCS_FrP01_PP_P2P_SecCH_SCS_FrP01_Tx_427ad0d9_2e7839d1
              PduRSrcPduPduRBswModulesRef = Com
          Can_PT_P2P_SecCH_SCS_FrP15_427ad0d9: PduRRoutingPathCommunicationType=COMMUNICATION_INTERFACE  # P2P_SecCH_SCS_FrP15_oCAN02
            SRC_Can_PT_P2P_SecCH_SCS_FrP15_427ad0d9 (PduRSrcPdu):
              PduRSourcePduHandleId = 41
              PduRSrcPduDirection = TRANSMIT
              PduRSrcPduRef = PT_P2P_SecCH_SCS_FrP15_PP_P2P_SecCH_SCS_FrP15_Tx_427ad0d9_2e7839d1
              PduRSrcPduPduRBswModulesRef = Com
            DST_Can_PT_P2P_SecCH_SCS_FrP15_427ad0d9 (PduRDestPdu):
              PduRDestPduHandleId = 43
              PduRDestPduDirection = TRANSMIT
              PduRDestPduRoutingType = API_FORWARDING
              PduRDestPduDataProvision = PDUR_DIRECT
              PduRTransmissionConfirmation = false
              PduRDestPduRef = PT_P2P_SecCH_SCS_FrP15_PP_P2P_SecCH_SCS_FrP15_Tx_427ad0d9_2e7839d1
              PduRDestPduPduRBswModulesRef = CanIf
          Can_PT_P2P_SecCH_GW_FrP08_427ad0d9: PduRRoutingPathCommunicationType=COMMUNICATION_INTERFACE  # P2P_SecCH_GW_FrP08_oCAN02
            SRC_Can_PT_P2P_SecCH_GW_FrP08_427ad0d9 (PduRSrcPdu):
              PduRSourcePduHandleId = 24
              PduRSrcPduDirection = TRANSMIT
              PduRSrcPduRef = PT_P2P_SecCH_GW_FrP08_PP_P2P_SecCH_GW_FrP08_Tx_427ad0d9_2e7839d1
              PduRSrcPduPduRBswModulesRef = Com
            DST_Can_PT_P2P_SecCH_GW_FrP08_427ad0d9 (PduRDestPdu):
              PduRDestPduHandleId = 26
              PduRDestPduDirection = TRANSMIT
              PduRDestPduRoutingType = API_FORWARDING
              PduRTransmissionConfirmation = false
              PduRDestPduDataProvision = PDUR_DIRECT
              PduRDestPduRef = PT_P2P_SecCH_GW_FrP08_PP_P2P_SecCH_GW_FrP08_Tx_427ad0d9_2e7839d1
              PduRDestPduPduRBswModulesRef = CanIf
          Can_PT_P2P_SecCH_SCS_FrP00_427ad0d9: PduRRoutingPathCommunicationType=COMMUNICATION_INTERFACE  # P2P_SecCH_SCS_FrP00_oCAN02
            SRC_Can_PT_P2P_SecCH_SCS_FrP00_427ad0d9 (PduRSrcPdu):
              PduRSourcePduHandleId = 34
              PduRSrcPduDirection = TRANSMIT
              PduRSrcPduRef = PT_P2P_SecCH_SCS_FrP00_PP_P2P_SecCH_SCS_FrP00_Tx_427ad0d9_2e7839d1
              PduRSrcPduPduRBswModulesRef = Com
            DST_Can_PT_P2P_SecCH_SCS_FrP00_427ad0d9 (PduRDestPdu):
              PduRDestPduHandleId = 36
              PduRDestPduDirection = TRANSMIT
              PduRDestPduRoutingType = API_FORWARDING
              PduRDestPduDataProvision = PDUR_DIRECT
              PduRTransmissionConfirmation = false
              PduRDestPduRef = PT_P2P_SecCH_SCS_FrP00_PP_P2P_SecCH_SCS_FrP00_Tx_427ad0d9_2e7839d1
              PduRDestPduPduRBswModulesRef = CanIf
          Can_PT_P2P_SecCH_FICM_FrP02_427ad0d9: PduRRoutingPathCommunicationType=COMMUNICATION_INTERFACE  # P2P_SecCH_FICM_FrP02_oCAN02
            SRC_Can_PT_P2P_SecCH_FICM_FrP02_427ad0d9 (PduRSrcPdu):
              PduRSourcePduHandleId = 19
              PduRSrcPduDirection = TRANSMIT
              PduRSrcPduRef = PT_P2P_SecCH_FICM_FrP02_PP_P2P_SecCH_FICM_FrP02_Tx_427ad0d9_2e7839d1
              PduRSrcPduPduRBswModulesRef = Com
            DST_Can_PT_P2P_SecCH_FICM_FrP02_427ad0d9 (PduRDestPdu):
              PduRDestPduHandleId = 21
              PduRDestPduDirection = TRANSMIT
              PduRDestPduRoutingType = API_FORWARDING
              PduRDestPduDataProvision = PDUR_DIRECT
              PduRTransmissionConfirmation = false
              PduRDestPduRef = PT_P2P_SecCH_FICM_FrP02_PP_P2P_SecCH_FICM_FrP02_Tx_427ad0d9_2e7839d1
              PduRDestPduPduRBswModulesRef = CanIf
          Can_PT_P2P_SecCH_FICM_FrP08_427ad0d9: PduRRoutingPathCommunicationType=COMMUNICATION_INTERFACE  # P2P_SecCH_FICM_FrP08_oCAN02
            SRC_Can_PT_P2P_SecCH_FICM_FrP08_427ad0d9 (PduRSrcPdu):
              PduRSourcePduHandleId = 20
              PduRSrcPduDirection = TRANSMIT
              PduRSrcPduRef = PT_P2P_SecCH_FICM_FrP08_PP_P2P_SecCH_FICM_FrP08_Tx_427ad0d9_2e7839d1
              PduRSrcPduPduRBswModulesRef = Com
            DST_Can_PT_P2P_SecCH_FICM_FrP08_427ad0d9 (PduRDestPdu):
              PduRDestPduHandleId = 22
              PduRDestPduDirection = TRANSMIT
              PduRDestPduRoutingType = API_FORWARDING
              PduRDestPduDataProvision = PDUR_DIRECT
              PduRTransmissionConfirmation = false
              PduRDestPduRef = PT_P2P_SecCH_FICM_FrP08_PP_P2P_SecCH_FICM_FrP08_Tx_427ad0d9_2e7839d1
              PduRDestPduPduRBswModulesRef = CanIf
          Can_PT_P2P_SecCH_SCS_FrP11_427ad0d9: PduRRoutingPathCommunicationType=COMMUNICATION_INTERFACE  # P2P_SecCH_SCS_FrP11_oCAN02
            DST_Can_PT_P2P_SecCH_SCS_FrP11_427ad0d9 (PduRDestPdu):
              PduRDestPduHandleId = 41
              PduRDestPduDirection = TRANSMIT
              PduRDestPduRoutingType = API_FORWARDING
              PduRDestPduDataProvision = PDUR_DIRECT
              PduRTransmissionConfirmation = false
              PduRDestPduRef = PT_P2P_SecCH_SCS_FrP11_PP_P2P_SecCH_SCS_FrP11_Tx_427ad0d9_2e7839d1
              PduRDestPduPduRBswModulesRef = CanIf
            SRC_Can_PT_P2P_SecCH_SCS_FrP11_427ad0d9 (PduRSrcPdu):
              PduRSourcePduHandleId = 39
              PduRSrcPduDirection = TRANSMIT
              PduRSrcPduRef = PT_P2P_SecCH_SCS_FrP11_PP_P2P_SecCH_SCS_FrP11_Tx_427ad0d9_2e7839d1
              PduRSrcPduPduRBswModulesRef = Com
          Can_PT_P2P_SecCH_SCS_FrP02_427ad0d9: PduRRoutingPathCommunicationType=COMMUNICATION_INTERFACE  # P2P_SecCH_SCS_FrP02_oCAN02
            DST_Can_PT_P2P_SecCH_SCS_FrP02_427ad0d9 (PduRDestPdu):
              PduRDestPduHandleId = 38
              PduRDestPduDirection = TRANSMIT
              PduRDestPduRoutingType = API_FORWARDING
              PduRDestPduDataProvision = PDUR_DIRECT
              PduRTransmissionConfirmation = false
              PduRDestPduRef = PT_P2P_SecCH_SCS_FrP02_PP_P2P_SecCH_SCS_FrP02_Tx_427ad0d9_2e7839d1
              PduRDestPduPduRBswModulesRef = CanIf
            SRC_Can_PT_P2P_SecCH_SCS_FrP02_427ad0d9 (PduRSrcPdu):
              PduRSourcePduHandleId = 36
              PduRSrcPduDirection = TRANSMIT
              PduRSrcPduRef = PT_P2P_SecCH_SCS_FrP02_PP_P2P_SecCH_SCS_FrP02_Tx_427ad0d9_2e7839d1
              PduRSrcPduPduRBswModulesRef = Com
          Can_PT_P2P_SecCH_SCS_FrP05_427ad0d9: PduRRoutingPathCommunicationType=COMMUNICATION_INTERFACE  # P2P_SecCH_SCS_FrP05_oCAN02
            DST_Can_PT_P2P_SecCH_SCS_FrP05_427ad0d9 (PduRDestPdu):
              PduRDestPduHandleId = 40
              PduRDestPduDirection = TRANSMIT
              PduRDestPduRoutingType = API_FORWARDING
              PduRDestPduDataProvision = PDUR_DIRECT
              PduRTransmissionConfirmation = false
              PduRDestPduRef = PT_P2P_SecCH_SCS_FrP05_PP_P2P_SecCH_SCS_FrP05_Tx_427ad0d9_2e7839d1
              PduRDestPduPduRBswModulesRef = CanIf
            SRC_Can_PT_P2P_SecCH_SCS_FrP05_427ad0d9 (PduRSrcPdu):
              PduRSourcePduHandleId = 38
              PduRSrcPduDirection = TRANSMIT
              PduRSrcPduRef = PT_P2P_SecCH_SCS_FrP05_PP_P2P_SecCH_SCS_FrP05_Tx_427ad0d9_2e7839d1
              PduRSrcPduPduRBswModulesRef = Com
          Can_PT_P2P_SecCH_Tester_GW_FrP14_427ad0d9: PduRRoutingPathCommunicationType=COMMUNICATION_INTERFACE  # P2P_SecCH_Tester_GW_FrP14_oCAN02
            DST_Can_PT_P2P_SecCH_Tester_GW_FrP14_427ad0d9 (PduRDestPdu):
              PduRDestPduHandleId = 47
              PduRDestPduDirection = TRANSMIT
              PduRDestPduRoutingType = API_FORWARDING
              PduRDestPduDataProvision = PDUR_DIRECT
              PduRTransmissionConfirmation = false
              PduRDestPduRef = PT_P2P_SecCH_Tester_GW_FrP14_PP_P2P_SecCH_Tester_GW_FrP14_Tx_427ad0d9_2e7839d1
              PduRDestPduPduRBswModulesRef = CanIf
            SRC_Can_PT_P2P_SecCH_Tester_GW_FrP14_427ad0d9 (PduRSrcPdu):
              PduRSourcePduHandleId = 45
              PduRSrcPduDirection = TRANSMIT
              PduRSrcPduRef = PT_P2P_SecCH_Tester_GW_FrP14_PP_P2P_SecCH_Tester_GW_FrP14_Tx_427ad0d9_2e7839d1
              PduRSrcPduPduRBswModulesRef = Com
          Can_PT_P2P_SecCH_GW_FrP13_427ad0d9: PduRRoutingPathCommunicationType=COMMUNICATION_INTERFACE  # P2P_SecCH_GW_FrP13_oCAN02
            DST_Can_PT_P2P_SecCH_GW_FrP13_427ad0d9 (PduRDestPdu):
              PduRDestPduHandleId = 28
              PduRDestPduDirection = TRANSMIT
              PduRDestPduRoutingType = API_FORWARDING
              PduRDestPduDataProvision = PDUR_DIRECT
              PduRTransmissionConfirmation = false
              PduRDestPduRef = PT_P2P_SecCH_GW_FrP13_PP_P2P_SecCH_GW_FrP13_Tx_427ad0d9_2e7839d1
              PduRDestPduPduRBswModulesRef = CanIf
            SRC_Can_PT_P2P_SecCH_GW_FrP13_427ad0d9 (PduRSrcPdu):
              PduRSourcePduHandleId = 26
              PduRSrcPduDirection = TRANSMIT
              PduRSrcPduRef = PT_P2P_SecCH_GW_FrP13_PP_P2P_SecCH_GW_FrP13_Tx_427ad0d9_2e7839d1
              PduRSrcPduPduRBswModulesRef = Com
          Can_PT_APA_SecCH_FrP01_427ad0d9: PduRRoutingPathCommunicationType=COMMUNICATION_INTERFACE  # APA_SecCH_FrP01_oCAN02
            DST_Can_PT_APA_SecCH_FrP01_427ad0d9 (PduRDestPdu):
              PduRDestPduHandleId = 1
              PduRDestPduDirection = RECEIVE
              PduRDestPduRoutingType = API_FORWARDING
              PduRTransmissionConfirmation = false
              PduRDestPduRef = PT_APA_SecCH_FrP01_PP_APA_SecCH_FrP01_Rx_427ad0d9_2e7839d1
              PduRDestPduPduRBswModulesRef = Com
            SRC_Can_PT_APA_SecCH_FrP01_427ad0d9 (PduRSrcPdu):
              PduRSourcePduHandleId = 1
              PduRSrcPduDirection = RECEIVE
              PduRSrcPduRef = PT_APA_SecCH_FrP01_PP_APA_SecCH_FrP01_Rx_427ad0d9_2e7839d1
              PduRSrcPduPduRBswModulesRef = CanIf
          Can_PT_P2P_SecCH_SCU_FrP00_427ad0d9: PduRRoutingPathCommunicationType=COMMUNICATION_INTERFACE  # P2P_SecCH_SCU_FrP00_oCAN02
            DST_Can_PT_P2P_SecCH_SCU_FrP00_427ad0d9 (PduRDestPdu):
              PduRDestPduHandleId = 44
              PduRDestPduDirection = TRANSMIT
              PduRDestPduRoutingType = API_FORWARDING
              PduRDestPduDataProvision = PDUR_DIRECT
              PduRTransmissionConfirmation = false
              PduRDestPduRef = PT_P2P_SecCH_SCU_FrP00_PP_P2P_SecCH_SCU_FrP00_Tx_427ad0d9_2e7839d1
              PduRDestPduPduRBswModulesRef = CanIf
            SRC_Can_PT_P2P_SecCH_SCU_FrP00_427ad0d9 (PduRSrcPdu):
              PduRSourcePduHandleId = 42
              PduRSrcPduDirection = TRANSMIT
              PduRSrcPduRef = PT_P2P_SecCH_SCU_FrP00_PP_P2P_SecCH_SCU_FrP00_Tx_427ad0d9_2e7839d1
              PduRSrcPduPduRBswModulesRef = Com
          Can_PT_P2P_SecCH_BCM_FrP03_427ad0d9: PduRRoutingPathCommunicationType=COMMUNICATION_INTERFACE  # P2P_SecCH_BCM_FrP03_oCAN02
            SRC_Can_PT_P2P_SecCH_BCM_FrP03_427ad0d9 (PduRSrcPdu):
              PduRSourcePduHandleId = 12
              PduRSrcPduDirection = TRANSMIT
              PduRSrcPduRef = PT_P2P_SecCH_BCM_FrP03_PP_P2P_SecCH_BCM_FrP03_Tx_427ad0d9_2e7839d1
              PduRSrcPduPduRBswModulesRef = Com
            DST_Can_PT_P2P_SecCH_BCM_FrP03_427ad0d9 (PduRDestPdu):
              PduRDestPduHandleId = 14
              PduRDestPduDirection = TRANSMIT
              PduRDestPduRoutingType = API_FORWARDING
              PduRTransmissionConfirmation = false
              PduRDestPduDataProvision = PDUR_DIRECT
              PduRDestPduRef = PT_P2P_SecCH_BCM_FrP03_PP_P2P_SecCH_BCM_FrP03_Tx_427ad0d9_2e7839d1
              PduRDestPduPduRBswModulesRef = CanIf
          Can_PT_PDC_SecCH_FrP01_427ad0d9: PduRRoutingPathCommunicationType=COMMUNICATION_INTERFACE  # PDC_SecCH_FrP01_oCAN02
            SRC_Can_PT_PDC_SecCH_FrP01_427ad0d9 (PduRSrcPdu):
              PduRSourcePduHandleId = 47
              PduRSrcPduDirection = RECEIVE
              PduRSrcPduRef = PT_PDC_SecCH_FrP01_PP_PDC_SecCH_FrP01_Rx_427ad0d9_2e7839d1
              PduRSrcPduPduRBswModulesRef = CanIf
            DST_Can_PT_PDC_SecCH_FrP01_427ad0d9 (PduRDestPdu):
              PduRDestPduHandleId = 47
              PduRDestPduDirection = RECEIVE
              PduRDestPduRoutingType = API_FORWARDING
              PduRTransmissionConfirmation = false
              PduRDestPduRef = PT_PDC_SecCH_FrP01_PP_PDC_SecCH_FrP01_Rx_427ad0d9_2e7839d1
              PduRDestPduPduRBswModulesRef = Com
          Can_PT_P2P_SecCH_HCU_ECM_FrP04_427ad0d9: PduRRoutingPathCommunicationType=COMMUNICATION_INTERFACE  # P2P_SecCH_HCU_ECM_FrP04_oCAN02
            DST_Can_PT_P2P_SecCH_HCU_ECM_FrP04_427ad0d9 (PduRDestPdu):
              PduRDestPduHandleId = 30
              PduRDestPduDirection = TRANSMIT
              PduRDestPduRoutingType = API_FORWARDING
              PduRTransmissionConfirmation = false
              PduRDestPduDataProvision = PDUR_DIRECT
              PduRDestPduRef = PT_P2P_SecCH_HCU_ECM_FrP04_PP_P2P_SecCH_HCU_ECM_FrP04_Tx_427ad0d9_2e7839d1
              PduRDestPduPduRBswModulesRef = CanIf
            SRC_Can_PT_P2P_SecCH_HCU_ECM_FrP04_427ad0d9 (PduRSrcPdu):
              PduRSourcePduHandleId = 28
              PduRSrcPduDirection = TRANSMIT
              PduRSrcPduRef = PT_P2P_SecCH_HCU_ECM_FrP04_PP_P2P_SecCH_HCU_ECM_FrP04_Tx_427ad0d9_2e7839d1
              PduRSrcPduPduRBswModulesRef = Com
          Can_PT_APA_SecCH_FrP04_427ad0d9: PduRRoutingPathCommunicationType=COMMUNICATION_INTERFACE  # APA_SecCH_FrP04_oCAN02
            DST_Can_PT_APA_SecCH_FrP04_427ad0d9 (PduRDestPdu):
              PduRDestPduHandleId = 4
              PduRDestPduDirection = RECEIVE
              PduRDestPduRoutingType = API_FORWARDING
              PduRTransmissionConfirmation = false
              PduRDestPduRef = PT_APA_SecCH_FrP04_PP_APA_SecCH_FrP04_Rx_427ad0d9_2e7839d1
              PduRDestPduPduRBswModulesRef = Com
            SRC_Can_PT_APA_SecCH_FrP04_427ad0d9 (PduRSrcPdu):
              PduRSourcePduHandleId = 4
              PduRSrcPduDirection = RECEIVE
              PduRSrcPduRef = PT_APA_SecCH_FrP04_PP_APA_SecCH_FrP04_Rx_427ad0d9_2e7839d1
              PduRSrcPduPduRBswModulesRef = CanIf
          Can_PT_P2P_SecCH_GW_FrP00_427ad0d9: PduRRoutingPathCommunicationType=COMMUNICATION_INTERFACE  # P2P_SecCH_GW_FrP00_oCAN02
            SRC_Can_PT_P2P_SecCH_GW_FrP00_427ad0d9 (PduRSrcPdu):
              PduRSourcePduHandleId = 22
              PduRSrcPduDirection = TRANSMIT
              PduRSrcPduRef = PT_P2P_SecCH_GW_FrP00_PP_P2P_SecCH_GW_FrP00_Tx_427ad0d9_2e7839d1
              PduRSrcPduPduRBswModulesRef = Com
            DST_Can_PT_P2P_SecCH_GW_FrP00_427ad0d9 (PduRDestPdu):
              PduRDestPduHandleId = 24
              PduRDestPduDirection = TRANSMIT
              PduRDestPduRoutingType = API_FORWARDING
              PduRDestPduDataProvision = PDUR_DIRECT
              PduRTransmissionConfirmation = false
              PduRDestPduRef = PT_P2P_SecCH_GW_FrP00_PP_P2P_SecCH_GW_FrP00_Tx_427ad0d9_2e7839d1
              PduRDestPduPduRBswModulesRef = CanIf
          Can_PT_P2P_SecCH_EPS_FrP02_427ad0d9: PduRRoutingPathCommunicationType=COMMUNICATION_INTERFACE  # P2P_SecCH_EPS_FrP02_oCAN02
            SRC_Can_PT_P2P_SecCH_EPS_FrP02_427ad0d9 (PduRSrcPdu):
              PduRSourcePduHandleId = 18
              PduRSrcPduDirection = TRANSMIT
              PduRSrcPduRef = PT_P2P_SecCH_EPS_FrP02_PP_P2P_SecCH_EPS_FrP02_Tx_427ad0d9_2e7839d1
              PduRSrcPduPduRBswModulesRef = Com
            DST_Can_PT_P2P_SecCH_EPS_FrP02_427ad0d9 (PduRDestPdu):
              PduRDestPduHandleId = 20
              PduRDestPduDirection = TRANSMIT
              PduRDestPduRoutingType = API_FORWARDING
              PduRDestPduDataProvision = PDUR_DIRECT
              PduRTransmissionConfirmation = false
              PduRDestPduRef = PT_P2P_SecCH_EPS_FrP02_PP_P2P_SecCH_EPS_FrP02_Tx_427ad0d9_2e7839d1
              PduRDestPduPduRBswModulesRef = CanIf
          Lin_PT_Read_LRU1_45618847: PduRRoutingPathCommunicationType=COMMUNICATION_INTERFACE  # Read_LRU1_oLIN00
            SRC_Lin_PT_Read_LRU1_45618847 (PduRSrcPdu):
              PduRSourcePduHandleId = 62
              PduRSrcPduDirection = RECEIVE
              PduRSrcPduRef = PT_Read_LRU1_PP_Read_LRU1_Rx_45618847_8792e7c3
              PduRSrcPduPduRBswModulesRef = LinIf
            DST_Lin_PT_Read_LRU1_45618847 (PduRDestPdu):
              PduRDestPduHandleId = 49
              PduRDestPduDirection = RECEIVE
              PduRDestPduRoutingType = API_FORWARDING
              PduRTransmissionConfirmation = false
              PduRDestPduRef = PT_Read_LRU1_PP_Read_LRU1_Rx_45618847_8792e7c3
              PduRDestPduPduRBswModulesRef = Com
          Lin_PT_Init_LRU1_45618847: PduRRoutingPathCommunicationType=COMMUNICATION_INTERFACE  # Init_LRU1_oLIN00
            SRC_Lin_PT_Init_LRU1_45618847 (PduRSrcPdu):
              PduRSourcePduHandleId = 47
              PduRSrcPduDirection = TRANSMIT
              PduRSrcPduRef = PT_Init_LRU1_PP_Init_LRU1_Tx_45618847_8792e7c3
              PduRSrcPduPduRBswModulesRef = Com
            DST_Lin_PT_Init_LRU1_45618847 (PduRDestPdu):
              PduRDestPduHandleId = 1
              PduRDestPduDirection = TRANSMIT
              PduRDestPduRoutingType = API_FORWARDING
              PduRTransmissionConfirmation = false
              PduRDestPduDataProvision = PDUR_TRIGGERTRANSMIT
              PduRDestPduRef = PT_Init_LRU1_PP_Init_LRU1_Tx_45618847_8792e7c3
              PduRDestPduPduRBswModulesRef = LinIf
          Lin_PT_Read_SRU3_45618847: PduRRoutingPathCommunicationType=COMMUNICATION_INTERFACE  # Read_SRU3_oLIN00
            DST_Lin_PT_Read_SRU3_45618847 (PduRDestPdu):
              PduRDestPduHandleId = 50
              PduRDestPduDirection = RECEIVE
              PduRDestPduRoutingType = API_FORWARDING
              PduRTransmissionConfirmation = false
              PduRDestPduRef = PT_Read_SRU3_PP_Read_SRU3_Rx_45618847_8792e7c3
              PduRDestPduPduRBswModulesRef = Com
            SRC_Lin_PT_Read_SRU3_45618847 (PduRSrcPdu):
              PduRSourcePduHandleId = 63
              PduRSrcPduDirection = RECEIVE
              PduRSrcPduRef = PT_Read_SRU3_PP_Read_SRU3_Rx_45618847_8792e7c3
              PduRSrcPduPduRBswModulesRef = LinIf
          Lin_PT_Init_SRU3_45618847: PduRRoutingPathCommunicationType=COMMUNICATION_INTERFACE  # Init_SRU3_oLIN00
            SRC_Lin_PT_Init_SRU3_45618847 (PduRSrcPdu):
              PduRSourcePduHandleId = 48
              PduRSrcPduDirection = TRANSMIT
              PduRSrcPduRef = PT_Init_SRU3_PP_Init_SRU3_Tx_45618847_8792e7c3
              PduRSrcPduPduRBswModulesRef = Com
            DST_Lin_PT_Init_SRU3_45618847 (PduRDestPdu):
              PduRDestPduHandleId = 2
              PduRDestPduDirection = TRANSMIT
              PduRDestPduRoutingType = API_FORWARDING
              PduRTransmissionConfirmation = false
              PduRDestPduDataProvision = PDUR_TRIGGERTRANSMIT
              PduRDestPduRef = PT_Init_SRU3_PP_Init_SRU3_Tx_45618847_8792e7c3
              PduRDestPduPduRBswModulesRef = LinIf
          PduRRoutingPath_Acceinna_Accel: PduRRoutingPathCommunicationType=COMMUNICATION_INTERFACE
            PduRDestPdu_3 (PduRDestPdu):
              PduRDestPduHandleId = 64
              PduRDestPduDirection = RECEIVE
              PduRDestPduRoutingType = API_FORWARDING
              PduRTransmissionConfirmation = false
              PduRDestPduRef = Pdu_Aceinna_Accel
              PduRDestPduPduRBswModulesRef = Com
            PduRSrcPdu_3 (PduRSrcPdu): PduRSourcePduHandleId=64, PduRSrcPduDirection=RECEIVE, PduRSrcPduRef=Pdu_Aceinna_Accel, PduRSrcPduPduRBswModulesRef=CanIf
          PduRRoutingPath_Aceinna_AngleRate: PduRRoutingPathCommunicationType=COMMUNICATION_INTERFACE
            PduRDestPdu_4 (PduRDestPdu):
              PduRDestPduHandleId = 65
              PduRDestPduDirection = RECEIVE
              PduRDestPduRoutingType = API_FORWARDING
              PduRTransmissionConfirmation = false
              PduRDestPduRef = Pdu_Aceinna_AngleRate
              PduRDestPduPduRBswModulesRef = Com
            PduRSrcPdu_4 (PduRSrcPdu): PduRSourcePduHandleId=65, PduRSrcPduDirection=RECEIVE, PduRSrcPduRef=Pdu_Aceinna_AngleRate, PduRSrcPduPduRBswModulesRef=CanIf
          PduRRoutingPath_Aceinna_Angles: PduRRoutingPathCommunicationType=COMMUNICATION_INTERFACE
            PduRDestPdu_5 (PduRDestPdu):
              PduRDestPduHandleId = 66
              PduRDestPduDirection = RECEIVE
              PduRDestPduRoutingType = API_FORWARDING
              PduRTransmissionConfirmation = false
              PduRDestPduRef = Pdu_Aceinna_Angles
              PduRDestPduPduRBswModulesRef = Com
            PduRSrcPdu_5 (PduRSrcPdu): PduRSourcePduHandleId=66, PduRSrcPduDirection=RECEIVE, PduRSrcPduRef=Pdu_Aceinna_Angles, PduRSrcPduPduRBswModulesRef=CanIf
    4 x PduRBswModules, all with PduRCancelReceive=false, PduRCancelTransmit=false, PduRChangeParameterRequestApi=false:
      Com: PduRCommunicationInterface=true, PduRLowerModule=false, PduRTransportProtocol=false, PduRTriggertransmit=true, PduRTxConfirmation=false, PduRUpperModule=true, PduRUseTag=false, PduRBswModuleRef=Com
      CanTp: PduRCommunicationInterface=false, PduRLowerModule=true, PduRTransportProtocol=true, PduRTriggertransmit=false, PduRTxConfirmation=false, PduRUpperModule=false, PduRUseTag=false, PduRBswModuleRef=CanTp
      Dcm: PduRCommunicationInterface=false, PduRLowerModule=false, PduRTransportProtocol=true, PduRTriggertransmit=false, PduRTxConfirmation=false, PduRUpperModule=true, PduRUseTag=true, PduRBswModuleRef=Dcm
      LinIf: PduRCommunicationInterface=true, PduRLowerModule=true, PduRTransportProtocol=false, PduRTriggertransmit=true, PduRTxConfirmation=true, PduRUpperModule=false, PduRUseTag=false, PduRBswModuleRef=LinIf
