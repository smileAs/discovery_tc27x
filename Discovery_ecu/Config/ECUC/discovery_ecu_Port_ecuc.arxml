AUTOSAR XML (schema 4-2-1)
package /ActiveEcuC
  module config Port: implementation-config-variant=VARIANT-POST-BUILD-LOADABLE, module-description=Port_Impl
    PortConfigSet
      17 x PortContainer:
        PortContainer_0: PortNumber=0, PortNumberOfPortPins=13
          13 x PortPin, all with PortPinDirectionChangeable=false, PortPinInputHysteresis=false, PortPinLevelValue=PORT_PIN_LEVEL_HIGH, PortPinModeChangeable=false, PortPinDriverStrength=PORT_CMOS_SPEED_GRADE1, PortPinPadLevel=PORT_PDR_CMOS_AUTOMOTIVE_LEVEL, PortPinAnalogInput=DISABLE, PortPinControllerSelect=DISABLE, PortPinInputCharacteristic=PORT_PIN_IN_PULL_UP, PortPinMode=PORT_PIN_MODE_ALL:
            P00_00_UART3_TXD: PortPinId=0, PortPinSymbolicName=PORT_0_PIN_0, PortPinDirection=PORT_PIN_OUT, PortPinInitialMode=PORT_PIN_MODE_ALT3, PortPinOutputCharacteristic=PORT_PIN_OUT_PUSHPULL
            P00_02_CAN3_TXD: PortPinId=2, PortPinSymbolicName=PORT_0_PIN_2, PortPinDirection=PORT_PIN_OUT, PortPinInitialMode=PORT_PIN_MODE_ALT5, PortPinOutputCharacteristic=PORT_PIN_OUT_PUSHPULL
            P00_03_CAN3_RXD: PortPinId=3, PortPinSymbolicName=PORT_0_PIN_3, PortPinDirection=PORT_PIN_IN, PortPinInitialMode=PORT_PIN_MODE_GPIO
            P00_04_CAN3_WAKE_N: PortPinId=4, PortPinSymbolicName=PORT_0_PIN_4, PortPinDirection=PORT_PIN_OUT, PortPinInitialMode=PORT_PIN_MODE_GPIO, PortPinOutputCharacteristic=PORT_PIN_OUT_PUSHPULL
            P00_05_CAN3_ERR_N: PortPinId=5, PortPinSymbolicName=PORT_0_PIN_5, PortPinDirection=PORT_PIN_IN, PortPinInitialMode=PORT_PIN_MODE_GPIO
            P00_06_CAN3_STB_N: PortPinId=6, PortPinSymbolicName=PORT_0_PIN_6, PortPinDirection=PORT_PIN_OUT, PortPinInitialMode=PORT_PIN_MODE_GPIO, PortPinOutputCharacteristic=PORT_PIN_OUT_PUSHPULL
            P00_07_CAN3_EN: PortPinId=7, PortPinSymbolicName=PORT_0_PIN_7, PortPinDirection=PORT_PIN_OUT, PortPinInitialMode=PORT_PIN_MODE_GPIO, PortPinOutputCharacteristic=PORT_PIN_OUT_PUSHPULL
            P00_08_CAN3_INH_N: PortPinId=8, PortPinSymbolicName=PORT_0_PIN_8, PortPinDirection=PORT_PIN_IN, PortPinInitialMode=PORT_PIN_MODE_GPIO
            P00_09_CAN2_WAKE_N: PortPinId=9, PortPinSymbolicName=PORT_0_PIN_9, PortPinDirection=PORT_PIN_OUT, PortPinInitialMode=PORT_PIN_MODE_GPIO, PortPinOutputCharacteristic=PORT_PIN_OUT_PUSHPULL
            P00_10_CAN2_ERR_N: PortPinId=10, PortPinSymbolicName=PORT_0_PIN_10, PortPinDirection=PORT_PIN_IN, PortPinInitialMode=PORT_PIN_MODE_GPIO
            P00_11_CAN2_STB_N: PortPinId=11, PortPinSymbolicName=PORT_0_PIN_11, PortPinDirection=PORT_PIN_OUT, PortPinInitialMode=PORT_PIN_MODE_GPIO, PortPinOutputCharacteristic=PORT_PIN_OUT_PUSHPULL
            P00_12_: PortPinId=12, PortPinSymbolicName=PORT_0_PIN_12, PortPinDirection=PORT_PIN_IN, PortPinInitialMode=PORT_PIN_MODE_GPIO
            P00_01_UART3_RXD: PortPinId=1, PortPinSymbolicName=PORT_0_PIN_1, PortPinDirection=PORT_PIN_IN, PortPinInitialMode=PORT_PIN_MODE_GPIO
        PortContainer_1: PortNumber=1, PortNumberOfPortPins=5
          5 x PortPin, all with PortPinDirectionChangeable=false, PortPinInputHysteresis=false, PortPinLevelValue=PORT_PIN_LEVEL_HIGH, PortPinInitialMode=PORT_PIN_MODE_GPIO, PortPinModeChangeable=false, PortPinDriverStrength=PORT_CMOS_SPEED_GRADE1, PortPinPadLevel=PORT_PDR_CMOS_AUTOMOTIVE_LEVEL, PortPinAnalogInput=DISABLE, PortPinControllerSelect=DISABLE, PortPinInputCharacteristic=PORT_PIN_IN_PULL_UP, PortPinMode=PORT_PIN_MODE_ALL:
            P01_03_CAN1_WAKE_N: PortPinId=19, PortPinSymbolicName=PORT_1_PIN_3, PortPinDirection=PORT_PIN_OUT, PortPinOutputCharacteristic=PORT_PIN_OUT_PUSHPULL
            P01_04_CAN1_ERR_N: PortPinId=20, PortPinSymbolicName=PORT_1_PIN_4, PortPinDirection=PORT_PIN_IN, PortPinOutputCharacteristic=PORT_PIN_OUT_PUSHPULL
            P01_05_CAN_1_STB_N: PortPinId=21, PortPinSymbolicName=PORT_1_PIN_5, PortPinDirection=PORT_PIN_OUT, PortPinOutputCharacteristic=PORT_PIN_OUT_PUSHPULL
            P01_06_CAN1_EN: PortPinId=22, PortPinSymbolicName=PORT_1_PIN_6, PortPinDirection=PORT_PIN_OUT, PortPinOutputCharacteristic=PORT_PIN_OUT_PUSHPULL
            P01_07_CAN1_INH_N: PortPinId=23, PortPinSymbolicName=PORT_1_PIN_7, PortPinDirection=PORT_PIN_IN
        PortContainer_2: PortNumber=2, PortNumberOfPortPins=12
          12 x PortPin, all with PortPinDirectionChangeable=false, PortPinInputHysteresis=false, PortPinModeChangeable=false, PortPinDriverStrength=PORT_CMOS_SPEED_GRADE1, PortPinPadLevel=PORT_PDR_CMOS_AUTOMOTIVE_LEVEL, PortPinAnalogInput=DISABLE, PortPinControllerSelect=DISABLE, PortPinInputCharacteristic=PORT_PIN_IN_PULL_UP, PortPinMode=PORT_PIN_MODE_ALL:
            P02_00_CAN2_EN: PortPinId=32, PortPinSymbolicName=PORT_2_PIN_0, PortPinDirection=PORT_PIN_OUT, PortPinLevelValue=PORT_PIN_LEVEL_HIGH, PortPinInitialMode=PORT_PIN_MODE_GPIO, PortPinOutputCharacteristic=PORT_PIN_OUT_PUSHPULL
            P02_01_CAN2_INH_N: PortPinId=33, PortPinSymbolicName=PORT_2_PIN_1, PortPinDirection=PORT_PIN_IN, PortPinLevelValue=PORT_PIN_LEVEL_LOW, PortPinInitialMode=PORT_PIN_MODE_GPIO
            P02_03_CAN2_RXD: PortPinId=35, PortPinSymbolicName=PORT_2_PIN_3, PortPinDirection=PORT_PIN_IN, PortPinLevelValue=PORT_PIN_LEVEL_HIGH, PortPinInitialMode=PORT_PIN_MODE_GPIO
            P02_04_CAN0_RXD: PortPinId=36, PortPinSymbolicName=PORT_2_PIN_4, PortPinDirection=PORT_PIN_IN, PortPinLevelValue=PORT_PIN_LEVEL_HIGH, PortPinInitialMode=PORT_PIN_MODE_GPIO
            P02_05_CAN0_TXD: PortPinId=37, PortPinSymbolicName=PORT_2_PIN_5, PortPinDirection=PORT_PIN_OUT, PortPinLevelValue=PORT_PIN_LEVEL_HIGH, PortPinInitialMode=PORT_PIN_MODE_ALT2, PortPinOutputCharacteristic=PORT_PIN_OUT_PUSHPULL
            P02_06_CAN0_WAKE_N: PortPinId=38, PortPinSymbolicName=PORT_2_PIN_6, PortPinDirection=PORT_PIN_OUT, PortPinLevelValue=PORT_PIN_LEVEL_HIGH, PortPinInitialMode=PORT_PIN_MODE_GPIO, PortPinOutputCharacteristic=PORT_PIN_OUT_PUSHPULL
            P02_07_CAN0_ERR_N: PortPinId=39, PortPinSymbolicName=PORT_2_PIN_7, PortPinDirection=PORT_PIN_IN, PortPinLevelValue=PORT_PIN_LEVEL_HIGH, PortPinInitialMode=PORT_PIN_MODE_GPIO
            P02_08_CAN0_STB_N: PortPinId=40, PortPinSymbolicName=PORT_2_PIN_8, PortPinDirection=PORT_PIN_OUT, PortPinLevelValue=PORT_PIN_LEVEL_HIGH, PortPinInitialMode=PORT_PIN_MODE_GPIO, PortPinOutputCharacteristic=PORT_PIN_OUT_PUSHPULL
            P02_09_CAN1_TXD: PortPinId=41, PortPinSymbolicName=PORT_2_PIN_9, PortPinDirection=PORT_PIN_OUT, PortPinLevelValue=PORT_PIN_LEVEL_HIGH, PortPinInitialMode=PORT_PIN_MODE_ALT5, PortPinOutputCharacteristic=PORT_PIN_OUT_PUSHPULL
            P02_10_CAN1_RXD: PortPinId=42, PortPinSymbolicName=PORT_2_PIN_10, PortPinDirection=PORT_PIN_IN, PortPinLevelValue=PORT_PIN_LEVEL_HIGH, PortPinInitialMode=PORT_PIN_MODE_GPIO
            P02_11_CAN0_EN: PortPinId=43, PortPinSymbolicName=PORT_2_PIN_11, PortPinDirection=PORT_PIN_OUT, PortPinLevelValue=PORT_PIN_LEVEL_HIGH, PortPinInitialMode=PORT_PIN_MODE_GPIO, PortPinOutputCharacteristic=PORT_PIN_OUT_PUSHPULL
            P02_02_CAN2_TXD: PortPinId=34, PortPinSymbolicName=PORT_2_PIN_2, PortPinDirection=PORT_PIN_OUT, PortPinLevelValue=PORT_PIN_LEVEL_HIGH, PortPinInitialMode=PORT_PIN_MODE_ALT5, PortPinOutputCharacteristic=PORT_PIN_OUT_PUSHPULL
        PortContainer_3: PortNumber=10, PortNumberOfPortPins=9
          9 x PortPin, all with PortPinDirectionChangeable=false, PortPinInputHysteresis=false, PortPinModeChangeable=false, PortPinDriverStrength=PORT_CMOS_SPEED_GRADE1, PortPinPadLevel=PORT_PDR_CMOS_AUTOMOTIVE_LEVEL, PortPinAnalogInput=DISABLE, PortPinControllerSelect=DISABLE, PortPinInputCharacteristic=PORT_PIN_IN_PULL_UP, PortPinMode=PORT_PIN_MODE_ALL:
            QSPI1_CS: PortPinId=160, PortPinSymbolicName=PORT_10_PIN_0, PortPinDirection=PORT_PIN_OUT, PortPinLevelValue=PORT_PIN_LEVEL_HIGH, PortPinInitialMode=PORT_PIN_MODE_ALT3, PortPinOutputCharacteristic=PORT_PIN_OUT_PUSHPULL
            QSPI1_MISO: PortPinId=161, PortPinSymbolicName=PORT_10_PIN_1, PortPinDirection=PORT_PIN_IN, PortPinLevelValue=PORT_PIN_LEVEL_HIGH, PortPinInitialMode=PORT_PIN_MODE_GPIO
            QSPI1_SCLK: PortPinId=162, PortPinSymbolicName=PORT_10_PIN_2, PortPinDirection=PORT_PIN_OUT, PortPinLevelValue=PORT_PIN_LEVEL_HIGH, PortPinInitialMode=PORT_PIN_MODE_ALT3, PortPinOutputCharacteristic=PORT_PIN_OUT_PUSHPULL
            QSPI1_MOSI: PortPinId=163, PortPinSymbolicName=PORT_10_PIN_3, PortPinDirection=PORT_PIN_OUT, PortPinLevelValue=PORT_PIN_LEVEL_HIGH, PortPinInitialMode=PORT_PIN_MODE_ALT3, PortPinOutputCharacteristic=PORT_PIN_OUT_PUSHPULL
            PortPin_4: PortPinId=164, PortPinSymbolicName=PORT_10_PIN_4, PortPinDirection=PORT_PIN_IN, PortPinLevelValue=PORT_PIN_LEVEL_LOW, PortPinInitialMode=PORT_PIN_MODE_GPIO
            PortPin_5: PortPinId=165, PortPinSymbolicName=PORT_10_PIN_5, PortPinDirection=PORT_PIN_IN, PortPinLevelValue=PORT_PIN_LEVEL_LOW, PortPinInitialMode=PORT_PIN_MODE_GPIO
            PortPin_6: PortPinId=166, PortPinSymbolicName=PORT_10_PIN_6, PortPinDirection=PORT_PIN_IN, PortPinLevelValue=PORT_PIN_LEVEL_LOW, PortPinInitialMode=PORT_PIN_MODE_GPIO
            PortPin_7: PortPinId=167, PortPinSymbolicName=PORT_10_PIN_7, PortPinDirection=PORT_PIN_IN, PortPinLevelValue=PORT_PIN_LEVEL_LOW, PortPinInitialMode=PORT_PIN_MODE_GPIO
            PortPin_8: PortPinId=168, PortPinSymbolicName=PORT_10_PIN_8, PortPinDirection=PORT_PIN_IN, PortPinLevelValue=PORT_PIN_LEVEL_LOW, PortPinInitialMode=PORT_PIN_MODE_GPIO
        PortContainer_4: PortNumber=11, PortNumberOfPortPins=16
          16 x PortPin, all with PortPinDirectionChangeable=false, PortPinInputHysteresis=false, PortPinModeChangeable=false, PortPinDriverStrength=PORT_CMOS_SPEED_GRADE1, PortPinPadLevel=PORT_PDR_CMOS_AUTOMOTIVE_LEVEL, PortPinAnalogInput=DISABLE, PortPinControllerSelect=DISABLE, PortPinInputCharacteristic=PORT_PIN_IN_PULL_UP:
            ETHTXD3: PortPinId=176, PortPinSymbolicName=PORT_11_PIN_0, PortPinDirection=PORT_PIN_OUT, PortPinLevelValue=PORT_PIN_LEVEL_LOW, PortPinInitialMode=PORT_PIN_MODE_ALT6, PortPinOutputCharacteristic=PORT_PIN_OUT_PUSHPULL, PortPinMode=PORT_PIN_MODE_ALT6
            ETHTXD2: PortPinId=177, PortPinSymbolicName=PORT_11_PIN_1, PortPinDirection=PORT_PIN_OUT, PortPinLevelValue=PORT_PIN_LEVEL_LOW, PortPinInitialMode=PORT_PIN_MODE_ALT6, PortPinOutputCharacteristic=PORT_PIN_OUT_PUSHPULL, PortPinMode=PORT_PIN_MODE_ALT6
            ETHTXD1: PortPinId=178, PortPinSymbolicName=PORT_11_PIN_2, PortPinDirection=PORT_PIN_OUT, PortPinLevelValue=PORT_PIN_LEVEL_LOW, PortPinInitialMode=PORT_PIN_MODE_ALT6, PortPinOutputCharacteristic=PORT_PIN_OUT_PUSHPULL, PortPinMode=PORT_PIN_MODE_ALT6
            ETHTXD0: PortPinId=179, PortPinSymbolicName=PORT_11_PIN_3, PortPinDirection=PORT_PIN_OUT, PortPinLevelValue=PORT_PIN_LEVEL_LOW, PortPinInitialMode=PORT_PIN_MODE_ALT6, PortPinOutputCharacteristic=PORT_PIN_OUT_PUSHPULL, PortPinMode=PORT_PIN_MODE_ALT6
            ETHTXER: PortPinId=180, PortPinSymbolicName=PORT_11_PIN_4, PortPinDirection=PORT_PIN_OUT, PortPinLevelValue=PORT_PIN_LEVEL_HIGH, PortPinInitialMode=PORT_PIN_MODE_ALT6, PortPinMode=PORT_PIN_MODE_ALL, PortPinOutputCharacteristic=PORT_PIN_OUT_PUSHPULL
            ETHTXCLK: PortPinId=181, PortPinSymbolicName=PORT_11_PIN_5, PortPinDirection=PORT_PIN_IN, PortPinLevelValue=PORT_PIN_LEVEL_HIGH, PortPinInitialMode=PORT_PIN_MODE_GPIO, PortPinMode=PORT_PIN_MODE_ALL
            ETHTXEN: PortPinId=182, PortPinSymbolicName=PORT_11_PIN_6, PortPinDirection=PORT_PIN_OUT, PortPinLevelValue=PORT_PIN_LEVEL_LOW, PortPinInitialMode=PORT_PIN_MODE_ALT6, PortPinOutputCharacteristic=PORT_PIN_OUT_PUSHPULL, PortPinMode=PORT_PIN_MODE_ALT6
            ETHRXD3: PortPinId=183, PortPinSymbolicName=PORT_11_PIN_7, PortPinDirection=PORT_PIN_IN, PortPinLevelValue=PORT_PIN_LEVEL_LOW, PortPinInitialMode=PORT_PIN_MODE_GPIO, PortPinMode=PORT_PIN_MODE_GPIO
            ETHRXD2: PortPinId=184, PortPinSymbolicName=PORT_11_PIN_8, PortPinDirection=PORT_PIN_IN, PortPinLevelValue=PORT_PIN_LEVEL_LOW, PortPinInitialMode=PORT_PIN_MODE_GPIO, PortPinMode=PORT_PIN_MODE_GPIO
            ETHRXD1: PortPinId=185, PortPinSymbolicName=PORT_11_PIN_9, PortPinDirection=PORT_PIN_IN, PortPinLevelValue=PORT_PIN_LEVEL_LOW, PortPinInitialMode=PORT_PIN_MODE_GPIO, PortPinMode=PORT_PIN_MODE_GPIO
            ETHRXD0: PortPinId=186, PortPinSymbolicName=PORT_11_PIN_10, PortPinDirection=PORT_PIN_IN, PortPinLevelValue=PORT_PIN_LEVEL_LOW, PortPinInitialMode=PORT_PIN_MODE_GPIO, PortPinMode=PORT_PIN_MODE_GPIO
            ETHRXDV: PortPinId=187, PortPinSymbolicName=PORT_11_PIN_11, PortPinDirection=PORT_PIN_IN, PortPinLevelValue=PORT_PIN_LEVEL_LOW, PortPinInitialMode=PORT_PIN_MODE_GPIO, PortPinOutputCharacteristic=PORT_PIN_OUT_PUSHPULL, PortPinMode=PORT_PIN_MODE_GPIO
            ETHRXCLK: PortPinId=188, PortPinSymbolicName=PORT_11_PIN_12, PortPinDirection=PORT_PIN_IN, PortPinLevelValue=PORT_PIN_LEVEL_LOW, PortPinInitialMode=PORT_PIN_MODE_GPIO, PortPinOutputCharacteristic=PORT_PIN_OUT_PUSHPULL, PortPinMode=PORT_PIN_MODE_GPIO
            ETHRXER: PortPinId=189, PortPinSymbolicName=PORT_11_PIN_13, PortPinDirection=PORT_PIN_IN, PortPinLevelValue=PORT_PIN_LEVEL_LOW, PortPinInitialMode=PORT_PIN_MODE_GPIO, PortPinOutputCharacteristic=PORT_PIN_OUT_PUSHPULL, PortPinMode=PORT_PIN_MODE_GPIO
            ETHCRS: PortPinId=190, PortPinSymbolicName=PORT_11_PIN_14, PortPinDirection=PORT_PIN_IN, PortPinLevelValue=PORT_PIN_LEVEL_HIGH, PortPinInitialMode=PORT_PIN_MODE_GPIO, PortPinMode=PORT_PIN_MODE_GPIO
            ETHCOL: PortPinId=191, PortPinSymbolicName=PORT_11_PIN_15, PortPinDirection=PORT_PIN_IN, PortPinLevelValue=PORT_PIN_LEVEL_HIGH, PortPinInitialMode=PORT_PIN_MODE_GPIO, PortPinMode=PORT_PIN_MODE_GPIO
        PortContainer_5: PortNumber=12, PortNumberOfPortPins=2
          ETHMDC (PortPin):
            PortPinId = 192
            PortPinSymbolicName = PORT_12_PIN_0
            PortPinDirection = PORT_PIN_OUT
            PortPinDirectionChangeable = false
            PortPinInputHysteresis = false
            PortPinLevelValue = PORT_PIN_LEVEL_HIGH
            PortPinInitialMode = PORT_PIN_MODE_ALT6
            PortPinModeChangeable = false
            PortPinDriverStrength = PORT_CMOS_SPEED_GRADE1
            PortPinPadLevel = PORT_PDR_CMOS_AUTOMOTIVE_LEVEL
            PortPinAnalogInput = DISABLE
            PortPinControllerSelect = DISABLE
            PortPinInputCharacteristic = PORT_PIN_IN_PULL_UP
            PortPinMode = PORT_PIN_MODE_ALL
            PortPinOutputCharacteristic = PORT_PIN_OUT_PUSHPULL
          ETHMDIO (PortPin):
            PortPinId = 193
            PortPinSymbolicName = PORT_12_PIN_1
            PortPinDirection = PORT_PIN_IN
            PortPinDirectionChangeable = false
            PortPinInputHysteresis = false
            PortPinLevelValue = PORT_PIN_LEVEL_HIGH
            PortPinInitialMode = PORT_PIN_MODE_GPIO
            PortPinModeChangeable = false
            PortPinDriverStrength = PORT_CMOS_SPEED_GRADE1
            PortPinPadLevel = PORT_PDR_CMOS_AUTOMOTIVE_LEVEL
            PortPinAnalogInput = DISABLE
            PortPinControllerSelect = DISABLE
            PortPinInputCharacteristic = PORT_PIN_IN_PULL_UP
            PortPinMode = PORT_PIN_MODE_ALL
        PortContainer_6: PortNumber=13, PortNumberOfPortPins=4
          4 x PortPin, all with PortPinDirectionChangeable=false, PortPinInputHysteresis=false, PortPinModeChangeable=false, PortPinDriverStrength=PORT_CMOS_SPEED_GRADE1, PortPinPadLevel=PORT_PDR_CMOS_AUTOMOTIVE_LEVEL, PortPinAnalogInput=DISABLE, PortPinControllerSelect=DISABLE, PortPinMode=PORT_PIN_MODE_ALL, PortPinInputCharacteristic=PORT_PIN_IN_PULL_UP:
            PortPin_0: PortPinId=208, PortPinSymbolicName=PORT_13_PIN_0, PortPinDirection=PORT_PIN_IN, PortPinLevelValue=PORT_PIN_LEVEL_LOW, PortPinInitialMode=PORT_PIN_MODE_GPIO
            I2C0_SCL: PortPinId=209, PortPinSymbolicName=PORT_13_PIN_1, PortPinDirection=PORT_PIN_OUT, PortPinLevelValue=PORT_PIN_LEVEL_HIGH, PortPinInitialMode=PORT_PIN_MODE_ALT6, PortPinOutputCharacteristic=PORT_PIN_OUT_OPENDRAIN
            I2C0_SDA: PortPinId=210, PortPinSymbolicName=PORT_13_PIN_2, PortPinDirection=PORT_PIN_OUT, PortPinLevelValue=PORT_PIN_LEVEL_HIGH, PortPinInitialMode=PORT_PIN_MODE_ALT6, PortPinOutputCharacteristic=PORT_PIN_OUT_OPENDRAIN
            PortPin_3: PortPinId=211, PortPinSymbolicName=PORT_13_PIN_4, PortPinDirection=PORT_PIN_IN, PortPinLevelValue=PORT_PIN_LEVEL_LOW, PortPinInitialMode=PORT_PIN_MODE_GPIO
          PortLVDSM_0 (PortLVDSM): PortLVDSMPinPair=Pin_0_Pin_1, PortPadSupplyVoltage=PAD_SUPPLY_5V
          PortLVDSM_1 (PortLVDSM): PortLVDSMPinPair=Pin_2_Pin_3, PortPadSupplyVoltage=PAD_SUPPLY_5V
        PortContainer_7: PortNumber=14, PortNumberOfPortPins=11
          11 x PortPin, all with PortPinDirectionChangeable=false, PortPinInputHysteresis=false, PortPinModeChangeable=false, PortPinDriverStrength=PORT_CMOS_SPEED_GRADE1, PortPinPadLevel=PORT_PDR_CMOS_AUTOMOTIVE_LEVEL, PortPinAnalogInput=DISABLE, PortPinControllerSelect=DISABLE, PortPinInputCharacteristic=PORT_PIN_IN_PULL_UP, PortPinMode=PORT_PIN_MODE_ALL:
            UART0TX: PortPinId=224, PortPinSymbolicName=PORT_14_PIN_0, PortPinDirection=PORT_PIN_OUT, PortPinLevelValue=PORT_PIN_LEVEL_HIGH, PortPinInitialMode=PORT_PIN_MODE_ALT2, PortPinOutputCharacteristic=PORT_PIN_OUT_PUSHPULL
            PortPin_2: PortPinId=226, PortPinSymbolicName=PORT_14_PIN_2, PortPinDirection=PORT_PIN_IN, PortPinLevelValue=PORT_PIN_LEVEL_LOW, PortPinInitialMode=PORT_PIN_MODE_GPIO
            PortPin_3: PortPinId=227, PortPinSymbolicName=PORT_14_PIN_3, PortPinDirection=PORT_PIN_IN, PortPinLevelValue=PORT_PIN_LEVEL_LOW, PortPinInitialMode=PORT_PIN_MODE_GPIO
            PortPin_4: PortPinId=228, PortPinSymbolicName=PORT_14_PIN_4, PortPinDirection=PORT_PIN_IN, PortPinLevelValue=PORT_PIN_LEVEL_LOW, PortPinInitialMode=PORT_PIN_MODE_GPIO
            PortPin_5: PortPinId=229, PortPinSymbolicName=PORT_14_PIN_5, PortPinDirection=PORT_PIN_IN, PortPinLevelValue=PORT_PIN_LEVEL_LOW, PortPinInitialMode=PORT_PIN_MODE_GPIO
            PortPin_6: PortPinId=230, PortPinSymbolicName=PORT_14_PIN_6, PortPinDirection=PORT_PIN_IN, PortPinLevelValue=PORT_PIN_LEVEL_LOW, PortPinInitialMode=PORT_PIN_MODE_GPIO
            UART0_RTS: PortPinId=231, PortPinSymbolicName=PORT_14_PIN_7, PortPinDirection=PORT_PIN_OUT, PortPinLevelValue=PORT_PIN_LEVEL_HIGH, PortPinInitialMode=PORT_PIN_MODE_ALT2, PortPinOutputCharacteristic=PORT_PIN_OUT_PUSHPULL
            RTC_MFP_WAK: PortPinId=232, PortPinSymbolicName=PORT_14_PIN_8, PortPinDirection=PORT_PIN_OUT, PortPinLevelValue=PORT_PIN_LEVEL_HIGH, PortPinInitialMode=PORT_PIN_MODE_GPIO, PortPinOutputCharacteristic=PORT_PIN_OUT_OPENDRAIN
            UART0_CTS: PortPinId=233, PortPinSymbolicName=PORT_14_PIN_9, PortPinDirection=PORT_PIN_IN, PortPinLevelValue=PORT_PIN_LEVEL_HIGH, PortPinInitialMode=PORT_PIN_MODE_GPIO
            PortPin_10: PortPinId=234, PortPinSymbolicName=PORT_14_PIN_10, PortPinDirection=PORT_PIN_IN, PortPinLevelValue=PORT_PIN_LEVEL_LOW, PortPinInitialMode=PORT_PIN_MODE_GPIO
            UART0RX: PortPinId=225, PortPinSymbolicName=PORT_14_PIN_1, PortPinDirection=PORT_PIN_IN, PortPinLevelValue=PORT_PIN_LEVEL_LOW, PortPinInitialMode=PORT_PIN_MODE_GPIO
        PortContainer_8: PortNumber=15, PortNumberOfPortPins=9
          9 x PortPin, all with PortPinDirectionChangeable=false, PortPinInputHysteresis=false, PortPinLevelValue=PORT_PIN_LEVEL_HIGH, PortPinInitialMode=PORT_PIN_MODE_GPIO, PortPinModeChangeable=false, PortPinDriverStrength=PORT_CMOS_SPEED_GRADE1, PortPinPadLevel=PORT_PDR_CMOS_AUTOMOTIVE_LEVEL, PortPinAnalogInput=DISABLE, PortPinControllerSelect=DISABLE, PortPinInputCharacteristic=PORT_PIN_IN_PULL_UP, PortPinMode=PORT_PIN_MODE_ALL:
            RELOAD_4G: PortPinId=241, PortPinSymbolicName=PORT_15_PIN_1, PortPinDirection=PORT_PIN_OUT, PortPinOutputCharacteristic=PORT_PIN_OUT_PUSHPULL
            NET_4G: PortPinId=242, PortPinSymbolicName=PORT_15_PIN_2, PortPinDirection=PORT_PIN_OUT, PortPinOutputCharacteristic=PORT_PIN_OUT_PUSHPULL
            WORK_4G: PortPinId=243, PortPinSymbolicName=PORT_15_PIN_3, PortPinDirection=PORT_PIN_OUT, PortPinOutputCharacteristic=PORT_PIN_OUT_PUSHPULL
            LINKB_4G: PortPinId=244, PortPinSymbolicName=PORT_15_PIN_4, PortPinDirection=PORT_PIN_OUT, PortPinOutputCharacteristic=PORT_PIN_OUT_PUSHPULL
            LINKA_4G: PortPinId=245, PortPinSymbolicName=PORT_15_PIN_5, PortPinDirection=PORT_PIN_OUT, PortPinOutputCharacteristic=PORT_PIN_OUT_PUSHPULL
            WAKEUP_EN: PortPinId=246, PortPinSymbolicName=PORT_15_PIN_6, PortPinDirection=PORT_PIN_IN
            KEY1_GPIO: PortPinId=247, PortPinSymbolicName=PORT_15_PIN_7, PortPinDirection=PORT_PIN_IN
            KEY2_GPIO: PortPinId=248, PortPinSymbolicName=PORT_15_PIN_8, PortPinDirection=PORT_PIN_IN
            POWER_4G: PortPinId=240, PortPinSymbolicName=PORT_15_PIN_0, PortPinDirection=PORT_PIN_OUT, PortPinOutputCharacteristic=PORT_PIN_OUT_PUSHPULL
        PortContainer_9: PortNumber=20, PortNumberOfPortPins=13
          13 x PortPin, all with PortPinDirectionChangeable=false, PortPinInputHysteresis=false, PortPinInitialMode=PORT_PIN_MODE_GPIO, PortPinModeChangeable=false, PortPinDriverStrength=PORT_CMOS_SPEED_GRADE1, PortPinPadLevel=PORT_PDR_CMOS_AUTOMOTIVE_LEVEL, PortPinAnalogInput=DISABLE, PortPinControllerSelect=DISABLE, PortPinMode=PORT_PIN_MODE_ALL, PortPinInputCharacteristic=PORT_PIN_IN_PULL_UP:
            P20_00_CAN_EN: PortPinId=320, PortPinSymbolicName=PORT_20_PIN_0, PortPinDirection=PORT_PIN_IN, PortPinLevelValue=PORT_PIN_LEVEL_LOW
            P20_01_CAN_ERR: PortPinId=321, PortPinSymbolicName=PORT_20_PIN_1, PortPinDirection=PORT_PIN_IN, PortPinLevelValue=PORT_PIN_LEVEL_LOW
            P20_02_CAN_STB: PortPinId=322, PortPinSymbolicName=PORT_20_PIN_2, PortPinDirection=PORT_PIN_IN, PortPinLevelValue=PORT_PIN_LEVEL_LOW
            P20_03: PortPinId=323, PortPinSymbolicName=PORT_20_PIN_3, PortPinDirection=PORT_PIN_IN, PortPinLevelValue=PORT_PIN_LEVEL_LOW
            P20_06: PortPinId=326, PortPinSymbolicName=PORT_20_PIN_6, PortPinDirection=PORT_PIN_IN, PortPinLevelValue=PORT_PIN_LEVEL_LOW
            P20_07: PortPinId=327, PortPinSymbolicName=PORT_20_PIN_7, PortPinDirection=PORT_PIN_IN, PortPinLevelValue=PORT_PIN_LEVEL_LOW
            P20_08: PortPinId=328, PortPinSymbolicName=PORT_20_PIN_8, PortPinDirection=PORT_PIN_IN, PortPinLevelValue=PORT_PIN_LEVEL_LOW
            P20_09: PortPinId=329, PortPinSymbolicName=PORT_20_PIN_9, PortPinDirection=PORT_PIN_IN, PortPinLevelValue=PORT_PIN_LEVEL_LOW
            P20_10: PortPinId=330, PortPinSymbolicName=PORT_20_PIN_10, PortPinDirection=PORT_PIN_IN, PortPinLevelValue=PORT_PIN_LEVEL_LOW
            P20_11: PortPinId=331, PortPinSymbolicName=PORT_20_PIN_11, PortPinDirection=PORT_PIN_IN, PortPinLevelValue=PORT_PIN_LEVEL_LOW
            P20_12: PortPinId=332, PortPinSymbolicName=PORT_20_PIN_12, PortPinDirection=PORT_PIN_IN, PortPinLevelValue=PORT_PIN_LEVEL_LOW
            P20_13: PortPinId=333, PortPinSymbolicName=PORT_20_PIN_13, PortPinDirection=PORT_PIN_IN, PortPinLevelValue=PORT_PIN_LEVEL_LOW
            P20_14_SOC_RESET: PortPinId=334, PortPinSymbolicName=PORT_20_PIN_14, PortPinDirection=PORT_PIN_OUT, PortPinLevelValue=PORT_PIN_LEVEL_HIGH, PortPinOutputCharacteristic=PORT_PIN_OUT_PUSHPULL
        PortContainer_10: PortNumber=21, PortNumberOfPortPins=8
          CAM0_PWR_EN (PortPin):
            PortPinId = 336
            PortPinSymbolicName = PORT_21_PIN_0
            PortPinDirection = PORT_PIN_OUT
            PortPinDirectionChangeable = false
            PortPinInputHysteresis = false
            PortPinLevelValue = PORT_PIN_LEVEL_LOW
            PortPinInitialMode = PORT_PIN_MODE_GPIO
            PortPinModeChangeable = false
            PortPinDriverStrength = PORT_CMOS_SPEED_GRADE1
            PortPinPadLevel = PORT_PDR_CMOS_AUTOMOTIVE_LEVEL
            PortPinAnalogInput = DISABLE
            PortPinControllerSelect = DISABLE
            PortPinInputCharacteristic = PORT_PIN_IN_PULL_UP
            PortPinOutputCharacteristic = PORT_PIN_OUT_PUSHPULL
            PortPinMode = PORT_PIN_MODE_ALL
          PortLVDSH_0 (PortLVDSH):
            PortLVDSRxDisable = DISABLE_LVDS
            PortLVDSRxDisableController = PORT_CONTROLLED
            PortLVDSRxTerminationMode = INTERNAL_TERMINATION
            PortLVDSHPinPair = Pin_2_Pin_3
          PortLVDSH_1 (PortLVDSH):
            PortLVDSPowerDown = PORT_LVDS_POWER_DOWN
            PortLVDSPowerDownPullDown = DISABLE
            PortLVDSTxDisable = DISABLE_LVDS
            PortLVDSTxDisableController = PORT_CONTROLLED
            PortLVDSTxSignallingMode = IEEE_GENERAL_PURPOSE_LINK
            PortLVDSHPinPair = Pin_4_Pin_5
          7 x PortPin, all with PortPinDirectionChangeable=false, PortPinInputHysteresis=false, PortPinInitialMode=PORT_PIN_MODE_GPIO, PortPinModeChangeable=false, PortPinDriverStrength=PORT_CMOS_SPEED_GRADE1, PortPinPadLevel=PORT_PDR_CMOS_AUTOMOTIVE_LEVEL, PortPinAnalogInput=DISABLE, PortPinControllerSelect=DISABLE, PortPinInputCharacteristic=PORT_PIN_IN_PULL_UP, PortPinMode=PORT_PIN_MODE_ALL:
            CAM1_PWR_EN: PortPinId=337, PortPinSymbolicName=PORT_21_PIN_1, PortPinDirection=PORT_PIN_OUT, PortPinLevelValue=PORT_PIN_LEVEL_LOW, PortPinOutputCharacteristic=PORT_PIN_OUT_PUSHPULL
            CAM2_PWR_EN: PortPinId=338, PortPinSymbolicName=PORT_21_PIN_2, PortPinDirection=PORT_PIN_OUT, PortPinLevelValue=PORT_PIN_LEVEL_LOW, PortPinOutputCharacteristic=PORT_PIN_OUT_PUSHPULL
            CAM3_PWR_EN: PortPinId=339, PortPinSymbolicName=PORT_21_PIN_3, PortPinDirection=PORT_PIN_OUT, PortPinLevelValue=PORT_PIN_LEVEL_LOW, PortPinOutputCharacteristic=PORT_PIN_OUT_PUSHPULL
            SOC_PWR_CTRL: PortPinId=340, PortPinSymbolicName=PORT_21_PIN_4, PortPinDirection=PORT_PIN_OUT, PortPinLevelValue=PORT_PIN_LEVEL_HIGH, PortPinOutputCharacteristic=PORT_PIN_OUT_PUSHPULL
            PortPin_5: PortPinId=341, PortPinSymbolicName=PORT_21_PIN_5, PortPinDirection=PORT_PIN_IN, PortPinLevelValue=PORT_PIN_LEVEL_LOW
            PortPin_6: PortPinId=342, PortPinSymbolicName=PORT_21_PIN_6, PortPinDirection=PORT_PIN_IN, PortPinLevelValue=PORT_PIN_LEVEL_LOW
            PortPin_7: PortPinId=343, PortPinSymbolicName=PORT_21_PIN_7, PortPinDirection=PORT_PIN_IN, PortPinLevelValue=PORT_PIN_LEVEL_LOW
        PortContainer_11: PortNumber=22, PortNumberOfPortPins=12
          QSPI3_MOSI (PortPin):
            PortPinId = 352
            PortPinSymbolicName = PORT_22_PIN_0
            PortPinDirection = PORT_PIN_OUT
            PortPinDirectionChangeable = false
            PortPinInputHysteresis = false
            PortPinLevelValue = PORT_PIN_LEVEL_HIGH
            PortPinInitialMode = PORT_PIN_MODE_ALT3
            PortPinModeChangeable = false
            PortPinDriverStrength = PORT_CMOS_SPEED_GRADE1
            PortPinPadLevel = PORT_PDR_CMOS_AUTOMOTIVE_LEVEL
            PortPinAnalogInput = DISABLE
            PortPinControllerSelect = DISABLE
            PortPinInputCharacteristic = PORT_PIN_IN_PULL_UP
            PortPinMode = PORT_PIN_MODE_ALL
            PortPinOutputCharacteristic = PORT_PIN_OUT_PUSHPULL
          PortLVDSM_0 (PortLVDSM): PortLVDSMPinPair=Pin_0_Pin_1, PortPadSupplyVoltage=PAD_SUPPLY_5V
          PortLVDSM_1 (PortLVDSM): PortLVDSMPinPair=Pin_2_Pin_3, PortPadSupplyVoltage=PAD_SUPPLY_5V
          11 x PortPin, all with PortPinDirectionChangeable=false, PortPinInputHysteresis=false, PortPinModeChangeable=false, PortPinDriverStrength=PORT_CMOS_SPEED_GRADE1, PortPinPadLevel=PORT_PDR_CMOS_AUTOMOTIVE_LEVEL, PortPinAnalogInput=DISABLE, PortPinControllerSelect=DISABLE, PortPinInputCharacteristic=PORT_PIN_IN_PULL_UP, PortPinMode=PORT_PIN_MODE_ALL:
            QSPI0_CS: PortPinId=363, PortPinSymbolicName=PORT_22_PIN_11, PortPinDirection=PORT_PIN_OUT, PortPinLevelValue=PORT_PIN_LEVEL_HIGH, PortPinInitialMode=PORT_PIN_MODE_ALT4, PortPinOutputCharacteristic=PORT_PIN_OUT_PUSHPULL
            QSPI0_MOSI: PortPinId=362, PortPinSymbolicName=PORT_22_PIN_10, PortPinDirection=PORT_PIN_OUT, PortPinLevelValue=PORT_PIN_LEVEL_HIGH, PortPinInitialMode=PORT_PIN_MODE_ALT4, PortPinOutputCharacteristic=PORT_PIN_OUT_PUSHPULL
            QSPI0_MISO: PortPinId=361, PortPinSymbolicName=PORT_22_PIN_9, PortPinDirection=PORT_PIN_IN, PortPinLevelValue=PORT_PIN_LEVEL_HIGH, PortPinInitialMode=PORT_PIN_MODE_GPIO
            PortPin_8: PortPinId=360, PortPinSymbolicName=PORT_22_PIN_8, PortPinDirection=PORT_PIN_IN, PortPinLevelValue=PORT_PIN_LEVEL_LOW, PortPinInitialMode=PORT_PIN_MODE_GPIO
            QSPI0_SCLK: PortPinId=359, PortPinSymbolicName=PORT_22_PIN_7, PortPinDirection=PORT_PIN_OUT, PortPinLevelValue=PORT_PIN_LEVEL_HIGH, PortPinInitialMode=PORT_PIN_MODE_ALT4, PortPinOutputCharacteristic=PORT_PIN_OUT_PUSHPULL
            PortPin_6: PortPinId=358, PortPinSymbolicName=PORT_22_PIN_6, PortPinDirection=PORT_PIN_IN, PortPinLevelValue=PORT_PIN_LEVEL_LOW, PortPinInitialMode=PORT_PIN_MODE_GPIO
            PortPin_5: PortPinId=357, PortPinSymbolicName=PORT_22_PIN_5, PortPinDirection=PORT_PIN_IN, PortPinLevelValue=PORT_PIN_LEVEL_LOW, PortPinInitialMode=PORT_PIN_MODE_GPIO
            PortPin_4: PortPinId=356, PortPinSymbolicName=PORT_22_PIN_4, PortPinDirection=PORT_PIN_IN, PortPinLevelValue=PORT_PIN_LEVEL_LOW, PortPinInitialMode=PORT_PIN_MODE_GPIO
            QSPI3_SCLK: PortPinId=355, PortPinSymbolicName=PORT_22_PIN_3, PortPinDirection=PORT_PIN_OUT, PortPinLevelValue=PORT_PIN_LEVEL_HIGH, PortPinInitialMode=PORT_PIN_MODE_ALT3, PortPinOutputCharacteristic=PORT_PIN_OUT_PUSHPULL
            QSPI3_CS: PortPinId=354, PortPinSymbolicName=PORT_22_PIN_2, PortPinDirection=PORT_PIN_OUT, PortPinLevelValue=PORT_PIN_LEVEL_HIGH, PortPinInitialMode=PORT_PIN_MODE_ALT3, PortPinOutputCharacteristic=PORT_PIN_OUT_PUSHPULL
            QSPI3_MISO: PortPinId=353, PortPinSymbolicName=PORT_22_PIN_1, PortPinDirection=PORT_PIN_IN, PortPinLevelValue=PORT_PIN_LEVEL_HIGH, PortPinInitialMode=PORT_PIN_MODE_GPIO
        PortContainer_12: PortNumber=23, PortNumberOfPortPins=8
          8 x PortPin, all with PortPinDirection=PORT_PIN_IN, PortPinDirectionChangeable=false, PortPinInputHysteresis=false, PortPinInitialMode=PORT_PIN_MODE_GPIO, PortPinModeChangeable=false, PortPinDriverStrength=PORT_CMOS_SPEED_GRADE1, PortPinPadLevel=PORT_PDR_CMOS_AUTOMOTIVE_LEVEL, PortPinAnalogInput=DISABLE, PortPinControllerSelect=DISABLE, PortPinInputCharacteristic=PORT_PIN_IN_PULL_UP, PortPinMode=PORT_PIN_MODE_ALL:
            MCU_SOC_GPIO1: PortPinId=368, PortPinSymbolicName=PORT_23_PIN_0, PortPinLevelValue=PORT_PIN_LEVEL_HIGH
            MCU_SOC_GPIO2: PortPinId=369, PortPinSymbolicName=PORT_23_PIN_1, PortPinLevelValue=PORT_PIN_LEVEL_HIGH
            MCU_SOC_GPIO3: PortPinId=370, PortPinSymbolicName=PORT_23_PIN_2, PortPinLevelValue=PORT_PIN_LEVEL_HIGH
            MCU_SOC_GPIO4: PortPinId=371, PortPinSymbolicName=PORT_23_PIN_3, PortPinLevelValue=PORT_PIN_LEVEL_HIGH
            MCU_SOC_GPIO5: PortPinId=372, PortPinSymbolicName=PORT_23_PIN_4, PortPinLevelValue=PORT_PIN_LEVEL_HIGH
            MCU_SOC_GPIO6: PortPinId=373, PortPinSymbolicName=PORT_23_PIN_5, PortPinLevelValue=PORT_PIN_LEVEL_HIGH
            PortPin_6: PortPinId=374, PortPinSymbolicName=PORT_23_PIN_6, PortPinLevelValue=PORT_PIN_LEVEL_LOW
            PortPin_7: PortPinId=375, PortPinSymbolicName=PORT_23_PIN_7, PortPinLevelValue=PORT_PIN_LEVEL_LOW
        PortContainer_13: PortNumber=32, PortNumberOfPortPins=7
          7 x PortPin, all with PortPinDirectionChangeable=false, PortPinInputHysteresis=false, PortPinInitialMode=PORT_PIN_MODE_GPIO, PortPinModeChangeable=false, PortPinDriverStrength=PORT_CMOS_SPEED_GRADE1, PortPinPadLevel=PORT_PDR_CMOS_AUTOMOTIVE_LEVEL, PortPinAnalogInput=DISABLE, PortPinControllerSelect=DISABLE, PortPinInputCharacteristic=PORT_PIN_IN_PULL_UP, PortPinMode=PORT_PIN_MODE_ALL:
            PortPin_0: PortPinId=512, PortPinSymbolicName=PORT_32_PIN_0, PortPinDirection=PORT_PIN_IN, PortPinLevelValue=PORT_PIN_LEVEL_LOW
            PortPin_2: PortPinId=514, PortPinSymbolicName=PORT_32_PIN_2, PortPinDirection=PORT_PIN_IN, PortPinLevelValue=PORT_PIN_LEVEL_LOW
            PortPin_3: PortPinId=515, PortPinSymbolicName=PORT_32_PIN_3, PortPinDirection=PORT_PIN_IN, PortPinLevelValue=PORT_PIN_LEVEL_LOW
            PortPin_4: PortPinId=516, PortPinSymbolicName=PORT_32_PIN_4, PortPinDirection=PORT_PIN_IN, PortPinLevelValue=PORT_PIN_LEVEL_LOW
            TLF35584_WDI: PortPinId=517, PortPinSymbolicName=PORT_32_PIN_5, PortPinDirection=PORT_PIN_OUT, PortPinLevelValue=PORT_PIN_LEVEL_HIGH, PortPinOutputCharacteristic=PORT_PIN_OUT_PUSHPULL
            TLF35584_ERR: PortPinId=518, PortPinSymbolicName=PORT_32_PIN_6, PortPinDirection=PORT_PIN_IN, PortPinLevelValue=PORT_PIN_LEVEL_HIGH
            TLF35584_SS1: PortPinId=519, PortPinSymbolicName=PORT_32_PIN_7, PortPinDirection=PORT_PIN_IN, PortPinLevelValue=PORT_PIN_LEVEL_LOW
        PortContainer_14: PortNumber=33, PortNumberOfPortPins=16
          16 x PortPin, all with PortPinDirectionChangeable=false, PortPinInputHysteresis=false, PortPinModeChangeable=false, PortPinDriverStrength=PORT_CMOS_SPEED_GRADE1, PortPinPadLevel=PORT_PDR_CMOS_AUTOMOTIVE_LEVEL, PortPinAnalogInput=DISABLE, PortPinControllerSelect=DISABLE, PortPinMode=PORT_PIN_MODE_ALL, PortPinInputCharacteristic=PORT_PIN_IN_PULL_UP:
            PortPin_0: PortPinId=528, PortPinSymbolicName=PORT_33_PIN_0, PortPinDirection=PORT_PIN_IN, PortPinLevelValue=PORT_PIN_LEVEL_LOW, PortPinInitialMode=PORT_PIN_MODE_GPIO
            PortPin_1: PortPinId=529, PortPinSymbolicName=PORT_33_PIN_1, PortPinDirection=PORT_PIN_IN, PortPinLevelValue=PORT_PIN_LEVEL_LOW, PortPinInitialMode=PORT_PIN_MODE_GPIO
            PortPin_7: PortPinId=535, PortPinSymbolicName=PORT_33_PIN_7, PortPinDirection=PORT_PIN_IN, PortPinLevelValue=PORT_PIN_LEVEL_LOW, PortPinInitialMode=PORT_PIN_MODE_GPIO
            PortPin_6: PortPinId=534, PortPinSymbolicName=PORT_33_PIN_6, PortPinDirection=PORT_PIN_IN, PortPinLevelValue=PORT_PIN_LEVEL_LOW, PortPinInitialMode=PORT_PIN_MODE_GPIO
            LIN2_TXD: PortPinId=537, PortPinSymbolicName=PORT_33_PIN_9, PortPinDirection=PORT_PIN_OUT, PortPinLevelValue=PORT_PIN_LEVEL_HIGH, PortPinInitialMode=PORT_PIN_MODE_ALT2, PortPinOutputCharacteristic=PORT_PIN_OUT_PUSHPULL
            LIN2_RXD: PortPinId=536, PortPinSymbolicName=PORT_33_PIN_8, PortPinDirection=PORT_PIN_IN, PortPinLevelValue=PORT_PIN_LEVEL_HIGH, PortPinInitialMode=PORT_PIN_MODE_GPIO
            LIN1_WAKE_N: PortPinId=531, PortPinSymbolicName=PORT_33_PIN_3, PortPinDirection=PORT_PIN_OUT, PortPinLevelValue=PORT_PIN_LEVEL_HIGH, PortPinInitialMode=PORT_PIN_MODE_GPIO, PortPinOutputCharacteristic=PORT_PIN_OUT_PUSHPULL
            LIN1_SLP_N: PortPinId=530, PortPinSymbolicName=PORT_33_PIN_2, PortPinDirection=PORT_PIN_OUT, PortPinLevelValue=PORT_PIN_LEVEL_HIGH, PortPinInitialMode=PORT_PIN_MODE_GPIO, PortPinOutputCharacteristic=PORT_PIN_OUT_PUSHPULL
            LIN2_WAKE_N: PortPinId=533, PortPinSymbolicName=PORT_33_PIN_5, PortPinDirection=PORT_PIN_OUT, PortPinLevelValue=PORT_PIN_LEVEL_HIGH, PortPinInitialMode=PORT_PIN_MODE_GPIO, PortPinOutputCharacteristic=PORT_PIN_OUT_PUSHPULL
            LIN2_SLP_N: PortPinId=532, PortPinSymbolicName=PORT_33_PIN_4, PortPinDirection=PORT_PIN_OUT, PortPinLevelValue=PORT_PIN_LEVEL_HIGH, PortPinInitialMode=PORT_PIN_MODE_GPIO, PortPinOutputCharacteristic=PORT_PIN_OUT_PUSHPULL
            LIN1_RXD: PortPinId=541, PortPinSymbolicName=PORT_33_PIN_13, PortPinDirection=PORT_PIN_IN, PortPinLevelValue=PORT_PIN_LEVEL_HIGH, PortPinInitialMode=PORT_PIN_MODE_GPIO
            LIN1_TXD: PortPinId=540, PortPinSymbolicName=PORT_33_PIN_12, PortPinDirection=PORT_PIN_OUT, PortPinLevelValue=PORT_PIN_LEVEL_HIGH, PortPinInitialMode=PORT_PIN_MODE_ALT2, PortPinOutputCharacteristic=PORT_PIN_OUT_PUSHPULL
            QSPI2_CS: PortPinId=543, PortPinSymbolicName=PORT_33_PIN_15, PortPinDirection=PORT_PIN_OUT, PortPinLevelValue=PORT_PIN_LEVEL_HIGH, PortPinInitialMode=PORT_PIN_MODE_ALT3, PortPinOutputCharacteristic=PORT_PIN_OUT_PUSHPULL
            QSPI2_SCLK: PortPinId=542, PortPinSymbolicName=PORT_33_PIN_14, PortPinDirection=PORT_PIN_OUT, PortPinLevelValue=PORT_PIN_LEVEL_HIGH, PortPinInitialMode=PORT_PIN_MODE_ALT3, PortPinOutputCharacteristic=PORT_PIN_OUT_PUSHPULL
            LIN1_INH_N: PortPinId=539, PortPinSymbolicName=PORT_33_PIN_11, PortPinDirection=PORT_PIN_IN, PortPinLevelValue=PORT_PIN_LEVEL_HIGH, PortPinInitialMode=PORT_PIN_MODE_GPIO
            LIN2_INH_N: PortPinId=538, PortPinSymbolicName=PORT_33_PIN_10, PortPinDirection=PORT_PIN_IN, PortPinLevelValue=PORT_PIN_LEVEL_HIGH, PortPinInitialMode=PORT_PIN_MODE_GPIO
        PortContainer_15: PortNumber=34, PortNumberOfPortPins=5
          5 x PortPin, all with PortPinDirectionChangeable=false, PortPinInputHysteresis=false, PortPinModeChangeable=false, PortPinDriverStrength=PORT_CMOS_SPEED_GRADE1, PortPinPadLevel=PORT_PDR_CMOS_AUTOMOTIVE_LEVEL, PortPinAnalogInput=DISABLE, PortPinControllerSelect=DISABLE, PortPinInputCharacteristic=PORT_PIN_IN_PULL_UP, PortPinMode=PORT_PIN_MODE_ALL:
            PortPin_1: PortPinId=545, PortPinSymbolicName=PORT_34_PIN_1, PortPinDirection=PORT_PIN_IN, PortPinLevelValue=PORT_PIN_LEVEL_LOW, PortPinInitialMode=PORT_PIN_MODE_GPIO
            QSPI2_MOSI: PortPinId=549, PortPinSymbolicName=PORT_34_PIN_5, PortPinDirection=PORT_PIN_OUT, PortPinLevelValue=PORT_PIN_LEVEL_HIGH, PortPinInitialMode=PORT_PIN_MODE_ALT4, PortPinOutputCharacteristic=PORT_PIN_OUT_PUSHPULL
            PortPin_3: PortPinId=547, PortPinSymbolicName=PORT_34_PIN_3, PortPinDirection=PORT_PIN_IN, PortPinLevelValue=PORT_PIN_LEVEL_LOW, PortPinInitialMode=PORT_PIN_MODE_GPIO
            PortPin_2: PortPinId=546, PortPinSymbolicName=PORT_34_PIN_2, PortPinDirection=PORT_PIN_IN, PortPinLevelValue=PORT_PIN_LEVEL_LOW, PortPinInitialMode=PORT_PIN_MODE_GPIO
            QSPI2_MISO: PortPinId=548, PortPinSymbolicName=PORT_34_PIN_4, PortPinDirection=PORT_PIN_IN, PortPinLevelValue=PORT_PIN_LEVEL_HIGH, PortPinInitialMode=PORT_PIN_MODE_GPIO
        PortContainer_16: PortNumber=40, PortNumberOfPortPins=10
          10 x PortPin, all with PortPinDirection=PORT_PIN_IN, PortPinDirectionChangeable=false, PortPinInputHysteresis=false, PortPinLevelValue=PORT_PIN_LEVEL_LOW, PortPinInitialMode=PORT_PIN_MODE_GPIO, PortPinModeChangeable=false, PortPinDriverStrength=PORT_CMOS_SPEED_GRADE1, PortPinPadLevel=PORT_PDR_CMOS_AUTOMOTIVE_LEVEL, PortPinAnalogInput=DISABLE, PortPinControllerSelect=DISABLE, PortPinInputCharacteristic=PORT_PIN_IN_PULL_UP:
            PortPin_5: PortPinId=645, PortPinSymbolicName=PORT_40_PIN_5
            PortPin_7: PortPinId=647, PortPinSymbolicName=PORT_40_PIN_7, PortPinMode=PORT_PIN_MODE_ALL
            PortPin_6: PortPinId=646, PortPinSymbolicName=PORT_40_PIN_6, PortPinMode=PORT_PIN_MODE_ALL
            PortPin_2: PortPinId=642, PortPinSymbolicName=PORT_40_PIN_2, PortPinMode=PORT_PIN_MODE_ALL
            PortPin_1: PortPinId=641, PortPinSymbolicName=PORT_40_PIN_1, PortPinMode=PORT_PIN_MODE_ALL
            PortPin_4: PortPinId=644, PortPinSymbolicName=PORT_40_PIN_4, PortPinMode=PORT_PIN_MODE_ALL
            PortPin_3: PortPinId=643, PortPinSymbolicName=PORT_40_PIN_3, PortPinMode=PORT_PIN_MODE_ALL
            PortPin_9: PortPinId=649, PortPinSymbolicName=PORT_40_PIN_9, PortPinMode=PORT_PIN_MODE_ALL
            PortPin_8: PortPinId=648, PortPinSymbolicName=PORT_40_PIN_8, PortPinMode=PORT_PIN_MODE_ALL
            PortPin_0: PortPinId=640, PortPinSymbolicName=PORT_40_PIN_0, PortPinMode=PORT_PIN_MODE_ALL
    PortSafety: PortSafetyEnable=false, PortInitCheckApi=false
    PortGeneral:
      PortDevErrorDetect = false
      PortPBFixedAddress = false
      PortSetPinDirectionApi = false
      PortSetPinModeApi = false
      PortVersionInfoApi = true
      PortRunningInUser0Mode = false
      PortUserModeInitApiEnable = false
      PortUserModeRuntimeApiEnable = true
    CommonPublishedInformation:
      ArMajorVersion = 3
      ArMinorVersion = 2
      ArPatchVersion = 0
      SwMajorVersion = 3
      SwMinorVersion = 1
      SwPatchVersion = 0
      ModuleId = 124
      VendorId = 17
      Release = _TRICORE_TC277
