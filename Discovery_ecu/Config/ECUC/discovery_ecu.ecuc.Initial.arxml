[part 1 of 2: package /InitialEcuC]
AUTOSAR XML (schema 4-2-1)
package /InitialEcuC
  ecuc value collection InitialEcuC: ecuc-values=[Can, CanIf, CanSM, Com, ComM, EcuC, EcuM, Lin, LinIf, LinSM, LinTp, PduR]
  module config Can
    CanConfigSet
      3 x CanController, all with CanControllerActivation=true:
        CT_CAN00_388e5969: CanControllerDefaultBaudrate=CT_CAN00_388e5969/CanControllerBaudrateConfig, CanWakeupSourceRef=EcuMCommonConfiguration/CAN00_f26020e5
          CanControllerBaudrateConfig
        CT_CAN01_388e5969: CanControllerDefaultBaudrate=CT_CAN01_388e5969/CanControllerBaudrateConfig, CanWakeupSourceRef=EcuMCommonConfiguration/CAN01_f26020e5
          CanControllerBaudrateConfig
        CT_CAN02_388e5969: CanControllerDefaultBaudrate=CT_CAN02_388e5969/CanControllerBaudrateConfig, CanWakeupSourceRef=EcuMCommonConfiguration/CAN02_f26020e5
          CanControllerBaudrateConfig
      6 x CanHardwareObject, all with CanHandleType=BASIC, CanIdType=STANDARD, CanIdValue=0:
        CN_CAN00_388e5969_Rx_Std: CanObjectType=RECEIVE, CanControllerRef=CanConfigSet/CT_CAN00_388e5969
        CN_CAN00_388e5969_Tx_Std: CanObjectType=TRANSMIT, CanControllerRef=CanConfigSet/CT_CAN00_388e5969
        CN_CAN01_388e5969_Rx_Std: CanObjectType=RECEIVE, CanControllerRef=CanConfigSet/CT_CAN01_388e5969
        CN_CAN01_388e5969_Tx_Std: CanObjectType=TRANSMIT, CanControllerRef=CanConfigSet/CT_CAN01_388e5969
        CN_CAN02_388e5969_Rx_Std: CanObjectType=RECEIVE, CanControllerRef=CanConfigSet/CT_CAN02_388e5969
        CN_CAN02_388e5969_Tx_Std: CanObjectType=TRANSMIT, CanControllerRef=CanConfigSet/CT_CAN02_388e5969
    CanGeneral: CanIndex=0
  module config CanIf
    Can (CanIfCtrlDrvCfg): CanIfCtrlDrvInitHohConfigRef=CanIfInitHohCfg, CanIfCtrlDrvNameRef=CanGeneral
      3 x CanIfCtrlCfg:
        CT_CAN{00..02}_388e5969: CanIfCtrlCanCtrlRef=CanConfigSet/CT_CAN{00..02}_388e5969
    CanIfInitCfg
      3 x CanIfBufferCfg, all with CanIfBufferSize=0:
        CanIfBufferCfg_Tx_Std_0fb271d2: CanIfBufferHthRef=CanIfInitHohCfg/CN_CAN00_388e5969_Tx_Std  # CHNL
        CanIfBufferCfg_Tx_Std_427ad0d9: CanIfBufferHthRef=CanIfInitHohCfg/CN_CAN02_388e5969_Tx_Std  # CHNL
        CanIfBufferCfg_Tx_Std_c4eea277: CanIfBufferHthRef=CanIfInitHohCfg/CN_CAN01_388e5969_Tx_Std  # CHNL
      CanIfInitHohCfg: CanIfInitRefCfgSet=CanConfigSet
        3 x CanIfHrhCfg:
          CN_CAN{00..02}_388e5969_Rx_Std: CanIfHrhCanCtrlIdRef=Can/CT_CAN{00..02}_388e5969, CanIfHrhIdSymRef=CanConfigSet/CN_CAN{00..02}_388e5969_Rx_Std
        3 x CanIfHthCfg:
          CN_CAN{00..02}_388e5969_Tx_Std: CanIfHthCanCtrlIdRef=Can/CT_CAN{00..02}_388e5969, CanIfHthIdSymRef=CanConfigSet/CN_CAN{00..02}_388e5969_Tx_Std
      64 x CanIfRxPduCfg, all with CanIfRxPduCanIdType=STANDARD_CAN, CanIfRxPduUserRxIndicationName=PduR_CanIfRxIndication, CanIfRxPduUserRxIndicationUL=PDUR:
        APA_SecCH_FrP00_oCAN02_Rx_3abd61be: CanIfRxPduCanId=424, CanIfRxPduDlc=6, CanIfRxPduHrhIdRef=CanIfInitHohCfg/CN_CAN02_388e5969_Rx_Std, CanIfRxPduRef=PT_APA_SecCH_FrP00_PP_APA_SecCH_FrP00_Rx_427ad0d9_2e7839d1
        APA_SecCH_FrP01_oCAN02_Rx_3abd61be: CanIfRxPduCanId=437, CanIfRxPduDlc=8, CanIfRxPduHrhIdRef=CanIfInitHohCfg/CN_CAN02_388e5969_Rx_Std, CanIfRxPduRef=PT_APA_SecCH_FrP01_PP_APA_SecCH_FrP01_Rx_427ad0d9_2e7839d1
        APA_SecCH_FrP02_oCAN02_Rx_3abd61be: CanIfRxPduCanId=966, CanIfRxPduDlc=8, CanIfRxPduHrhIdRef=CanIfInitHohCfg/CN_CAN02_388e5969_Rx_Std, CanIfRxPduRef=PT_APA_SecCH_FrP02_PP_APA_SecCH_FrP02_Rx_427ad0d9_2e7839d1
        APA_SecCH_FrP03_oCAN02_Rx_3abd61be: CanIfRxPduCanId=651, CanIfRxPduDlc=8, CanIfRxPduHrhIdRef=CanIfInitHohCfg/CN_CAN02_388e5969_Rx_Std, CanIfRxPduRef=PT_APA_SecCH_FrP03_PP_APA_SecCH_FrP03_Rx_427ad0d9_2e7839d1
        APA_SecCH_FrP04_oCAN02_Rx_3abd61be: CanIfRxPduCanId=652, CanIfRxPduDlc=8, CanIfRxPduHrhIdRef=CanIfInitHohCfg/CN_CAN02_388e5969_Rx_Std, CanIfRxPduRef=PT_APA_SecCH_FrP04_PP_APA_SecCH_FrP04_Rx_427ad0d9_2e7839d1
        DIAG_DTCInfo_APA_oCAN02_Rx_3abd61be: CanIfRxPduCanId=1945, CanIfRxPduDlc=7, CanIfRxPduHrhIdRef=CanIfInitHohCfg/CN_CAN02_388e5969_Rx_Std, CanIfRxPduRef=PT_DIAG_DTCInfo_APA_PP_DIAG_DTCInfo_APA_Rx_427ad0d9_2e7839d1
        DIAG_FuncReq_HSC2_oCAN00_Rx_3abd61be: CanIfRxPduCanId=2015, CanIfRxPduDlc=8, CanIfRxPduHrhIdRef=CanIfInitHohCfg/CN_CAN00_388e5969_Rx_Std, CanIfRxPduRef=PT_DIAG_FuncReq_HSC2_PP_DIAG_FuncReq_HSC2_Rx_0fb271d2_c07658fd
        DIAG_PhysReq_P2P_oCAN00_Rx_3abd61be: CanIfRxPduCanId=1846, CanIfRxPduDlc=8, CanIfRxPduHrhIdRef=CanIfInitHohCfg/CN_CAN00_388e5969_Rx_Std, CanIfRxPduRef=PT_DIAG_PhysReq_P2P_PP_DIAG_PhysReq_P2P_Rx_0fb271d2_c07658fd
        EHBS_HSC2_FrP00_oCAN00_Rx_3abd61be: CanIfRxPduCanId=438, CanIfRxPduDlc=8, CanIfRxPduHrhIdRef=CanIfInitHohCfg/CN_CAN00_388e5969_Rx_Std, CanIfRxPduRef=PT_EHBS_HSC2_FrP00_PP_EHBS_HSC2_FrP00_Rx_0fb271d2_c07658fd
        EPB_HSC2_FrP00_oCAN00_Rx_3abd61be: CanIfRxPduCanId=560, CanIfRxPduDlc=8, CanIfRxPduHrhIdRef=CanIfInitHohCfg/CN_CAN00_388e5969_Rx_Std, CanIfRxPduRef=PT_EPB_HSC2_FrP00_PP_EPB_HSC2_FrP00_Rx_0fb271d2_c07658fd
        EPB_HSC2_FrP01_oCAN00_Rx_3abd61be: CanIfRxPduCanId=554, CanIfRxPduDlc=2, CanIfRxPduHrhIdRef=CanIfInitHohCfg/CN_CAN00_388e5969_Rx_Std, CanIfRxPduRef=PT_EPB_HSC2_FrP01_PP_EPB_HSC2_FrP01_Rx_0fb271d2_c07658fd
        EPS_HSC2_FrP02_oCAN00_Rx_3abd61be: CanIfRxPduCanId=433, CanIfRxPduDlc=4, CanIfRxPduHrhIdRef=CanIfInitHohCfg/CN_CAN00_388e5969_Rx_Std, CanIfRxPduRef=PT_EPS_HSC2_FrP02_PP_EPS_HSC2_FrP02_Rx_0fb271d2_c07658fd
        FICM_HSC4_FrP02_oCAN01_Rx_3abd61be: CanIfRxPduCanId=886, CanIfRxPduDlc=8, CanIfRxPduHrhIdRef=CanIfInitHohCfg/CN_CAN01_388e5969_Rx_Std, CanIfRxPduRef=PT_FICM_HSC4_FrP02_PP_FICM_HSC4_FrP02_Rx_c4eea277_b771686b
        FICM_HSC4_FrP08_oCAN01_Rx_3abd61be: CanIfRxPduCanId=758, CanIfRxPduDlc=8, CanIfRxPduHrhIdRef=CanIfInitHohCfg/CN_CAN01_388e5969_Rx_Std, CanIfRxPduRef=PT_FICM_HSC4_FrP08_PP_FICM_HSC4_FrP08_Rx_c4eea277_b771686b
        FICM_HSC4_FrP13_oCAN01_Rx_3abd61be: CanIfRxPduCanId=754, CanIfRxPduDlc=8, CanIfRxPduHrhIdRef=CanIfInitHohCfg/CN_CAN01_388e5969_Rx_Std, CanIfRxPduRef=PT_FICM_HSC4_FrP13_PP_FICM_HSC4_FrP13_Rx_c4eea277_b771686b
        FICM_HSC4_FrP18_oCAN01_Rx_3abd61be: CanIfRxPduCanId=893, CanIfRxPduDlc=8, CanIfRxPduHrhIdRef=CanIfInitHohCfg/CN_CAN01_388e5969_Rx_Std, CanIfRxPduRef=PT_FICM_HSC4_FrP18_PP_FICM_HSC4_FrP18_Rx_c4eea277_b771686b
        FICM_HSC4_FrP32_oCAN01_Rx_3abd61be: CanIfRxPduCanId=128, CanIfRxPduDlc=8, CanIfRxPduHrhIdRef=CanIfInitHohCfg/CN_CAN01_388e5969_Rx_Std, CanIfRxPduRef=PT_FICM_HSC4_FrP32_PP_FICM_HSC4_FrP32_Rx_c4eea277_b771686b
        FICM_HSC4_FrP33_oCAN01_Rx_3abd61be: CanIfRxPduCanId=822, CanIfRxPduDlc=8, CanIfRxPduHrhIdRef=CanIfInitHohCfg/CN_CAN01_388e5969_Rx_Std, CanIfRxPduRef=PT_FICM_HSC4_FrP33_PP_FICM_HSC4_FrP33_Rx_c4eea277_b771686b
        GW_HSC2_BCM_FrP04_oCAN00_Rx_3abd61be: CanIfRxPduCanId=1130, CanIfRxPduDlc=8, CanIfRxPduHrhIdRef=CanIfInitHohCfg/CN_CAN00_388e5969_Rx_Std, CanIfRxPduRef=PT_GW_HSC2_BCM_FrP04_PP_GW_HSC2_BCM_FrP04_Rx_0fb271d2_c07658fd
        GW_HSC2_BCM_FrP06_oCAN00_Rx_3abd61be: CanIfRxPduCanId=540, CanIfRxPduDlc=8, CanIfRxPduHrhIdRef=CanIfInitHohCfg/CN_CAN00_388e5969_Rx_Std, CanIfRxPduRef=PT_GW_HSC2_BCM_FrP06_PP_GW_HSC2_BCM_FrP06_Rx_0fb271d2_c07658fd
        GW_HSC2_BCM_FrP07_oCAN00_Rx_3abd61be: CanIfRxPduCanId=498, CanIfRxPduDlc=2, CanIfRxPduHrhIdRef=CanIfInitHohCfg/CN_CAN00_388e5969_Rx_Std, CanIfRxPduRef=PT_GW_HSC2_BCM_FrP07_PP_GW_HSC2_BCM_FrP07_Rx_0fb271d2_c07658fd
        GW_HSC2_BCM_FrS16_oCAN00_Rx_3abd61be: CanIfRxPduCanId=1539, CanIfRxPduDlc=8, CanIfRxPduHrhIdRef=CanIfInitHohCfg/CN_CAN00_388e5969_Rx_Std, CanIfRxPduRef=PT_GW_HSC2_BCM_FrS16_PP_GW_HSC2_BCM_FrS16_Rx_0fb271d2_c07658fd
        GW_HSC2_ECM_FrP04_oCAN00_Rx_3abd61be: CanIfRxPduCanId=404, CanIfRxPduDlc=8, CanIfRxPduHrhIdRef=CanIfInitHohCfg/CN_CAN00_388e5969_Rx_Std, CanIfRxPduRef=PT_GW_HSC2_ECM_FrP04_PP_GW_HSC2_ECM_FrP04_Rx_0fb271d2_c07658fd
        GW_HSC2_FICM_FrP02_oCAN00_Rx_3abd61be: CanIfRxPduCanId=886, CanIfRxPduDlc=8, CanIfRxPduHrhIdRef=CanIfInitHohCfg/CN_CAN00_388e5969_Rx_Std, CanIfRxPduRef=PT_GW_HSC2_FICM_FrP02_PP_GW_HSC2_FICM_FrP02_Rx_0fb271d2_c07658fd
        GW_HSC2_FICM_FrP08_oCAN00_Rx_3abd61be: CanIfRxPduCanId=758, CanIfRxPduDlc=8, CanIfRxPduHrhIdRef=CanIfInitHohCfg/CN_CAN00_388e5969_Rx_Std, CanIfRxPduRef=PT_GW_HSC2_FICM_FrP08_PP_GW_HSC2_FICM_FrP08_Rx_0fb271d2_c07658fd
        GW_HSC2_FrP00_oCAN00_Rx_3abd61be: CanIfRxPduCanId=361, CanIfRxPduDlc=6, CanIfRxPduHrhIdRef=CanIfInitHohCfg/CN_CAN00_388e5969_Rx_Std, CanIfRxPduRef=PT_GW_HSC2_FrP00_PP_GW_HSC2_FrP00_Rx_0fb271d2_c07658fd
        GW_HSC2_FrP01_oCAN00_Rx_3abd61be: CanIfRxPduCanId=497, CanIfRxPduDlc=8, CanIfRxPduHrhIdRef=CanIfInitHohCfg/CN_CAN00_388e5969_Rx_Std, CanIfRxPduRef=PT_GW_HSC2_FrP01_PP_GW_HSC2_FrP01_Rx_0fb271d2_c07658fd
        GW_HSC2_FrP08_oCAN00_Rx_3abd61be: CanIfRxPduCanId=1344, CanIfRxPduDlc=8, CanIfRxPduHrhIdRef=CanIfInitHohCfg/CN_CAN00_388e5969_Rx_Std, CanIfRxPduRef=PT_GW_HSC2_FrP08_PP_GW_HSC2_FrP08_Rx_0fb271d2_c07658fd
        GW_HSC2_FrP10_oCAN00_Rx_3abd61be: CanIfRxPduCanId=1009, CanIfRxPduDlc=8, CanIfRxPduHrhIdRef=CanIfInitHohCfg/CN_CAN00_388e5969_Rx_Std, CanIfRxPduRef=PT_GW_HSC2_FrP10_PP_GW_HSC2_FrP10_Rx_0fb271d2_c07658fd
        GW_HSC2_FrP13_oCAN00_Rx_3abd61be: CanIfRxPduCanId=425, CanIfRxPduDlc=8, CanIfRxPduHrhIdRef=CanIfInitHohCfg/CN_CAN00_388e5969_Rx_Std, CanIfRxPduRef=PT_GW_HSC2_FrP13_PP_GW_HSC2_FrP13_Rx_0fb271d2_c07658fd
        GW_HSC2_FrS00_oCAN00_Rx_3abd61be: CanIfRxPduCanId=1699, CanIfRxPduDlc=8, CanIfRxPduHrhIdRef=CanIfInitHohCfg/CN_CAN00_388e5969_Rx_Std, CanIfRxPduRef=PT_GW_HSC2_FrS00_PP_GW_HSC2_FrS00_Rx_0fb271d2_c07658fd
        GW_HSC2_HCU_FrP00_oCAN00_Rx_3abd61be: CanIfRxPduCanId=175, CanIfRxPduDlc=8, CanIfRxPduHrhIdRef=CanIfInitHohCfg/CN_CAN00_388e5969_Rx_Std, CanIfRxPduRef=PT_GW_HSC2_HCU_FrP00_PP_GW_HSC2_HCU_FrP00_Rx_0fb271d2_c07658fd
        GW_HSC2_HCU_FrP01_oCAN00_Rx_3abd61be: CanIfRxPduCanId=406, CanIfRxPduDlc=8, CanIfRxPduHrhIdRef=CanIfInitHohCfg/CN_CAN00_388e5969_Rx_Std, CanIfRxPduRef=PT_GW_HSC2_HCU_FrP01_PP_GW_HSC2_HCU_FrP01_Rx_0fb271d2_c07658fd
        GW_HSC2_HCU_FrP13_oCAN00_Rx_3abd61be: CanIfRxPduCanId=412, CanIfRxPduDlc=8, CanIfRxPduHrhIdRef=CanIfInitHohCfg/CN_CAN00_388e5969_Rx_Std, CanIfRxPduRef=PT_GW_HSC2_HCU_FrP13_PP_GW_HSC2_HCU_FrP13_Rx_0fb271d2_c07658fd
        GW_HSC2_IPK_FrP06_oCAN00_Rx_3abd61be: CanIfRxPduCanId=1345, CanIfRxPduDlc=8, CanIfRxPduHrhIdRef=CanIfInitHohCfg/CN_CAN00_388e5969_Rx_Std, CanIfRxPduRef=PT_GW_HSC2_IPK_FrP06_PP_GW_HSC2_IPK_FrP06_Rx_0fb271d2_c07658fd
        GW_HSC2_SCU_FrP00_oCAN00_Rx_3abd61be: CanIfRxPduCanId=157, CanIfRxPduDlc=8, CanIfRxPduHrhIdRef=CanIfInitHohCfg/CN_CAN00_388e5969_Rx_Std, CanIfRxPduRef=PT_GW_HSC2_SCU_FrP00_PP_GW_HSC2_SCU_FrP00_Rx_0fb271d2_c07658fd
        GW_HSC2_SDM_FrP00_oCAN00_Rx_3abd61be: CanIfRxPduCanId=355, CanIfRxPduDlc=8, CanIfRxPduHrhIdRef=CanIfInitHohCfg/CN_CAN00_388e5969_Rx_Std, CanIfRxPduRef=PT_GW_HSC2_SDM_FrP00_PP_GW_HSC2_SDM_FrP00_Rx_0fb271d2_c07658fd
        GW_HSC4_BCM_FrP04_oCAN01_Rx_3abd61be: CanIfRxPduCanId=1130, CanIfRxPduDlc=8, CanIfRxPduHrhIdRef=CanIfInitHohCfg/CN_CAN01_388e5969_Rx_Std, CanIfRxPduRef=PT_GW_HSC4_BCM_FrP04_PP_GW_HSC4_BCM_FrP04_Rx_c4eea277_b771686b
        GW_HSC4_BCM_FrS09_oCAN01_Rx_3abd61be: CanIfRxPduCanId=60, CanIfRxPduDlc=8, CanIfRxPduHrhIdRef=CanIfInitHohCfg/CN_CAN01_388e5969_Rx_Std, CanIfRxPduRef=PT_GW_HSC4_BCM_FrS09_PP_GW_HSC4_BCM_FrS09_Rx_c4eea277_b771686b
        GW_HSC4_BCM_FrS10_oCAN01_Rx_3abd61be: CanIfRxPduCanId=61, CanIfRxPduDlc=8, CanIfRxPduHrhIdRef=CanIfInitHohCfg/CN_CAN01_388e5969_Rx_Std, CanIfRxPduRef=PT_GW_HSC4_BCM_FrS10_PP_GW_HSC4_BCM_FrS10_Rx_c4eea277_b771686b
        GW_HSC4_BMS_FrP07_oCAN01_Rx_3abd61be: CanIfRxPduCanId=667, CanIfRxPduDlc=8, CanIfRxPduHrhIdRef=CanIfInitHohCfg/CN_CAN01_388e5969_Rx_Std, CanIfRxPduRef=PT_GW_HSC4_BMS_FrP07_PP_GW_HSC4_BMS_FrP07_Rx_c4eea277_b771686b
        GW_HSC4_PEPS_FrP01_oCAN01_Rx_3abd61be: CanIfRxPduCanId=379, CanIfRxPduDlc=8, CanIfRxPduHrhIdRef=CanIfInitHohCfg/CN_CAN01_388e5969_Rx_Std, CanIfRxPduRef=PT_GW_HSC4_PEPS_FrP01_PP_GW_HSC4_PEPS_FrP01_Rx_c4eea277_b771686b
        GW_HSC4_PEPS_FrP02_oCAN01_Rx_3abd61be: CanIfRxPduCanId=569, CanIfRxPduDlc=8, CanIfRxPduHrhIdRef=CanIfInitHohCfg/CN_CAN01_388e5969_Rx_Std, CanIfRxPduRef=PT_GW_HSC4_PEPS_FrP02_PP_GW_HSC4_PEPS_FrP02_Rx_c4eea277_b771686b
        GW_HSC4_TBOX_FrP01_oCAN01_Rx_3abd61be: CanIfRxPduCanId=845, CanIfRxPduDlc=8, CanIfRxPduHrhIdRef=CanIfInitHohCfg/CN_CAN01_388e5969_Rx_Std, CanIfRxPduRef=PT_GW_HSC4_TBOX_FrP01_PP_GW_HSC4_TBOX_FrP01_Rx_c4eea277_b771686b
        GW_HSC4_TBOX_FrP05_oCAN01_Rx_3abd61be: CanIfRxPduCanId=434, CanIfRxPduDlc=8, CanIfRxPduHrhIdRef=CanIfInitHohCfg/CN_CAN01_388e5969_Rx_Std, CanIfRxPduRef=PT_GW_HSC4_TBOX_FrP05_PP_GW_HSC4_TBOX_FrP05_Rx_c4eea277_b771686b
        GW_HSC4_TBOX_FrS10_oCAN01_Rx_3abd61be: CanIfRxPduCanId=1553, CanIfRxPduDlc=8, CanIfRxPduHrhIdRef=CanIfInitHohCfg/CN_CAN01_388e5969_Rx_Std, CanIfRxPduRef=PT_GW_HSC4_TBOX_FrS10_PP_GW_HSC4_TBOX_FrS10_Rx_c4eea277_b771686b
        GW_HSC4_TC_FrP01_oCAN01_Rx_3abd61be: CanIfRxPduCanId=148, CanIfRxPduDlc=8, CanIfRxPduHrhIdRef=CanIfInitHohCfg/CN_CAN01_388e5969_Rx_Std, CanIfRxPduRef=PT_GW_HSC4_TC_FrP01_PP_GW_HSC4_TC_FrP01_Rx_c4eea277_b771686b
        IPK_HSC4_FrP06_oCAN01_Rx_3abd61be: CanIfRxPduCanId=1345, CanIfRxPduDlc=8, CanIfRxPduHrhIdRef=CanIfInitHohCfg/CN_CAN01_388e5969_Rx_Std, CanIfRxPduRef=PT_IPK_HSC4_FrP06_PP_IPK_HSC4_FrP06_Rx_c4eea277_b771686b
        PDC_SecCH_FrP00_oCAN02_Rx_3abd61be: CanIfRxPduCanId=573, CanIfRxPduDlc=8, CanIfRxPduHrhIdRef=CanIfInitHohCfg/CN_CAN02_388e5969_Rx_Std, CanIfRxPduRef=PT_PDC_SecCH_FrP00_PP_PDC_SecCH_FrP00_Rx_427ad0d9_2e7839d1
        PDC_SecCH_FrP01_oCAN02_Rx_3abd61be: CanIfRxPduCanId=567, CanIfRxPduDlc=8, CanIfRxPduHrhIdRef=CanIfInitHohCfg/CN_CAN02_388e5969_Rx_Std, CanIfRxPduRef=PT_PDC_SecCH_FrP01_PP_PDC_SecCH_FrP01_Rx_427ad0d9_2e7839d1
        RDA_HSC4_P02_oCAN01_Rx_3abd61be: CanIfRxPduCanId=516, CanIfRxPduDlc=8, CanIfRxPduHrhIdRef=CanIfInitHohCfg/CN_CAN01_388e5969_Rx_Std, CanIfRxPduRef=PT_RDA_HSC4_P02_PP_RDA_HSC4_P02_Rx_c4eea277_b771686b
        SAS_HSC2_FrP00_oCAN00_Rx_3abd61be: CanIfRxPduCanId=485, CanIfRxPduDlc=8, CanIfRxPduHrhIdRef=CanIfInitHohCfg/CN_CAN00_388e5969_Rx_Std, CanIfRxPduRef=PT_SAS_HSC2_FrP00_PP_SAS_HSC2_FrP00_Rx_0fb271d2_c07658fd
        SCS_HSC2_FrP00_oCAN00_Rx_3abd61be: CanIfRxPduCanId=193, CanIfRxPduDlc=8, CanIfRxPduHrhIdRef=CanIfInitHohCfg/CN_CAN00_388e5969_Rx_Std, CanIfRxPduRef=PT_SCS_HSC2_FrP00_PP_SCS_HSC2_FrP00_Rx_0fb271d2_c07658fd
        SCS_HSC2_FrP01_oCAN00_Rx_3abd61be: CanIfRxPduCanId=197, CanIfRxPduDlc=8, CanIfRxPduHrhIdRef=CanIfInitHohCfg/CN_CAN00_388e5969_Rx_Std, CanIfRxPduRef=PT_SCS_HSC2_FrP01_PP_SCS_HSC2_FrP01_Rx_0fb271d2_c07658fd
        SCS_HSC2_FrP02_oCAN00_Rx_3abd61be: CanIfRxPduCanId=389, CanIfRxPduDlc=4, CanIfRxPduHrhIdRef=CanIfInitHohCfg/CN_CAN00_388e5969_Rx_Std, CanIfRxPduRef=PT_SCS_HSC2_FrP02_PP_SCS_HSC2_FrP02_Rx_0fb271d2_c07658fd
        SCS_HSC2_FrP03_oCAN00_Rx_3abd61be: CanIfRxPduCanId=455, CanIfRxPduDlc=8, CanIfRxPduHrhIdRef=CanIfInitHohCfg/CN_CAN00_388e5969_Rx_Std, CanIfRxPduRef=PT_SCS_HSC2_FrP03_PP_SCS_HSC2_FrP03_Rx_0fb271d2_c07658fd
        SCS_HSC2_FrP05_oCAN00_Rx_3abd61be: CanIfRxPduCanId=489, CanIfRxPduDlc=8, CanIfRxPduHrhIdRef=CanIfInitHohCfg/CN_CAN00_388e5969_Rx_Std, CanIfRxPduRef=PT_SCS_HSC2_FrP05_PP_SCS_HSC2_FrP05_Rx_0fb271d2_c07658fd
        SCS_HSC2_FrP11_oCAN00_Rx_3abd61be: CanIfRxPduCanId=840, CanIfRxPduDlc=8, CanIfRxPduHrhIdRef=CanIfInitHohCfg/CN_CAN00_388e5969_Rx_Std, CanIfRxPduRef=PT_SCS_HSC2_FrP11_PP_SCS_HSC2_FrP11_Rx_0fb271d2_c07658fd
        SCS_HSC2_FrP12_oCAN00_Rx_3abd61be: CanIfRxPduCanId=842, CanIfRxPduDlc=8, CanIfRxPduHrhIdRef=CanIfInitHohCfg/CN_CAN00_388e5969_Rx_Std, CanIfRxPduRef=PT_SCS_HSC2_FrP12_PP_SCS_HSC2_FrP12_Rx_0fb271d2_c07658fd
        SCS_HSC2_FrP15_oCAN00_Rx_3abd61be: CanIfRxPduCanId=851, CanIfRxPduDlc=8, CanIfRxPduHrhIdRef=CanIfInitHohCfg/CN_CAN00_388e5969_Rx_Std, CanIfRxPduRef=PT_SCS_HSC2_FrP15_PP_SCS_HSC2_FrP15_Rx_0fb271d2_c07658fd
        TPMS_HSC3_FrP01_oCAN01_Rx_3abd61be: CanIfRxPduCanId=1149, CanIfRxPduDlc=8, CanIfRxPduHrhIdRef=CanIfInitHohCfg/CN_CAN01_388e5969_Rx_Std, CanIfRxPduRef=PT_TPMS_HSC3_FrP01_PP_TPMS_HSC3_FrP01_Rx_c4eea277_b771686b
        TPMS_HSC3_FrP02_oCAN01_Rx_3abd61be: CanIfRxPduCanId=1150, CanIfRxPduDlc=8, CanIfRxPduHrhIdRef=CanIfInitHohCfg/CN_CAN01_388e5969_Rx_Std, CanIfRxPduRef=PT_TPMS_HSC3_FrP02_PP_TPMS_HSC3_FrP02_Rx_c4eea277_b771686b
        Tester_HSC2_ECM_FrP00_oCAN00_Rx_3abd61be: CanIfRxPduCanId=201, CanIfRxPduDlc=8, CanIfRxPduHrhIdRef=CanIfInitHohCfg/CN_CAN00_388e5969_Rx_Std, CanIfRxPduRef=PT_Tester_HSC2_ECM_FrP00_PP_Tester_HSC2_ECM_FrP00_Rx_0fb271d2_c07658fd
        Tester_HSC2_GW_FrP14_oCAN00_Rx_3abd61be: CanIfRxPduCanId=429, CanIfRxPduDlc=6, CanIfRxPduHrhIdRef=CanIfInitHohCfg/CN_CAN00_388e5969_Rx_Std, CanIfRxPduRef=PT_Tester_HSC2_GW_FrP14_PP_Tester_HSC2_GW_FrP14_Rx_0fb271d2_c07658fd
      47 x CanIfTxPduCfg, all with CanIfTxPduCanIdType=STANDARD_CAN, CanIfTxPduUserTxConfirmationName=PduR_CanIfTxConfirmation, CanIfTxPduUserTxConfirmationUL=PDUR:
        DIAG_DTCInfo_P2P_oCAN00_Tx_3abd61be: CanIfTxPduCanId=1950, CanIfTxPduDlc=7, CanIfTxPduBufferRef=CanIfBufferCfg_Tx_Std_0fb271d2, CanIfTxPduRef=PT_DIAG_DTCInfo_P2P_PP_DIAG_DTCInfo_P2P_Tx_0fb271d2_c07658fd
        DIAG_PhysResp_P2P_oCAN00_Tx_3abd61be: CanIfTxPduCanId=1854, CanIfTxPduDlc=8, CanIfTxPduBufferRef=CanIfBufferCfg_Tx_Std_0fb271d2, CanIfTxPduRef=PT_DIAG_PhysResp_P2P_PP_DIAG_PhysResp_P2P_Tx_0fb271d2_c07658fd
        P2P_DIAG_DTCInfo_APA_oCAN00_Tx_3abd61be: CanIfTxPduCanId=1945, CanIfTxPduDlc=7, CanIfTxPduBufferRef=CanIfBufferCfg_Tx_Std_0fb271d2, CanIfTxPduRef=PT_P2P_DIAG_DTCInfo_APA_PP_P2P_DIAG_DTCInfo_APA_Tx_0fb271d2_c07658fd
        P2P_HSC2_FrP00_oCAN00_Tx_3abd61be: CanIfTxPduCanId=424, CanIfTxPduDlc=6, CanIfTxPduBufferRef=CanIfBufferCfg_Tx_Std_0fb271d2, CanIfTxPduRef=PT_P2P_HSC2_FrP00_PP_P2P_HSC2_FrP00_Tx_0fb271d2_c07658fd
        P2P_HSC2_FrP01_oCAN00_Tx_3abd61be: CanIfTxPduCanId=437, CanIfTxPduDlc=8, CanIfTxPduBufferRef=CanIfBufferCfg_Tx_Std_0fb271d2, CanIfTxPduRef=PT_P2P_HSC2_FrP01_PP_P2P_HSC2_FrP01_Tx_0fb271d2_c07658fd
        P2P_HSC2_FrP02_oCAN00_Tx_3abd61be: CanIfTxPduCanId=966, CanIfTxPduDlc=8, CanIfTxPduBufferRef=CanIfBufferCfg_Tx_Std_0fb271d2, CanIfTxPduRef=PT_P2P_HSC2_FrP02_PP_P2P_HSC2_FrP02_Tx_0fb271d2_c07658fd
        P2P_HSC2_FrP03_oCAN00_Tx_3abd61be: CanIfTxPduCanId=573, CanIfTxPduDlc=8, CanIfTxPduBufferRef=CanIfBufferCfg_Tx_Std_0fb271d2, CanIfTxPduRef=PT_P2P_HSC2_FrP03_PP_P2P_HSC2_FrP03_Tx_0fb271d2_c07658fd
        P2P_HSC2_FrP04_oCAN00_Tx_3abd61be: CanIfTxPduCanId=567, CanIfTxPduDlc=8, CanIfTxPduBufferRef=CanIfBufferCfg_Tx_Std_0fb271d2, CanIfTxPduRef=PT_P2P_HSC2_FrP04_PP_P2P_HSC2_FrP04_Tx_0fb271d2_c07658fd
        P2P_HSC2_FrS01_oCAN00_Tx_3abd61be: CanIfTxPduCanId=1538, CanIfTxPduDlc=8, CanIfTxPduBufferRef=CanIfBufferCfg_Tx_Std_0fb271d2, CanIfTxPduRef=PT_P2P_HSC2_FrS01_PP_P2P_HSC2_FrS01_Tx_0fb271d2_c07658fd
        P2P_HSC4_FrP03_oCAN01_Tx_3abd61be: CanIfTxPduCanId=781, CanIfTxPduDlc=8, CanIfTxPduBufferRef=CanIfBufferCfg_Tx_Std_c4eea277, CanIfTxPduRef=PT_P2P_HSC4_FrP03_PP_P2P_HSC4_FrP03_Tx_c4eea277_b771686b
        P2P_HSC4_FrS01_oCAN01_Tx_3abd61be: CanIfTxPduCanId=1551, CanIfTxPduDlc=8, CanIfTxPduBufferRef=CanIfBufferCfg_Tx_Std_c4eea277, CanIfTxPduRef=PT_P2P_HSC4_FrS01_PP_P2P_HSC4_FrS01_Tx_c4eea277_b771686b
        P2P_IECU_HSC4_FrP01_oCAN01_Tx_3abd61be: CanIfTxPduCanId=764, CanIfTxPduDlc=8, CanIfTxPduBufferRef=CanIfBufferCfg_Tx_Std_c4eea277, CanIfTxPduRef=PT_P2P_IECU_HSC4_FrP01_PP_P2P_IECU_HSC4_FrP01_Tx_c4eea277_b771686b
        P2P_IECU_HSC4_FrP02_oCAN01_Tx_3abd61be: CanIfTxPduCanId=912, CanIfTxPduDlc=8, CanIfTxPduBufferRef=CanIfBufferCfg_Tx_Std_c4eea277, CanIfTxPduRef=PT_P2P_IECU_HSC4_FrP02_PP_P2P_IECU_HSC4_FrP02_Tx_c4eea277_b771686b
        P2P_SecCH_BCM_FrP03_oCAN02_Tx_3abd61be: CanIfTxPduCanId=1146, CanIfTxPduDlc=8, CanIfTxPduBufferRef=CanIfBufferCfg_Tx_Std_427ad0d9, CanIfTxPduRef=PT_P2P_SecCH_BCM_FrP03_PP_P2P_SecCH_BCM_FrP03_Tx_427ad0d9_2e7839d1
        P2P_SecCH_BCM_FrP04_oCAN02_Tx_3abd61be: CanIfTxPduCanId=1130, CanIfTxPduDlc=8, CanIfTxPduBufferRef=CanIfBufferCfg_Tx_Std_427ad0d9, CanIfTxPduRef=PT_P2P_SecCH_BCM_FrP04_PP_P2P_SecCH_BCM_FrP04_Tx_427ad0d9_2e7839d1
        P2P_SecCH_BCM_FrP07_oCAN02_Tx_3abd61be: CanIfTxPduCanId=498, CanIfTxPduDlc=2, CanIfTxPduBufferRef=CanIfBufferCfg_Tx_Std_427ad0d9, CanIfTxPduRef=PT_P2P_SecCH_BCM_FrP07_PP_P2P_SecCH_BCM_FrP07_Tx_427ad0d9_2e7839d1
        P2P_SecCH_ECM_FrP00_oCAN02_Tx_3abd61be: CanIfTxPduCanId=201, CanIfTxPduDlc=8, CanIfTxPduBufferRef=CanIfBufferCfg_Tx_Std_427ad0d9, CanIfTxPduRef=PT_P2P_SecCH_ECM_FrP00_PP_P2P_SecCH_ECM_FrP00_Tx_427ad0d9_2e7839d1
        P2P_SecCH_EPB_FrP00_oCAN02_Tx_3abd61be: CanIfTxPduCanId=560, CanIfTxPduDlc=8, CanIfTxPduBufferRef=CanIfBufferCfg_Tx_Std_427ad0d9, CanIfTxPduRef=PT_P2P_SecCH_EPB_FrP00_PP_P2P_SecCH_EPB_FrP00_Tx_427ad0d9_2e7839d1
        P2P_SecCH_EPB_FrP01_oCAN02_Tx_3abd61be: CanIfTxPduCanId=554, CanIfTxPduDlc=2, CanIfTxPduBufferRef=CanIfBufferCfg_Tx_Std_427ad0d9, CanIfTxPduRef=PT_P2P_SecCH_EPB_FrP01_PP_P2P_SecCH_EPB_FrP01_Tx_427ad0d9_2e7839d1
        P2P_SecCH_EPS_FrP02_oCAN02_Tx_3abd61be: CanIfTxPduCanId=433, CanIfTxPduDlc=4, CanIfTxPduBufferRef=CanIfBufferCfg_Tx_Std_427ad0d9, CanIfTxPduRef=PT_P2P_SecCH_EPS_FrP02_PP_P2P_SecCH_EPS_FrP02_Tx_427ad0d9_2e7839d1
        P2P_SecCH_FICM_FrP02_oCAN02_Tx_3abd61be: CanIfTxPduCanId=886, CanIfTxPduDlc=8, CanIfTxPduBufferRef=CanIfBufferCfg_Tx_Std_427ad0d9, CanIfTxPduRef=PT_P2P_SecCH_FICM_FrP02_PP_P2P_SecCH_FICM_FrP02_Tx_427ad0d9_2e7839d1
        P2P_SecCH_FICM_FrP08_oCAN02_Tx_3abd61be: CanIfTxPduCanId=758, CanIfTxPduDlc=8, CanIfTxPduBufferRef=CanIfBufferCfg_Tx_Std_427ad0d9, CanIfTxPduRef=PT_P2P_SecCH_FICM_FrP08_PP_P2P_SecCH_FICM_FrP08_Tx_427ad0d9_2e7839d1
        P2P_SecCH_FICM_FrP18_oCAN02_Tx_3abd61be: CanIfTxPduCanId=893, CanIfTxPduDlc=8, CanIfTxPduBufferRef=CanIfBufferCfg_Tx_Std_427ad0d9, CanIfTxPduRef=PT_P2P_SecCH_FICM_FrP18_PP_P2P_SecCH_FICM_FrP18_Tx_427ad0d9_2e7839d1
        P2P_SecCH_GW_FrP00_oCAN02_Tx_3abd61be: CanIfTxPduCanId=361, CanIfTxPduDlc=6, CanIfTxPduBufferRef=CanIfBufferCfg_Tx_Std_427ad0d9, CanIfTxPduRef=PT_P2P_SecCH_GW_FrP00_PP_P2P_SecCH_GW_FrP00_Tx_427ad0d9_2e7839d1
        P2P_SecCH_GW_FrP01_oCAN02_Tx_3abd61be: CanIfTxPduCanId=497, CanIfTxPduDlc=8, CanIfTxPduBufferRef=CanIfBufferCfg_Tx_Std_427ad0d9, CanIfTxPduRef=PT_P2P_SecCH_GW_FrP01_PP_P2P_SecCH_GW_FrP01_Tx_427ad0d9_2e7839d1
        P2P_SecCH_GW_FrP08_oCAN02_Tx_3abd61be: CanIfTxPduCanId=1344, CanIfTxPduDlc=8, CanIfTxPduBufferRef=CanIfBufferCfg_Tx_Std_427ad0d9, CanIfTxPduRef=PT_P2P_SecCH_GW_FrP08_PP_P2P_SecCH_GW_FrP08_Tx_427ad0d9_2e7839d1
        P2P_SecCH_GW_FrP10_oCAN02_Tx_3abd61be: CanIfTxPduCanId=1009, CanIfTxPduDlc=8, CanIfTxPduBufferRef=CanIfBufferCfg_Tx_Std_427ad0d9, CanIfTxPduRef=PT_P2P_SecCH_GW_FrP10_PP_P2P_SecCH_GW_FrP10_Tx_427ad0d9_2e7839d1
        P2P_SecCH_GW_FrP13_oCAN02_Tx_3abd61be: CanIfTxPduCanId=425, CanIfTxPduDlc=8, CanIfTxPduBufferRef=CanIfBufferCfg_Tx_Std_427ad0d9, CanIfTxPduRef=PT_P2P_SecCH_GW_FrP13_PP_P2P_SecCH_GW_FrP13_Tx_427ad0d9_2e7839d1
        P2P_SecCH_GW_FrS00_oCAN02_Tx_3abd61be: CanIfTxPduCanId=1699, CanIfTxPduDlc=8, CanIfTxPduBufferRef=CanIfBufferCfg_Tx_Std_427ad0d9, CanIfTxPduRef=PT_P2P_SecCH_GW_FrS00_PP_P2P_SecCH_GW_FrS00_Tx_427ad0d9_2e7839d1
        P2P_SecCH_HCU_ECM_FrP04_oCAN02_Tx_3abd61be: CanIfTxPduCanId=404, CanIfTxPduDlc=8, CanIfTxPduBufferRef=CanIfBufferCfg_Tx_Std_427ad0d9, CanIfTxPduRef=PT_P2P_SecCH_HCU_ECM_FrP04_PP_P2P_SecCH_HCU_ECM_FrP04_Tx_427ad0d9_2e7839d1
        P2P_SecCH_HCU_FrP00_oCAN02_Tx_3abd61be: CanIfTxPduCanId=175, CanIfTxPduDlc=8, CanIfTxPduBufferRef=CanIfBufferCfg_Tx_Std_427ad0d9, CanIfTxPduRef=PT_P2P_SecCH_HCU_FrP00_PP_P2P_SecCH_HCU_FrP00_Tx_427ad0d9_2e7839d1
        P2P_SecCH_HCU_FrP01_oCAN02_Tx_3abd61be: CanIfTxPduCanId=406, CanIfTxPduDlc=8, CanIfTxPduBufferRef=CanIfBufferCfg_Tx_Std_427ad0d9, CanIfTxPduRef=PT_P2P_SecCH_HCU_FrP01_PP_P2P_SecCH_HCU_FrP01_Tx_427ad0d9_2e7839d1
        P2P_SecCH_HCU_FrP13_oCAN02_Tx_3abd61be: CanIfTxPduCanId=412, CanIfTxPduDlc=8, CanIfTxPduBufferRef=CanIfBufferCfg_Tx_Std_427ad0d9, CanIfTxPduRef=PT_P2P_SecCH_HCU_FrP13_PP_P2P_SecCH_HCU_FrP13_Tx_427ad0d9_2e7839d1
        P2P_SecCH_IPK_FrP06_oCAN02_Tx_3abd61be: CanIfTxPduCanId=1345, CanIfTxPduDlc=8, CanIfTxPduBufferRef=CanIfBufferCfg_Tx_Std_427ad0d9, CanIfTxPduRef=PT_P2P_SecCH_IPK_FrP06_PP_P2P_SecCH_IPK_FrP06_Tx_427ad0d9_2e7839d1
        P2P_SecCH_SAS_FrP00_oCAN02_Tx_3abd61be: CanIfTxPduCanId=485, CanIfTxPduDlc=8, CanIfTxPduBufferRef=CanIfBufferCfg_Tx_Std_427ad0d9, CanIfTxPduRef=PT_P2P_SecCH_SAS_FrP00_PP_P2P_SecCH_SAS_FrP00_Tx_427ad0d9_2e7839d1
        P2P_SecCH_SCS_FrP00_oCAN02_Tx_3abd61be: CanIfTxPduCanId=193, CanIfTxPduDlc=8, CanIfTxPduBufferRef=CanIfBufferCfg_Tx_Std_427ad0d9, CanIfTxPduRef=PT_P2P_SecCH_SCS_FrP00_PP_P2P_SecCH_SCS_FrP00_Tx_427ad0d9_2e7839d1
        P2P_SecCH_SCS_FrP01_oCAN02_Tx_3abd61be: CanIfTxPduCanId=197, CanIfTxPduDlc=8, CanIfTxPduBufferRef=CanIfBufferCfg_Tx_Std_427ad0d9, CanIfTxPduRef=PT_P2P_SecCH_SCS_FrP01_PP_P2P_SecCH_SCS_FrP01_Tx_427ad0d9_2e7839d1
        P2P_SecCH_SCS_FrP02_oCAN02_Tx_3abd61be: CanIfTxPduCanId=389, CanIfTxPduDlc=4, CanIfTxPduBufferRef=CanIfBufferCfg_Tx_Std_427ad0d9, CanIfTxPduRef=PT_P2P_SecCH_SCS_FrP02_PP_P2P_SecCH_SCS_FrP02_Tx_427ad0d9_2e7839d1
        P2P_SecCH_SCS_FrP03_oCAN02_Tx_3abd61be: CanIfTxPduCanId=455, CanIfTxPduDlc=8, CanIfTxPduBufferRef=CanIfBufferCfg_Tx_Std_427ad0d9, CanIfTxPduRef=PT_P2P_SecCH_SCS_FrP03_PP_P2P_SecCH_SCS_FrP03_Tx_427ad0d9_2e7839d1
        P2P_SecCH_SCS_FrP05_oCAN02_Tx_3abd61be: CanIfTxPduCanId=489, CanIfTxPduDlc=8, CanIfTxPduBufferRef=CanIfBufferCfg_Tx_Std_427ad0d9, CanIfTxPduRef=PT_P2P_SecCH_SCS_FrP05_PP_P2P_SecCH_SCS_FrP05_Tx_427ad0d9_2e7839d1
        P2P_SecCH_SCS_FrP11_oCAN02_Tx_3abd61be: CanIfTxPduCanId=840, CanIfTxPduDlc=8, CanIfTxPduBufferRef=CanIfBufferCfg_Tx_Std_427ad0d9, CanIfTxPduRef=PT_P2P_SecCH_SCS_FrP11_PP_P2P_SecCH_SCS_FrP11_Tx_427ad0d9_2e7839d1
        P2P_SecCH_SCS_FrP12_oCAN02_Tx_3abd61be: CanIfTxPduCanId=842, CanIfTxPduDlc=8, CanIfTxPduBufferRef=CanIfBufferCfg_Tx_Std_427ad0d9, CanIfTxPduRef=PT_P2P_SecCH_SCS_FrP12_PP_P2P_SecCH_SCS_FrP12_Tx_427ad0d9_2e7839d1
        P2P_SecCH_SCS_FrP15_oCAN02_Tx_3abd61be: CanIfTxPduCanId=851, CanIfTxPduDlc=8, CanIfTxPduBufferRef=CanIfBufferCfg_Tx_Std_427ad0d9, CanIfTxPduRef=PT_P2P_SecCH_SCS_FrP15_PP_P2P_SecCH_SCS_FrP15_Tx_427ad0d9_2e7839d1
        P2P_SecCH_SCU_FrP00_oCAN02_Tx_3abd61be: CanIfTxPduCanId=157, CanIfTxPduDlc=8, CanIfTxPduBufferRef=CanIfBufferCfg_Tx_Std_427ad0d9, CanIfTxPduRef=PT_P2P_SecCH_SCU_FrP00_PP_P2P_SecCH_SCU_FrP00_Tx_427ad0d9_2e7839d1
        P2P_SecCH_SDM_FrP00_oCAN02_Tx_3abd61be: CanIfTxPduCanId=355, CanIfTxPduDlc=8, CanIfTxPduBufferRef=CanIfBufferCfg_Tx_Std_427ad0d9, CanIfTxPduRef=PT_P2P_SecCH_SDM_FrP00_PP_P2P_SecCH_SDM_FrP00_Tx_427ad0d9_2e7839d1
        P2P_SecCH_TC_FrP07_oCAN02_Tx_3abd61be: CanIfTxPduCanId=148, CanIfTxPduDlc=8, CanIfTxPduBufferRef=CanIfBufferCfg_Tx_Std_427ad0d9, CanIfTxPduRef=PT_P2P_SecCH_TC_FrP07_PP_P2P_SecCH_TC_FrP07_Tx_427ad0d9_2e7839d1
        P2P_SecCH_Tester_GW_FrP14_oCAN02_Tx_3abd61be: CanIfTxPduCanId=429, CanIfTxPduDlc=8, CanIfTxPduBufferRef=CanIfBufferCfg_Tx_Std_427ad0d9, CanIfTxPduRef=PT_P2P_SecCH_Tester_GW_FrP14_PP_P2P_SecCH_Tester_GW_FrP14_Tx_427ad0d9_2e7839d1
    CanIfPrivateCfg: CanIfPrivateSoftwareFilterType=LINEAR
    CanIfPublicCfg: CanIfPublicPnSupport=false
  module config CanSM
    CanSMConfiguration
      3 x CanSMManagerNetwork:
        CHNL_1c7839b0: CanSMComMNetworkHandleRef=ComMConfigSet/CAN02_f26020e5
          CT_CAN02_388e5969 (CanSMController): CanSMControllerId=Can/CT_CAN02_388e5969
        CHNL_8571680a: CanSMComMNetworkHandleRef=ComMConfigSet/CAN01_f26020e5
          CT_CAN01_388e5969 (CanSMController): CanSMControllerId=Can/CT_CAN01_388e5969
        CHNL_f276589c: CanSMComMNetworkHandleRef=ComMConfigSet/CAN00_f26020e5
          CT_CAN00_388e5969 (CanSMController): CanSMControllerId=Can/CT_CAN00_388e5969
  module config Com
    ComConfig
      115 x ComIPdu, all with ComIPduType=NORMAL:
        APA_SecCH_FrP00_oCAN02_3abd61be: ComIPduDirection=RECEIVE, ComIPduGroupRef=P2P_oCAN02_Rx_fcef2243, ComIPduSignalRef=APAAlvRC_sech2_SecCAN2_0adb690c, ComIPduSignalRef=APAChksm_sech2_SecCAN2_0adb690c, ComIPduSignalRef=APACmdEPSSts_sech2_SecCAN2_0adb690c, ComIPduSignalRef=APAF_sech2_SecCAN2_0adb690c, ComIPduSignalRef=APAToqReqSts_sech2_SecCAN2_0adb690c, ComIPduSignalRef=APAToqReqVal_sech2_SecCAN2_0adb690c, ComIPduSignalRef=APATrgtEPSStrgWhlAng_sech2_SecCAN2_0adb690c, ComPduIdRef=PT_APA_SecCH_FrP00_PP_APA_SecCH_FrP00_Rx_427ad0d9_2e7839d1
        APA_SecCH_FrP01_oCAN02_3abd61be: ComIPduDirection=RECEIVE, ComIPduGroupRef=P2P_oCAN02_Rx_fcef2243, ComIPduSignalRef=APACrpSpdReqSts_sech2_SecCAN2_c6716992, ComIPduSignalRef=APACrpSpdReqVal_sech2_SecCAN2_c6716992, ComIPduSignalRef=APAEPBOPReq_sech2_SecCAN2_c6716992, ComIPduSignalRef=APAEPBOpReqValPV_sech2_SecCAN2_c6716992, ComIPduSignalRef=APAEPBReqAlvRC_sech2_SecCAN2_c6716992, ComIPduSignalRef=APAInfoDispReq_sech2_SecCAN2_c6716992, ComIPduSignalRef=APAMd_sech2_SecCAN2_c6716992, ComIPduSignalRef=APANRCDAvlbl_sech2_SecCAN2_c6716992, ComIPduSignalRef=APAReq_sech2_SecCAN2_c6716992, ComIPduSignalRef=APASCSAcclReqSts_sech2_SecCAN2_c6716992, ComIPduSignalRef=APASCSAcclReqValPV_sech2_SecCAN2_c6716992, ComIPduSignalRef=APASCSAcclReqVal_sech2_SecCAN2_c6716992, ComIPduSignalRef=APASCSAlvRC_sech2_SecCAN2_c6716992, ComIPduSignalRef=APAShifterPosReqd_sech2_SecCAN2_c6716992, ComIPduSignalRef=APASts_sech2_SecCAN2_c6716992, ComPduIdRef=PT_APA_SecCH_FrP01_PP_APA_SecCH_FrP01_Rx_427ad0d9_2e7839d1
        APA_SecCH_FrP02_oCAN02_3abd61be: ComIPduDirection=RECEIVE, ComIPduGroupRef=P2P_oCAN02_Rx_fcef2243, ComIPduSignalRef=APAParkngSchedV_sech2_SecCAN2_48fe6e71, ComIPduSignalRef=APAParkngSched_sech2_SecCAN2_48fe6e71, ComIPduSignalRef=APASlotBearng_sech2_SecCAN2_48fe6e71, ComIPduSignalRef=APASlotLngth_sech2_SecCAN2_48fe6e71, ComIPduSignalRef=APAVehCrdnatAzmth_sech2_SecCAN2_48fe6e71, ComIPduSignalRef=APAVehCrdnatPosX_sech2_SecCAN2_48fe6e71, ComIPduSignalRef=APAVehCrdnatPosY_sech2_SecCAN2_48fe6e71, ComPduIdRef=PT_APA_SecCH_FrP02_PP_APA_SecCH_FrP02_Rx_427ad0d9_2e7839d1
        APA_SecCH_FrP03_oCAN02_3abd61be: ComIPduDirection=RECEIVE, ComIPduGroupRef=P2P_oCAN02_Rx_fcef2243, ComIPduSignalRef=FLObsDist_sech2_SecCAN2_84546eef, ComIPduSignalRef=FRObsDist_sech2_SecCAN2_84546eef, ComIPduSignalRef=RLObsDist_sech2_SecCAN2_84546eef, ComIPduSignalRef=RRObsDist_sech2_SecCAN2_84546eef, ComPduIdRef=PT_APA_SecCH_FrP03_PP_APA_SecCH_FrP03_Rx_427ad0d9_2e7839d1
        APA_SecCH_FrP04_oCAN02_3abd61be: ComIPduDirection=RECEIVE, ComIPduGroupRef=P2P_oCAN02_Rx_fcef2243, ComIPduSignalRef=FrtMidLObsDist_sech2_SecCAN2_8e9167f6, ComIPduSignalRef=FrtMidRObsDist_sech2_SecCAN2_8e9167f6, ComIPduSignalRef=RrMidLObsDist_sech2_SecCAN2_8e9167f6, ComIPduSignalRef=RrMidRObsDist_sech2_SecCAN2_8e9167f6, ComPduIdRef=PT_APA_SecCH_FrP04_PP_APA_SecCH_FrP04_Rx_427ad0d9_2e7839d1
        DIAG_DTCInfo_APA_oCAN02_3abd61be: ComIPduDirection=RECEIVE, ComIPduGroupRef=P2P_oCAN02_Rx_fcef2243, ComIPduSignalRef=DTCInfomationAPA_SecCAN2_3e47bb85, ComPduIdRef=PT_DIAG_DTCInfo_APA_PP_DIAG_DTCInfo_APA_Rx_427ad0d9_2e7839d1
        DIAG_DTCInfo_P2P_oCAN00_3abd61be: ComIPduDirection=SEND, ComIPduGroupRef=P2P_oCAN00_Tx_fcef2243, ComIPduSignalRef=DTCInfomationP2PHSC2_daa1a8e8, ComPduIdRef=PT_DIAG_DTCInfo_P2P_PP_DIAG_DTCInfo_P2P_Tx_0fb271d2_c07658fd
          ComTxIPdu: ComTxIPduUnusedAreasDefault=0
        DIAG_FuncReq_HSC2_oCAN00_3abd61be: ComIPduDirection=RECEIVE, ComIPduGroupRef=P2P_oCAN00_Rx_fcef2243, ComIPduSignalRef=DiagnosticFuncAddrReq_h2_a8412cb3, ComPduIdRef=PT_DIAG_FuncReq_HSC2_PP_DIAG_FuncReq_HSC2_Rx_0fb271d2_c07658fd
        DIAG_PhysReq_P2P_oCAN00_3abd61be: ComIPduDirection=RECEIVE, ComIPduGroupRef=P2P_oCAN00_Rx_fcef2243, ComIPduSignalRef=DiagnosticReqP2P_h2_2483449d, ComPduIdRef=PT_DIAG_PhysReq_P2P_PP_DIAG_PhysReq_P2P_Rx_0fb271d2_c07658fd
        DIAG_PhysResp_P2P_oCAN00_3abd61be: ComIPduDirection=SEND, ComIPduGroupRef=P2P_oCAN00_Tx_fcef2243, ComIPduSignalRef=DiagnosticRespP2P_3926bf28, ComPduIdRef=PT_DIAG_PhysResp_P2P_PP_DIAG_PhysResp_P2P_Tx_0fb271d2_c07658fd
          ComTxIPdu: ComTxIPduUnusedAreasDefault=0
        EHBS_HSC2_FrP00_oCAN00_3abd61be: ComIPduDirection=RECEIVE, ComIPduGroupRef=P2P_oCAN00_Rx_fcef2243, ComIPduSignalRef=BrkPdlAppdHSC2_70a619c8, ComIPduSignalRef=HydBstrCmpstnReqHSC2_70a619c8, ComPduIdRef=PT_EHBS_HSC2_FrP00_PP_EHBS_HSC2_FrP00_Rx_0fb271d2_c07658fd
        EPB_HSC2_FrP00_oCAN00_3abd61be: ComIPduDirection=RECEIVE, ComIPduGroupRef=P2P_oCAN00_Rx_fcef2243, ComIPduSignalRef=EPBSwStsHSC2_20142b17, ComIPduSignalRef=EPBSwStsVHSC2_20142b17, ComPduIdRef=PT_EPB_HSC2_FrP00_PP_EPB_HSC2_FrP00_Rx_0fb271d2_c07658fd
        EPB_HSC2_FrP01_oCAN00_3abd61be: ComIPduDirection=RECEIVE, ComIPduGroupRef=P2P_oCAN00_Rx_fcef2243, ComIPduSignalRef=EPBAppcnStsHSC2_ecbe2b89, ComIPduSignalRef=EPBAppcnStsPVHSC2_ecbe2b89, ComIPduSignalRef=EPBAvlblyStsHSC2_ecbe2b89, ComIPduSignalRef=EPBAvlblyStsPVHSC2_ecbe2b89, ComPduIdRef=PT_EPB_HSC2_FrP01_PP_EPB_HSC2_FrP01_Rx_0fb271d2_c07658fd
        EPS_HSC2_FrP02_oCAN00_3abd61be: ComIPduDirection=RECEIVE, ComIPduGroupRef=P2P_oCAN00_Rx_fcef2243, ComIPduSignalRef=EPSAPAAlvRCHSC2_a6919738, ComIPduSignalRef=EPSAPAChksmHSC2_a6919738, ComIPduSignalRef=EPSAPAInhHSC2_a6919738, ComIPduSignalRef=EPSAPAStsHSC2_a6919738, ComPduIdRef=PT_EPS_HSC2_FrP02_PP_EPS_HSC2_FrP02_Rx_0fb271d2_c07658fd
        FICM_HSC4_FrP02_oCAN01_3abd61be: ComIPduDirection=RECEIVE, ComIPduGroupRef=P2P_oCAN01_Rx_fcef2243, ComIPduSignalRef=RstrFctryDeftsReqHSC4_f9bc5d91, ComPduIdRef=PT_FICM_HSC4_FrP02_PP_FICM_HSC4_FrP02_Rx_c4eea277_b771686b
        FICM_HSC4_FrP08_oCAN01_3abd61be: ComIPduDirection=RECEIVE, ComIPduGroupRef=P2P_oCAN01_Rx_fcef2243, ComIPduSignalRef=APASwReqHSC4_687c4159, ComIPduSignalRef=PDCSwReqHSC4_687c4159, ComPduIdRef=PT_FICM_HSC4_FrP08_PP_FICM_HSC4_FrP08_Rx_c4eea277_b771686b
        FICM_HSC4_FrP13_oCAN01_3abd61be: ComIPduDirection=RECEIVE, ComIPduGroupRef=P2P_oCAN01_Rx_fcef2243, ComIPduSignalRef=AlisysrdyHSC4_226d494c, ComPduIdRef=PT_FICM_HSC4_FrP13_PP_FICM_HSC4_FrP13_Rx_c4eea277_b771686b
        FICM_HSC4_FrP18_oCAN01_3abd61be: ComIPduDirection=RECEIVE, ComIPduGroupRef=P2P_oCAN01_Rx_fcef2243, ComIPduSignalRef=DrvrSelAPAParkngMdHSC4_7f07551a, ComIPduSignalRef=DrvrSelAPASlotBearngHSC4_7f07551a, ComPduIdRef=PT_FICM_HSC4_FrP18_PP_FICM_HSC4_FrP18_Rx_c4eea277_b771686b
        FICM_HSC4_FrP32_oCAN01_3abd61be: ComIPduDirection=RECEIVE, ComIPduGroupRef=P2P_oCAN01_Rx_fcef2243, ComIPduSignalRef=SCREEN_COORD_AXHSC4_c0316154, ComIPduSignalRef=SCREEN_COORD_AYHSC4_c0316154, ComIPduSignalRef=SCREEN_COORD_BXHSC4_c0316154, ComIPduSignalRef=SCREEN_COORD_BYHSC4_c0316154, ComIPduSignalRef=SurndViewSelnHSC4_c0316154, ComIPduSignalRef=TOUCH_SCREEN_ACMDHSC4_c0316154, ComIPduSignalRef=TOUCH_SCREEN_BCMDHSC4_c0316154, ComIPduSignalRef=TOUCH_SCREEN_STATUS_h4HSC4_c0316154, ComPduIdRef=PT_FICM_HSC4_FrP32_PP_FICM_HSC4_FrP32_Rx_c4eea277_b771686b
        FICM_HSC4_FrP33_oCAN01_3abd61be: ComIPduDirection=RECEIVE, ComIPduGroupRef=P2P_oCAN01_Rx_fcef2243, ComIPduSignalRef=AVMAutoViewChgHSC4_0c9b61ca, ComIPduSignalRef=FICMP2PQuitReqHSC4_0c9b61ca, ComIPduSignalRef=FICMPLCRtCoverSwReqHSC4_0c9b61ca, ComIPduSignalRef=FICMPLCRtEndSwReqHSC4_0c9b61ca, ComIPduSignalRef=FICMPLCSwReqHSC4_0c9b61ca, ComIPduSignalRef=FICMRouteChangeCheckHSC4_0c9b61ca, ComIPduSignalRef=FICMRouteReqHSC4_0c9b61ca, ComIPduSignalRef=FICMSilentSearchCheckHSC4_0c9b61ca, ComIPduSignalRef=FICMSilentSearchReqHSC4_0c9b61ca, ComPduIdRef=PT_FICM_HSC4_FrP33_PP_FICM_HSC4_FrP33_Rx_c4eea277_b771686b
        GW_HSC2_BCM_FrP04_oCAN00_3abd61be: ComIPduDirection=RECEIVE, ComIPduGroupRef=P2P_oCAN00_Rx_fcef2243, ComIPduSignalRef=BntOpenStsHSC2_762c2774, ComIPduSignalRef=DipdBeamLghtOnHSC2_762c2774, ComIPduSignalRef=DircnIndLampSwStsHSC2_762c2774, ComIPduSignalRef=DrvrDoorOpenStsHSC2_762c2774, ComIPduSignalRef=FrtFogLghtOnHSC2_762c2774, ComIPduSignalRef=FrtPsngDoorOpenStsHSC2_762c2774, ComIPduSignalRef=LDircnIOHSC2_762c2774, ComIPduSignalRef=LdspcOpenStsHSC2_762c2774, ComIPduSignalRef=MainBeamLghtOnHSC2_762c2774, ComIPduSignalRef=RDircnIOHSC2_762c2774, ComIPduSignalRef=RLDoorOpenStsHSC2_762c2774, ComIPduSignalRef=RRDoorOpenStsHSC2_762c2774, ComIPduSignalRef=RrFogLghtOnHSC2_762c2774, ComIPduSignalRef=TrlrHitchSwAHSC2_762c2774, ComIPduSignalRef=VehSideLghtStsHSC2_762c2774, ComPduIdRef=PT_GW_HSC2_BCM_FrP04_PP_GW_HSC2_BCM_FrP04_Rx_0fb271d2_c07658fd
        GW_HSC2_BCM_FrP06_oCAN00_3abd61be: ComIPduDirection=RECEIVE, ComIPduGroupRef=P2P_oCAN00_Rx_fcef2243, ComIPduSignalRef=BCMSSBFltStsHSC2_34092009, ComIPduSignalRef=DayTimeRunningLampOnHSC2_34092009, ComPduIdRef=PT_GW_HSC2_BCM_FrP06_PP_GW_HSC2_BCM_FrP06_Rx_0fb271d2_c07658fd
        GW_HSC2_BCM_FrP07_oCAN00_3abd61be: ComIPduDirection=RECEIVE, ComIPduGroupRef=P2P_oCAN00_Rx_fcef2243, ComIPduSignalRef=BCMSSBAHSC2_f8a32097, ComIPduSignalRef=BCMSSBAVHSC2_f8a32097, ComIPduSignalRef=PwrMdAutoCtrlAvlblHSC2_f8a32097, ComIPduSignalRef=SysBPMEnbdHSC2_f8a32097, ComIPduSignalRef=SysBPMHSC2_f8a32097, ComPduIdRef=PT_GW_HSC2_BCM_FrP07_PP_GW_HSC2_BCM_FrP07_Rx_0fb271d2_c07658fd
        GW_HSC2_BCM_FrS16_oCAN00_3abd61be: ComIPduDirection=RECEIVE, ComIPduGroupRef=P2P_oCAN00_Rx_fcef2243, ComIPduSignalRef=BCMToIECURmtCtrlPotclHSC2_c8458f49, ComPduIdRef=PT_GW_HSC2_BCM_FrS16_PP_GW_HSC2_BCM_FrS16_Rx_0fb271d2_c07658fd
        GW_HSC2_ECM_FrP04_oCAN00_3abd61be: ComIPduDirection=RECEIVE, ComIPduGroupRef=P2P_oCAN00_Rx_fcef2243, ComIPduSignalRef=TrShftLvrPosV_h1HSC2_8bd5df01, ComIPduSignalRef=TrShftLvrPos_h1HSC2_8bd5df01, ComPduIdRef=PT_GW_HSC2_ECM_FrP04_PP_GW_HSC2_ECM_FrP04_Rx_0fb271d2_c07658fd
        GW_HSC2_FICM_FrP02_oCAN00_3abd61be: ComIPduDirection=RECEIVE, ComIPduGroupRef=P2P_oCAN00_Rx_fcef2243, ComIPduSignalRef=DrvrSelAPAParkngMdHSC2_d7b82a4e, ComIPduSignalRef=DrvrSelAPASlotBearngHSC2_d7b82a4e, ComIPduSignalRef=RstrFctryDeftsReqHSC2_d7b82a4e, ComPduIdRef=PT_GW_HSC2_FICM_FrP02_PP_GW_HSC2_FICM_FrP02_Rx_0fb271d2_c07658fd
        GW_HSC2_FICM_FrP08_oCAN00_3abd61be: ComIPduDirection=RECEIVE, ComIPduGroupRef=P2P_oCAN00_Rx_fcef2243, ComIPduSignalRef=APASwReqHSC2_46783686, ComIPduSignalRef=PDCSwReqHSC2_46783686, ComPduIdRef=PT_GW_HSC2_FICM_FrP08_PP_GW_HSC2_FICM_FrP08_Rx_0fb271d2_c07658fd
        GW_HSC2_FrP00_oCAN00_3abd61be: ComIPduDirection=RECEIVE, ComIPduGroupRef=P2P_oCAN00_Rx_fcef2243, ComIPduSignalRef=BCMAvlbly_h2HSC2_ab4ba2ce, ComIPduSignalRef=ECMAvlbly_h2HSC2_ab4ba2ce, ComIPduSignalRef=FICMAvlbly_h2HSC2_ab4ba2ce, ComIPduSignalRef=HCUAvlbly_h2HSC2_ab4ba2ce, ComIPduSignalRef=IPCAvlbly_h2HSC2_ab4ba2ce, ComIPduSignalRef=SCUAvlbly_h2HSC2_ab4ba2ce, ComIPduSignalRef=SDMAvlbly_h2HSC2_ab4ba2ce, ComIPduSignalRef=TCAvlbly_h2HSC2_ab4ba2ce, ComPduIdRef=PT_GW_HSC2_FrP00_PP_GW_HSC2_FrP00_Rx_0fb271d2_c07658fd
        GW_HSC2_FrP01_oCAN00_3abd61be: ComIPduDirection=RECEIVE, ComIPduGroupRef=P2P_oCAN00_Rx_fcef2243, ComIPduSignalRef=BPMMstrAvlbly_h2HSC2_67e1a250, ComIPduSignalRef=PwrMdMstrAccryA_h2HSC2_67e1a250, ComIPduSignalRef=PwrMdMstrRunCrkA_h2HSC2_67e1a250, ComIPduSignalRef=SysOpnlMd_h2HSC2_67e1a250, ComIPduSignalRef=SysPwrMd_h2HSC2_67e1a250, ComIPduSignalRef=SysVolMdV_h2HSC2_67e1a250, ComIPduSignalRef=SysVolMd_h2HSC2_67e1a250, ComIPduSignalRef=SysVolV_h2HSC2_67e1a250, ComIPduSignalRef=SysVol_h2HSC2_67e1a250, ComPduIdRef=PT_GW_HSC2_FrP01_PP_GW_HSC2_FrP01_Rx_0fb271d2_c07658fd
        GW_HSC2_FrP08_oCAN00_3abd61be: ComIPduDirection=RECEIVE, ComIPduGroupRef=P2P_oCAN00_Rx_fcef2243, ComIPduSignalRef=VehOdoV_h2HSC2_78aeb97b, ComIPduSignalRef=VehOdo_h2HSC2_78aeb97b, ComPduIdRef=PT_GW_HSC2_FrP08_PP_GW_HSC2_FrP08_Rx_0fb271d2_c07658fd
        GW_HSC2_FrP10_oCAN00_3abd61be: ComIPduDirection=RECEIVE, ComIPduGroupRef=P2P_oCAN00_Rx_fcef2243, ComIPduSignalRef=OtsdAirTemCrValMsk_h2HSC2_bc30b68d, ComIPduSignalRef=OtsdAirTemCrValV_h2HSC2_bc30b68d, ComIPduSignalRef=OtsdAirTemCrVal_h2HSC2_bc30b68d, ComPduIdRef=PT_GW_HSC2_FrP10_PP_GW_HSC2_FrP10_Rx_0fb271d2_c07658fd
        GW_HSC2_FrP13_oCAN00_3abd61be: ComIPduDirection=RECEIVE, ComIPduGroupRef=P2P_oCAN00_Rx_fcef2243, ComIPduSignalRef=APACtrlAbotdRsnHSC2_32bfb16e, ComIPduSignalRef=NRCDSts_h2HSC2_32bfb16e, ComPduIdRef=PT_GW_HSC2_FrP13_PP_GW_HSC2_FrP13_Rx_0fb271d2_c07658fd
        GW_HSC2_FrS00_oCAN00_3abd61be: ComIPduDirection=RECEIVE, ComIPduGroupRef=P2P_oCAN00_Rx_fcef2243, ComIPduSignalRef=NRCDMstrChlg_h2HSC2_407c19cd, ComPduIdRef=PT_GW_HSC2_FrS00_PP_GW_HSC2_FrS00_Rx_0fb271d2_c07658fd
        GW_HSC2_HCU_FrP00_oCAN00_3abd61be: ComIPduDirection=RECEIVE, ComIPduGroupRef=P2P_oCAN00_Rx_fcef2243, ComIPduSignalRef=EPTAccelActuPosHSC2_533eb1f8, ComIPduSignalRef=EPTAccelActuPosVHSC2_533eb1f8, ComIPduSignalRef=EPTBrkPdlDscrtInptStsHSC2_533eb1f8, ComIPduSignalRef=EPTBrkPdlDscrtInptStsVHSC2_533eb1f8, ComIPduSignalRef=EPTStCmdOn_h1HSC2_533eb1f8, ComPduIdRef=PT_GW_HSC2_HCU_FrP00_PP_GW_HSC2_HCU_FrP00_Rx_0fb271d2_c07658fd
        GW_HSC2_HCU_FrP01_oCAN00_3abd61be: ComIPduDirection=RECEIVE, ComIPduGroupRef=P2P_oCAN00_Rx_fcef2243, ComIPduSignalRef=EPTRdy_h1HSC2_9f94b166, ComPduIdRef=PT_GW_HSC2_HCU_FrP01_PP_GW_HSC2_HCU_FrP01_Rx_0fb271d2_c07658fd
        GW_HSC2_HCU_FrP13_oCAN00_3abd61be: ComIPduDirection=RECEIVE, ComIPduGroupRef=P2P_oCAN00_Rx_fcef2243, ComIPduSignalRef=VCUAccReqStsHSC2_cacaa258, ComIPduSignalRef=VCUAccReqValHSC2_cacaa258, ComIPduSignalRef=VCUNRCDAvlblHSC2_cacaa258, ComPduIdRef=PT_GW_HSC2_HCU_FrP13_PP_GW_HSC2_HCU_FrP13_Rx_0fb271d2_c07658fd
        GW_HSC2_IPK_FrP06_oCAN00_3abd61be: ComIPduDirection=RECEIVE, ComIPduGroupRef=P2P_oCAN00_Rx_fcef2243, ComIPduSignalRef=CalendarDayHSC2_c30fb534, ComIPduSignalRef=CalendarMonthHSC2_c30fb534, ComIPduSignalRef=CalendarYearHSC2_c30fb534, ComIPduSignalRef=HourOfDayHSC2_c30fb534, ComIPduSignalRef=MinuteOfHourHSC2_c30fb534, ComIPduSignalRef=SecsOfMinuteHSC2_c30fb534, ComIPduSignalRef=TimeDspFmtHSC2_c30fb534, ComPduIdRef=PT_GW_HSC2_IPK_FrP06_PP_GW_HSC2_IPK_FrP06_Rx_0fb271d2_c07658fd
        GW_HSC2_SCU_FrP00_oCAN00_3abd61be: ComIPduDirection=RECEIVE, ComIPduGroupRef=P2P_oCAN00_Rx_fcef2243, ComIPduSignalRef=SCUDrvrIntrvnAHSC2_efc2a4db, ComIPduSignalRef=SCUNRCDAvlblHSC2_efc2a4db, ComIPduSignalRef=SCUShifterLvrPosHSC2_efc2a4db, ComIPduSignalRef=SCUShifterPosInvsnHSC2_efc2a4db, ComIPduSignalRef=SCUShifterPosRCHSC2_efc2a4db, ComPduIdRef=PT_GW_HSC2_SCU_FrP00_PP_GW_HSC2_SCU_FrP00_Rx_0fb271d2_c07658fd
        GW_HSC2_SDM_FrP00_oCAN00_3abd61be: ComIPduDirection=RECEIVE, ComIPduGroupRef=P2P_oCAN00_Rx_fcef2243, ComIPduSignalRef=AirbagDplHSC2_2128899b, ComIPduSignalRef=AirbagDplInvsnHSC2_2128899b, ComIPduSignalRef=DrvrSbltAtcHSC2_2128899b, ComIPduSignalRef=DrvrSbltAtcVHSC2_2128899b, ComPduIdRef=PT_GW_HSC2_SDM_FrP00_PP_GW_HSC2_SDM_FrP00_Rx_0fb271d2_c07658fd
        GW_HSC4_BCM_FrP04_oCAN01_3abd61be: ComIPduDirection=RECEIVE, ComIPduGroupRef=P2P_oCAN01_Rx_fcef2243, ComIPduSignalRef=VehLckngStaHSC4_0f57ab67, ComPduIdRef=PT_GW_HSC4_BCM_FrP04_PP_GW_HSC4_BCM_FrP04_Rx_c4eea277_b771686b
        GW_HSC4_BCM_FrS09_oCAN01_3abd61be: ComIPduDirection=RECEIVE, ComIPduGroupRef=P2P_oCAN01_Rx_fcef2243, ComIPduSignalRef=BCMImmoData4HSC4_7f6505b5, ComPduIdRef=PT_GW_HSC4_BCM_FrS09_PP_GW_HSC4_BCM_FrS09_Rx_c4eea277_b771686b
        GW_HSC4_BCM_FrS10_oCAN01_3abd61be: ComIPduDirection=RECEIVE, ComIPduGroupRef=P2P_oCAN01_Rx_fcef2243, ComIPduSignalRef=BCMImmoData5HSC4_77510add, ComPduIdRef=PT_GW_HSC4_BCM_FrS10_PP_GW_HSC4_BCM_FrS10_Rx_c4eea277_b771686b
        GW_HSC4_BMS_FrP07_oCAN01_3abd61be: ComIPduDirection=RECEIVE, ComIPduGroupRef=P2P_oCAN01_Rx_fcef2243, ComIPduSignalRef=BMSBscSta_h1HSC4_c182dd1d, ComPduIdRef=PT_GW_HSC4_BMS_FrP07_PP_GW_HSC4_BMS_FrP07_Rx_c4eea277_b771686b
        GW_HSC4_PEPS_FrP01_oCAN01_3abd61be: ComIPduDirection=RECEIVE, ComIPduGroupRef=P2P_oCAN01_Rx_fcef2243, ComIPduSignalRef=FLDoorHadlSwAHSC4_5c9d774f, ComIPduSignalRef=FRDoorHadlSwAHSC4_5c9d774f, ComIPduSignalRef=PEPSSSBAHSC4_5c9d774f, ComIPduSignalRef=PEPSSSBAVHSC4_5c9d774f, ComPduIdRef=PT_GW_HSC4_PEPS_FrP01_PP_GW_HSC4_PEPS_FrP01_Rx_c4eea277_b771686b
        GW_HSC4_PEPS_FrP02_oCAN01_3abd61be: ComIPduDirection=RECEIVE, ComIPduGroupRef=P2P_oCAN01_Rx_fcef2243, ComIPduSignalRef=PEPSSSBFltStsHSC4_d21270ac, ComPduIdRef=PT_GW_HSC4_PEPS_FrP02_PP_GW_HSC4_PEPS_FrP02_Rx_c4eea277_b771686b
        GW_HSC4_TBOX_FrP01_oCAN01_3abd61be: ComIPduDirection=RECEIVE, ComIPduGroupRef=P2P_oCAN01_Rx_fcef2243, ComIPduSignalRef=P2PSwReqHSC4_8dbecfca, ComPduIdRef=PT_GW_HSC4_TBOX_FrP01_PP_GW_HSC4_TBOX_FrP01_Rx_c4eea277_b771686b
        GW_HSC4_TBOX_FrP05_oCAN01_3abd61be: ComIPduDirection=RECEIVE, ComIPduGroupRef=P2P_oCAN01_Rx_fcef2243, ComIPduSignalRef=P2PExeAvlblHSC4_09f4c130, ComIPduSignalRef=P2PExeAvlblVHSC4_09f4c130, ComIPduSignalRef=TBOXAccelZHSC4_09f4c130, ComIPduSignalRef=TBOXAccelZVHSC4_09f4c130, ComIPduSignalRef=TboxP2PRCHSC4_09f4c130, ComIPduSignalRef=VehBkwdSwReqHSC4_09f4c130, ComIPduSignalRef=VehBkwdSwReqVHSC4_09f4c130, ComIPduSignalRef=VehFwdSwReqHSC4_09f4c130, ComIPduSignalRef=VehFwdSwReqVHSC4_09f4c130, ComIPduSignalRef=VehRoadWhlLReqHSC4_09f4c130, ComIPduSignalRef=VehRoadWhlLReqVHSC4_09f4c130, ComIPduSignalRef=VehRoadWhlRReqHSC4_09f4c130, ComIPduSignalRef=VehRoadWhlRReqVHSC4_09f4c130, ComPduIdRef=PT_GW_HSC4_TBOX_FrP05_PP_GW_HSC4_TBOX_FrP05_Rx_c4eea277_b771686b
        GW_HSC4_TBOX_FrS10_oCAN01_3abd61be: ComIPduDirection=RECEIVE, ComIPduGroupRef=P2P_oCAN01_Rx_fcef2243, ComIPduSignalRef=TBOXToIECUCtrlPotclHSC4_bd586014, ComPduIdRef=PT_GW_HSC4_TBOX_FrS10_PP_GW_HSC4_TBOX_FrS10_Rx_c4eea277_b771686b
        GW_HSC4_TC_FrP01_oCAN01_3abd61be: ComIPduDirection=RECEIVE, ComIPduGroupRef=P2P_oCAN01_Rx_fcef2243, ComIPduSignalRef=TMSpdV_h1HSC4_d68cf0b9, ComIPduSignalRef=TMSpd_h1HSC4_d68cf0b9, ComPduIdRef=PT_GW_HSC4_TC_FrP01_PP_GW_HSC4_TC_FrP01_Rx_c4eea277_b771686b
        IPK_HSC4_FrP06_oCAN01_3abd61be: ComIPduDirection=RECEIVE, ComIPduGroupRef=P2P_oCAN01_Rx_fcef2243, ComIPduSignalRef=CalendarDayHSC4_80f6c9a0, ComIPduSignalRef=CalendarMonthHSC4_80f6c9a0, ComIPduSignalRef=CalendarYearHSC4_80f6c9a0, ComIPduSignalRef=HourOfDayHSC4_80f6c9a0, ComIPduSignalRef=MinuteOfHourHSC4_80f6c9a0, ComIPduSignalRef=SecsOfMinuteHSC4_80f6c9a0, ComIPduSignalRef=TimeDspFmtHSC4_80f6c9a0, ComPduIdRef=PT_IPK_HSC4_FrP06_PP_IPK_HSC4_FrP06_Rx_c4eea277_b771686b
        Init_LRU1_oLIN00_3abd61be: ComIPduDirection=SEND, ComIPduGroupRef=P2P_oLIN00_Tx_fcef2243, ComIPduSignalRef=Sin_Init_LRU1_fdb965bc, ComPduIdRef=PT_Init_LRU1_PP_Init_LRU1_Tx_45618847_8792e7c3
          ComTxIPdu: ComTxIPduUnusedAreasDefault=255
        Init_SRU3_oLIN00_3abd61be: ComIPduDirection=SEND, ComIPduGroupRef=P2P_oLIN00_Tx_fcef2243, ComIPduSignalRef=Sig_Init_SRU3_829252cc, ComPduIdRef=PT_Init_SRU3_PP_Init_SRU3_Tx_45618847_8792e7c3
          ComTxIPdu: ComTxIPduUnusedAreasDefault=255
        P2P_DIAG_DTCInfo_APA_oCAN00_3abd61be: ComIPduDirection=SEND, ComIPduGroupRef=P2P_oCAN00_Tx_fcef2243, ComIPduSignalRef=DTCInfomationAPAHSC2_c3e0343e, ComPduIdRef=PT_P2P_DIAG_DTCInfo_APA_PP_P2P_DIAG_DTCInfo_APA_Tx_0fb271d2_c07658fd
          ComTxIPdu: ComTxIPduUnusedAreasDefault=0
        P2P_HSC2_FrP00_oCAN00_3abd61be: ComIPduDirection=SEND, ComIPduGroupRef=P2P_oCAN00_Tx_fcef2243, ComIPduSignalRef=APAAlvRCHSC2_64ef05b4, ComIPduSignalRef=APAChksmHSC2_64ef05b4, ComIPduSignalRef=APACmdEPSStsHSC2_64ef05b4, ComIPduSignalRef=APAFHSC2_64ef05b4, ComIPduSignalRef=APAToqReqStsHSC2_64ef05b4, ComIPduSignalRef=APAToqReqValHSC2_64ef05b4, ComIPduSignalRef=APATrgtEPSStrgWhlAngHSC2_64ef05b4, ComPduIdRef=PT_P2P_HSC2_FrP00_PP_P2P_HSC2_FrP00_Tx_0fb271d2_c07658fd
          ComTxIPdu: ComTxIPduUnusedAreasDefault=0
            ComTxModeFalse
              ComTxMode: ComTxModeMode=PERIODIC, ComTxModeTimePeriod=0
            ComTxModeTrue
              ComTxMode: ComTxModeMode=PERIODIC, ComTxModeTimePeriod=0
        P2P_HSC2_FrP01_oCAN00_3abd61be: ComIPduDirection=SEND, ComIPduGroupRef=P2P_oCAN00_Tx_fcef2243, ComIPduSignalRef=APACrpSpdReqStsHSC2_a845052a, ComIPduSignalRef=APACrpSpdReqValHSC2_a845052a, ComIPduSignalRef=APAEPBOPReqHSC2_a845052a, ComIPduSignalRef=APAEPBOpReqValPVHSC2_a845052a, ComIPduSignalRef=APAEPBReqAlvRCHSC2_a845052a, ComIPduSignalRef=APAInfoDispReqHSC2_a845052a, ComIPduSignalRef=APAMdHSC2_a845052a, ComIPduSignalRef=APANRCDAvlblHSC2_a845052a, ComIPduSignalRef=APAReqHSC2_a845052a, ComIPduSignalRef=APASCSAcclReqStsHSC2_a845052a, ComIPduSignalRef=APASCSAcclReqValHSC2_a845052a, ComIPduSignalRef=APASCSAcclReqValPVHSC2_a845052a, ComIPduSignalRef=APASCSAlvRCHSC2_a845052a, ComIPduSignalRef=APAShifterPosReqdHSC2_a845052a, ComIPduSignalRef=APAStsHSC2_a845052a, ComPduIdRef=PT_P2P_HSC2_FrP01_PP_P2P_HSC2_FrP01_Tx_0fb271d2_c07658fd
          ComTxIPdu: ComTxIPduUnusedAreasDefault=0
            ComTxModeFalse
              ComTxMode: ComTxModeMode=PERIODIC, ComTxModeTimePeriod=0
            ComTxModeTrue
              ComTxMode: ComTxModeMode=PERIODIC, ComTxModeTimePeriod=0
        P2P_HSC2_FrP02_oCAN00_3abd61be: ComIPduDirection=SEND, ComIPduGroupRef=P2P_oCAN00_Tx_fcef2243, ComIPduSignalRef=APAParkngSchedHSC2_26ca02c9, ComIPduSignalRef=APAParkngSchedVHSC2_26ca02c9, ComIPduSignalRef=APASlotBearngHSC2_26ca02c9, ComIPduSignalRef=APASlotLngthHSC2_26ca02c9, ComIPduSignalRef=APAVehCrdnatAzmthHSC2_26ca02c9, ComIPduSignalRef=APAVehCrdnatPosXHSC2_26ca02c9, ComIPduSignalRef=APAVehCrdnatPosYHSC2_26ca02c9, ComPduIdRef=PT_P2P_HSC2_FrP02_PP_P2P_HSC2_FrP02_Tx_0fb271d2_c07658fd
          ComTxIPdu: ComTxIPduUnusedAreasDefault=0
            ComTxModeFalse
              ComTxMode: ComTxModeMode=PERIODIC, ComTxModeTimePeriod=0
            ComTxModeTrue
              ComTxMode: ComTxModeMode=PERIODIC, ComTxModeTimePeriod=0
        P2P_HSC2_FrP03_oCAN00_3abd61be: ComIPduDirection=SEND, ComIPduGroupRef=P2P_oCAN00_Tx_fcef2243, ComIPduSignalRef=FLObsRngHSC2_ea600257, ComIPduSignalRef=FRObsRngHSC2_ea600257, ComIPduSignalRef=FrtMidLObsRngHSC2_ea600257, ComIPduSignalRef=FrtMidRObsRngHSC2_ea600257, ComIPduSignalRef=FrtObsDistHSC2_ea600257, ComIPduSignalRef=FrtPDCAudWrnngHSC2_ea600257, ComIPduSignalRef=PDCCofignStsHSC2_ea600257, ComIPduSignalRef=PDCSysStsHSC2_ea600257, ComIPduSignalRef=RLObsRngHSC2_ea600257, ComIPduSignalRef=RRObsRngHSC2_ea600257, ComIPduSignalRef=RrMidLObsRngHSC2_ea600257, ComIPduSignalRef=RrMidRObsRngHSC2_ea600257, ComIPduSignalRef=RrObsDistHSC2_ea600257, ComIPduSignalRef=RrPDCAudWrnngHSC2_ea600257, ComPduIdRef=PT_P2P_HSC2_FrP03_PP_P2P_HSC2_FrP03_Tx_0fb271d2_c07658fd
          ComTxIPdu: ComTxIPduUnusedAreasDefault=0
            ComTxModeFalse
              ComTxMode: ComTxModeMode=PERIODIC, ComTxModeTimePeriod=0
            ComTxModeTrue
              ComTxMode: ComTxModeMode=PERIODIC, ComTxModeTimePeriod=0
        P2P_HSC2_FrP04_oCAN00_3abd61be: ComIPduDirection=SEND, ComIPduGroupRef=P2P_oCAN00_Tx_fcef2243, ComIPduSignalRef=FLSideObsDistHSC2_e0a50b4e, ComIPduSignalRef=FRSideObsDistHSC2_e0a50b4e, ComIPduSignalRef=RLSideObsDistHSC2_e0a50b4e, ComIPduSignalRef=RRSideObsDistHSC2_e0a50b4e, ComPduIdRef=PT_P2P_HSC2_FrP04_PP_P2P_HSC2_FrP04_Tx_0fb271d2_c07658fd
          ComTxIPdu: ComTxIPduUnusedAreasDefault=0
            ComTxModeFalse
              ComTxMode: ComTxModeMode=PERIODIC, ComTxModeTimePeriod=0
            ComTxModeTrue
              ComTxMode: ComTxModeMode=PERIODIC, ComTxModeTimePeriod=0
        P2P_HSC2_FrS01_oCAN00_3abd61be: ComIPduDirection=SEND, ComIPduGroupRef=P2P_oCAN00_Tx_fcef2243, ComIPduSignalRef=IECUToBCMRmtCtrlPotclHSC2_4372be29, ComPduIdRef=PT_P2P_HSC2_FrS01_PP_P2P_HSC2_FrS01_Tx_0fb271d2_c07658fd
          ComTxIPdu: ComTxIPduUnusedAreasDefault=0
        P2P_HSC4_FrP03_oCAN01_3abd61be: ComIPduDirection=SEND, ComIPduGroupRef=P2P_oCAN01_Tx_fcef2243, ComIPduSignalRef=P2PACTMdChngTmotHSC4_65a57977, ComIPduSignalRef=P2PDisplayHSC4_65a57977, ComIPduSignalRef=P2PProgressHSC4_65a57977, ComIPduSignalRef=Route1SavePercentageHSC4_65a57977, ComIPduSignalRef=Route1StateHSC4_65a57977, ComIPduSignalRef=Route2SavePercentageHSC4_65a57977, ComIPduSignalRef=Route2StateHSC4_65a57977, ComPduIdRef=PT_P2P_HSC4_FrP03_PP_P2P_HSC4_FrP03_Tx_c4eea277_b771686b
          ComTxIPdu: ComTxIPduUnusedAreasDefault=0
            ComTxModeFalse
              ComTxMode: ComTxModeMode=PERIODIC, ComTxModeTimePeriod=0
            ComTxModeTrue
              ComTxMode: ComTxModeMode=PERIODIC, ComTxModeTimePeriod=0
        P2P_HSC4_FrS01_oCAN01_3abd61be: ComIPduDirection=SEND, ComIPduGroupRef=P2P_oCAN01_Tx_fcef2243, ComIPduSignalRef=IECUToTBOXCtrlPotclHSC4_ccb7c509, ComPduIdRef=PT_P2P_HSC4_FrS01_PP_P2P_HSC4_FrS01_Tx_c4eea277_b771686b
          ComTxIPdu: ComTxIPduUnusedAreasDefault=0
        P2P_IECU_HSC4_FrP01_oCAN01_3abd61be: ComIPduDirection=SEND, ComIPduGroupRef=P2P_oCAN01_Tx_fcef2243, ComIPduSignalRef=HD_AVMCurViewHSC4_4337a868, ComIPduSignalRef=HD_AVMErrorDisplay_h4HSC4_4337a868, ComIPduSignalRef=HD_AVMInfoDisplayHSC4_4337a868, ComIPduSignalRef=HD_AVMVideoFmtStaHSC4_4337a868, ComIPduSignalRef=HD_AVMsysrdyHSC4_4337a868, ComPduIdRef=PT_P2P_IECU_HSC4_FrP01_PP_P2P_IECU_HSC4_FrP01_Tx_c4eea277_b771686b
          ComTxIPdu: ComTxIPduUnusedAreasDefault=0
            ComTxModeFalse
              ComTxMode: ComTxModeMode=PERIODIC, ComTxModeTimePeriod=0
            ComTxModeTrue
              ComTxMode: ComTxModeMode=PERIODIC, ComTxModeTimePeriod=0
        P2P_IECU_HSC4_FrP02_oCAN01_3abd61be: ComIPduDirection=SEND, ComIPduGroupRef=P2P_oCAN01_Tx_fcef2243, ComIPduSignalRef=AutoDrvngSysStsHSC4_cdb8af8b, ComPduIdRef=PT_P2P_IECU_HSC4_FrP02_PP_P2P_IECU_HSC4_FrP02_Tx_c4eea277_b771686b
          ComTxIPdu: ComTxIPduUnusedAreasDefault=0
            ComTxModeFalse
              ComTxMode: ComTxModeMode=PERIODIC, ComTxModeTimePeriod=0
            ComTxModeTrue
              ComTxMode: ComTxModeMode=PERIODIC, ComTxModeTimePeriod=0
        P2P_SecCH_BCM_FrP03_oCAN02_3abd61be: ComIPduDirection=SEND, ComIPduGroupRef=P2P_oCAN02_Tx_fcef2243, ComIPduSignalRef=TrlrHitchSwA_SecCAN2_516d4ee4, ComPduIdRef=PT_P2P_SecCH_BCM_FrP03_PP_P2P_SecCH_BCM_FrP03_Tx_427ad0d9_2e7839d1
          ComTxIPdu: ComTxIPduUnusedAreasDefault=0
            ComTxModeFalse
              ComTxMode: ComTxModeMode=PERIODIC, ComTxModeTimePeriod=0
            ComTxModeTrue
              ComTxMode: ComTxModeMode=PERIODIC, ComTxModeTimePeriod=0
        P2P_SecCH_BCM_FrP04_oCAN02_3abd61be: ComIPduDirection=SEND, ComIPduGroupRef=P2P_oCAN02_Tx_fcef2243, ComIPduSignalRef=BntOpenSts_SecCAN2_5ba847fd, ComIPduSignalRef=DrvrDoorOpenSts_SecCAN2_5ba847fd, ComIPduSignalRef=FrtPsngDoorOpenSts_SecCAN2_5ba847fd, ComIPduSignalRef=LDircnIO_SecCAN2_5ba847fd, ComIPduSignalRef=LdspcOpenSts_SecCAN2_5ba847fd, ComIPduSignalRef=RDircnIO_SecCAN2_5ba847fd, ComIPduSignalRef=RLDoorOpenSts_SecCAN2_5ba847fd, ComIPduSignalRef=RRDoorOpenSts_SecCAN2_5ba847fd, ComPduIdRef=PT_P2P_SecCH_BCM_FrP04_PP_P2P_SecCH_BCM_FrP04_Tx_427ad0d9_2e7839d1
          ComTxIPdu: ComTxIPduUnusedAreasDefault=0
            ComTxModeFalse
              ComTxMode: ComTxModeMode=PERIODIC, ComTxModeTimePeriod=0
            ComTxModeTrue
              ComTxMode: ComTxModeMode=PERIODIC, ComTxModeTimePeriod=0
        P2P_SecCH_BCM_FrP07_oCAN02_3abd61be: ComIPduDirection=SEND, ComIPduGroupRef=P2P_oCAN02_Tx_fcef2243, ComIPduSignalRef=SysBPMEnbd_SecCAN2_d527401e, ComIPduSignalRef=SysBPM_SecCAN2_d527401e, ComPduIdRef=PT_P2P_SecCH_BCM_FrP07_PP_P2P_SecCH_BCM_FrP07_Tx_427ad0d9_2e7839d1
          ComTxIPdu: ComTxIPduUnusedAreasDefault=0
            ComTxModeFalse
              ComTxMode: ComTxModeMode=PERIODIC, ComTxModeTimePeriod=0
            ComTxModeTrue
              ComTxMode: ComTxModeMode=PERIODIC, ComTxModeTimePeriod=0
        P2P_SecCH_ECM_FrP00_oCAN02_3abd61be: ComIPduDirection=SEND, ComIPduGroupRef=P2P_oCAN02_Tx_fcef2243, ComIPduSignalRef=EnRunA_SecCAN2_221bb172, ComPduIdRef=PT_P2P_SecCH_ECM_FrP00_PP_P2P_SecCH_ECM_FrP00_Tx_427ad0d9_2e7839d1
          ComTxIPdu: ComTxIPduUnusedAreasDefault=0
            ComTxModeFalse
              ComTxMode: ComTxModeMode=PERIODIC, ComTxModeTimePeriod=0
            ComTxModeTrue
              ComTxMode: ComTxModeMode=PERIODIC, ComTxModeTimePeriod=0
        P2P_SecCH_EPB_FrP00_oCAN02_3abd61be: ComIPduDirection=SEND, ComIPduGroupRef=P2P_oCAN02_Tx_fcef2243, ComIPduSignalRef=EPBSwStsV_SecCAN2_2190f0b2, ComIPduSignalRef=EPBSwSts_SecCAN2_2190f0b2, ComPduIdRef=PT_P2P_SecCH_EPB_FrP00_PP_P2P_SecCH_EPB_FrP00_Tx_427ad0d9_2e7839d1
          ComTxIPdu: ComTxIPduUnusedAreasDefault=0
            ComTxModeFalse
              ComTxMode: ComTxModeMode=PERIODIC, ComTxModeTimePeriod=0
            ComTxModeTrue
              ComTxMode: ComTxModeMode=PERIODIC, ComTxModeTimePeriod=0
        P2P_SecCH_EPB_FrP01_oCAN02_3abd61be: ComIPduDirection=SEND, ComIPduGroupRef=P2P_oCAN02_Tx_fcef2243, ComIPduSignalRef=EPBAppcnSts_SecCAN2_ed3af02c, ComIPduSignalRef=EPBAvlblyStsPV_SecCAN2_ed3af02c, ComIPduSignalRef=EPBAvlblySts_SecCAN2_ed3af02c, ComPduIdRef=PT_P2P_SecCH_EPB_FrP01_PP_P2P_SecCH_EPB_FrP01_Tx_427ad0d9_2e7839d1
          ComTxIPdu: ComTxIPduUnusedAreasDefault=0
            ComTxModeFalse
              ComTxMode: ComTxModeMode=PERIODIC, ComTxModeTimePeriod=0
            ComTxModeTrue
              ComTxMode: ComTxModeMode=PERIODIC, ComTxModeTimePeriod=0
        P2P_SecCH_EPS_FrP02_oCAN02_3abd61be: ComIPduDirection=SEND, ComIPduGroupRef=P2P_oCAN02_Tx_fcef2243, ComIPduSignalRef=EPSAPAAlvRC_SecCAN2_98082ad5, ComIPduSignalRef=EPSAPAChksm_SecCAN2_98082ad5, ComIPduSignalRef=EPSAPAInh_SecCAN2_98082ad5, ComIPduSignalRef=EPSAPASts_SecCAN2_98082ad5, ComPduIdRef=PT_P2P_SecCH_EPS_FrP02_PP_P2P_SecCH_EPS_FrP02_Tx_427ad0d9_2e7839d1
          ComTxIPdu: ComTxIPduUnusedAreasDefault=0
            ComTxModeFalse
              ComTxMode: ComTxModeMode=PERIODIC, ComTxModeTimePeriod=0
            ComTxModeTrue
              ComTxMode: ComTxModeMode=PERIODIC, ComTxModeTimePeriod=0
        P2P_SecCH_FICM_FrP02_oCAN02_3abd61be: ComIPduDirection=SEND, ComIPduGroupRef=P2P_oCAN02_Tx_fcef2243, ComIPduSignalRef=RstrFctryDeftsReq_SecCAN2_9fc99604, ComPduIdRef=PT_P2P_SecCH_FICM_FrP02_PP_P2P_SecCH_FICM_FrP02_Tx_427ad0d9_2e7839d1
          ComTxIPdu: ComTxIPduUnusedAreasDefault=0
            ComTxModeFalse
              ComTxMode: ComTxModeMode=PERIODIC, ComTxModeTimePeriod=0
            ComTxModeTrue
              ComTxMode: ComTxModeMode=PERIODIC, ComTxModeTimePeriod=0
        P2P_SecCH_FICM_FrP08_oCAN02_3abd61be: ComIPduDirection=SEND, ComIPduGroupRef=P2P_oCAN02_Tx_fcef2243, ComIPduSignalRef=APASwReq_SecCAN2_0e098acc, ComIPduSignalRef=PDCSwReq_SecCAN2_0e098acc, ComPduIdRef=PT_P2P_SecCH_FICM_FrP08_PP_P2P_SecCH_FICM_FrP08_Tx_427ad0d9_2e7839d1
          ComTxIPdu: ComTxIPduUnusedAreasDefault=0
            ComTxModeFalse
              ComTxMode: ComTxModeMode=PERIODIC, ComTxModeTimePeriod=0
            ComTxModeTrue
              ComTxMode: ComTxModeMode=PERIODIC, ComTxModeTimePeriod=0
        P2P_SecCH_FICM_FrP18_oCAN02_3abd61be: ComIPduDirection=SEND, ComIPduGroupRef=P2P_oCAN02_Tx_fcef2243, ComIPduSignalRef=DrvrSelAPAParkngMd_SecCAN2_19729e8f, ComIPduSignalRef=DrvrSelAPASlotBearng_SecCAN2_19729e8f, ComPduIdRef=PT_P2P_SecCH_FICM_FrP18_PP_P2P_SecCH_FICM_FrP18_Tx_427ad0d9_2e7839d1
          ComTxIPdu: ComTxIPduUnusedAreasDefault=0
            ComTxModeFalse
              ComTxMode: ComTxModeMode=PERIODIC, ComTxModeTimePeriod=0
            ComTxModeTrue
              ComTxMode: ComTxModeMode=PERIODIC, ComTxModeTimePeriod=0
        P2P_SecCH_GW_FrP00_oCAN02_3abd61be: ComIPduDirection=SEND, ComIPduGroupRef=P2P_oCAN02_Tx_fcef2243, ComIPduSignalRef=BCMAvlbly_h2_SecCAN2_88955429, ComIPduSignalRef=ECMAvlbly_h2_SecCAN2_88955429, ComIPduSignalRef=FICMAvlbly_h2_SecCAN2_88955429, ComIPduSignalRef=HCUAvlbly_h2_SecCAN2_88955429, ComIPduSignalRef=IPCAvlbly_h2_SecCAN2_88955429, ComIPduSignalRef=SCUAvlbly_h2_SecCAN2_88955429, ComIPduSignalRef=SDMAvlbly_h2_SecCAN2_88955429, ComIPduSignalRef=TCAvlbly_h2_SecCAN2_88955429, ComPduIdRef=PT_P2P_SecCH_GW_FrP00_PP_P2P_SecCH_GW_FrP00_Tx_427ad0d9_2e7839d1
          ComTxIPdu: ComTxIPduUnusedAreasDefault=0
            ComTxModeFalse
              ComTxMode: ComTxModeMode=PERIODIC, ComTxModeTimePeriod=0
            ComTxModeTrue
              ComTxMode: ComTxModeMode=PERIODIC, ComTxModeTimePeriod=0
        P2P_SecCH_GW_FrP01_oCAN02_3abd61be: ComIPduDirection=SEND, ComIPduGroupRef=P2P_oCAN02_Tx_fcef2243, ComIPduSignalRef=BPMMstrAvlbly_h2_SecCAN2_443f54b7, ComIPduSignalRef=PwrMdMstrAccryA_h2_SecCAN2_443f54b7, ComIPduSignalRef=PwrMdMstrRunCrkA_h2_SecCAN2_443f54b7, ComIPduSignalRef=SysOpnlMd_h2_SecCAN2_443f54b7, ComIPduSignalRef=SysPwrMd_h2_SecCAN2_443f54b7, ComIPduSignalRef=SysVolMdV_h2_SecCAN2_443f54b7, ComIPduSignalRef=SysVolMd_h2_SecCAN2_443f54b7, ComIPduSignalRef=SysVolV_h2_SecCAN2_443f54b7, ComIPduSignalRef=SysVol_h2_SecCAN2_443f54b7, ComPduIdRef=PT_P2P_SecCH_GW_FrP01_PP_P2P_SecCH_GW_FrP01_Tx_427ad0d9_2e7839d1
          ComTxIPdu: ComTxIPduUnusedAreasDefault=0
            ComTxModeFalse
              ComTxMode: ComTxModeMode=PERIODIC, ComTxModeTimePeriod=0
            ComTxModeTrue
              ComTxMode: ComTxModeMode=PERIODIC, ComTxModeTimePeriod=0
        P2P_SecCH_GW_FrP08_oCAN02_3abd61be: ComIPduDirection=SEND, ComIPduGroupRef=P2P_oCAN02_Tx_fcef2243, ComIPduSignalRef=VehOdoV_h2_SecCAN2_5b704f9c, ComIPduSignalRef=VehOdo_h2_SecCAN2_5b704f9c, ComPduIdRef=PT_P2P_SecCH_GW_FrP08_PP_P2P_SecCH_GW_FrP08_Tx_427ad0d9_2e7839d1
          ComTxIPdu: ComTxIPduUnusedAreasDefault=0
            ComTxModeFalse
              ComTxMode: ComTxModeMode=PERIODIC, ComTxModeTimePeriod=0
            ComTxModeTrue
              ComTxMode: ComTxModeMode=PERIODIC, ComTxModeTimePeriod=0
        P2P_SecCH_GW_FrP10_oCAN02_3abd61be: ComIPduDirection=SEND, ComIPduGroupRef=P2P_oCAN02_Tx_fcef2243, ComIPduSignalRef=OtsdAirTemCrValMsk_h2_SecCAN2_9fee406a, ComIPduSignalRef=OtsdAirTemCrValV_h2_SecCAN2_9fee406a, ComIPduSignalRef=OtsdAirTemCrVal_h2_SecCAN2_9fee406a, ComPduIdRef=PT_P2P_SecCH_GW_FrP10_PP_P2P_SecCH_GW_FrP10_Tx_427ad0d9_2e7839d1
          ComTxIPdu: ComTxIPduUnusedAreasDefault=0
            ComTxModeFalse
              ComTxMode: ComTxModeMode=PERIODIC, ComTxModeTimePeriod=0
            ComTxModeTrue
              ComTxMode: ComTxModeMode=PERIODIC, ComTxModeTimePeriod=0
        P2P_SecCH_GW_FrP13_oCAN02_3abd61be: ComIPduDirection=SEND, ComIPduGroupRef=P2P_oCAN02_Tx_fcef2243, ComIPduSignalRef=APACtrlAbotdRsn_SecCAN2_11614789, ComIPduSignalRef=NRCDSts_h2_SecCAN2_11614789, ComPduIdRef=PT_P2P_SecCH_GW_FrP13_PP_P2P_SecCH_GW_FrP13_Tx_427ad0d9_2e7839d1
          ComTxIPdu: ComTxIPduUnusedAreasDefault=0
            ComTxModeFalse
              ComTxMode: ComTxModeMode=PERIODIC, ComTxModeTimePeriod=0
            ComTxModeTrue
              ComTxMode: ComTxModeMode=PERIODIC, ComTxModeTimePeriod=0
        P2P_SecCH_GW_FrS00_oCAN02_3abd61be: ComIPduDirection=SEND, ComIPduGroupRef=P2P_oCAN02_Tx_fcef2243, ComIPduSignalRef=NRCDMstrChlg_h2_SecCAN2_63a2ef2a, ComPduIdRef=PT_P2P_SecCH_GW_FrS00_PP_P2P_SecCH_GW_FrS00_Tx_427ad0d9_2e7839d1
          ComTxIPdu: ComTxIPduUnusedAreasDefault=0
        P2P_SecCH_HCU_ECM_FrP04_oCAN02_3abd61be: ComIPduDirection=SEND, ComIPduGroupRef=P2P_oCAN02_Tx_fcef2243, ComIPduSignalRef=TrShftLvrPosV_h1_SecCAN2_f7a3932f, ComIPduSignalRef=TrShftLvrPos_h1_SecCAN2_f7a3932f, ComPduIdRef=PT_P2P_SecCH_HCU_ECM_FrP04_PP_P2P_SecCH_HCU_ECM_FrP04_Tx_427ad0d9_2e7839d1
          ComTxIPdu: ComTxIPduUnusedAreasDefault=0
            ComTxModeFalse
              ComTxMode: ComTxModeMode=PERIODIC, ComTxModeTimePeriod=0
            ComTxModeTrue
              ComTxMode: ComTxModeMode=PERIODIC, ComTxModeTimePeriod=0
        P2P_SecCH_HCU_FrP00_oCAN02_3abd61be: ComIPduDirection=SEND, ComIPduGroupRef=P2P_oCAN02_Tx_fcef2243, ComIPduSignalRef=EPTAccelActuPosV_SecCAN2_7ebad171, ComIPduSignalRef=EPTAccelActuPos_SecCAN2_7ebad171, ComIPduSignalRef=EPTBrkPdlDscrtInptStsV_SecCAN2_7ebad171, ComIPduSignalRef=EPTBrkPdlDscrtInptSts_SecCAN2_7ebad171, ComIPduSignalRef=EPTStCmdOn_h1_SecCAN2_7ebad171, ComPduIdRef=PT_P2P_SecCH_HCU_FrP00_PP_P2P_SecCH_HCU_FrP00_Tx_427ad0d9_2e7839d1
          ComTxIPdu: ComTxIPduUnusedAreasDefault=0
            ComTxModeFalse
              ComTxMode: ComTxModeMode=PERIODIC, ComTxModeTimePeriod=0
            ComTxModeTrue
              ComTxMode: ComTxModeMode=PERIODIC, ComTxModeTimePeriod=0
        P2P_SecCH_HCU_FrP01_oCAN02_3abd61be: ComIPduDirection=SEND, ComIPduGroupRef=P2P_oCAN02_Tx_fcef2243, ComIPduSignalRef=EPTRdy_h1_SecCAN2_b210d1ef, ComPduIdRef=PT_P2P_SecCH_HCU_FrP01_PP_P2P_SecCH_HCU_FrP01_Tx_427ad0d9_2e7839d1
          ComTxIPdu: ComTxIPduUnusedAreasDefault=0
            ComTxModeFalse
              ComTxMode: ComTxModeMode=PERIODIC, ComTxModeTimePeriod=0
            ComTxModeTrue
              ComTxMode: ComTxModeMode=PERIODIC, ComTxModeTimePeriod=0
        P2P_SecCH_HCU_FrP13_oCAN02_3abd61be: ComIPduDirection=SEND, ComIPduGroupRef=P2P_oCAN02_Tx_fcef2243, ComIPduSignalRef=VCUAccReqSts_SecCAN2_e74ec2d1, ComIPduSignalRef=VCUAccReqVal_SecCAN2_e74ec2d1, ComIPduSignalRef=VCUNRCDAvlbl_SecCAN2_e74ec2d1, ComPduIdRef=PT_P2P_SecCH_HCU_FrP13_PP_P2P_SecCH_HCU_FrP13_Tx_427ad0d9_2e7839d1
          ComTxIPdu: ComTxIPduUnusedAreasDefault=0
            ComTxModeFalse
              ComTxMode: ComTxModeMode=PERIODIC, ComTxModeTimePeriod=0
            ComTxModeTrue
              ComTxMode: ComTxModeMode=PERIODIC, ComTxModeTimePeriod=0
        P2P_SecCH_IPK_FrP06_oCAN02_3abd61be: ComIPduDirection=SEND, ComIPduGroupRef=P2P_oCAN02_Tx_fcef2243, ComIPduSignalRef=CalendarDay_SecCAN2_ee8bd5bd, ComIPduSignalRef=CalendarMonth_SecCAN2_ee8bd5bd, ComIPduSignalRef=CalendarYear_SecCAN2_ee8bd5bd, ComIPduSignalRef=HourOfDay_SecCAN2_ee8bd5bd, ComIPduSignalRef=MinuteOfHour_SecCAN2_ee8bd5bd, ComIPduSignalRef=SecsOfMinute_SecCAN2_ee8bd5bd, ComIPduSignalRef=TimeDspFmt_SecCAN2_ee8bd5bd, ComPduIdRef=PT_P2P_SecCH_IPK_FrP06_PP_P2P_SecCH_IPK_FrP06_Tx_427ad0d9_2e7839d1
          ComTxIPdu: ComTxIPduUnusedAreasDefault=0
            ComTxModeFalse
              ComTxMode: ComTxModeMode=PERIODIC, ComTxModeTimePeriod=0
            ComTxModeTrue
              ComTxMode: ComTxModeMode=PERIODIC, ComTxModeTimePeriod=0
        P2P_SecCH_SAS_FrP00_oCAN02_3abd61be: ComIPduDirection=SEND, ComIPduGroupRef=P2P_oCAN02_Tx_fcef2243, ComIPduSignalRef=StrgWhlAngV_SecCAN2_92023e75, ComIPduSignalRef=StrgWhlAng_SecCAN2_92023e75, ComPduIdRef=PT_P2P_SecCH_SAS_FrP00_PP_P2P_SecCH_SAS_FrP00_Tx_427ad0d9_2e7839d1
          ComTxIPdu: ComTxIPduUnusedAreasDefault=0
            ComTxModeFalse
              ComTxMode: ComTxModeMode=PERIODIC, ComTxModeTimePeriod=0
            ComTxModeTrue
              ComTxMode: ComTxModeMode=PERIODIC, ComTxModeTimePeriod=0
        P2P_SecCH_SCS_FrP00_oCAN02_3abd61be: ComIPduDirection=SEND, ComIPduGroupRef=P2P_oCAN02_Tx_fcef2243, ComIPduSignalRef=LDrvnWhlRotlDistPlsCtr_SecCAN2_3a848fe4, ComIPduSignalRef=LDrvnWhlRotlDistTRC_SecCAN2_3a848fe4, ComIPduSignalRef=LDrvnWhlRotlDistTmsp_SecCAN2_3a848fe4, ComIPduSignalRef=LDrvnWhlRotlDistV_SecCAN2_3a848fe4, ComIPduSignalRef=LDrvnWhlRotlRstOcd_SecCAN2_3a848fe4, ComIPduSignalRef=LDrvnWhlRotlSeqNum_SecCAN2_3a848fe4, ComIPduSignalRef=RDrvnWhlRotlDistPlsCtr_SecCAN2_3a848fe4, ComIPduSignalRef=RDrvnWhlRotlDistTRC_SecCAN2_3a848fe4, ComIPduSignalRef=RDrvnWhlRotlDistTmsp_SecCAN2_3a848fe4, ComIPduSignalRef=RDrvnWhlRotlDistV_SecCAN2_3a848fe4, ComIPduSignalRef=RDrvnWhlRotlRstOcd_SecCAN2_3a848fe4, ComIPduSignalRef=RDrvnWhlRotlSeqNum_SecCAN2_3a848fe4, ComPduIdRef=PT_P2P_SecCH_SCS_FrP00_PP_P2P_SecCH_SCS_FrP00_Tx_427ad0d9_2e7839d1
          ComTxIPdu: ComTxIPduUnusedAreasDefault=0
            ComTxModeFalse
              ComTxMode: ComTxModeMode=PERIODIC, ComTxModeTimePeriod=0
            ComTxModeTrue
              ComTxMode: ComTxModeMode=PERIODIC, ComTxModeTimePeriod=0
        P2P_SecCH_SCS_FrP01_oCAN02_3abd61be: ComIPduDirection=SEND, ComIPduGroupRef=P2P_oCAN02_Tx_fcef2243, ComIPduSignalRef=LNonDrvnWhlRotlDistPC_SecCAN2_f62e8f7a, ComIPduSignalRef=LNonDrvnWhlRotlDistTRC_SecCAN2_f62e8f7a, ComIPduSignalRef=LNonDrvnWhlRotlDistT_SecCAN2_f62e8f7a, ComIPduSignalRef=LNonDrvnWhlRotlDistV_SecCAN2_f62e8f7a, ComIPduSignalRef=LNonDrvnWhlRotlRstOcd_SecCAN2_f62e8f7a, ComIPduSignalRef=LNonDrvnWhlRotlSeqNum_SecCAN2_f62e8f7a, ComIPduSignalRef=RNonDrvnWhlRotlDistPC_SecCAN2_f62e8f7a, ComIPduSignalRef=RNonDrvnWhlRotlDistTRC_SecCAN2_f62e8f7a, ComIPduSignalRef=RNonDrvnWhlRotlDistT_SecCAN2_f62e8f7a, ComIPduSignalRef=RNonDrvnWhlRotlDistV_SecCAN2_f62e8f7a, ComIPduSignalRef=RNonDrvnWhlRotlRstOcd_SecCAN2_f62e8f7a, ComIPduSignalRef=RNonDrvnWhlRotlSeqNum_SecCAN2_f62e8f7a, ComPduIdRef=PT_P2P_SecCH_SCS_FrP01_PP_P2P_SecCH_SCS_FrP01_Tx_427ad0d9_2e7839d1
          ComTxIPdu: ComTxIPduUnusedAreasDefault=0
            ComTxModeFalse
              ComTxMode: ComTxModeMode=PERIODIC, ComTxModeTimePeriod=0
            ComTxModeTrue
              ComTxMode: ComTxModeMode=PERIODIC, ComTxModeTimePeriod=0
        P2P_SecCH_SCS_FrP02_oCAN02_3abd61be: ComIPduDirection=SEND, ComIPduGroupRef=P2P_oCAN02_Tx_fcef2243, ComIPduSignalRef=VSELatAccV_SecCAN2_78a18899, ComIPduSignalRef=VSELatAcc_SecCAN2_78a18899, ComIPduSignalRef=VSELongtAccV_SecCAN2_78a18899, ComIPduSignalRef=VSELongtAcc_SecCAN2_78a18899, ComPduIdRef=PT_P2P_SecCH_SCS_FrP02_PP_P2P_SecCH_SCS_FrP02_Tx_427ad0d9_2e7839d1
          ComTxIPdu: ComTxIPduUnusedAreasDefault=0
            ComTxModeFalse
              ComTxMode: ComTxModeMode=PERIODIC, ComTxModeTimePeriod=0
            ComTxModeTrue
              ComTxMode: ComTxModeMode=PERIODIC, ComTxModeTimePeriod=0
        P2P_SecCH_SCS_FrP03_oCAN02_3abd61be: ComIPduDirection=SEND, ComIPduGroupRef=P2P_oCAN02_Tx_fcef2243, ComIPduSignalRef=LNonDrvnWhlRotlDircn_SecCAN2_b40b8807, ComIPduSignalRef=RNonDrvnWhlRotlDircn_SecCAN2_b40b8807, ComIPduSignalRef=SCSAPAAcclA_SecCAN2_b40b8807, ComIPduSignalRef=SCSAPAAlvRC_SecCAN2_b40b8807, ComIPduSignalRef=SCSAPAAvlbl_SecCAN2_b40b8807, ComIPduSignalRef=SCSNRCDAvlbl_SecCAN2_b40b8807, ComPduIdRef=PT_P2P_SecCH_SCS_FrP03_PP_P2P_SecCH_SCS_FrP03_Tx_427ad0d9_2e7839d1
          ComTxIPdu: ComTxIPduUnusedAreasDefault=0
            ComTxModeFalse
              ComTxMode: ComTxModeMode=PERIODIC, ComTxModeTimePeriod=0
            ComTxModeTrue
              ComTxMode: ComTxModeMode=PERIODIC, ComTxModeTimePeriod=0
        P2P_SecCH_SCS_FrP05_oCAN02_3abd61be: ComIPduDirection=SEND, ComIPduGroupRef=P2P_oCAN02_Tx_fcef2243, ComIPduSignalRef=ABSA_SecCAN2_72648180, ComIPduSignalRef=TCSA_SecCAN2_72648180, ComIPduSignalRef=VSESysA_SecCAN2_72648180, ComIPduSignalRef=VehDynYawRateV_SecCAN2_72648180, ComIPduSignalRef=VehDynYawRate_SecCAN2_72648180, ComPduIdRef=PT_P2P_SecCH_SCS_FrP05_PP_P2P_SecCH_SCS_FrP05_Tx_427ad0d9_2e7839d1
          ComTxIPdu: ComTxIPduUnusedAreasDefault=0
            ComTxModeFalse
              ComTxMode: ComTxModeMode=PERIODIC, ComTxModeTimePeriod=0
            ComTxModeTrue
              ComTxMode: ComTxModeMode=PERIODIC, ComTxModeTimePeriod=0
        P2P_SecCH_SCS_FrP11_oCAN02_3abd61be: ComIPduDirection=SEND, ComIPduGroupRef=P2P_oCAN02_Tx_fcef2243, ComIPduSignalRef=WhlGndVelLDrvnV_SecCAN2_e1559b39, ComIPduSignalRef=WhlGndVelLDrvn_SecCAN2_e1559b39, ComIPduSignalRef=WhlGndVelRDrvnV_SecCAN2_e1559b39, ComIPduSignalRef=WhlGndVelRDrvn_SecCAN2_e1559b39, ComPduIdRef=PT_P2P_SecCH_SCS_FrP11_PP_P2P_SecCH_SCS_FrP11_Tx_427ad0d9_2e7839d1
          ComTxIPdu: ComTxIPduUnusedAreasDefault=0
            ComTxModeFalse
              ComTxMode: ComTxModeMode=PERIODIC, ComTxModeTimePeriod=0
            ComTxModeTrue
              ComTxMode: ComTxModeMode=PERIODIC, ComTxModeTimePeriod=0
        P2P_SecCH_SCS_FrP12_oCAN02_3abd61be: ComIPduDirection=SEND, ComIPduGroupRef=P2P_oCAN02_Tx_fcef2243, ComIPduSignalRef=WhlGndVelLNonDrvnV_SecCAN2_6fda9cda, ComIPduSignalRef=WhlGndVelLNonDrvn_SecCAN2_6fda9cda, ComIPduSignalRef=WhlGndVelRNonDrvnV_SecCAN2_6fda9cda, ComIPduSignalRef=WhlGndVelRNonDrvn_SecCAN2_6fda9cda, ComPduIdRef=PT_P2P_SecCH_SCS_FrP12_PP_P2P_SecCH_SCS_FrP12_Tx_427ad0d9_2e7839d1
          ComTxIPdu: ComTxIPduUnusedAreasDefault=0
            ComTxModeFalse
              ComTxMode: ComTxModeMode=PERIODIC, ComTxModeTimePeriod=0
            ComTxModeTrue
              ComTxMode: ComTxModeMode=PERIODIC, ComTxModeTimePeriod=0
        P2P_SecCH_SCS_FrP15_oCAN02_3abd61be: ComIPduDirection=SEND, ComIPduGroupRef=P2P_oCAN02_Tx_fcef2243, ComIPduSignalRef=DistRCAvgDrvnRstOcd_SecCAN2_651f95c3, ComIPduSignalRef=DistRCAvgDrvnSrc_SecCAN2_651f95c3, ComIPduSignalRef=DistRCAvgDrvnV_SecCAN2_651f95c3, ComIPduSignalRef=DistRCAvgDrvn_SecCAN2_651f95c3, ComIPduSignalRef=VehSpdAvgDrvnV_SecCAN2_651f95c3, ComIPduSignalRef=VehSpdAvgDrvn_SecCAN2_651f95c3, ComIPduSignalRef=VehSpdAvgNonDrvnV_SecCAN2_651f95c3, ComIPduSignalRef=VehSpdAvgNonDrvn_SecCAN2_651f95c3, ComPduIdRef=PT_P2P_SecCH_SCS_FrP15_PP_P2P_SecCH_SCS_FrP15_Tx_427ad0d9_2e7839d1
          ComTxIPdu: ComTxIPduUnusedAreasDefault=0
            ComTxModeFalse
              ComTxMode: ComTxModeMode=PERIODIC, ComTxModeTimePeriod=0
            ComTxModeTrue
              ComTxMode: ComTxModeMode=PERIODIC, ComTxModeTimePeriod=0
        P2P_SecCH_SCU_FrP00_oCAN02_3abd61be: ComIPduDirection=SEND, ComIPduGroupRef=P2P_oCAN02_Tx_fcef2243, ComIPduSignalRef=SCUDrvrIntrvnA_SecCAN2_c246c452, ComIPduSignalRef=SCUNRCDAvlbl_SecCAN2_c246c452, ComPduIdRef=PT_P2P_SecCH_SCU_FrP00_PP_P2P_SecCH_SCU_FrP00_Tx_427ad0d9_2e7839d1
          ComTxIPdu: ComTxIPduUnusedAreasDefault=0
            ComTxModeFalse
              ComTxMode: ComTxModeMode=PERIODIC, ComTxModeTimePeriod=0
            ComTxModeTrue
              ComTxMode: ComTxModeMode=PERIODIC, ComTxModeTimePeriod=0
        P2P_SecCH_SDM_FrP00_oCAN02_3abd61be: ComIPduDirection=SEND, ComIPduGroupRef=P2P_oCAN02_Tx_fcef2243, ComIPduSignalRef=DrvrSbltAtcV_SecCAN2_0cace912, ComIPduSignalRef=DrvrSbltAtc_SecCAN2_0cace912, ComPduIdRef=PT_P2P_SecCH_SDM_FrP00_PP_P2P_SecCH_SDM_FrP00_Tx_427ad0d9_2e7839d1
          ComTxIPdu: ComTxIPduUnusedAreasDefault=0
            ComTxModeFalse
              ComTxMode: ComTxModeMode=PERIODIC, ComTxModeTimePeriod=0
            ComTxModeTrue
              ComTxMode: ComTxModeMode=PERIODIC, ComTxModeTimePeriod=0
        P2P_SecCH_TC_FrP07_oCAN02_3abd61be: ComIPduDirection=SEND, ComIPduGroupRef=P2P_oCAN02_Tx_fcef2243, ComIPduSignalRef=TMSpdV_h1_SecCAN2_a8511b71, ComIPduSignalRef=TMSpd_h1_SecCAN2_a8511b71, ComPduIdRef=PT_P2P_SecCH_TC_FrP07_PP_P2P_SecCH_TC_FrP07_Tx_427ad0d9_2e7839d1
          ComTxIPdu: ComTxIPduUnusedAreasDefault=0
            ComTxModeFalse
              ComTxMode: ComTxModeMode=PERIODIC, ComTxModeTimePeriod=0
            ComTxModeTrue
              ComTxMode: ComTxModeMode=PERIODIC, ComTxModeTimePeriod=0
        P2P_SecCH_Tester_GW_FrP14_oCAN02_3abd61be: ComIPduDirection=SEND, ComIPduGroupRef=P2P_oCAN02_Tx_fcef2243, ComIPduSignalRef=NRCDAlvRC_SecCAN2_d64f184b, ComIPduSignalRef=NRCDF_SecCAN2_d64f184b, ComPduIdRef=PT_P2P_SecCH_Tester_GW_FrP14_PP_P2P_SecCH_Tester_GW_FrP14_Tx_427ad0d9_2e7839d1
          ComTxIPdu: ComTxIPduUnusedAreasDefault=0
            ComTxModeFalse
              ComTxMode: ComTxModeMode=PERIODIC, ComTxModeTimePeriod=0
            ComTxModeTrue
              ComTxMode: ComTxModeMode=PERIODIC, ComTxModeTimePeriod=0
        PDC_SecCH_FrP00_oCAN02_3abd61be: ComIPduDirection=RECEIVE, ComIPduGroupRef=P2P_oCAN02_Rx_fcef2243, ComIPduSignalRef=FLObsRng_sech2_SecCAN2_27d72756, ComIPduSignalRef=FRObsRng_sech2_SecCAN2_27d72756, ComIPduSignalRef=FrtMidLObsRng_sech2_SecCAN2_27d72756, ComIPduSignalRef=FrtMidRObsRng_sech2_SecCAN2_27d72756, ComIPduSignalRef=FrtObsDist_sech2_SecCAN2_27d72756, ComIPduSignalRef=FrtPDCAudWrnng_sech2_SecCAN2_27d72756, ComIPduSignalRef=PDCCofignSts_sech2_SecCAN2_27d72756, ComIPduSignalRef=PDCSysSts_sech2_SecCAN2_27d72756, ComIPduSignalRef=RLObsRng_sech2_SecCAN2_27d72756, ComIPduSignalRef=RRObsRng_sech2_SecCAN2_27d72756, ComIPduSignalRef=RrMidLObsRng_sech2_SecCAN2_27d72756, ComIPduSignalRef=RrMidRObsRng_sech2_SecCAN2_27d72756, ComIPduSignalRef=RrObsDist_sech2_SecCAN2_27d72756, ComIPduSignalRef=RrPDCAudWrnng_sech2_SecCAN2_27d72756, ComPduIdRef=PT_PDC_SecCH_FrP00_PP_PDC_SecCH_FrP00_Rx_427ad0d9_2e7839d1
        PDC_SecCH_FrP01_oCAN02_3abd61be: ComIPduDirection=RECEIVE, ComIPduGroupRef=P2P_oCAN02_Rx_fcef2243, ComIPduSignalRef=FLSideObsDist_sech2_SecCAN2_eb7d27c8, ComIPduSignalRef=FRSideObsDist_sech2_SecCAN2_eb7d27c8, ComIPduSignalRef=RLSideObsDist_sech2_SecCAN2_eb7d27c8, ComIPduSignalRef=RRSideObsDist_sech2_SecCAN2_eb7d27c8, ComPduIdRef=PT_PDC_SecCH_FrP01_PP_PDC_SecCH_FrP01_Rx_427ad0d9_2e7839d1
        RDA_HSC4_P02_oCAN01_3abd61be: ComIPduDirection=RECEIVE, ComIPduGroupRef=P2P_oCAN01_Rx_fcef2243, ComIPduSignalRef=LRCTAWrnngHSC4_693ba2af, ComIPduSignalRef=RRCTAWrnngHSC4_693ba2af, ComPduIdRef=PT_RDA_HSC4_P02_PP_RDA_HSC4_P02_Rx_c4eea277_b771686b
        Read_LRU1_oLIN00_3abd61be: ComIPduDirection=RECEIVE, ComIPduGroupRef=P2P_oLIN00_Rx_fcef2243, ComIPduSignalRef=Peak_LRU1_18ef6e8d, ComIPduSignalRef=Status_LRU1_18ef6e8d, ComIPduSignalRef=TOF_LRU1_18ef6e8d, ComIPduSignalRef=Width_LRU1_18ef6e8d, ComPduIdRef=PT_Read_LRU1_PP_Read_LRU1_Rx_45618847_8792e7c3
        Read_SRU3_oLIN00_3abd61be: ComIPduDirection=RECEIVE, ComIPduGroupRef=P2P_oLIN00_Rx_fcef2243, ComIPduSignalRef=Status_SRU3_67c459fd, ComIPduSignalRef=TOF_SRU3_67c459fd, ComPduIdRef=PT_Read_SRU3_PP_Read_SRU3_Rx_45618847_8792e7c3
        SAS_HSC2_FrP00_oCAN00_3abd61be: ComIPduDirection=RECEIVE, ComIPduGroupRef=P2P_oCAN00_Rx_fcef2243, ComIPduSignalRef=StrgWhlAngHSC2_dccc170c, ComIPduSignalRef=StrgWhlAngVHSC2_dccc170c, ComPduIdRef=PT_SAS_HSC2_FrP00_PP_SAS_HSC2_FrP00_Rx_0fb271d2_c07658fd
        SCS_HSC2_FrP00_oCAN00_3abd61be: ComIPduDirection=RECEIVE, ComIPduGroupRef=P2P_oCAN00_Rx_fcef2243, ComIPduSignalRef=LDrvnWhlRotlDistPlsCtrHSC2_16026180, ComIPduSignalRef=LDrvnWhlRotlDistTRCHSC2_16026180, ComIPduSignalRef=LDrvnWhlRotlDistTmspHSC2_16026180, ComIPduSignalRef=LDrvnWhlRotlDistVHSC2_16026180, ComIPduSignalRef=LDrvnWhlRotlRstOcdHSC2_16026180, ComIPduSignalRef=LDrvnWhlRotlSeqNumHSC2_16026180, ComIPduSignalRef=RDrvnWhlRotlDistPlsCtrHSC2_16026180, ComIPduSignalRef=RDrvnWhlRotlDistTRCHSC2_16026180, ComIPduSignalRef=RDrvnWhlRotlDistTmspHSC2_16026180, ComIPduSignalRef=RDrvnWhlRotlDistVHSC2_16026180, ComIPduSignalRef=RDrvnWhlRotlRstOcdHSC2_16026180, ComIPduSignalRef=RDrvnWhlRotlSeqNumHSC2_16026180, ComPduIdRef=PT_SCS_HSC2_FrP00_PP_SCS_HSC2_FrP00_Rx_0fb271d2_c07658fd
        SCS_HSC2_FrP01_oCAN00_3abd61be: ComIPduDirection=RECEIVE, ComIPduGroupRef=P2P_oCAN00_Rx_fcef2243, ComIPduSignalRef=LNonDrvnWhlRotlDistPCHSC2_daa8611e, ComIPduSignalRef=LNonDrvnWhlRotlDistTHSC2_daa8611e, ComIPduSignalRef=LNonDrvnWhlRotlDistTRCHSC2_daa8611e, ComIPduSignalRef=LNonDrvnWhlRotlDistVHSC2_daa8611e, ComIPduSignalRef=LNonDrvnWhlRotlRstOcdHSC2_daa8611e, ComIPduSignalRef=LNonDrvnWhlRotlSeqNumHSC2_daa8611e, ComIPduSignalRef=RNonDrvnWhlRotlDistPCHSC2_daa8611e, ComIPduSignalRef=RNonDrvnWhlRotlDistTHSC2_daa8611e, ComIPduSignalRef=RNonDrvnWhlRotlDistTRCHSC2_daa8611e, ComIPduSignalRef=RNonDrvnWhlRotlDistVHSC2_daa8611e, ComIPduSignalRef=RNonDrvnWhlRotlRstOcdHSC2_daa8611e, ComIPduSignalRef=RNonDrvnWhlRotlSeqNumHSC2_daa8611e, ComPduIdRef=PT_SCS_HSC2_FrP01_PP_SCS_HSC2_FrP01_Rx_0fb271d2_c07658fd
        SCS_HSC2_FrP02_oCAN00_3abd61be: ComIPduDirection=RECEIVE, ComIPduGroupRef=P2P_oCAN00_Rx_fcef2243, ComIPduSignalRef=VSELatAccHSC2_542766fd, ComIPduSignalRef=VSELatAccVHSC2_542766fd, ComIPduSignalRef=VSELongtAccHSC2_542766fd, ComIPduSignalRef=VSELongtAccVHSC2_542766fd, ComPduIdRef=PT_SCS_HSC2_FrP02_PP_SCS_HSC2_FrP02_Rx_0fb271d2_c07658fd
        SCS_HSC2_FrP03_oCAN00_3abd61be: ComIPduDirection=RECEIVE, ComIPduGroupRef=P2P_oCAN00_Rx_fcef2243, ComIPduSignalRef=LNonDrvnWhlRotlDircnHSC2_988d6663, ComIPduSignalRef=RNonDrvnWhlRotlDircnHSC2_988d6663, ComIPduSignalRef=SCSAPAAcclAHSC2_988d6663, ComIPduSignalRef=SCSAPAAlvRCHSC2_988d6663, ComIPduSignalRef=SCSAPAAvlblHSC2_988d6663, ComIPduSignalRef=SCSNRCDAvlblHSC2_988d6663, ComPduIdRef=PT_SCS_HSC2_FrP03_PP_SCS_HSC2_FrP03_Rx_0fb271d2_c07658fd
        SCS_HSC2_FrP05_oCAN00_3abd61be: ComIPduDirection=RECEIVE, ComIPduGroupRef=P2P_oCAN00_Rx_fcef2243, ComIPduSignalRef=ABSAHSC2_5ee26fe4, ComIPduSignalRef=TCSAHSC2_5ee26fe4, ComIPduSignalRef=VSESysAHSC2_5ee26fe4, ComIPduSignalRef=VehDynYawRateHSC2_5ee26fe4, ComIPduSignalRef=VehDynYawRateVHSC2_5ee26fe4, ComPduIdRef=PT_SCS_HSC2_FrP05_PP_SCS_HSC2_FrP05_Rx_0fb271d2_c07658fd
        SCS_HSC2_FrP11_oCAN00_3abd61be: ComIPduDirection=RECEIVE, ComIPduGroupRef=P2P_oCAN00_Rx_fcef2243, ComIPduSignalRef=WhlGndVelLDrvnHSC2_cdd3755d, ComIPduSignalRef=WhlGndVelLDrvnVHSC2_cdd3755d, ComIPduSignalRef=WhlGndVelRDrvnHSC2_cdd3755d, ComIPduSignalRef=WhlGndVelRDrvnVHSC2_cdd3755d, ComPduIdRef=PT_SCS_HSC2_FrP11_PP_SCS_HSC2_FrP11_Rx_0fb271d2_c07658fd
        SCS_HSC2_FrP12_oCAN00_3abd61be: ComIPduDirection=RECEIVE, ComIPduGroupRef=P2P_oCAN00_Rx_fcef2243, ComIPduSignalRef=WhlGndVelLNonDrvnHSC2_435c72be, ComIPduSignalRef=WhlGndVelLNonDrvnVHSC2_435c72be, ComIPduSignalRef=WhlGndVelRNonDrvnHSC2_435c72be, ComIPduSignalRef=WhlGndVelRNonDrvnVHSC2_435c72be, ComPduIdRef=PT_SCS_HSC2_FrP12_PP_SCS_HSC2_FrP12_Rx_0fb271d2_c07658fd
        SCS_HSC2_FrP15_oCAN00_3abd61be: ComIPduDirection=RECEIVE, ComIPduGroupRef=P2P_oCAN00_Rx_fcef2243, ComIPduSignalRef=DistRCAvgDrvnHSC2_49997ba7, ComIPduSignalRef=DistRCAvgDrvnRstOcdHSC2_49997ba7, ComIPduSignalRef=DistRCAvgDrvnSrcHSC2_49997ba7, ComIPduSignalRef=DistRCAvgDrvnVHSC2_49997ba7, ComIPduSignalRef=VehSpdAvgDrvnHSC2_49997ba7, ComIPduSignalRef=VehSpdAvgDrvnVHSC2_49997ba7, ComIPduSignalRef=VehSpdAvgNonDrvnHSC2_49997ba7, ComIPduSignalRef=VehSpdAvgNonDrvnVHSC2_49997ba7, ComPduIdRef=PT_SCS_HSC2_FrP15_PP_SCS_HSC2_FrP15_Rx_0fb271d2_c07658fd
        TPMS_HSC3_FrP01_oCAN01_3abd61be: ComIPduDirection=RECEIVE, ComIPduGroupRef=P2P_oCAN01_Rx_fcef2243, ComIPduSignalRef=FLTirePrsHSC4_fa528d8c, ComIPduSignalRef=FLTirePrsVHSC4_fa528d8c, ComIPduSignalRef=FRTirePrsHSC4_fa528d8c, ComIPduSignalRef=FRTirePrsVHSC4_fa528d8c, ComIPduSignalRef=RLTirePrsHSC4_fa528d8c, ComIPduSignalRef=RLTirePrsVHSC4_fa528d8c, ComIPduSignalRef=RRTirePrsHSC4_fa528d8c, ComIPduSignalRef=RRTirePrsVHSC4_fa528d8c, ComPduIdRef=PT_TPMS_HSC3_FrP01_PP_TPMS_HSC3_FrP01_Rx_c4eea277_b771686b
        TPMS_HSC3_FrP02_oCAN01_3abd61be: ComIPduDirection=RECEIVE, ComIPduGroupRef=P2P_oCAN01_Rx_fcef2243, ComIPduSignalRef=TPMSFHSC4_74dd8a6f, ComPduIdRef=PT_TPMS_HSC3_FrP02_PP_TPMS_HSC3_FrP02_Rx_c4eea277_b771686b
        Tester_HSC2_ECM_FrP00_oCAN00_3abd61be: ComIPduDirection=RECEIVE, ComIPduGroupRef=P2P_oCAN00_Rx_fcef2243, ComIPduSignalRef=EnRunAHSC2_235f8f9b, ComPduIdRef=PT_Tester_HSC2_ECM_FrP00_PP_Tester_HSC2_ECM_FrP00_Rx_0fb271d2_c07658fd
        Tester_HSC2_GW_FrP14_oCAN00_3abd61be: ComIPduDirection=RECEIVE, ComIPduGroupRef=P2P_oCAN00_Rx_fcef2243, ComIPduSignalRef=NRCDAlvRCHSC2_6ae5c0ff, ComIPduSignalRef=NRCDFHSC2_6ae5c0ff, ComPduIdRef=PT_Tester_HSC2_GW_FrP14_PP_Tester_HSC2_GW_FrP14_Rx_0fb271d2_c07658fd
      8 x ComIPduGroup:
        P2P_oCAN00_Rx_fcef2243
        P2P_oCAN00_Tx_fcef2243
        P2P_oCAN01_Rx_fcef2243
        P2P_oCAN01_Tx_fcef2243
        P2P_oCAN02_Rx_fcef2243
        P2P_oCAN02_Tx_fcef2243
        P2P_oLIN00_Rx_fcef2243
        P2P_oLIN00_Tx_fcef2243
      484 x ComSignal:
        ABSAHSC2_5ee26fe4: ComBitPosition=30, ComBitSize=1, ComSignalEndianness=BIG_ENDIAN, ComSignalInitValue=0, ComSignalType=BOOLEAN, ComSystemTemplateSystemSignalRef=ABSAHSC2
        ABSA_SecCAN2_72648180: ComBitPosition=30, ComBitSize=1, ComSignalEndianness=BIG_ENDIAN, ComSignalInitValue=0, ComSignalType=BOOLEAN, ComTransferProperty=PENDING, ComSystemTemplateSystemSignalRef=ABSA_SecCAN2
        APAAlvRCHSC2_64ef05b4: ComBitPosition=39, ComBitSize=8, ComSignalEndianness=BIG_ENDIAN, ComSignalInitValue=0, ComSignalType=UINT8, ComTransferProperty=PENDING, ComSystemTemplateSystemSignalRef=APAAlvRCHSC2
        APAAlvRC_sech2_SecCAN2_0adb690c: ComBitPosition=39, ComBitSize=8, ComSignalEndianness=BIG_ENDIAN, ComSignalInitValue=0, ComSignalType=UINT8, ComSystemTemplateSystemSignalRef=APAAlvRC_sech2_SecCAN2
        APAChksmHSC2_64ef05b4: ComBitPosition=47, ComBitSize=8, ComSignalEndianness=BIG_ENDIAN, ComSignalInitValue=0, ComSignalType=UINT8, ComTransferProperty=PENDING, ComSystemTemplateSystemSignalRef=APAChksmHSC2
        APAChksm_sech2_SecCAN2_0adb690c: ComBitPosition=47, ComBitSize=8, ComSignalEndianness=BIG_ENDIAN, ComSignalInitValue=0, ComSignalType=UINT8, ComSystemTemplateSystemSignalRef=APAChksm_sech2_SecCAN2
        APACmdEPSStsHSC2_64ef05b4: ComBitPosition=7, ComBitSize=2, ComSignalEndianness=BIG_ENDIAN, ComSignalInitValue=0, ComSignalType=UINT8, ComTransferProperty=PENDING, ComSystemTemplateSystemSignalRef=APACmdEPSStsHSC2
        APACmdEPSSts_sech2_SecCAN2_0adb690c: ComBitPosition=7, ComBitSize=2, ComSignalEndianness=BIG_ENDIAN, ComSignalInitValue=0, ComSignalType=UINT8, ComSystemTemplateSystemSignalRef=APACmdEPSSts_sech2_SecCAN2
        APACrpSpdReqStsHSC2_a845052a: ComBitPosition=39, ComBitSize=1, ComSignalEndianness=BIG_ENDIAN, ComSignalInitValue=0, ComSignalType=BOOLEAN, ComTransferProperty=PENDING, ComSystemTemplateSystemSignalRef=APACrpSpdReqStsHSC2
        APACrpSpdReqSts_sech2_SecCAN2_c6716992: ComBitPosition=39, ComBitSize=1, ComSignalEndianness=BIG_ENDIAN, ComSignalInitValue=0, ComSignalType=BOOLEAN, ComSystemTemplateSystemSignalRef=APACrpSpdReqSts_sech2_SecCAN2
        APACrpSpdReqValHSC2_a845052a: ComBitPosition=29, ComBitSize=6, ComSignalEndianness=BIG_ENDIAN, ComSignalInitValue=0, ComSignalType=UINT8, ComTransferProperty=PENDING, ComSystemTemplateSystemSignalRef=APACrpSpdReqValHSC2
        APACrpSpdReqVal_sech2_SecCAN2_c6716992: ComBitPosition=29, ComBitSize=6, ComSignalEndianness=BIG_ENDIAN, ComSignalInitValue=0, ComSignalType=UINT8, ComSystemTemplateSystemSignalRef=APACrpSpdReqVal_sech2_SecCAN2
        APACtrlAbotdRsnHSC2_32bfb16e: ComBitPosition=47, ComBitSize=4, ComSignalEndianness=BIG_ENDIAN, ComSignalInitValue=0, ComSignalType=UINT8, ComSystemTemplateSystemSignalRef=APACtrlAbotdRsnHSC2
        APACtrlAbotdRsn_SecCAN2_11614789: ComBitPosition=47, ComBitSize=4, ComSignalEndianness=BIG_ENDIAN, ComSignalInitValue=0, ComSignalType=UINT8, ComTransferProperty=PENDING, ComSystemTemplateSystemSignalRef=APACtrlAbotdRsn_SecCAN2
        APAEPBOPReqHSC2_a845052a: ComBitPosition=31, ComBitSize=2, ComSignalEndianness=BIG_ENDIAN, ComSignalInitValue=0, ComSignalType=UINT8, ComTransferProperty=PENDING, ComSystemTemplateSystemSignalRef=APAEPBOPReqHSC2
        APAEPBOPReq_sech2_SecCAN2_c6716992: ComBitPosition=31, ComBitSize=2, ComSignalEndianness=BIG_ENDIAN, ComSignalInitValue=0, ComSignalType=UINT8, ComSystemTemplateSystemSignalRef=APAEPBOPReq_sech2_SecCAN2
        APAEPBOpReqValPVHSC2_a845052a: ComBitPosition=63, ComBitSize=8, ComSignalEndianness=BIG_ENDIAN, ComSignalInitValue=0, ComSignalType=UINT8, ComTransferProperty=PENDING, ComSystemTemplateSystemSignalRef=APAEPBOpReqValPVHSC2
        APAEPBOpReqValPV_sech2_SecCAN2_c6716992: ComBitPosition=63, ComBitSize=8, ComSignalEndianness=BIG_ENDIAN, ComSignalInitValue=0, ComSignalType=UINT8, ComSystemTemplateSystemSignalRef=APAEPBOpReqValPV_sech2_SecCAN2
        APAEPBReqAlvRCHSC2_a845052a: ComBitPosition=51, ComBitSize=4, ComSignalEndianness=BIG_ENDIAN, ComSignalInitValue=0, ComSignalType=UINT8, ComTransferProperty=PENDING, ComSystemTemplateSystemSignalRef=APAEPBReqAlvRCHSC2
        APAEPBReqAlvRC_sech2_SecCAN2_c6716992: ComBitPosition=51, ComBitSize=4, ComSignalEndianness=BIG_ENDIAN, ComSignalInitValue=0, ComSignalType=UINT8, ComSystemTemplateSystemSignalRef=APAEPBReqAlvRC_sech2_SecCAN2
        APAFHSC2_64ef05b4: ComBitPosition=5, ComBitSize=1, ComSignalEndianness=BIG_ENDIAN, ComSignalInitValue=0, ComSignalType=BOOLEAN, ComTransferProperty=PENDING, ComSystemTemplateSystemSignalRef=APAFHSC2
        APAF_sech2_SecCAN2_0adb690c: ComBitPosition=5, ComBitSize=1, ComSignalEndianness=BIG_ENDIAN, ComSignalInitValue=0, ComSignalType=BOOLEAN, ComSystemTemplateSystemSignalRef=APAF_sech2_SecCAN2
        APAInfoDispReqHSC2_a845052a: ComBitPosition=37, ComBitSize=6, ComSignalEndianness=BIG_ENDIAN, ComSignalInitValue=0, ComSignalType=UINT8, ComTransferProperty=PENDING, ComSystemTemplateSystemSignalRef=APAInfoDispReqHSC2
        APAInfoDispReq_sech2_SecCAN2_c6716992: ComBitPosition=37, ComBitSize=6, ComSignalEndianness=BIG_ENDIAN, ComSignalInitValue=0, ComSignalType=UINT8, ComSystemTemplateSystemSignalRef=APAInfoDispReq_sech2_SecCAN2
        APAMdHSC2_a845052a: ComBitPosition=4, ComBitSize=3, ComSignalEndianness=BIG_ENDIAN, ComSignalInitValue=0, ComSignalType=UINT8, ComTransferProperty=PENDING, ComSystemTemplateSystemSignalRef=APAMdHSC2
        APAMd_sech2_SecCAN2_c6716992: ComBitPosition=4, ComBitSize=3, ComSignalEndianness=BIG_ENDIAN, ComSignalInitValue=0, ComSignalType=UINT8, ComSystemTemplateSystemSignalRef=APAMd_sech2_SecCAN2
        APANRCDAvlblHSC2_a845052a: ComBitPosition=38, ComBitSize=1, ComSignalEndianness=BIG_ENDIAN, ComSignalInitValue=0, ComSignalType=BOOLEAN, ComTransferProperty=PENDING, ComSystemTemplateSystemSignalRef=APANRCDAvlblHSC2
        APANRCDAvlbl_sech2_SecCAN2_c6716992: ComBitPosition=38, ComBitSize=1, ComSignalEndianness=BIG_ENDIAN, ComSignalInitValue=0, ComSignalType=BOOLEAN, ComSystemTemplateSystemSignalRef=APANRCDAvlbl_sech2_SecCAN2
        APAParkngSchedHSC2_26ca02c9: ComBitPosition=22, ComBitSize=7, ComSignalEndianness=BIG_ENDIAN, ComSignalInitValue=0, ComSignalType=UINT8, ComTransferProperty=PENDING, ComSystemTemplateSystemSignalRef=APAParkngSchedHSC2
        APAParkngSchedVHSC2_26ca02c9: ComBitPosition=25, ComBitSize=1, ComSignalEndianness=BIG_ENDIAN, ComSignalInitValue=0, ComSignalType=BOOLEAN, ComTransferProperty=PENDING, ComSystemTemplateSystemSignalRef=APAParkngSchedVHSC2
        APAParkngSchedV_sech2_SecCAN2_48fe6e71: ComBitPosition=25, ComBitSize=1, ComSignalEndianness=BIG_ENDIAN, ComSignalInitValue=0, ComSignalType=BOOLEAN, ComSystemTemplateSystemSignalRef=APAParkngSchedV_sech2_SecCAN2
        APAParkngSched_sech2_SecCAN2_48fe6e71: ComBitPosition=22, ComBitSize=7, ComSignalEndianness=BIG_ENDIAN, ComSignalInitValue=0, ComSignalType=UINT8, ComSystemTemplateSystemSignalRef=APAParkngSched_sech2_SecCAN2
        APAReqHSC2_a845052a: ComBitPosition=7, ComBitSize=3, ComSignalEndianness=BIG_ENDIAN, ComSignalInitValue=0, ComSignalType=UINT8, ComTransferProperty=PENDING, ComSystemTemplateSystemSignalRef=APAReqHSC2
        APAReq_sech2_SecCAN2_c6716992: ComBitPosition=7, ComBitSize=3, ComSignalEndianness=BIG_ENDIAN, ComSignalInitValue=0, ComSignalType=UINT8, ComSystemTemplateSystemSignalRef=APAReq_sech2_SecCAN2
        APASCSAcclReqStsHSC2_a845052a: ComBitPosition=55, ComBitSize=1, ComSignalEndianness=BIG_ENDIAN, ComSignalInitValue=0, ComSignalType=BOOLEAN, ComTransferProperty=PENDING, ComSystemTemplateSystemSignalRef=APASCSAcclReqStsHSC2
        APASCSAcclReqSts_sech2_SecCAN2_c6716992: ComBitPosition=55, ComBitSize=1, ComSignalEndianness=BIG_ENDIAN, ComSignalInitValue=0, ComSignalType=BOOLEAN, ComSystemTemplateSystemSignalRef=APASCSAcclReqSts_sech2_SecCAN2
        APASCSAcclReqValHSC2_a845052a: ComBitPosition=23, ComBitSize=8, ComSignalEndianness=BIG_ENDIAN, ComSignalInitValue=0, ComSignalType=UINT8, ComTransferProperty=PENDING, ComSystemTemplateSystemSignalRef=APASCSAcclReqValHSC2
        APASCSAcclReqValPVHSC2_a845052a: ComBitPosition=1, ComBitSize=10, ComSignalEndianness=BIG_ENDIAN, ComSignalInitValue=0, ComSignalType=UINT16, ComTransferProperty=PENDING, ComSystemTemplateSystemSignalRef=APASCSAcclReqValPVHSC2
        APASCSAcclReqValPV_sech2_SecCAN2_c6716992: ComBitPosition=1, ComBitSize=10, ComSignalEndianness=BIG_ENDIAN, ComSignalInitValue=0, ComSignalType=UINT16, ComSystemTemplateSystemSignalRef=APASCSAcclReqValPV_sech2_SecCAN2
        APASCSAcclReqVal_sech2_SecCAN2_c6716992: ComBitPosition=23, ComBitSize=8, ComSignalEndianness=BIG_ENDIAN, ComSignalInitValue=0, ComSignalType=UINT8, ComSystemTemplateSystemSignalRef=APASCSAcclReqVal_sech2_SecCAN2
        APASCSAlvRCHSC2_a845052a: ComBitPosition=47, ComBitSize=4, ComSignalEndianness=BIG_ENDIAN, ComSignalInitValue=0, ComSignalType=UINT8, ComTransferProperty=PENDING, ComSystemTemplateSystemSignalRef=APASCSAlvRCHSC2
        APASCSAlvRC_sech2_SecCAN2_c6716992: ComBitPosition=47, ComBitSize=4, ComSignalEndianness=BIG_ENDIAN, ComSignalInitValue=0, ComSignalType=UINT8, ComSystemTemplateSystemSignalRef=APASCSAlvRC_sech2_SecCAN2
        APAShifterPosReqdHSC2_a845052a: ComBitPosition=43, ComBitSize=4, ComSignalEndianness=BIG_ENDIAN, ComSignalInitValue=0, ComSignalType=UINT8, ComTransferProperty=PENDING, ComSystemTemplateSystemSignalRef=APAShifterPosReqdHSC2
        APAShifterPosReqd_sech2_SecCAN2_c6716992: ComBitPosition=43, ComBitSize=4, ComSignalEndianness=BIG_ENDIAN, ComSignalInitValue=0, ComSignalType=UINT8, ComSystemTemplateSystemSignalRef=APAShifterPosReqd_sech2_SecCAN2
        APASlotBearngHSC2_26ca02c9: ComBitPosition=47, ComBitSize=2, ComSignalEndianness=BIG_ENDIAN, ComSignalInitValue=0, ComSignalType=UINT8, ComTransferProperty=PENDING, ComSystemTemplateSystemSignalRef=APASlotBearngHSC2
        APASlotBearng_sech2_SecCAN2_48fe6e71: ComBitPosition=47, ComBitSize=2, ComSignalEndianness=BIG_ENDIAN, ComSignalInitValue=0, ComSignalType=UINT8, ComSystemTemplateSystemSignalRef=APASlotBearng_sech2_SecCAN2
        APASlotLngthHSC2_26ca02c9: ComBitPosition=2, ComBitSize=11, ComSignalEndianness=BIG_ENDIAN, ComSignalInitValue=0, ComSignalType=UINT16, ComTransferProperty=PENDING, ComSystemTemplateSystemSignalRef=APASlotLngthHSC2
        APASlotLngth_sech2_SecCAN2_48fe6e71: ComBitPosition=2, ComBitSize=11, ComSignalEndianness=BIG_ENDIAN, ComSignalInitValue=0, ComSignalType=UINT16, ComSystemTemplateSystemSignalRef=APASlotLngth_sech2_SecCAN2
        APAStsHSC2_a845052a: ComBitPosition=54, ComBitSize=3, ComSignalEndianness=BIG_ENDIAN, ComSignalInitValue=0, ComSignalType=UINT8, ComTransferProperty=PENDING, ComSystemTemplateSystemSignalRef=APAStsHSC2
        APASts_sech2_SecCAN2_c6716992: ComBitPosition=54, ComBitSize=3, ComSignalEndianness=BIG_ENDIAN, ComSignalInitValue=0, ComSignalType=UINT8, ComSystemTemplateSystemSignalRef=APASts_sech2_SecCAN2
        APASwReqHSC2_46783686: ComBitPosition=59, ComBitSize=2, ComSignalEndianness=BIG_ENDIAN, ComSignalInitValue=0, ComSignalType=UINT8, ComSystemTemplateSystemSignalRef=APASwReqHSC2
        APASwReqHSC4_687c4159: ComBitPosition=59, ComBitSize=2, ComSignalEndianness=BIG_ENDIAN, ComSignalInitValue=0, ComSignalType=UINT8, ComSystemTemplateSystemSignalRef=APASwReqHSC4
        APASwReq_SecCAN2_0e098acc: ComBitPosition=59, ComBitSize=2, ComSignalEndianness=BIG_ENDIAN, ComSignalInitValue=0, ComSignalType=UINT8, ComTransferProperty=PENDING, ComSystemTemplateSystemSignalRef=APASwReq_SecCAN2
        APAToqReqStsHSC2_64ef05b4: ComBitPosition=4, ComBitSize=1, ComSignalEndianness=BIG_ENDIAN, ComSignalInitValue=0, ComSignalType=BOOLEAN, ComTransferProperty=PENDING, ComSystemTemplateSystemSignalRef=APAToqReqStsHSC2
        APAToqReqSts_sech2_SecCAN2_0adb690c: ComBitPosition=4, ComBitSize=1, ComSignalEndianness=BIG_ENDIAN, ComSignalInitValue=0, ComSignalType=BOOLEAN, ComSystemTemplateSystemSignalRef=APAToqReqSts_sech2_SecCAN2
        APAToqReqValHSC2_64ef05b4: ComBitPosition=3, ComBitSize=12, ComSignalEndianness=BIG_ENDIAN, ComSignalInitValue=0, ComSignalType=UINT16, ComTransferProperty=PENDING, ComSystemTemplateSystemSignalRef=APAToqReqValHSC2
        APAToqReqVal_sech2_SecCAN2_0adb690c: ComBitPosition=3, ComBitSize=12, ComSignalEndianness=BIG_ENDIAN, ComSignalInitValue=0, ComSignalType=UINT16, ComSystemTemplateSystemSignalRef=APAToqReqVal_sech2_SecCAN2
        APATrgtEPSStrgWhlAngHSC2_64ef05b4: ComBitPosition=23, ComBitSize=16, ComSignalEndianness=BIG_ENDIAN, ComSignalInitValue=0, ComSignalType=UINT16, ComTransferProperty=PENDING, ComSystemTemplateSystemSignalRef=APATrgtEPSStrgWhlAngHSC2
        APATrgtEPSStrgWhlAng_sech2_SecCAN2_0adb690c: ComBitPosition=23, ComBitSize=16, ComSignalEndianness=BIG_ENDIAN, ComSignalInitValue=0, ComSignalType=UINT16, ComSystemTemplateSystemSignalRef=APATrgtEPSStrgWhlAng_sech2_SecCAN2
        APAVehCrdnatAzmthHSC2_26ca02c9: ComBitPosition=24, ComBitSize=9, ComSignalEndianness=BIG_ENDIAN, ComSignalInitValue=0, ComSignalType=UINT16, ComTransferProperty=PENDING, ComSystemTemplateSystemSignalRef=APAVehCrdnatAzmthHSC2
        APAVehCrdnatAzmth_sech2_SecCAN2_48fe6e71: ComBitPosition=24, ComBitSize=9, ComSignalEndianness=BIG_ENDIAN, ComSignalInitValue=0, ComSignalType=UINT16, ComSystemTemplateSystemSignalRef=APAVehCrdnatAzmth_sech2_SecCAN2
        APAVehCrdnatPosXHSC2_26ca02c9: ComBitPosition=45, ComBitSize=12, ComSignalEndianness=BIG_ENDIAN, ComSignalInitValue=0, ComSignalType=UINT16, ComTransferProperty=PENDING, ComSystemTemplateSystemSignalRef=APAVehCrdnatPosXHSC2
        APAVehCrdnatPosX_sech2_SecCAN2_48fe6e71: ComBitPosition=45, ComBitSize=12, ComSignalEndianness=BIG_ENDIAN, ComSignalInitValue=0, ComSignalType=UINT16, ComSystemTemplateSystemSignalRef=APAVehCrdnatPosX_sech2_SecCAN2
        APAVehCrdnatPosYHSC2_26ca02c9: ComBitPosition=49, ComBitSize=10, ComSignalEndianness=BIG_ENDIAN, ComSignalInitValue=0, ComSignalType=UINT16, ComTransferProperty=PENDING, ComSystemTemplateSystemSignalRef=APAVehCrdnatPosYHSC2
        APAVehCrdnatPosY_sech2_SecCAN2_48fe6e71: ComBitPosition=49, ComBitSize=10, ComSignalEndianness=BIG_ENDIAN, ComSignalInitValue=0, ComSignalType=UINT16, ComSystemTemplateSystemSignalRef=APAVehCrdnatPosY_sech2_SecCAN2
        AVMAutoViewChgHSC4_0c9b61ca: ComBitPosition=22, ComBitSize=1, ComSignalEndianness=BIG_ENDIAN, ComSignalInitValue=0, ComSignalType=BOOLEAN, ComSystemTemplateSystemSignalRef=AVMAutoViewChgHSC4
        AirbagDplHSC2_2128899b: ComBitPosition=11, ComBitSize=1, ComSignalEndianness=BIG_ENDIAN, ComSignalInitValue=0, ComSignalType=BOOLEAN, ComSystemTemplateSystemSignalRef=AirbagDplHSC2
        AirbagDplInvsnHSC2_2128899b: ComBitPosition=10, ComBitSize=1, ComSignalEndianness=BIG_ENDIAN, ComSignalInitValue=1, ComSignalType=BOOLEAN, ComSystemTemplateSystemSignalRef=AirbagDplInvsnHSC2
        AlisysrdyHSC4_226d494c: ComBitPosition=50, ComBitSize=1, ComSignalEndianness=BIG_ENDIAN, ComSignalInitValue=0, ComSignalType=BOOLEAN, ComSystemTemplateSystemSignalRef=AlisysrdyHSC4
        AutoDrvngSysStsHSC4_cdb8af8b: ComBitPosition=23, ComBitSize=8, ComSignalEndianness=BIG_ENDIAN, ComSignalInitValue=0, ComSignalType=UINT8, ComTransferProperty=PENDING, ComSystemTemplateSystemSignalRef=AutoDrvngSysStsHSC4
        BCMAvlbly_h2HSC2_ab4ba2ce: ComBitPosition=31, ComBitSize=1, ComSignalEndianness=BIG_ENDIAN, ComSignalInitValue=0, ComSignalType=BOOLEAN, ComSystemTemplateSystemSignalRef=BCMAvlbly_h2HSC2
        BCMAvlbly_h2_SecCAN2_88955429: ComBitPosition=31, ComBitSize=1, ComSignalEndianness=BIG_ENDIAN, ComSignalInitValue=0, ComSignalType=BOOLEAN, ComTransferProperty=PENDING, ComSystemTemplateSystemSignalRef=BCMAvlbly_h2_SecCAN2
        BCMImmoData4HSC4_7f6505b5: ComBitPosition=0, ComSignalEndianness=opaque, ComSignalInitValue=0 0 0 0 0 0 0 0, ComSignalLength=8, ComSignalType=UINT8_N, ComSystemTemplateSystemSignalRef=BCMImmoData4HSC4
        BCMImmoData5HSC4_77510add: ComBitPosition=0, ComSignalEndianness=opaque, ComSignalInitValue=0 0 0 0 0 0 0 0, ComSignalLength=8, ComSignalType=UINT8_N, ComSystemTemplateSystemSignalRef=BCMImmoData5HSC4
        BCMSSBAHSC2_f8a32097: ComBitPosition=0, ComBitSize=1, ComSignalEndianness=BIG_ENDIAN, ComSignalInitValue=0, ComSignalType=BOOLEAN, ComSystemTemplateSystemSignalRef=BCMSSBAHSC2
        BCMSSBAVHSC2_f8a32097: ComBitPosition=1, ComBitSize=1, ComSignalEndianness=BIG_ENDIAN, ComSignalInitValue=0, ComSignalType=BOOLEAN, ComSystemTemplateSystemSignalRef=BCMSSBAVHSC2
        BCMSSBFltStsHSC2_34092009: ComBitPosition=7, ComBitSize=3, ComSignalEndianness=BIG_ENDIAN, ComSignalInitValue=0, ComSignalType=UINT8, ComSystemTemplateSystemSignalRef=BCMSSBFltStsHSC2
        BCMToIECURmtCtrlPotclHSC2_c8458f49: ComBitPosition=0, ComSignalEndianness=opaque, ComSignalInitValue=0 0 0 0 0 0 0 0, ComSignalLength=8, ComSignalType=UINT8_N, ComSystemTemplateSystemSignalRef=BCMToIECURmtCtrlPotclHSC2
        BMSBscSta_h1HSC4_c182dd1d: ComBitPosition=5, ComBitSize=5, ComSignalEndianness=BIG_ENDIAN, ComSignalInitValue=0, ComSignalType=UINT8, ComSystemTemplateSystemSignalRef=BMSBscSta_h1HSC4
        BPMMstrAvlbly_h2HSC2_67e1a250: ComBitPosition=35, ComBitSize=1, ComSignalEndianness=BIG_ENDIAN, ComSignalInitValue=0, ComSignalType=BOOLEAN, ComSystemTemplateSystemSignalRef=BPMMstrAvlbly_h2HSC2
        BPMMstrAvlbly_h2_SecCAN2_443f54b7: ComBitPosition=35, ComBitSize=1, ComSignalEndianness=BIG_ENDIAN, ComSignalInitValue=0, ComSignalType=BOOLEAN, ComTransferProperty=PENDING, ComSystemTemplateSystemSignalRef=BPMMstrAvlbly_h2_SecCAN2
        BntOpenStsHSC2_762c2774: ComBitPosition=47, ComBitSize=2, ComSignalEndianness=BIG_ENDIAN, ComSignalInitValue=0, ComSignalType=UINT8, ComSystemTemplateSystemSignalRef=BntOpenStsHSC2
        BntOpenSts_SecCAN2_5ba847fd: ComBitPosition=45, ComBitSize=2, ComSignalEndianness=BIG_ENDIAN, ComSignalInitValue=0, ComSignalType=UINT8, ComTransferProperty=PENDING, ComSystemTemplateSystemSignalRef=BntOpenSts_SecCAN2
        BrkPdlAppdHSC2_70a619c8: ComBitPosition=10, ComBitSize=1, ComSignalEndianness=BIG_ENDIAN, ComSignalInitValue=0, ComSignalType=BOOLEAN, ComSystemTemplateSystemSignalRef=BrkPdlAppdHSC2
        CalendarDayHSC2_c30fb534: ComBitPosition=20, ComBitSize=5, ComSignalEndianness=BIG_ENDIAN, ComSignalInitValue=0, ComSignalType=UINT8, ComSystemTemplateSystemSignalRef=CalendarDayHSC2
        CalendarDayHSC4_80f6c9a0: ComBitPosition=20, ComBitSize=5, ComSignalEndianness=BIG_ENDIAN, ComSignalInitValue=0, ComSignalType=UINT8, ComSystemTemplateSystemSignalRef=CalendarDayHSC4
        CalendarDay_SecCAN2_ee8bd5bd: ComBitPosition=20, ComBitSize=5, ComSignalEndianness=BIG_ENDIAN, ComSignalInitValue=0, ComSignalType=UINT8, ComTransferProperty=PENDING, ComSystemTemplateSystemSignalRef=CalendarDay_SecCAN2
        CalendarMonthHSC2_c30fb534: ComBitPosition=11, ComBitSize=4, ComSignalEndianness=BIG_ENDIAN, ComSignalInitValue=0, ComSignalType=UINT8, ComSystemTemplateSystemSignalRef=CalendarMonthHSC2
        CalendarMonthHSC4_80f6c9a0: ComBitPosition=11, ComBitSize=4, ComSignalEndianness=BIG_ENDIAN, ComSignalInitValue=0, ComSignalType=UINT8, ComSystemTemplateSystemSignalRef=CalendarMonthHSC4
        CalendarMonth_SecCAN2_ee8bd5bd: ComBitPosition=11, ComBitSize=4, ComSignalEndianness=BIG_ENDIAN, ComSignalInitValue=0, ComSignalType=UINT8, ComTransferProperty=PENDING, ComSystemTemplateSystemSignalRef=CalendarMonth_SecCAN2
        CalendarYearHSC2_c30fb534: ComBitPosition=7, ComBitSize=8, ComSignalEndianness=BIG_ENDIAN, ComSignalInitValue=0, ComSignalType=UINT8, ComSystemTemplateSystemSignalRef=CalendarYearHSC2
        CalendarYearHSC4_80f6c9a0: ComBitPosition=7, ComBitSize=8, ComSignalEndianness=BIG_ENDIAN, ComSignalInitValue=0, ComSignalType=UINT8, ComSystemTemplateSystemSignalRef=CalendarYearHSC4
        CalendarYear_SecCAN2_ee8bd5bd: ComBitPosition=7, ComBitSize=8, ComSignalEndianness=BIG_ENDIAN, ComSignalInitValue=0, ComSignalType=UINT8, ComTransferProperty=PENDING, ComSystemTemplateSystemSignalRef=CalendarYear_SecCAN2
        DTCInfomationAPAHSC2_c3e0343e: ComBitPosition=0, ComSignalEndianness=opaque, ComSignalInitValue=0 0 0 0 0 0 0, ComSignalLength=7, ComSignalType=UINT8_N, ComTransferProperty=PENDING, ComSystemTemplateSystemSignalRef=DTCInfomationAPAHSC2
        DTCInfomationAPA_SecCAN2_3e47bb85: ComBitPosition=0, ComSignalEndianness=opaque, ComSignalInitValue=0 0 0 0 0 0 0, ComSignalLength=7, ComSignalType=UINT8_N, ComSystemTemplateSystemSignalRef=DTCInfomationAPA_SecCAN2
        DTCInfomationP2PHSC2_daa1a8e8: ComBitPosition=0, ComSignalEndianness=opaque, ComSignalInitValue=0 0 0 0 0 0 0, ComSignalLength=7, ComSignalType=UINT8_N, ComTransferProperty=PENDING, ComSystemTemplateSystemSignalRef=DTCInfomationP2PHSC2
        DayTimeRunningLampOnHSC2_34092009: ComBitPosition=29, ComBitSize=1, ComSignalEndianness=BIG_ENDIAN, ComSignalInitValue=0, ComSignalType=BOOLEAN, ComSystemTemplateSystemSignalRef=DayTimeRunningLampOnHSC2
        DiagnosticFuncAddrReq_h2_a8412cb3: ComBitPosition=0, ComSignalEndianness=opaque, ComSignalInitValue=0 0 0 0 0 0 0 0, ComSignalLength=8, ComSignalType=UINT8_N, ComSystemTemplateSystemSignalRef=DiagnosticFuncAddrReq_h2
        DiagnosticReqP2P_h2_2483449d: ComBitPosition=0, ComSignalEndianness=opaque, ComSignalInitValue=0 0 0 0 0 0 0 0, ComSignalLength=8, ComSignalType=UINT8_N, ComSystemTemplateSystemSignalRef=DiagnosticReqP2P_h2
        DiagnosticRespP2P_3926bf28: ComBitPosition=0, ComSignalEndianness=opaque, ComSignalInitValue=0 0 0 0 0 0 0 0, ComSignalLength=8, ComSignalType=UINT8_N, ComTransferProperty=PENDING, ComSystemTemplateSystemSignalRef=DiagnosticRespP2P
        DipdBeamLghtOnHSC2_762c2774: ComBitPosition=13, ComBitSize=1, ComSignalEndianness=BIG_ENDIAN, ComSignalInitValue=0, ComSignalType=BOOLEAN, ComSystemTemplateSystemSignalRef=DipdBeamLghtOnHSC2
        DircnIndLampSwStsHSC2_762c2774: ComBitPosition=3, ComBitSize=2, ComSignalEndianness=BIG_ENDIAN, ComSignalInitValue=0, ComSignalType=UINT8, ComSystemTemplateSystemSignalRef=DircnIndLampSwStsHSC2
        DistRCAvgDrvnHSC2_49997ba7: ComBitPosition=20, ComBitSize=13, ComSignalEndianness=BIG_ENDIAN, ComSignalInitValue=0, ComSignalType=UINT16, ComSystemTemplateSystemSignalRef=DistRCAvgDrvnHSC2
        DistRCAvgDrvnRstOcdHSC2_49997ba7: ComBitPosition=21, ComBitSize=1, ComSignalEndianness=BIG_ENDIAN, ComSignalInitValue=0, ComSignalType=BOOLEAN, ComSystemTemplateSystemSignalRef=DistRCAvgDrvnRstOcdHSC2
        DistRCAvgDrvnRstOcd_SecCAN2_651f95c3: ComBitPosition=21, ComBitSize=1, ComSignalEndianness=BIG_ENDIAN, ComSignalInitValue=0, ComSignalType=BOOLEAN, ComTransferProperty=PENDING, ComSystemTemplateSystemSignalRef=DistRCAvgDrvnRstOcd_SecCAN2
        DistRCAvgDrvnSrcHSC2_49997ba7: ComBitPosition=55, ComBitSize=1, ComSignalEndianness=BIG_ENDIAN, ComSignalInitValue=0, ComSignalType=BOOLEAN, ComSystemTemplateSystemSignalRef=DistRCAvgDrvnSrcHSC2
        DistRCAvgDrvnSrc_SecCAN2_651f95c3: ComBitPosition=55, ComBitSize=1, ComSignalEndianness=BIG_ENDIAN, ComSignalInitValue=0, ComSignalType=BOOLEAN, ComTransferProperty=PENDING, ComSystemTemplateSystemSignalRef=DistRCAvgDrvnSrc_SecCAN2
        DistRCAvgDrvnVHSC2_49997ba7: ComBitPosition=22, ComBitSize=1, ComSignalEndianness=BIG_ENDIAN, ComSignalInitValue=0, ComSignalType=BOOLEAN, ComSystemTemplateSystemSignalRef=DistRCAvgDrvnVHSC2
        DistRCAvgDrvnV_SecCAN2_651f95c3: ComBitPosition=22, ComBitSize=1, ComSignalEndianness=BIG_ENDIAN, ComSignalInitValue=0, ComSignalType=BOOLEAN, ComTransferProperty=PENDING, ComSystemTemplateSystemSignalRef=DistRCAvgDrvnV_SecCAN2
        DistRCAvgDrvn_SecCAN2_651f95c3: ComBitPosition=20, ComBitSize=13, ComSignalEndianness=BIG_ENDIAN, ComSignalInitValue=0, ComSignalType=UINT16, ComTransferProperty=PENDING, ComSystemTemplateSystemSignalRef=DistRCAvgDrvn_SecCAN2
        DrvrDoorOpenStsHSC2_762c2774: ComBitPosition=1, ComBitSize=2, ComSignalEndianness=BIG_ENDIAN, ComSignalInitValue=0, ComSignalType=UINT8, ComSystemTemplateSystemSignalRef=DrvrDoorOpenStsHSC2
        DrvrDoorOpenSts_SecCAN2_5ba847fd: ComBitPosition=47, ComBitSize=2, ComSignalEndianness=BIG_ENDIAN, ComSignalInitValue=0, ComSignalType=UINT8, ComTransferProperty=PENDING, ComSystemTemplateSystemSignalRef=DrvrDoorOpenSts_SecCAN2
        DrvrSbltAtcHSC2_2128899b: ComBitPosition=12, ComBitSize=1, ComSignalEndianness=BIG_ENDIAN, ComSignalInitValue=0, ComSignalType=BOOLEAN, ComSystemTemplateSystemSignalRef=DrvrSbltAtcHSC2
        DrvrSbltAtcVHSC2_2128899b: ComBitPosition=13, ComBitSize=1, ComSignalEndianness=BIG_ENDIAN, ComSignalInitValue=0, ComSignalType=BOOLEAN, ComSystemTemplateSystemSignalRef=DrvrSbltAtcVHSC2
        DrvrSbltAtcV_SecCAN2_0cace912: ComBitPosition=13, ComBitSize=1, ComSignalEndianness=BIG_ENDIAN, ComSignalInitValue=0, ComSignalType=BOOLEAN, ComTransferProperty=PENDING, ComSystemTemplateSystemSignalRef=DrvrSbltAtcV_SecCAN2
        DrvrSbltAtc_SecCAN2_0cace912: ComBitPosition=12, ComBitSize=1, ComSignalEndianness=BIG_ENDIAN, ComSignalInitValue=0, ComSignalType=BOOLEAN, ComTransferProperty=PENDING, ComSystemTemplateSystemSignalRef=DrvrSbltAtc_SecCAN2
        DrvrSelAPAParkngMdHSC2_d7b82a4e: ComBitPosition=10, ComBitSize=3, ComSignalEndianness=BIG_ENDIAN, ComSignalInitValue=0, ComSignalType=UINT8, ComSystemTemplateSystemSignalRef=DrvrSelAPAParkngMdHSC2
        DrvrSelAPAParkngMdHSC4_7f07551a: ComBitPosition=0, ComBitSize=3, ComSignalEndianness=BIG_ENDIAN, ComSignalInitValue=0, ComSignalType=UINT8, ComSystemTemplateSystemSignalRef=DrvrSelAPAParkngMdHSC4
        DrvrSelAPAParkngMd_SecCAN2_19729e8f: ComBitPosition=0, ComBitSize=3, ComSignalEndianness=BIG_ENDIAN, ComSignalInitValue=0, ComSignalType=UINT8, ComTransferProperty=PENDING, ComSystemTemplateSystemSignalRef=DrvrSelAPAParkngMd_SecCAN2
        DrvrSelAPASlotBearngHSC2_d7b82a4e: ComBitPosition=12, ComBitSize=2, ComSignalEndianness=BIG_ENDIAN, ComSignalInitValue=0, ComSignalType=UINT8, ComSystemTemplateSystemSignalRef=DrvrSelAPASlotBearngHSC2
        DrvrSelAPASlotBearngHSC4_7f07551a: ComBitPosition=6, ComBitSize=2, ComSignalEndianness=BIG_ENDIAN, ComSignalInitValue=0, ComSignalType=UINT8, ComSystemTemplateSystemSignalRef=DrvrSelAPASlotBearngHSC4
        DrvrSelAPASlotBearng_SecCAN2_19729e8f: ComBitPosition=6, ComBitSize=2, ComSignalEndianness=BIG_ENDIAN, ComSignalInitValue=0, ComSignalType=UINT8, ComTransferProperty=PENDING, ComSystemTemplateSystemSignalRef=DrvrSelAPASlotBearng_SecCAN2
        ECMAvlbly_h2HSC2_ab4ba2ce: ComBitPosition=7, ComBitSize=1, ComSignalEndianness=BIG_ENDIAN, ComSignalInitValue=0, ComSignalType=BOOLEAN, ComSystemTemplateSystemSignalRef=ECMAvlbly_h2HSC2
        ECMAvlbly_h2_SecCAN2_88955429: ComBitPosition=7, ComBitSize=1, ComSignalEndianness=BIG_ENDIAN, ComSignalInitValue=0, ComSignalType=BOOLEAN, ComTransferProperty=PENDING, ComSystemTemplateSystemSignalRef=ECMAvlbly_h2_SecCAN2
        EPBAppcnStsHSC2_ecbe2b89: ComBitPosition=15, ComBitSize=2, ComSignalEndianness=BIG_ENDIAN, ComSignalInitValue=0, ComSignalType=UINT8, ComSystemTemplateSystemSignalRef=EPBAppcnStsHSC2
        EPBAppcnStsPVHSC2_ecbe2b89: ComBitPosition=13, ComBitSize=2, ComSignalEndianness=BIG_ENDIAN, ComSignalInitValue=0, ComSignalType=UINT8, ComSystemTemplateSystemSignalRef=EPBAppcnStsPVHSC2
        EPBAppcnSts_SecCAN2_ed3af02c: ComBitPosition=15, ComBitSize=2, ComSignalEndianness=BIG_ENDIAN, ComSignalInitValue=0, ComSignalType=UINT8, ComTransferProperty=PENDING, ComSystemTemplateSystemSignalRef=EPBAppcnSts_SecCAN2
        EPBAvlblyStsHSC2_ecbe2b89: ComBitPosition=5, ComBitSize=3, ComSignalEndianness=BIG_ENDIAN, ComSignalInitValue=0, ComSignalType=UINT8, ComSystemTemplateSystemSignalRef=EPBAvlblyStsHSC2
        EPBAvlblyStsPVHSC2_ecbe2b89: ComBitPosition=2, ComBitSize=3, ComSignalEndianness=BIG_ENDIAN, ComSignalInitValue=0, ComSignalType=UINT8, ComSystemTemplateSystemSignalRef=EPBAvlblyStsPVHSC2
        EPBAvlblyStsPV_SecCAN2_ed3af02c: ComBitPosition=2, ComBitSize=3, ComSignalEndianness=BIG_ENDIAN, ComSignalInitValue=0, ComSignalType=UINT8, ComTransferProperty=PENDING, ComSystemTemplateSystemSignalRef=EPBAvlblyStsPV_SecCAN2
        EPBAvlblySts_SecCAN2_ed3af02c: ComBitPosition=5, ComBitSize=3, ComSignalEndianness=BIG_ENDIAN, ComSignalInitValue=0, ComSignalType=UINT8, ComTransferProperty=PENDING, ComSystemTemplateSystemSignalRef=EPBAvlblySts_SecCAN2
        EPBSwStsHSC2_20142b17: ComBitPosition=7, ComBitSize=2, ComSignalEndianness=BIG_ENDIAN, ComSignalInitValue=0, ComSignalType=UINT8, ComSystemTemplateSystemSignalRef=EPBSwStsHSC2
        EPBSwStsVHSC2_20142b17: ComBitPosition=5, ComBitSize=1, ComSignalEndianness=BIG_ENDIAN, ComSignalInitValue=0, ComSignalType=BOOLEAN, ComSystemTemplateSystemSignalRef=EPBSwStsVHSC2
        EPBSwStsV_SecCAN2_2190f0b2: ComBitPosition=5, ComBitSize=1, ComSignalEndianness=BIG_ENDIAN, ComSignalInitValue=0, ComSignalType=BOOLEAN, ComTransferProperty=PENDING, ComSystemTemplateSystemSignalRef=EPBSwStsV_SecCAN2
        EPBSwSts_SecCAN2_2190f0b2: ComBitPosition=7, ComBitSize=2, ComSignalEndianness=BIG_ENDIAN, ComSignalInitValue=0, ComSignalType=UINT8, ComTransferProperty=PENDING, ComSystemTemplateSystemSignalRef=EPBSwSts_SecCAN2
        EPSAPAAlvRCHSC2_a6919738: ComBitPosition=23, ComBitSize=8, ComSignalEndianness=BIG_ENDIAN, ComSignalInitValue=0, ComSignalType=UINT8, ComSystemTemplateSystemSignalRef=EPSAPAAlvRCHSC2
        EPSAPAAlvRC_SecCAN2_98082ad5: ComBitPosition=23, ComBitSize=8, ComSignalEndianness=BIG_ENDIAN, ComSignalInitValue=0, ComSignalType=UINT8, ComTransferProperty=PENDING, ComSystemTemplateSystemSignalRef=EPSAPAAlvRC_SecCAN2
        EPSAPAChksmHSC2_a6919738: ComBitPosition=31, ComBitSize=8, ComSignalEndianness=BIG_ENDIAN, ComSignalInitValue=0, ComSignalType=UINT8, ComSystemTemplateSystemSignalRef=EPSAPAChksmHSC2
        EPSAPAChksm_SecCAN2_98082ad5: ComBitPosition=31, ComBitSize=8, ComSignalEndianness=BIG_ENDIAN, ComSignalInitValue=0, ComSignalType=UINT8, ComTransferProperty=PENDING, ComSystemTemplateSystemSignalRef=EPSAPAChksm_SecCAN2
        EPSAPAInhHSC2_a6919738: ComBitPosition=15, ComBitSize=8, ComSignalEndianness=BIG_ENDIAN, ComSignalInitValue=0, ComSignalType=UINT8, ComSystemTemplateSystemSignalRef=EPSAPAInhHSC2
        EPSAPAInh_SecCAN2_98082ad5: ComBitPosition=15, ComBitSize=8, ComSignalEndianness=BIG_ENDIAN, ComSignalInitValue=0, ComSignalType=UINT8, ComTransferProperty=PENDING, ComSystemTemplateSystemSignalRef=EPSAPAInh_SecCAN2
        EPSAPAStsHSC2_a6919738: ComBitPosition=4, ComBitSize=4, ComSignalEndianness=BIG_ENDIAN, ComSignalInitValue=7, ComSignalType=UINT8, ComSystemTemplateSystemSignalRef=EPSAPAStsHSC2
        EPSAPASts_SecCAN2_98082ad5: ComBitPosition=4, ComBitSize=4, ComSignalEndianness=BIG_ENDIAN, ComSignalInitValue=7, ComSignalType=UINT8, ComTransferProperty=PENDING, ComSystemTemplateSystemSignalRef=EPSAPASts_SecCAN2
        EPTAccelActuPosHSC2_533eb1f8: ComBitPosition=7, ComBitSize=8, ComSignalEndianness=BIG_ENDIAN, ComSignalInitValue=0, ComSignalType=UINT8, ComSystemTemplateSystemSignalRef=EPTAccelActuPosHSC2
        EPTAccelActuPosVHSC2_533eb1f8: ComBitPosition=43, ComBitSize=1, ComSignalEndianness=BIG_ENDIAN, ComSignalInitValue=0, ComSignalType=BOOLEAN, ComSystemTemplateSystemSignalRef=EPTAccelActuPosVHSC2
        EPTAccelActuPosV_SecCAN2_7ebad171: ComBitPosition=43, ComBitSize=1, ComSignalEndianness=BIG_ENDIAN, ComSignalInitValue=0, ComSignalType=BOOLEAN, ComTransferProperty=PENDING, ComSystemTemplateSystemSignalRef=EPTAccelActuPosV_SecCAN2
        EPTAccelActuPos_SecCAN2_7ebad171: ComBitPosition=7, ComBitSize=8, ComSignalEndianness=BIG_ENDIAN, ComSignalInitValue=0, ComSignalType=UINT8, ComTransferProperty=PENDING, ComSystemTemplateSystemSignalRef=EPTAccelActuPos_SecCAN2
        EPTBrkPdlDscrtInptStsHSC2_533eb1f8: ComBitPosition=31, ComBitSize=1, ComSignalEndianness=BIG_ENDIAN, ComSignalInitValue=0, ComSignalType=BOOLEAN, ComSystemTemplateSystemSignalRef=EPTBrkPdlDscrtInptStsHSC2
        EPTBrkPdlDscrtInptStsVHSC2_533eb1f8: ComBitPosition=16, ComBitSize=1, ComSignalEndianness=BIG_ENDIAN, ComSignalInitValue=1, ComSignalType=BOOLEAN, ComSystemTemplateSystemSignalRef=EPTBrkPdlDscrtInptStsVHSC2
        EPTBrkPdlDscrtInptStsV_SecCAN2_7ebad171: ComBitPosition=16, ComBitSize=1, ComSignalEndianness=BIG_ENDIAN, ComSignalInitValue=1, ComSignalType=BOOLEAN, ComTransferProperty=PENDING, ComSystemTemplateSystemSignalRef=EPTBrkPdlDscrtInptStsV_SecCAN2
        EPTBrkPdlDscrtInptSts_SecCAN2_7ebad171: ComBitPosition=31, ComBitSize=1, ComSignalEndianness=BIG_ENDIAN, ComSignalInitValue=0, ComSignalType=BOOLEAN, ComTransferProperty=PENDING, ComSystemTemplateSystemSignalRef=EPTBrkPdlDscrtInptSts_SecCAN2
        EPTRdy_h1HSC2_9f94b166: ComBitPosition=38, ComBitSize=1, ComSignalEndianness=BIG_ENDIAN, ComSignalInitValue=0, ComSignalType=BOOLEAN, ComSystemTemplateSystemSignalRef=EPTRdy_h1HSC2
        EPTRdy_h1_SecCAN2_b210d1ef: ComBitPosition=38, ComBitSize=1, ComSignalEndianness=BIG_ENDIAN, ComSignalInitValue=0, ComSignalType=BOOLEAN, ComTransferProperty=PENDING, ComSystemTemplateSystemSignalRef=EPTRdy_h1_SecCAN2
        EPTStCmdOn_h1HSC2_533eb1f8: ComBitPosition=17, ComBitSize=1, ComSignalEndianness=BIG_ENDIAN, ComSignalInitValue=0, ComSignalType=BOOLEAN, ComSystemTemplateSystemSignalRef=EPTStCmdOn_h1HSC2
        EPTStCmdOn_h1_SecCAN2_7ebad171: ComBitPosition=17, ComBitSize=1, ComSignalEndianness=BIG_ENDIAN, ComSignalInitValue=0, ComSignalType=BOOLEAN, ComTransferProperty=PENDING, ComSystemTemplateSystemSignalRef=EPTStCmdOn_h1_SecCAN2
        EnRunAHSC2_235f8f9b: ComBitPosition=7, ComBitSize=1, ComSignalEndianness=BIG_ENDIAN, ComSignalInitValue=0, ComSignalType=BOOLEAN, ComSystemTemplateSystemSignalRef=EnRunAHSC2
        EnRunA_SecCAN2_221bb172: ComBitPosition=7, ComBitSize=1, ComSignalEndianness=BIG_ENDIAN, ComSignalInitValue=0, ComSignalType=BOOLEAN, ComTransferProperty=PENDING, ComSystemTemplateSystemSignalRef=EnRunA_SecCAN2
        FICMAvlbly_h2HSC2_ab4ba2ce: ComBitPosition=25, ComBitSize=1, ComSignalEndianness=BIG_ENDIAN, ComSignalInitValue=0, ComSignalType=BOOLEAN, ComSystemTemplateSystemSignalRef=FICMAvlbly_h2HSC2
        FICMAvlbly_h2_SecCAN2_88955429: ComBitPosition=25, ComBitSize=1, ComSignalEndianness=BIG_ENDIAN, ComSignalInitValue=0, ComSignalType=BOOLEAN, ComTransferProperty=PENDING, ComSystemTemplateSystemSignalRef=FICMAvlbly_h2_SecCAN2
        FICMP2PQuitReqHSC4_0c9b61ca: ComBitPosition=23, ComBitSize=1, ComSignalEndianness=BIG_ENDIAN, ComSignalInitValue=0, ComSignalType=BOOLEAN, ComSystemTemplateSystemSignalRef=FICMP2PQuitReqHSC4
        FICMPLCRtCoverSwReqHSC4_0c9b61ca: ComBitPosition=3, ComBitSize=2, ComSignalEndianness=BIG_ENDIAN, ComSignalInitValue=0, ComSignalType=UINT8, ComSystemTemplateSystemSignalRef=FICMPLCRtCoverSwReqHSC4
        FICMPLCRtEndSwReqHSC4_0c9b61ca: ComBitPosition=1, ComBitSize=2, ComSignalEndianness=BIG_ENDIAN, ComSignalInitValue=0, ComSignalType=UINT8, ComSystemTemplateSystemSignalRef=FICMPLCRtEndSwReqHSC4
        FICMPLCSwReqHSC4_0c9b61ca: ComBitPosition=7, ComBitSize=4, ComSignalEndianness=BIG_ENDIAN, ComSignalInitValue=0, ComSignalType=UINT8, ComSystemTemplateSystemSignalRef=FICMPLCSwReqHSC4
        FICMRouteChangeCheckHSC4_0c9b61ca: ComBitPosition=15, ComBitSize=2, ComSignalEndianness=BIG_ENDIAN, ComSignalInitValue=0, ComSignalType=UINT8, ComSystemTemplateSystemSignalRef=FICMRouteChangeCheckHSC4
        FICMRouteReqHSC4_0c9b61ca: ComBitPosition=13, ComBitSize=2, ComSignalEndianness=BIG_ENDIAN, ComSignalInitValue=0, ComSignalType=UINT8, ComSystemTemplateSystemSignalRef=FICMRouteReqHSC4
        FICMSilentSearchCheckHSC4_0c9b61ca: ComBitPosition=11, ComBitSize=2, ComSignalEndianness=BIG_ENDIAN, ComSignalInitValue=0, ComSignalType=UINT8, ComSystemTemplateSystemSignalRef=FICMSilentSearchCheckHSC4
        FICMSilentSearchReqHSC4_0c9b61ca: ComBitPosition=9, ComBitSize=2, ComSignalEndianness=BIG_ENDIAN, ComSignalInitValue=0, ComSignalType=UINT8, ComSystemTemplateSystemSignalRef=FICMSilentSearchReqHSC4
        FLDoorHadlSwAHSC4_5c9d774f: ComBitPosition=59, ComBitSize=1, ComSignalEndianness=BIG_ENDIAN, ComSignalInitValue=0, ComSignalType=BOOLEAN, ComSystemTemplateSystemSignalRef=FLDoorHadlSwAHSC4
        FLObsDist_sech2_SecCAN2_84546eef: ComBitPosition=24, ComBitSize=9, ComSignalEndianness=BIG_ENDIAN, ComSignalInitValue=0, ComSignalType=UINT16, ComSystemTemplateSystemSignalRef=FLObsDist_sech2_SecCAN2
        FLObsRngHSC2_ea600257: ComBitPosition=47, ComBitSize=4, ComSignalEndianness=BIG_ENDIAN, ComSignalInitValue=0, ComSignalType=UINT8, ComTransferProperty=PENDING, ComSystemTemplateSystemSignalRef=FLObsRngHSC2
        FLObsRng_sech2_SecCAN2_27d72756: ComBitPosition=47, ComBitSize=4, ComSignalEndianness=BIG_ENDIAN, ComSignalInitValue=0, ComSignalType=UINT8, ComSystemTemplateSystemSignalRef=FLObsRng_sech2_SecCAN2
        FLSideObsDistHSC2_e0a50b4e: ComBitPosition=48, ComBitSize=9, ComSignalEndianness=BIG_ENDIAN, ComSignalInitValue=0, ComSignalType=UINT16, ComTransferProperty=PENDING, ComSystemTemplateSystemSignalRef=FLSideObsDistHSC2
        FLSideObsDist_sech2_SecCAN2_eb7d27c8: ComBitPosition=48, ComBitSize=9, ComSignalEndianness=BIG_ENDIAN, ComSignalInitValue=0, ComSignalType=UINT16, ComSystemTemplateSystemSignalRef=FLSideObsDist_sech2_SecCAN2
        FLTirePrsHSC4_fa528d8c: ComBitPosition=62, ComBitSize=7, ComSignalEndianness=BIG_ENDIAN, ComSignalInitValue=55, ComSignalType=UINT8, ComSystemTemplateSystemSignalRef=FLTirePrsHSC4
        FLTirePrsVHSC4_fa528d8c: ComBitPosition=63, ComBitSize=1, ComSignalEndianness=BIG_ENDIAN, ComSignalInitValue=0, ComSignalType=BOOLEAN, ComSystemTemplateSystemSignalRef=FLTirePrsVHSC4
        FRDoorHadlSwAHSC4_5c9d774f: ComBitPosition=58, ComBitSize=1, ComSignalEndianness=BIG_ENDIAN, ComSignalInitValue=0, ComSignalType=BOOLEAN, ComSystemTemplateSystemSignalRef=FRDoorHadlSwAHSC4
        FRObsDist_sech2_SecCAN2_84546eef: ComBitPosition=21, ComBitSize=9, ComSignalEndianness=BIG_ENDIAN, ComSignalInitValue=0, ComSignalType=UINT16, ComSystemTemplateSystemSignalRef=FRObsDist_sech2_SecCAN2
        FRObsRngHSC2_ea600257: ComBitPosition=35, ComBitSize=4, ComSignalEndianness=BIG_ENDIAN, ComSignalInitValue=0, ComSignalType=UINT8, ComTransferProperty=PENDING, ComSystemTemplateSystemSignalRef=FRObsRngHSC2
        FRObsRng_sech2_SecCAN2_27d72756: ComBitPosition=35, ComBitSize=4, ComSignalEndianness=BIG_ENDIAN, ComSignalInitValue=0, ComSignalType=UINT8, ComSystemTemplateSystemSignalRef=FRObsRng_sech2_SecCAN2
        FRSideObsDistHSC2_e0a50b4e: ComBitPosition=32, ComBitSize=9, ComSignalEndianness=BIG_ENDIAN, ComSignalInitValue=0, ComSignalType=UINT16, ComTransferProperty=PENDING, ComSystemTemplateSystemSignalRef=FRSideObsDistHSC2
        FRSideObsDist_sech2_SecCAN2_eb7d27c8: ComBitPosition=32, ComBitSize=9, ComSignalEndianness=BIG_ENDIAN, ComSignalInitValue=0, ComSignalType=UINT16, ComSystemTemplateSystemSignalRef=FRSideObsDist_sech2_SecCAN2
        FRTirePrsHSC4_fa528d8c: ComBitPosition=46, ComBitSize=7, ComSignalEndianness=BIG_ENDIAN, ComSignalInitValue=55, ComSignalType=UINT8, ComSystemTemplateSystemSignalRef=FRTirePrsHSC4
        FRTirePrsVHSC4_fa528d8c: ComBitPosition=47, ComBitSize=1, ComSignalEndianness=BIG_ENDIAN, ComSignalInitValue=0, ComSignalType=BOOLEAN, ComSystemTemplateSystemSignalRef=FRTirePrsVHSC4
        FrtFogLghtOnHSC2_762c2774: ComBitPosition=14, ComBitSize=1, ComSignalEndianness=BIG_ENDIAN, ComSignalInitValue=0, ComSignalType=BOOLEAN, ComSystemTemplateSystemSignalRef=FrtFogLghtOnHSC2
        FrtMidLObsDist_sech2_SecCAN2_8e9167f6: ComBitPosition=24, ComBitSize=9, ComSignalEndianness=BIG_ENDIAN, ComSignalInitValue=0, ComSignalType=UINT16, ComSystemTemplateSystemSignalRef=FrtMidLObsDist_sech2_SecCAN2
        FrtMidLObsRngHSC2_ea600257: ComBitPosition=31, ComBitSize=4, ComSignalEndianness=BIG_ENDIAN, ComSignalInitValue=0, ComSignalType=UINT8, ComTransferProperty=PENDING, ComSystemTemplateSystemSignalRef=FrtMidLObsRngHSC2
        FrtMidLObsRng_sech2_SecCAN2_27d72756: ComBitPosition=31, ComBitSize=4, ComSignalEndianness=BIG_ENDIAN, ComSignalInitValue=0, ComSignalType=UINT8, ComSystemTemplateSystemSignalRef=FrtMidLObsRng_sech2_SecCAN2
        FrtMidRObsDist_sech2_SecCAN2_8e9167f6: ComBitPosition=21, ComBitSize=9, ComSignalEndianness=BIG_ENDIAN, ComSignalInitValue=0, ComSignalType=UINT16, ComSystemTemplateSystemSignalRef=FrtMidRObsDist_sech2_SecCAN2
        FrtMidRObsRngHSC2_ea600257: ComBitPosition=19, ComBitSize=4, ComSignalEndianness=BIG_ENDIAN, ComSignalInitValue=0, ComSignalType=UINT8, ComTransferProperty=PENDING, ComSystemTemplateSystemSignalRef=FrtMidRObsRngHSC2
        FrtMidRObsRng_sech2_SecCAN2_27d72756: ComBitPosition=19, ComBitSize=4, ComSignalEndianness=BIG_ENDIAN, ComSignalInitValue=0, ComSignalType=UINT8, ComSystemTemplateSystemSignalRef=FrtMidRObsRng_sech2_SecCAN2
        FrtObsDistHSC2_ea600257: ComBitPosition=55, ComBitSize=8, ComSignalEndianness=BIG_ENDIAN, ComSignalInitValue=0, ComSignalType=UINT8, ComTransferProperty=PENDING, ComSystemTemplateSystemSignalRef=FrtObsDistHSC2
        FrtObsDist_sech2_SecCAN2_27d72756: ComBitPosition=55, ComBitSize=8, ComSignalEndianness=BIG_ENDIAN, ComSignalInitValue=0, ComSignalType=UINT8, ComSystemTemplateSystemSignalRef=FrtObsDist_sech2_SecCAN2
        FrtPDCAudWrnngHSC2_ea600257: ComBitPosition=15, ComBitSize=4, ComSignalEndianness=BIG_ENDIAN, ComSignalInitValue=0, ComSignalType=UINT8, ComTransferProperty=PENDING, ComSystemTemplateSystemSignalRef=FrtPDCAudWrnngHSC2
        FrtPDCAudWrnng_sech2_SecCAN2_27d72756: ComBitPosition=15, ComBitSize=4, ComSignalEndianness=BIG_ENDIAN, ComSignalInitValue=0, ComSignalType=UINT8, ComSystemTemplateSystemSignalRef=FrtPDCAudWrnng_sech2_SecCAN2
        FrtPsngDoorOpenStsHSC2_762c2774: ComBitPosition=43, ComBitSize=2, ComSignalEndianness=BIG_ENDIAN, ComSignalInitValue=0, ComSignalType=UINT8, ComSystemTemplateSystemSignalRef=FrtPsngDoorOpenStsHSC2
        FrtPsngDoorOpenSts_SecCAN2_5ba847fd: ComBitPosition=43, ComBitSize=2, ComSignalEndianness=BIG_ENDIAN, ComSignalInitValue=0, ComSignalType=UINT8, ComTransferProperty=PENDING, ComSystemTemplateSystemSignalRef=FrtPsngDoorOpenSts_SecCAN2
        HCUAvlbly_h2HSC2_ab4ba2ce: ComBitPosition=12, ComBitSize=1, ComSignalEndianness=BIG_ENDIAN, ComSignalInitValue=0, ComSignalType=BOOLEAN, ComSystemTemplateSystemSignalRef=HCUAvlbly_h2HSC2
        HCUAvlbly_h2_SecCAN2_88955429: ComBitPosition=12, ComBitSize=1, ComSignalEndianness=BIG_ENDIAN, ComSignalInitValue=0, ComSignalType=BOOLEAN, ComTransferProperty=PENDING, ComSystemTemplateSystemSignalRef=HCUAvlbly_h2_SecCAN2
        HD_AVMCurViewHSC4_4337a868: ComBitPosition=51, ComBitSize=4, ComSignalEndianness=BIG_ENDIAN, ComSignalInitValue=0, ComSignalType=UINT8, ComTransferProperty=PENDING, ComSystemTemplateSystemSignalRef=HD_AVMCurViewHSC4
        HD_AVMErrorDisplay_h4HSC4_4337a868: ComBitPosition=59, ComBitSize=4, ComSignalEndianness=BIG_ENDIAN, ComSignalInitValue=0, ComSignalType=UINT8, ComTransferProperty=PENDING, ComSystemTemplateSystemSignalRef=HD_AVMErrorDisplay_h4HSC4
        HD_AVMInfoDisplayHSC4_4337a868: ComBitPosition=63, ComBitSize=4, ComSignalEndianness=BIG_ENDIAN, ComSignalInitValue=0, ComSignalType=UINT8, ComTransferProperty=PENDING, ComSystemTemplateSystemSignalRef=HD_AVMInfoDisplayHSC4
        HD_AVMVideoFmtStaHSC4_4337a868: ComBitPosition=55, ComBitSize=4, ComSignalEndianness=BIG_ENDIAN, ComSignalInitValue=0, ComSignalType=UINT8, ComTransferProperty=PENDING, ComSystemTemplateSystemSignalRef=HD_AVMVideoFmtStaHSC4
        HD_AVMsysrdyHSC4_4337a868: ComBitPosition=40, ComBitSize=1, ComSignalEndianness=BIG_ENDIAN, ComSignalInitValue=0, ComSignalType=BOOLEAN, ComTransferProperty=PENDING, ComSystemTemplateSystemSignalRef=HD_AVMsysrdyHSC4
        HourOfDayHSC2_c30fb534: ComBitPosition=28, ComBitSize=5, ComSignalEndianness=BIG_ENDIAN, ComSignalInitValue=0, ComSignalType=UINT8, ComSystemTemplateSystemSignalRef=HourOfDayHSC2
        HourOfDayHSC4_80f6c9a0: ComBitPosition=28, ComBitSize=5, ComSignalEndianness=BIG_ENDIAN, ComSignalInitValue=0, ComSignalType=UINT8, ComSystemTemplateSystemSignalRef=HourOfDayHSC4
        HourOfDay_SecCAN2_ee8bd5bd: ComBitPosition=28, ComBitSize=5, ComSignalEndianness=BIG_ENDIAN, ComSignalInitValue=0, ComSignalType=UINT8, ComTransferProperty=PENDING, ComSystemTemplateSystemSignalRef=HourOfDay_SecCAN2
        HydBstrCmpstnReqHSC2_70a619c8: ComBitPosition=54, ComBitSize=1, ComSignalEndianness=BIG_ENDIAN, ComSignalInitValue=0, ComSignalType=BOOLEAN, ComSystemTemplateSystemSignalRef=HydBstrCmpstnReqHSC2
        IECUToBCMRmtCtrlPotclHSC2_4372be29: ComBitPosition=0, ComSignalEndianness=opaque, ComSignalInitValue=0 0 0 0 0 0 0 0, ComSignalLength=8, ComSignalType=UINT8_N, ComTransferProperty=PENDING, ComSystemTemplateSystemSignalRef=IECUToBCMRmtCtrlPotclHSC2
        IECUToTBOXCtrlPotclHSC4_ccb7c509: ComBitPosition=0, ComSignalEndianness=opaque, ComSignalInitValue=0 0 0 0 0 0 0 0, ComSignalLength=8, ComSignalType=UINT8_N, ComTransferProperty=PENDING, ComSystemTemplateSystemSignalRef=IECUToTBOXCtrlPotclHSC4
        IPCAvlbly_h2HSC2_ab4ba2ce: ComBitPosition=30, ComBitSize=1, ComSignalEndianness=BIG_ENDIAN, ComSignalInitValue=0, ComSignalType=BOOLEAN, ComSystemTemplateSystemSignalRef=IPCAvlbly_h2HSC2
        IPCAvlbly_h2_SecCAN2_88955429: ComBitPosition=30, ComBitSize=1, ComSignalEndianness=BIG_ENDIAN, ComSignalInitValue=0, ComSignalType=BOOLEAN, ComTransferProperty=PENDING, ComSystemTemplateSystemSignalRef=IPCAvlbly_h2_SecCAN2
        LDircnIOHSC2_762c2774: ComBitPosition=11, ComBitSize=1, ComSignalEndianness=BIG_ENDIAN, ComSignalInitValue=0, ComSignalType=BOOLEAN, ComSystemTemplateSystemSignalRef=LDircnIOHSC2
        LDircnIO_SecCAN2_5ba847fd: ComBitPosition=37, ComBitSize=1, ComSignalEndianness=BIG_ENDIAN, ComSignalInitValue=0, ComSignalType=BOOLEAN, ComTransferProperty=PENDING, ComSystemTemplateSystemSignalRef=LDircnIO_SecCAN2
        LDrvnWhlRotlDistPlsCtrHSC2_16026180: ComBitPosition=1, ComBitSize=10, ComSignalEndianness=BIG_ENDIAN, ComSignalInitValue=0, ComSignalType=UINT16, ComSystemTemplateSystemSignalRef=LDrvnWhlRotlDistPlsCtrHSC2
        LDrvnWhlRotlDistPlsCtr_SecCAN2_3a848fe4: ComBitPosition=1, ComBitSize=10, ComSignalEndianness=BIG_ENDIAN, ComSignalInitValue=0, ComSignalType=UINT16, ComTransferProperty=PENDING, ComSystemTemplateSystemSignalRef=LDrvnWhlRotlDistPlsCtr_SecCAN2
        LDrvnWhlRotlDistTRCHSC2_16026180: ComBitPosition=7, ComBitSize=2, ComSignalEndianness=BIG_ENDIAN, ComSignalInitValue=0, ComSignalType=UINT8, ComSystemTemplateSystemSignalRef=LDrvnWhlRotlDistTRCHSC2
        LDrvnWhlRotlDistTRC_SecCAN2_3a848fe4: ComBitPosition=7, ComBitSize=2, ComSignalEndianness=BIG_ENDIAN, ComSignalInitValue=0, ComSignalType=UINT8, ComTransferProperty=PENDING, ComSystemTemplateSystemSignalRef=LDrvnWhlRotlDistTRC_SecCAN2
        LDrvnWhlRotlDistTmspHSC2_16026180: ComBitPosition=23, ComBitSize=16, ComSignalEndianness=BIG_ENDIAN, ComSignalInitValue=0, ComSignalType=UINT16, ComSystemTemplateSystemSignalRef=LDrvnWhlRotlDistTmspHSC2
        LDrvnWhlRotlDistTmsp_SecCAN2_3a848fe4: ComBitPosition=23, ComBitSize=16, ComSignalEndianness=BIG_ENDIAN, ComSignalInitValue=0, ComSignalType=UINT16, ComTransferProperty=PENDING, ComSystemTemplateSystemSignalRef=LDrvnWhlRotlDistTmsp_SecCAN2
        LDrvnWhlRotlDistVHSC2_16026180: ComBitPosition=2, ComBitSize=1, ComSignalEndianness=BIG_ENDIAN, ComSignalInitValue=0, ComSignalType=BOOLEAN, ComSystemTemplateSystemSignalRef=LDrvnWhlRotlDistVHSC2
        LDrvnWhlRotlDistV_SecCAN2_3a848fe4: ComBitPosition=2, ComBitSize=1, ComSignalEndianness=BIG_ENDIAN, ComSignalInitValue=0, ComSignalType=BOOLEAN, ComTransferProperty=PENDING, ComSystemTemplateSystemSignalRef=LDrvnWhlRotlDistV_SecCAN2
        LDrvnWhlRotlRstOcdHSC2_16026180: ComBitPosition=3, ComBitSize=1, ComSignalEndianness=BIG_ENDIAN, ComSignalInitValue=0, ComSignalType=BOOLEAN, ComSystemTemplateSystemSignalRef=LDrvnWhlRotlRstOcdHSC2
        LDrvnWhlRotlRstOcd_SecCAN2_3a848fe4: ComBitPosition=3, ComBitSize=1, ComSignalEndianness=BIG_ENDIAN, ComSignalInitValue=0, ComSignalType=BOOLEAN, ComTransferProperty=PENDING, ComSystemTemplateSystemSignalRef=LDrvnWhlRotlRstOcd_SecCAN2
        LDrvnWhlRotlSeqNumHSC2_16026180: ComBitPosition=5, ComBitSize=2, ComSignalEndianness=BIG_ENDIAN, ComSignalInitValue=0, ComSignalType=UINT8, ComSystemTemplateSystemSignalRef=LDrvnWhlRotlSeqNumHSC2
        LDrvnWhlRotlSeqNum_SecCAN2_3a848fe4: ComBitPosition=5, ComBitSize=2, ComSignalEndianness=BIG_ENDIAN, ComSignalInitValue=0, ComSignalType=UINT8, ComTransferProperty=PENDING, ComSystemTemplateSystemSignalRef=LDrvnWhlRotlSeqNum_SecCAN2
        LNonDrvnWhlRotlDircnHSC2_988d6663: ComBitPosition=33, ComBitSize=2, ComSignalEndianness=BIG_ENDIAN, ComSignalInitValue=3, ComSignalType=UINT8, ComSystemTemplateSystemSignalRef=LNonDrvnWhlRotlDircnHSC2
        LNonDrvnWhlRotlDircn_SecCAN2_b40b8807: ComBitPosition=33, ComBitSize=2, ComSignalEndianness=BIG_ENDIAN, ComSignalInitValue=3, ComSignalType=UINT8, ComTransferProperty=PENDING, ComSystemTemplateSystemSignalRef=LNonDrvnWhlRotlDircn_SecCAN2
        LNonDrvnWhlRotlDistPCHSC2_daa8611e: ComBitPosition=1, ComBitSize=10, ComSignalEndianness=BIG_ENDIAN, ComSignalInitValue=0, ComSignalType=UINT16, ComSystemTemplateSystemSignalRef=LNonDrvnWhlRotlDistPCHSC2
        LNonDrvnWhlRotlDistPC_SecCAN2_f62e8f7a: ComBitPosition=1, ComBitSize=10, ComSignalEndianness=BIG_ENDIAN, ComSignalInitValue=0, ComSignalType=UINT16, ComTransferProperty=PENDING, ComSystemTemplateSystemSignalRef=LNonDrvnWhlRotlDistPC_SecCAN2
        LNonDrvnWhlRotlDistTHSC2_daa8611e: ComBitPosition=23, ComBitSize=16, ComSignalEndianness=BIG_ENDIAN, ComSignalInitValue=0, ComSignalType=UINT16, ComSystemTemplateSystemSignalRef=LNonDrvnWhlRotlDistTHSC2
        LNonDrvnWhlRotlDistTRCHSC2_daa8611e: ComBitPosition=7, ComBitSize=2, ComSignalEndianness=BIG_ENDIAN, ComSignalInitValue=0, ComSignalType=UINT8, ComSystemTemplateSystemSignalRef=LNonDrvnWhlRotlDistTRCHSC2
        LNonDrvnWhlRotlDistTRC_SecCAN2_f62e8f7a: ComBitPosition=7, ComBitSize=2, ComSignalEndianness=BIG_ENDIAN, ComSignalInitValue=0, ComSignalType=UINT8, ComTransferProperty=PENDING, ComSystemTemplateSystemSignalRef=LNonDrvnWhlRotlDistTRC_SecCAN2
        LNonDrvnWhlRotlDistT_SecCAN2_f62e8f7a: ComBitPosition=23, ComBitSize=16, ComSignalEndianness=BIG_ENDIAN, ComSignalInitValue=0, ComSignalType=UINT16, ComTransferProperty=PENDING, ComSystemTemplateSystemSignalRef=LNonDrvnWhlRotlDistT_SecCAN2
        LNonDrvnWhlRotlDistVHSC2_daa8611e: ComBitPosition=2, ComBitSize=1, ComSignalEndianness=BIG_ENDIAN, ComSignalInitValue=0, ComSignalType=BOOLEAN, ComSystemTemplateSystemSignalRef=LNonDrvnWhlRotlDistVHSC2
        LNonDrvnWhlRotlDistV_SecCAN2_f62e8f7a: ComBitPosition=2, ComBitSize=1, ComSignalEndianness=BIG_ENDIAN, ComSignalInitValue=0, ComSignalType=BOOLEAN, ComTransferProperty=PENDING, ComSystemTemplateSystemSignalRef=LNonDrvnWhlRotlDistV_SecCAN2
        LNonDrvnWhlRotlRstOcdHSC2_daa8611e: ComBitPosition=3, ComBitSize=1, ComSignalEndianness=BIG_ENDIAN, ComSignalInitValue=0, ComSignalType=BOOLEAN, ComSystemTemplateSystemSignalRef=LNonDrvnWhlRotlRstOcdHSC2
        LNonDrvnWhlRotlRstOcd_SecCAN2_f62e8f7a: ComBitPosition=3, ComBitSize=1, ComSignalEndianness=BIG_ENDIAN, ComSignalInitValue=0, ComSignalType=BOOLEAN, ComTransferProperty=PENDING, ComSystemTemplateSystemSignalRef=LNonDrvnWhlRotlRstOcd_SecCAN2
        LNonDrvnWhlRotlSeqNumHSC2_daa8611e: ComBitPosition=5, ComBitSize=2, ComSignalEndianness=BIG_ENDIAN, ComSignalInitValue=0, ComSignalType=UINT8, ComSystemTemplateSystemSignalRef=LNonDrvnWhlRotlSeqNumHSC2
        LNonDrvnWhlRotlSeqNum_SecCAN2_f62e8f7a: ComBitPosition=5, ComBitSize=2, ComSignalEndianness=BIG_ENDIAN, ComSignalInitValue=0, ComSignalType=UINT8, ComTransferProperty=PENDING, ComSystemTemplateSystemSignalRef=LNonDrvnWhlRotlSeqNum_SecCAN2
        LRCTAWrnngHSC4_693ba2af: ComBitPosition=3, ComBitSize=2, ComSignalEndianness=BIG_ENDIAN, ComSignalInitValue=0, ComSignalType=UINT8, ComSystemTemplateSystemSignalRef=LRCTAWrnngHSC4
        LdspcOpenStsHSC2_762c2774: ComBitPosition=7, ComBitSize=2, ComSignalEndianness=BIG_ENDIAN, ComSignalInitValue=0, ComSignalType=UINT8, ComSystemTemplateSystemSignalRef=LdspcOpenStsHSC2
        LdspcOpenSts_SecCAN2_5ba847fd: ComBitPosition=48, ComBitSize=2, ComSignalEndianness=BIG_ENDIAN, ComSignalInitValue=0, ComSignalType=UINT8, ComTransferProperty=PENDING, ComSystemTemplateSystemSignalRef=LdspcOpenSts_SecCAN2
        MainBeamLghtOnHSC2_762c2774: ComBitPosition=15, ComBitSize=1, ComSignalEndianness=BIG_ENDIAN, ComSignalInitValue=0, ComSignalType=BOOLEAN, ComSystemTemplateSystemSignalRef=MainBeamLghtOnHSC2
        MinuteOfHourHSC2_c30fb534: ComBitPosition=37, ComBitSize=6, ComSignalEndianness=BIG_ENDIAN, ComSignalInitValue=0, ComSignalType=UINT8, ComSystemTemplateSystemSignalRef=MinuteOfHourHSC2
        MinuteOfHourHSC4_80f6c9a0: ComBitPosition=37, ComBitSize=6, ComSignalEndianness=BIG_ENDIAN, ComSignalInitValue=0, ComSignalType=UINT8, ComSystemTemplateSystemSignalRef=MinuteOfHourHSC4
        MinuteOfHour_SecCAN2_ee8bd5bd: ComBitPosition=37, ComBitSize=6, ComSignalEndianness=BIG_ENDIAN, ComSignalInitValue=0, ComSignalType=UINT8, ComTransferProperty=PENDING, ComSystemTemplateSystemSignalRef=MinuteOfHour_SecCAN2
        NRCDAlvRCHSC2_6ae5c0ff: ComBitPosition=39, ComBitSize=8, ComSignalEndianness=BIG_ENDIAN, ComSignalInitValue=0, ComSignalType=UINT8, ComSystemTemplateSystemSignalRef=NRCDAlvRCHSC2
        NRCDAlvRC_SecCAN2_d64f184b: ComBitPosition=55, ComBitSize=8, ComSignalEndianness=BIG_ENDIAN, ComSignalInitValue=0, ComSignalType=UINT8, ComTransferProperty=PENDING, ComSystemTemplateSystemSignalRef=NRCDAlvRC_SecCAN2
        NRCDFHSC2_6ae5c0ff: ComBitPosition=5, ComBitSize=1, ComSignalEndianness=BIG_ENDIAN, ComSignalInitValue=0, ComSignalType=BOOLEAN, ComSystemTemplateSystemSignalRef=NRCDFHSC2
        NRCDF_SecCAN2_d64f184b: ComBitPosition=21, ComBitSize=1, ComSignalEndianness=BIG_ENDIAN, ComSignalInitValue=0, ComSignalType=BOOLEAN, ComTransferProperty=PENDING, ComSystemTemplateSystemSignalRef=NRCDF_SecCAN2
        NRCDMstrChlg_h2HSC2_407c19cd: ComBitPosition=0, ComSignalEndianness=opaque, ComSignalInitValue=0 0 0 0 0 0 0 0, ComSignalLength=8, ComSignalType=UINT8_N, ComSystemTemplateSystemSignalRef=NRCDMstrChlg_h2HSC2
        NRCDMstrChlg_h2_SecCAN2_63a2ef2a: ComBitPosition=0, ComSignalEndianness=opaque, ComSignalInitValue=0 0 0 0 0 0 0 0, ComSignalLength=8, ComSignalType=UINT8_N, ComTransferProperty=PENDING, ComSystemTemplateSystemSignalRef=NRCDMstrChlg_h2_SecCAN2
        NRCDSts_h2HSC2_32bfb16e: ComBitPosition=39, ComBitSize=2, ComSignalEndianness=BIG_ENDIAN, ComSignalInitValue=0, ComSignalType=UINT8, ComSystemTemplateSystemSignalRef=NRCDSts_h2HSC2
        NRCDSts_h2_SecCAN2_11614789: ComBitPosition=25, ComBitSize=2, ComSignalEndianness=BIG_ENDIAN, ComSignalInitValue=0, ComSignalType=UINT8, ComTransferProperty=PENDING, ComSystemTemplateSystemSignalRef=NRCDSts_h2_SecCAN2
        OtsdAirTemCrValMsk_h2HSC2_bc30b68d: ComBitPosition=51, ComBitSize=1, ComSignalEndianness=BIG_ENDIAN, ComSignalInitValue=0, ComSignalType=BOOLEAN, ComSystemTemplateSystemSignalRef=OtsdAirTemCrValMsk_h2HSC2
        OtsdAirTemCrValMsk_h2_SecCAN2_9fee406a: ComBitPosition=51, ComBitSize=1, ComSignalEndianness=BIG_ENDIAN, ComSignalInitValue=0, ComSignalType=BOOLEAN, ComTransferProperty=PENDING, ComSystemTemplateSystemSignalRef=OtsdAirTemCrValMsk_h2_SecCAN2
        OtsdAirTemCrValV_h2HSC2_bc30b68d: ComBitPosition=48, ComBitSize=1, ComSignalEndianness=BIG_ENDIAN, ComSignalInitValue=0, ComSignalType=BOOLEAN, ComSystemTemplateSystemSignalRef=OtsdAirTemCrValV_h2HSC2
        OtsdAirTemCrValV_h2_SecCAN2_9fee406a: ComBitPosition=48, ComBitSize=1, ComSignalEndianness=BIG_ENDIAN, ComSignalInitValue=0, ComSignalType=BOOLEAN, ComTransferProperty=PENDING, ComSystemTemplateSystemSignalRef=OtsdAirTemCrValV_h2_SecCAN2
        OtsdAirTemCrVal_h2HSC2_bc30b68d: ComBitPosition=63, ComBitSize=8, ComSignalEndianness=BIG_ENDIAN, ComSignalInitValue=0, ComSignalType=UINT8, ComSystemTemplateSystemSignalRef=OtsdAirTemCrVal_h2HSC2
        OtsdAirTemCrVal_h2_SecCAN2_9fee406a: ComBitPosition=63, ComBitSize=8, ComSignalEndianness=BIG_ENDIAN, ComSignalInitValue=0, ComSignalType=UINT8, ComTransferProperty=PENDING, ComSystemTemplateSystemSignalRef=OtsdAirTemCrVal_h2_SecCAN2
        P2PACTMdChngTmotHSC4_65a57977: ComBitPosition=7, ComBitSize=8, ComSignalEndianness=BIG_ENDIAN, ComSignalInitValue=0, ComSignalType=UINT8, ComTransferProperty=PENDING, ComSystemTemplateSystemSignalRef=P2PACTMdChngTmotHSC4
        P2PDisplayHSC4_65a57977: ComBitPosition=15, ComBitSize=8, ComSignalEndianness=BIG_ENDIAN, ComSignalInitValue=0, ComSignalType=UINT8, ComTransferProperty=PENDING, ComSystemTemplateSystemSignalRef=P2PDisplayHSC4
        P2PExeAvlblHSC4_09f4c130: ComBitPosition=28, ComBitSize=1, ComSignalEndianness=BIG_ENDIAN, ComSignalInitValue=0, ComSignalType=BOOLEAN, ComSystemTemplateSystemSignalRef=P2PExeAvlblHSC4
        P2PExeAvlblVHSC4_09f4c130: ComBitPosition=29, ComBitSize=1, ComSignalEndianness=BIG_ENDIAN, ComSignalInitValue=0, ComSignalType=BOOLEAN, ComSystemTemplateSystemSignalRef=P2PExeAvlblVHSC4
        P2PProgressHSC4_65a57977: ComBitPosition=23, ComBitSize=4, ComSignalEndianness=BIG_ENDIAN, ComSignalInitValue=0, ComSignalType=UINT8, ComTransferProperty=PENDING, ComSystemTemplateSystemSignalRef=P2PProgressHSC4
        P2PSwReqHSC4_8dbecfca: ComBitPosition=15, ComBitSize=1, ComSignalEndianness=BIG_ENDIAN, ComSignalInitValue=0, ComSignalType=BOOLEAN, ComSystemTemplateSystemSignalRef=P2PSwReqHSC4
        PDCCofignStsHSC2_ea600257: ComBitPosition=42, ComBitSize=3, ComSignalEndianness=BIG_ENDIAN, ComSignalInitValue=1, ComSignalType=UINT8, ComTransferProperty=PENDING, ComSystemTemplateSystemSignalRef=PDCCofignStsHSC2
        PDCCofignSts_sech2_SecCAN2_27d72756: ComBitPosition=42, ComBitSize=3, ComSignalEndianness=BIG_ENDIAN, ComSignalInitValue=1, ComSignalType=UINT8, ComSystemTemplateSystemSignalRef=PDCCofignSts_sech2_SecCAN2
        PDCSwReqHSC2_46783686: ComBitPosition=61, ComBitSize=2, ComSignalEndianness=BIG_ENDIAN, ComSignalInitValue=0, ComSignalType=UINT8, ComSystemTemplateSystemSignalRef=PDCSwReqHSC2
        PDCSwReqHSC4_687c4159: ComBitPosition=61, ComBitSize=2, ComSignalEndianness=BIG_ENDIAN, ComSignalInitValue=0, ComSignalType=UINT8, ComSystemTemplateSystemSignalRef=PDCSwReqHSC4
        PDCSwReq_SecCAN2_0e098acc: ComBitPosition=61, ComBitSize=2, ComSignalEndianness=BIG_ENDIAN, ComSignalInitValue=0, ComSignalType=UINT8, ComTransferProperty=PENDING, ComSystemTemplateSystemSignalRef=PDCSwReq_SecCAN2
        PDCSysStsHSC2_ea600257: ComBitPosition=7, ComBitSize=4, ComSignalEndianness=BIG_ENDIAN, ComSignalInitValue=0, ComSignalType=UINT8, ComTransferProperty=PENDING, ComSystemTemplateSystemSignalRef=PDCSysStsHSC2
        PDCSysSts_sech2_SecCAN2_27d72756: ComBitPosition=7, ComBitSize=4, ComSignalEndianness=BIG_ENDIAN, ComSignalInitValue=0, ComSignalType=UINT8, ComSystemTemplateSystemSignalRef=PDCSysSts_sech2_SecCAN2
        PEPSSSBAHSC4_5c9d774f: ComBitPosition=56, ComBitSize=1, ComSignalEndianness=BIG_ENDIAN, ComSignalInitValue=0, ComSignalType=BOOLEAN, ComSystemTemplateSystemSignalRef=PEPSSSBAHSC4
        PEPSSSBAVHSC4_5c9d774f: ComBitPosition=61, ComBitSize=1, ComSignalEndianness=BIG_ENDIAN, ComSignalInitValue=0, ComSignalType=BOOLEAN, ComSystemTemplateSystemSignalRef=PEPSSSBAVHSC4
        PEPSSSBFltStsHSC4_d21270ac: ComBitPosition=54, ComBitSize=3, ComSignalEndianness=BIG_ENDIAN, ComSignalInitValue=0, ComSignalType=UINT8, ComSystemTemplateSystemSignalRef=PEPSSSBFltStsHSC4
        Peak_LRU1_18ef6e8d: ComBitPosition=16, ComBitSize=8, ComSignalEndianness=LITTLE_ENDIAN, ComSignalInitValue=0, ComSignalType=UINT8, ComSystemTemplateSystemSignalRef=Peak_LRU1
        PwrMdAutoCtrlAvlblHSC2_f8a32097: ComBitPosition=2, ComBitSize=1, ComSignalEndianness=BIG_ENDIAN, ComSignalInitValue=0, ComSignalType=BOOLEAN, ComSystemTemplateSystemSignalRef=PwrMdAutoCtrlAvlblHSC2
        PwrMdMstrAccryA_h2HSC2_67e1a250: ComBitPosition=2, ComBitSize=1, ComSignalEndianness=BIG_ENDIAN, ComSignalInitValue=0, ComSignalType=BOOLEAN, ComSystemTemplateSystemSignalRef=PwrMdMstrAccryA_h2HSC2
        PwrMdMstrAccryA_h2_SecCAN2_443f54b7: ComBitPosition=2, ComBitSize=1, ComSignalEndianness=BIG_ENDIAN, ComSignalInitValue=0, ComSignalType=BOOLEAN, ComTransferProperty=PENDING, ComSystemTemplateSystemSignalRef=PwrMdMstrAccryA_h2_SecCAN2
        PwrMdMstrRunCrkA_h2HSC2_67e1a250: ComBitPosition=3, ComBitSize=1, ComSignalEndianness=BIG_ENDIAN, ComSignalInitValue=0, ComSignalType=BOOLEAN, ComSystemTemplateSystemSignalRef=PwrMdMstrRunCrkA_h2HSC2
        PwrMdMstrRunCrkA_h2_SecCAN2_443f54b7: ComBitPosition=3, ComBitSize=1, ComSignalEndianness=BIG_ENDIAN, ComSignalInitValue=0, ComSignalType=BOOLEAN, ComTransferProperty=PENDING, ComSystemTemplateSystemSignalRef=PwrMdMstrRunCrkA_h2_SecCAN2
        RDircnIOHSC2_762c2774: ComBitPosition=9, ComBitSize=1, ComSignalEndianness=BIG_ENDIAN, ComSignalInitValue=0, ComSignalType=BOOLEAN, ComSystemTemplateSystemSignalRef=RDircnIOHSC2
        RDircnIO_SecCAN2_5ba847fd: ComBitPosition=38, ComBitSize=1, ComSignalEndianness=BIG_ENDIAN, ComSignalInitValue=0, ComSignalType=BOOLEAN, ComTransferProperty=PENDING, ComSystemTemplateSystemSignalRef=RDircnIO_SecCAN2
        RDrvnWhlRotlDistPlsCtrHSC2_16026180: ComBitPosition=33, ComBitSize=10, ComSignalEndianness=BIG_ENDIAN, ComSignalInitValue=0, ComSignalType=UINT16, ComSystemTemplateSystemSignalRef=RDrvnWhlRotlDistPlsCtrHSC2
        RDrvnWhlRotlDistPlsCtr_SecCAN2_3a848fe4: ComBitPosition=33, ComBitSize=10, ComSignalEndianness=BIG_ENDIAN, ComSignalInitValue=0, ComSignalType=UINT16, ComTransferProperty=PENDING, ComSystemTemplateSystemSignalRef=RDrvnWhlRotlDistPlsCtr_SecCAN2
        RDrvnWhlRotlDistTRCHSC2_16026180: ComBitPosition=39, ComBitSize=2, ComSignalEndianness=BIG_ENDIAN, ComSignalInitValue=0, ComSignalType=UINT8, ComSystemTemplateSystemSignalRef=RDrvnWhlRotlDistTRCHSC2
        RDrvnWhlRotlDistTRC_SecCAN2_3a848fe4: ComBitPosition=39, ComBitSize=2, ComSignalEndianness=BIG_ENDIAN, ComSignalInitValue=0, ComSignalType=UINT8, ComTransferProperty=PENDING, ComSystemTemplateSystemSignalRef=RDrvnWhlRotlDistTRC_SecCAN2
        RDrvnWhlRotlDistTmspHSC2_16026180: ComBitPosition=55, ComBitSize=16, ComSignalEndianness=BIG_ENDIAN, ComSignalInitValue=0, ComSignalType=UINT16, ComSystemTemplateSystemSignalRef=RDrvnWhlRotlDistTmspHSC2
        RDrvnWhlRotlDistTmsp_SecCAN2_3a848fe4: ComBitPosition=55, ComBitSize=16, ComSignalEndianness=BIG_ENDIAN, ComSignalInitValue=0, ComSignalType=UINT16, ComTransferProperty=PENDING, ComSystemTemplateSystemSignalRef=RDrvnWhlRotlDistTmsp_SecCAN2
        RDrvnWhlRotlDistVHSC2_16026180: ComBitPosition=34, ComBitSize=1, ComSignalEndianness=BIG_ENDIAN, ComSignalInitValue=0, ComSignalType=BOOLEAN, ComSystemTemplateSystemSignalRef=RDrvnWhlRotlDistVHSC2
        RDrvnWhlRotlDistV_SecCAN2_3a848fe4: ComBitPosition=34, ComBitSize=1, ComSignalEndianness=BIG_ENDIAN, ComSignalInitValue=0, ComSignalType=BOOLEAN, ComTransferProperty=PENDING, ComSystemTemplateSystemSignalRef=RDrvnWhlRotlDistV_SecCAN2
        RDrvnWhlRotlRstOcdHSC2_16026180: ComBitPosition=35, ComBitSize=1, ComSignalEndianness=BIG_ENDIAN, ComSignalInitValue=0, ComSignalType=BOOLEAN, ComSystemTemplateSystemSignalRef=RDrvnWhlRotlRstOcdHSC2
        RDrvnWhlRotlRstOcd_SecCAN2_3a848fe4: ComBitPosition=35, ComBitSize=1, ComSignalEndianness=BIG_ENDIAN, ComSignalInitValue=0, ComSignalType=BOOLEAN, ComTransferProperty=PENDING, ComSystemTemplateSystemSignalRef=RDrvnWhlRotlRstOcd_SecCAN2
        RDrvnWhlRotlSeqNumHSC2_16026180: ComBitPosition=37, ComBitSize=2, ComSignalEndianness=BIG_ENDIAN, ComSignalInitValue=0, ComSignalType=UINT8, ComSystemTemplateSystemSignalRef=RDrvnWhlRotlSeqNumHSC2
        RDrvnWhlRotlSeqNum_SecCAN2_3a848fe4: ComBitPosition=37, ComBitSize=2, ComSignalEndianness=BIG_ENDIAN, ComSignalInitValue=0, ComSignalType=UINT8, ComTransferProperty=PENDING, ComSystemTemplateSystemSignalRef=RDrvnWhlRotlSeqNum_SecCAN2
        RLDoorOpenStsHSC2_762c2774: ComBitPosition=41, ComBitSize=2, ComSignalEndianness=BIG_ENDIAN, ComSignalInitValue=0, ComSignalType=UINT8, ComSystemTemplateSystemSignalRef=RLDoorOpenStsHSC2
        RLDoorOpenSts_SecCAN2_5ba847fd: ComBitPosition=50, ComBitSize=2, ComSignalEndianness=BIG_ENDIAN, ComSignalInitValue=0, ComSignalType=UINT8, ComTransferProperty=PENDING, ComSystemTemplateSystemSignalRef=RLDoorOpenSts_SecCAN2
        RLObsDist_sech2_SecCAN2_84546eef: ComBitPosition=14, ComBitSize=9, ComSignalEndianness=BIG_ENDIAN, ComSignalInitValue=0, ComSignalType=UINT16, ComSystemTemplateSystemSignalRef=RLObsDist_sech2_SecCAN2
        RLObsRngHSC2_ea600257: ComBitPosition=39, ComBitSize=4, ComSignalEndianness=BIG_ENDIAN, ComSignalInitValue=0, ComSignalType=UINT8, ComTransferProperty=PENDING, ComSystemTemplateSystemSignalRef=RLObsRngHSC2
        RLObsRng_sech2_SecCAN2_27d72756: ComBitPosition=39, ComBitSize=4, ComSignalEndianness=BIG_ENDIAN, ComSignalInitValue=0, ComSignalType=UINT8, ComSystemTemplateSystemSignalRef=RLObsRng_sech2_SecCAN2
        RLSideObsDistHSC2_e0a50b4e: ComBitPosition=16, ComBitSize=9, ComSignalEndianness=BIG_ENDIAN, ComSignalInitValue=0, ComSignalType=UINT16, ComTransferProperty=PENDING, ComSystemTemplateSystemSignalRef=RLSideObsDistHSC2
        RLSideObsDist_sech2_SecCAN2_eb7d27c8: ComBitPosition=16, ComBitSize=9, ComSignalEndianness=BIG_ENDIAN, ComSignalInitValue=0, ComSignalType=UINT16, ComSystemTemplateSystemSignalRef=RLSideObsDist_sech2_SecCAN2
        RLTirePrsHSC4_fa528d8c: ComBitPosition=30, ComBitSize=7, ComSignalEndianness=BIG_ENDIAN, ComSignalInitValue=55, ComSignalType=UINT8, ComSystemTemplateSystemSignalRef=RLTirePrsHSC4
        RLTirePrsVHSC4_fa528d8c: ComBitPosition=31, ComBitSize=1, ComSignalEndianness=BIG_ENDIAN, ComSignalInitValue=0, ComSignalType=BOOLEAN, ComSystemTemplateSystemSignalRef=RLTirePrsVHSC4
        RNonDrvnWhlRotlDircnHSC2_988d6663: ComBitPosition=35, ComBitSize=2, ComSignalEndianness=BIG_ENDIAN, ComSignalInitValue=3, ComSignalType=UINT8, ComSystemTemplateSystemSignalRef=RNonDrvnWhlRotlDircnHSC2
        RNonDrvnWhlRotlDircn_SecCAN2_b40b8807: ComBitPosition=35, ComBitSize=2, ComSignalEndianness=BIG_ENDIAN, ComSignalInitValue=3, ComSignalType=UINT8, ComTransferProperty=PENDING, ComSystemTemplateSystemSignalRef=RNonDrvnWhlRotlDircn_SecCAN2
        RNonDrvnWhlRotlDistPCHSC2_daa8611e: ComBitPosition=33, ComBitSize=10, ComSignalEndianness=BIG_ENDIAN, ComSignalInitValue=0, ComSignalType=UINT16, ComSystemTemplateSystemSignalRef=RNonDrvnWhlRotlDistPCHSC2
        RNonDrvnWhlRotlDistPC_SecCAN2_f62e8f7a: ComBitPosition=33, ComBitSize=10, ComSignalEndianness=BIG_ENDIAN, ComSignalInitValue=0, ComSignalType=UINT16, ComTransferProperty=PENDING, ComSystemTemplateSystemSignalRef=RNonDrvnWhlRotlDistPC_SecCAN2
        RNonDrvnWhlRotlDistTHSC2_daa8611e: ComBitPosition=55, ComBitSize=16, ComSignalEndianness=BIG_ENDIAN, ComSignalInitValue=0, ComSignalType=UINT16, ComSystemTemplateSystemSignalRef=RNonDrvnWhlRotlDistTHSC2
        RNonDrvnWhlRotlDistTRCHSC2_daa8611e: ComBitPosition=39, ComBitSize=2, ComSignalEndianness=BIG_ENDIAN, ComSignalInitValue=0, ComSignalType=UINT8, ComSystemTemplateSystemSignalRef=RNonDrvnWhlRotlDistTRCHSC2
        RNonDrvnWhlRotlDistTRC_SecCAN2_f62e8f7a: ComBitPosition=39, ComBitSize=2, ComSignalEndianness=BIG_ENDIAN, ComSignalInitValue=0, ComSignalType=UINT8, ComTransferProperty=PENDING, ComSystemTemplateSystemSignalRef=RNonDrvnWhlRotlDistTRC_SecCAN2
        RNonDrvnWhlRotlDistT_SecCAN2_f62e8f7a: ComBitPosition=55, ComBitSize=16, ComSignalEndianness=BIG_ENDIAN, ComSignalInitValue=0, ComSignalType=UINT16, ComTransferProperty=PENDING, ComSystemTemplateSystemSignalRef=RNonDrvnWhlRotlDistT_SecCAN2
        RNonDrvnWhlRotlDistVHSC2_daa8611e: ComBitPosition=34, ComBitSize=1, ComSignalEndianness=BIG_ENDIAN, ComSignalInitValue=0, ComSignalType=BOOLEAN, ComSystemTemplateSystemSignalRef=RNonDrvnWhlRotlDistVHSC2
        RNonDrvnWhlRotlDistV_SecCAN2_f62e8f7a: ComBitPosition=34, ComBitSize=1, ComSignalEndianness=BIG_ENDIAN, ComSignalInitValue=0, ComSignalType=BOOLEAN, ComTransferProperty=PENDING, ComSystemTemplateSystemSignalRef=RNonDrvnWhlRotlDistV_SecCAN2
        RNonDrvnWhlRotlRstOcdHSC2_daa8611e: ComBitPosition=35, ComBitSize=1, ComSignalEndianness=BIG_ENDIAN, ComSignalInitValue=0, ComSignalType=BOOLEAN, ComSystemTemplateSystemSignalRef=RNonDrvnWhlRotlRstOcdHSC2
        RNonDrvnWhlRotlRstOcd_SecCAN2_f62e8f7a: ComBitPosition=35, ComBitSize=1, ComSignalEndianness=BIG_ENDIAN, ComSignalInitValue=0, ComSignalType=BOOLEAN, ComTransferProperty=PENDING, ComSystemTemplateSystemSignalRef=RNonDrvnWhlRotlRstOcd_SecCAN2
        RNonDrvnWhlRotlSeqNumHSC2_daa8611e: ComBitPosition=37, ComBitSize=2, ComSignalEndianness=BIG_ENDIAN, ComSignalInitValue=0, ComSignalType=UINT8, ComSystemTemplateSystemSignalRef=RNonDrvnWhlRotlSeqNumHSC2
        RNonDrvnWhlRotlSeqNum_SecCAN2_f62e8f7a: ComBitPosition=37, ComBitSize=2, ComSignalEndianness=BIG_ENDIAN, ComSignalInitValue=0, ComSignalType=UINT8, ComTransferProperty=PENDING, ComSystemTemplateSystemSignalRef=RNonDrvnWhlRotlSeqNum_SecCAN2
        RRCTAWrnngHSC4_693ba2af: ComBitPosition=1, ComBitSize=2, ComSignalEndianness=BIG_ENDIAN, ComSignalInitValue=0, ComSignalType=UINT8, ComSystemTemplateSystemSignalRef=RRCTAWrnngHSC4
        RRDoorOpenStsHSC2_762c2774: ComBitPosition=5, ComBitSize=2, ComSignalEndianness=BIG_ENDIAN, ComSignalInitValue=0, ComSignalType=UINT8, ComSystemTemplateSystemSignalRef=RRDoorOpenStsHSC2
        RRDoorOpenSts_SecCAN2_5ba847fd: ComBitPosition=41, ComBitSize=2, ComSignalEndianness=BIG_ENDIAN, ComSignalInitValue=0, ComSignalType=UINT8, ComTransferProperty=PENDING, ComSystemTemplateSystemSignalRef=RRDoorOpenSts_SecCAN2
        RRObsDist_sech2_SecCAN2_84546eef: ComBitPosition=7, ComBitSize=9, ComSignalEndianness=BIG_ENDIAN, ComSignalInitValue=0, ComSignalType=UINT16, ComSystemTemplateSystemSignalRef=RRObsDist_sech2_SecCAN2
        RRObsRngHSC2_ea600257: ComBitPosition=27, ComBitSize=4, ComSignalEndianness=BIG_ENDIAN, ComSignalInitValue=0, ComSignalType=UINT8, ComTransferProperty=PENDING, ComSystemTemplateSystemSignalRef=RRObsRngHSC2
        RRObsRng_sech2_SecCAN2_27d72756: ComBitPosition=27, ComBitSize=4, ComSignalEndianness=BIG_ENDIAN, ComSignalInitValue=0, ComSignalType=UINT8, ComSystemTemplateSystemSignalRef=RRObsRng_sech2_SecCAN2
        RRSideObsDistHSC2_e0a50b4e: ComBitPosition=0, ComBitSize=9, ComSignalEndianness=BIG_ENDIAN, ComSignalInitValue=0, ComSignalType=UINT16, ComTransferProperty=PENDING, ComSystemTemplateSystemSignalRef=RRSideObsDistHSC2
        RRSideObsDist_sech2_SecCAN2_eb7d27c8: ComBitPosition=0, ComBitSize=9, ComSignalEndianness=BIG_ENDIAN, ComSignalInitValue=0, ComSignalType=UINT16, ComSystemTemplateSystemSignalRef=RRSideObsDist_sech2_SecCAN2
        RRTirePrsHSC4_fa528d8c: ComBitPosition=14, ComBitSize=7, ComSignalEndianness=BIG_ENDIAN, ComSignalInitValue=55, ComSignalType=UINT8, ComSystemTemplateSystemSignalRef=RRTirePrsHSC4
        RRTirePrsVHSC4_fa528d8c: ComBitPosition=15, ComBitSize=1, ComSignalEndianness=BIG_ENDIAN, ComSignalInitValue=0, ComSignalType=BOOLEAN, ComSystemTemplateSystemSignalRef=RRTirePrsVHSC4
        Route1SavePercentageHSC4_65a57977: ComBitPosition=30, ComBitSize=7, ComSignalEndianness=BIG_ENDIAN, ComSignalInitValue=0, ComSignalType=UINT8, ComTransferProperty=PENDING, ComSystemTemplateSystemSignalRef=Route1SavePercentageHSC4
        Route1StateHSC4_65a57977: ComBitPosition=19, ComBitSize=2, ComSignalEndianness=BIG_ENDIAN, ComSignalInitValue=0, ComSignalType=UINT8, ComTransferProperty=PENDING, ComSystemTemplateSystemSignalRef=Route1StateHSC4
        Route2SavePercentageHSC4_65a57977: ComBitPosition=38, ComBitSize=7, ComSignalEndianness=BIG_ENDIAN, ComSignalInitValue=0, ComSignalType=UINT8, ComTransferProperty=PENDING, ComSystemTemplateSystemSignalRef=Route2SavePercentageHSC4
        Route2StateHSC4_65a57977: ComBitPosition=17, ComBitSize=2, ComSignalEndianness=BIG_ENDIAN, ComSignalInitValue=0, ComSignalType=UINT8, ComTransferProperty=PENDING, ComSystemTemplateSystemSignalRef=Route2StateHSC4
        RrFogLghtOnHSC2_762c2774: ComBitPosition=8, ComBitSize=1, ComSignalEndianness=BIG_ENDIAN, ComSignalInitValue=0, ComSignalType=BOOLEAN, ComSystemTemplateSystemSignalRef=RrFogLghtOnHSC2
        RrMidLObsDist_sech2_SecCAN2_8e9167f6: ComBitPosition=14, ComBitSize=9, ComSignalEndianness=BIG_ENDIAN, ComSignalInitValue=0, ComSignalType=UINT16, ComSystemTemplateSystemSignalRef=RrMidLObsDist_sech2_SecCAN2
        RrMidLObsRngHSC2_ea600257: ComBitPosition=23, ComBitSize=4, ComSignalEndianness=BIG_ENDIAN, ComSignalInitValue=0, ComSignalType=UINT8, ComTransferProperty=PENDING, ComSystemTemplateSystemSignalRef=RrMidLObsRngHSC2
        RrMidLObsRng_sech2_SecCAN2_27d72756: ComBitPosition=23, ComBitSize=4, ComSignalEndianness=BIG_ENDIAN, ComSignalInitValue=0, ComSignalType=UINT8, ComSystemTemplateSystemSignalRef=RrMidLObsRng_sech2_SecCAN2
        RrMidRObsDist_sech2_SecCAN2_8e9167f6: ComBitPosition=7, ComBitSize=9, ComSignalEndianness=BIG_ENDIAN, ComSignalInitValue=0, ComSignalType=UINT16, ComSystemTemplateSystemSignalRef=RrMidRObsDist_sech2_SecCAN2
        RrMidRObsRngHSC2_ea600257: ComBitPosition=11, ComBitSize=4, ComSignalEndianness=BIG_ENDIAN, ComSignalInitValue=0, ComSignalType=UINT8, ComTransferProperty=PENDING, ComSystemTemplateSystemSignalRef=RrMidRObsRngHSC2
        RrMidRObsRng_sech2_SecCAN2_27d72756: ComBitPosition=11, ComBitSize=4, ComSignalEndianness=BIG_ENDIAN, ComSignalInitValue=0, ComSignalType=UINT8, ComSystemTemplateSystemSignalRef=RrMidRObsRng_sech2_SecCAN2
        RrObsDistHSC2_ea600257: ComBitPosition=63, ComBitSize=8, ComSignalEndianness=BIG_ENDIAN, ComSignalInitValue=0, ComSignalType=UINT8, ComTransferProperty=PENDING, ComSystemTemplateSystemSignalRef=RrObsDistHSC2
        RrObsDist_sech2_SecCAN2_27d72756: ComBitPosition=63, ComBitSize=8, ComSignalEndianness=BIG_ENDIAN, ComSignalInitValue=0, ComSignalType=UINT8, ComSystemTemplateSystemSignalRef=RrObsDist_sech2_SecCAN2
        RrPDCAudWrnngHSC2_ea600257: ComBitPosition=3, ComBitSize=4, ComSignalEndianness=BIG_ENDIAN, ComSignalInitValue=0, ComSignalType=UINT8, ComTransferProperty=PENDING, ComSystemTemplateSystemSignalRef=RrPDCAudWrnngHSC2
        RrPDCAudWrnng_sech2_SecCAN2_27d72756: ComBitPosition=3, ComBitSize=4, ComSignalEndianness=BIG_ENDIAN, ComSignalInitValue=0, ComSignalType=UINT8, ComSystemTemplateSystemSignalRef=RrPDCAudWrnng_sech2_SecCAN2
        RstrFctryDeftsReqHSC2_d7b82a4e: ComBitPosition=56, ComBitSize=1, ComSignalEndianness=BIG_ENDIAN, ComSignalInitValue=0, ComSignalType=BOOLEAN, ComSystemTemplateSystemSignalRef=RstrFctryDeftsReqHSC2
        RstrFctryDeftsReqHSC4_f9bc5d91: ComBitPosition=56, ComBitSize=1, ComSignalEndianness=BIG_ENDIAN, ComSignalInitValue=0, ComSignalType=BOOLEAN, ComSystemTemplateSystemSignalRef=RstrFctryDeftsReqHSC4
        RstrFctryDeftsReq_SecCAN2_9fc99604: ComBitPosition=56, ComBitSize=1, ComSignalEndianness=BIG_ENDIAN, ComSignalInitValue=0, ComSignalType=BOOLEAN, ComTransferProperty=PENDING, ComSystemTemplateSystemSignalRef=RstrFctryDeftsReq_SecCAN2
        SCREEN_COORD_AXHSC4_c0316154: ComBitPosition=3, ComBitSize=12, ComSignalEndianness=BIG_ENDIAN, ComSignalInitValue=0, ComSignalType=UINT16, ComSystemTemplateSystemSignalRef=SCREEN_COORD_AXHSC4
        SCREEN_COORD_AYHSC4_c0316154: ComBitPosition=19, ComBitSize=12, ComSignalEndianness=BIG_ENDIAN, ComSignalInitValue=0, ComSignalType=UINT16, ComSystemTemplateSystemSignalRef=SCREEN_COORD_AYHSC4
        SCREEN_COORD_BXHSC4_c0316154: ComBitPosition=35, ComBitSize=12, ComSignalEndianness=BIG_ENDIAN, ComSignalInitValue=0, ComSignalType=UINT16, ComSystemTemplateSystemSignalRef=SCREEN_COORD_BXHSC4
        SCREEN_COORD_BYHSC4_c0316154: ComBitPosition=51, ComBitSize=12, ComSignalEndianness=BIG_ENDIAN, ComSignalInitValue=0, ComSignalType=UINT16, ComSystemTemplateSystemSignalRef=SCREEN_COORD_BYHSC4
        SCSAPAAcclAHSC2_988d6663: ComBitPosition=46, ComBitSize=1, ComSignalEndianness=BIG_ENDIAN, ComSignalInitValue=0, ComSignalType=BOOLEAN, ComSystemTemplateSystemSignalRef=SCSAPAAcclAHSC2
        SCSAPAAcclA_SecCAN2_b40b8807: ComBitPosition=46, ComBitSize=1, ComSignalEndianness=BIG_ENDIAN, ComSignalInitValue=0, ComSignalType=BOOLEAN, ComTransferProperty=PENDING, ComSystemTemplateSystemSignalRef=SCSAPAAcclA_SecCAN2
        SCSAPAAlvRCHSC2_988d6663: ComBitPosition=39, ComBitSize=4, ComSignalEndianness=BIG_ENDIAN, ComSignalInitValue=0, ComSignalType=UINT8, ComSystemTemplateSystemSignalRef=SCSAPAAlvRCHSC2
        SCSAPAAlvRC_SecCAN2_b40b8807: ComBitPosition=39, ComBitSize=4, ComSignalEndianness=BIG_ENDIAN, ComSignalInitValue=0, ComSignalType=UINT8, ComTransferProperty=PENDING, ComSystemTemplateSystemSignalRef=SCSAPAAlvRC_SecCAN2
        SCSAPAAvlblHSC2_988d6663: ComBitPosition=47, ComBitSize=1, ComSignalEndianness=BIG_ENDIAN, ComSignalInitValue=0, ComSignalType=BOOLEAN, ComSystemTemplateSystemSignalRef=SCSAPAAvlblHSC2
        SCSAPAAvlbl_SecCAN2_b40b8807: ComBitPosition=47, ComBitSize=1, ComSignalEndianness=BIG_ENDIAN, ComSignalInitValue=0, ComSignalType=BOOLEAN, ComTransferProperty=PENDING, ComSystemTemplateSystemSignalRef=SCSAPAAvlbl_SecCAN2
        SCSNRCDAvlblHSC2_988d6663: ComBitPosition=45, ComBitSize=1, ComSignalEndianness=BIG_ENDIAN, ComSignalInitValue=0, ComSignalType=BOOLEAN, ComSystemTemplateSystemSignalRef=SCSNRCDAvlblHSC2
        SCSNRCDAvlbl_SecCAN2_b40b8807: ComBitPosition=45, ComBitSize=1, ComSignalEndianness=BIG_ENDIAN, ComSignalInitValue=0, ComSignalType=BOOLEAN, ComTransferProperty=PENDING, ComSystemTemplateSystemSignalRef=SCSNRCDAvlbl_SecCAN2
        SCUAvlbly_h2HSC2_ab4ba2ce: ComBitPosition=3, ComBitSize=1, ComSignalEndianness=BIG_ENDIAN, ComSignalInitValue=0, ComSignalType=BOOLEAN, ComSystemTemplateSystemSignalRef=SCUAvlbly_h2HSC2
        SCUAvlbly_h2_SecCAN2_88955429: ComBitPosition=3, ComBitSize=1, ComSignalEndianness=BIG_ENDIAN, ComSignalInitValue=0, ComSignalType=BOOLEAN, ComTransferProperty=PENDING, ComSystemTemplateSystemSignalRef=SCUAvlbly_h2_SecCAN2
        SCUDrvrIntrvnAHSC2_efc2a4db: ComBitPosition=2, ComBitSize=1, ComSignalEndianness=BIG_ENDIAN, ComSignalInitValue=0, ComSignalType=BOOLEAN, ComSystemTemplateSystemSignalRef=SCUDrvrIntrvnAHSC2
        SCUDrvrIntrvnA_SecCAN2_c246c452: ComBitPosition=2, ComBitSize=1, ComSignalEndianness=BIG_ENDIAN, ComSignalInitValue=0, ComSignalType=BOOLEAN, ComTransferProperty=PENDING, ComSystemTemplateSystemSignalRef=SCUDrvrIntrvnA_SecCAN2
        SCUNRCDAvlblHSC2_efc2a4db: ComBitPosition=3, ComBitSize=1, ComSignalEndianness=BIG_ENDIAN, ComSignalInitValue=0, ComSignalType=BOOLEAN, ComSystemTemplateSystemSignalRef=SCUNRCDAvlblHSC2
        SCUNRCDAvlbl_SecCAN2_c246c452: ComBitPosition=3, ComBitSize=1, ComSignalEndianness=BIG_ENDIAN, ComSignalInitValue=0, ComSignalType=BOOLEAN, ComTransferProperty=PENDING, ComSystemTemplateSystemSignalRef=SCUNRCDAvlbl_SecCAN2
        SCUShifterLvrPosHSC2_efc2a4db: ComBitPosition=23, ComBitSize=4, ComSignalEndianness=BIG_ENDIAN, ComSignalInitValue=0, ComSignalType=UINT8, ComSystemTemplateSystemSignalRef=SCUShifterLvrPosHSC2
        SCUShifterPosInvsnHSC2_efc2a4db: ComBitPosition=31, ComBitSize=4, ComSignalEndianness=BIG_ENDIAN, ComSignalInitValue=15, ComSignalType=UINT8, ComSystemTemplateSystemSignalRef=SCUShifterPosInvsnHSC2
        SCUShifterPosRCHSC2_efc2a4db: ComBitPosition=11, ComBitSize=4, ComSignalEndianness=BIG_ENDIAN, ComSignalInitValue=0, ComSignalType=UINT8, ComSystemTemplateSystemSignalRef=SCUShifterPosRCHSC2
        SDMAvlbly_h2HSC2_ab4ba2ce: ComBitPosition=5, ComBitSize=1, ComSignalEndianness=BIG_ENDIAN, ComSignalInitValue=0, ComSignalType=BOOLEAN, ComSystemTemplateSystemSignalRef=SDMAvlbly_h2HSC2
        SDMAvlbly_h2_SecCAN2_88955429: ComBitPosition=5, ComBitSize=1, ComSignalEndianness=BIG_ENDIAN, ComSignalInitValue=0, ComSignalType=BOOLEAN, ComTransferProperty=PENDING, ComSystemTemplateSystemSignalRef=SDMAvlbly_h2_SecCAN2
        SecsOfMinuteHSC2_c30fb534: ComBitPosition=45, ComBitSize=6, ComSignalEndianness=BIG_ENDIAN, ComSignalInitValue=0, ComSignalType=UINT8, ComSystemTemplateSystemSignalRef=SecsOfMinuteHSC2
        SecsOfMinuteHSC4_80f6c9a0: ComBitPosition=45, ComBitSize=6, ComSignalEndianness=BIG_ENDIAN, ComSignalInitValue=0, ComSignalType=UINT8, ComSystemTemplateSystemSignalRef=SecsOfMinuteHSC4
        SecsOfMinute_SecCAN2_ee8bd5bd: ComBitPosition=45, ComBitSize=6, ComSignalEndianness=BIG_ENDIAN, ComSignalInitValue=0, ComSignalType=UINT8, ComTransferProperty=PENDING, ComSystemTemplateSystemSignalRef=SecsOfMinute_SecCAN2
        Sig_Init_SRU3_829252cc: ComBitPosition=0, ComBitSize=16, ComSignalEndianness=LITTLE_ENDIAN, ComSignalInitValue=0, ComSignalType=UINT16, ComSystemTemplateSystemSignalRef=Sig_Init_SRU3
        Sin_Init_LRU1_fdb965bc: ComBitPosition=0, ComBitSize=8, ComSignalEndianness=LITTLE_ENDIAN, ComSignalInitValue=0, ComSignalType=UINT8, ComSystemTemplateSystemSignalRef=Sin_Init_LRU1
        Status_LRU1_18ef6e8d: ComBitPosition=48, ComBitSize=8, ComSignalEndianness=LITTLE_ENDIAN, ComSignalInitValue=0, ComSignalType=UINT8, ComSystemTemplateSystemSignalRef=Status_LRU1
        Status_SRU3_67c459fd: ComBitPosition=16, ComBitSize=8, ComSignalEndianness=LITTLE_ENDIAN, ComSignalInitValue=0, ComSignalType=UINT8, ComSystemTemplateSystemSignalRef=Status_SRU3
        StrgWhlAngHSC2_dccc170c: ComBitPosition=15, ComBitSize=16, ComSignalEndianness=BIG_ENDIAN, ComSignalInitValue=0, ComSignalType=UINT16, ComSystemTemplateSystemSignalRef=StrgWhlAngHSC2
        StrgWhlAngVHSC2_dccc170c: ComBitPosition=7, ComBitSize=1, ComSignalEndianness=BIG_ENDIAN, ComSignalInitValue=0, ComSignalType=BOOLEAN, ComSystemTemplateSystemSignalRef=StrgWhlAngVHSC2
        StrgWhlAngV_SecCAN2_92023e75: ComBitPosition=7, ComBitSize=1, ComSignalEndianness=BIG_ENDIAN, ComSignalInitValue=0, ComSignalType=BOOLEAN, ComTransferProperty=PENDING, ComSystemTemplateSystemSignalRef=StrgWhlAngV_SecCAN2
        StrgWhlAng_SecCAN2_92023e75: ComBitPosition=15, ComBitSize=16, ComSignalEndianness=BIG_ENDIAN, ComSignalInitValue=0, ComSignalType=UINT16, ComTransferProperty=PENDING, ComSystemTemplateSystemSignalRef=StrgWhlAng_SecCAN2
        SurndViewSelnHSC4_c0316154: ComBitPosition=7, ComBitSize=4, ComSignalEndianness=BIG_ENDIAN, ComSignalInitValue=0, ComSignalType=UINT8, ComSystemTemplateSystemSignalRef=SurndViewSelnHSC4
        SysBPMEnbdHSC2_f8a32097: ComBitPosition=6, ComBitSize=1, ComSignalEndianness=BIG_ENDIAN, ComSignalInitValue=0, ComSignalType=BOOLEAN, ComSystemTemplateSystemSignalRef=SysBPMEnbdHSC2
        SysBPMEnbd_SecCAN2_d527401e: ComBitPosition=6, ComBitSize=1, ComSignalEndianness=BIG_ENDIAN, ComSignalInitValue=0, ComSignalType=BOOLEAN, ComTransferProperty=PENDING, ComSystemTemplateSystemSignalRef=SysBPMEnbd_SecCAN2
        SysBPMHSC2_f8a32097: ComBitPosition=5, ComBitSize=2, ComSignalEndianness=BIG_ENDIAN, ComSignalInitValue=0, ComSignalType=UINT8, ComSystemTemplateSystemSignalRef=SysBPMHSC2
        SysBPM_SecCAN2_d527401e: ComBitPosition=5, ComBitSize=2, ComSignalEndianness=BIG_ENDIAN, ComSignalInitValue=0, ComSignalType=UINT8, ComTransferProperty=PENDING, ComSystemTemplateSystemSignalRef=SysBPM_SecCAN2
        SysOpnlMd_h2HSC2_67e1a250: ComBitPosition=6, ComBitSize=3, ComSignalEndianness=BIG_ENDIAN, ComSignalInitValue=0, ComSignalType=UINT8, ComSystemTemplateSystemSignalRef=SysOpnlMd_h2HSC2
        SysOpnlMd_h2_SecCAN2_443f54b7: ComBitPosition=6, ComBitSize=3, ComSignalEndianness=BIG_ENDIAN, ComSignalInitValue=0, ComSignalType=UINT8, ComTransferProperty=PENDING, ComSystemTemplateSystemSignalRef=SysOpnlMd_h2_SecCAN2
        SysPwrMd_h2HSC2_67e1a250: ComBitPosition=1, ComBitSize=2, ComSignalEndianness=BIG_ENDIAN, ComSignalInitValue=0, ComSignalType=UINT8, ComSystemTemplateSystemSignalRef=SysPwrMd_h2HSC2
        SysPwrMd_h2_SecCAN2_443f54b7: ComBitPosition=1, ComBitSize=2, ComSignalEndianness=BIG_ENDIAN, ComSignalInitValue=0, ComSignalType=UINT8, ComTransferProperty=PENDING, ComSystemTemplateSystemSignalRef=SysPwrMd_h2_SecCAN2
        SysVolMdV_h2HSC2_67e1a250: ComBitPosition=7, ComBitSize=1, ComSignalEndianness=BIG_ENDIAN, ComSignalInitValue=0, ComSignalType=BOOLEAN, ComSystemTemplateSystemSignalRef=SysVolMdV_h2HSC2
        SysVolMdV_h2_SecCAN2_443f54b7: ComBitPosition=7, ComBitSize=1, ComSignalEndianness=BIG_ENDIAN, ComSignalInitValue=0, ComSignalType=BOOLEAN, ComTransferProperty=PENDING, ComSystemTemplateSystemSignalRef=SysVolMdV_h2_SecCAN2
        SysVolMd_h2HSC2_67e1a250: ComBitPosition=58, ComBitSize=2, ComSignalEndianness=BIG_ENDIAN, ComSignalInitValue=0, ComSignalType=UINT8, ComSystemTemplateSystemSignalRef=SysVolMd_h2HSC2
        SysVolMd_h2_SecCAN2_443f54b7: ComBitPosition=58, ComBitSize=2, ComSignalEndianness=BIG_ENDIAN, ComSignalInitValue=0, ComSignalType=UINT8, ComTransferProperty=PENDING, ComSystemTemplateSystemSignalRef=SysVolMd_h2_SecCAN2
        SysVolV_h2HSC2_67e1a250: ComBitPosition=32, ComBitSize=1, ComSignalEndianness=BIG_ENDIAN, ComSignalInitValue=0, ComSignalType=BOOLEAN, ComSystemTemplateSystemSignalRef=SysVolV_h2HSC2
        SysVolV_h2_SecCAN2_443f54b7: ComBitPosition=32, ComBitSize=1, ComSignalEndianness=BIG_ENDIAN, ComSignalInitValue=0, ComSignalType=BOOLEAN, ComTransferProperty=PENDING, ComSystemTemplateSystemSignalRef=SysVolV_h2_SecCAN2
        SysVol_h2HSC2_67e1a250: ComBitPosition=47, ComBitSize=8, ComSignalEndianness=BIG_ENDIAN, ComSignalInitValue=0, ComSignalType=UINT8, ComSystemTemplateSystemSignalRef=SysVol_h2HSC2
        SysVol_h2_SecCAN2_443f54b7: ComBitPosition=47, ComBitSize=8, ComSignalEndianness=BIG_ENDIAN, ComSignalInitValue=0, ComSignalType=UINT8, ComTransferProperty=PENDING, ComSystemTemplateSystemSignalRef=SysVol_h2_SecCAN2
        TBOXAccelZHSC4_09f4c130: ComBitPosition=35, ComBitSize=12, ComSignalEndianness=BIG_ENDIAN, ComSignalInitValue=0, ComSignalType=SINT16, ComSystemTemplateSystemSignalRef=TBOXAccelZHSC4
        TBOXAccelZVHSC4_09f4c130: ComBitPosition=36, ComBitSize=1, ComSignalEndianness=BIG_ENDIAN, ComSignalInitValue=0, ComSignalType=BOOLEAN, ComSystemTemplateSystemSignalRef=TBOXAccelZVHSC4
        TBOXToIECUCtrlPotclHSC4_bd586014: ComBitPosition=0, ComSignalEndianness=opaque, ComSignalInitValue=0 0 0 0 0 0 0 0, ComSignalLength=8, ComSignalType=UINT8_N, ComSystemTemplateSystemSignalRef=TBOXToIECUCtrlPotclHSC4
        TCAvlbly_h2HSC2_ab4ba2ce: ComBitPosition=8, ComBitSize=1, ComSignalEndianness=BIG_ENDIAN, ComSignalInitValue=0, ComSignalType=BOOLEAN, ComSystemTemplateSystemSignalRef=TCAvlbly_h2HSC2
        TCAvlbly_h2_SecCAN2_88955429: ComBitPosition=8, ComBitSize=1, ComSignalEndianness=BIG_ENDIAN, ComSignalInitValue=0, ComSignalType=BOOLEAN, ComTransferProperty=PENDING, ComSystemTemplateSystemSignalRef=TCAvlbly_h2_SecCAN2
        TCSAHSC2_5ee26fe4: ComBitPosition=28, ComBitSize=1, ComSignalEndianness=BIG_ENDIAN, ComSignalInitValue=0, ComSignalType=BOOLEAN, ComSystemTemplateSystemSignalRef=TCSAHSC2
        TCSA_SecCAN2_72648180: ComBitPosition=28, ComBitSize=1, ComSignalEndianness=BIG_ENDIAN, ComSignalInitValue=0, ComSignalType=BOOLEAN, ComTransferProperty=PENDING, ComSystemTemplateSystemSignalRef=TCSA_SecCAN2
        TMSpdV_h1HSC4_d68cf0b9: ComBitPosition=23, ComBitSize=1, ComSignalEndianness=BIG_ENDIAN, ComSignalInitValue=1, ComSignalType=BOOLEAN, ComSystemTemplateSystemSignalRef=TMSpdV_h1HSC4
        TMSpdV_h1_SecCAN2_a8511b71: ComBitPosition=23, ComBitSize=1, ComSignalEndianness=BIG_ENDIAN, ComSignalInitValue=1, ComSignalType=BOOLEAN, ComTransferProperty=PENDING, ComSystemTemplateSystemSignalRef=TMSpdV_h1_SecCAN2
        TMSpd_h1HSC4_d68cf0b9: ComBitPosition=7, ComBitSize=16, ComSignalEndianness=BIG_ENDIAN, ComSignalInitValue=32768, ComSignalType=UINT16, ComSystemTemplateSystemSignalRef=TMSpd_h1HSC4
        TMSpd_h1_SecCAN2_a8511b71: ComBitPosition=7, ComBitSize=16, ComSignalEndianness=BIG_ENDIAN, ComSignalInitValue=32768, ComSignalType=UINT16, ComTransferProperty=PENDING, ComSystemTemplateSystemSignalRef=TMSpd_h1_SecCAN2
        TOF_LRU1_18ef6e8d: ComBitPosition=0, ComBitSize=16, ComSignalEndianness=LITTLE_ENDIAN, ComSignalInitValue=0, ComSignalType=UINT16, ComSystemTemplateSystemSignalRef=TOF_LRU1
        TOF_SRU3_67c459fd: ComBitPosition=0, ComBitSize=16, ComSignalEndianness=LITTLE_ENDIAN, ComSignalInitValue=0, ComSignalType=UINT16, ComSystemTemplateSystemSignalRef=TOF_SRU3
        TOUCH_SCREEN_ACMDHSC4_c0316154: ComBitPosition=23, ComBitSize=4, ComSignalEndianness=BIG_ENDIAN, ComSignalInitValue=0, ComSignalType=UINT8, ComSystemTemplateSystemSignalRef=TOUCH_SCREEN_ACMDHSC4
        TOUCH_SCREEN_BCMDHSC4_c0316154: ComBitPosition=55, ComBitSize=4, ComSignalEndianness=BIG_ENDIAN, ComSignalInitValue=0, ComSignalType=UINT8, ComSystemTemplateSystemSignalRef=TOUCH_SCREEN_BCMDHSC4
        TOUCH_SCREEN_STATUS_h4HSC4_c0316154: ComBitPosition=39, ComBitSize=4, ComSignalEndianness=BIG_ENDIAN, ComSignalInitValue=0, ComSignalType=UINT8, ComSystemTemplateSystemSignalRef=TOUCH_SCREEN_STATUS_h4HSC4
        TPMSFHSC4_74dd8a6f: ComBitPosition=0, ComBitSize=1, ComSignalEndianness=BIG_ENDIAN, ComSignalInitValue=0, ComSignalType=BOOLEAN, ComSystemTemplateSystemSignalRef=TPMSFHSC4
        TboxP2PRCHSC4_09f4c130: ComBitPosition=27, ComBitSize=4, ComSignalEndianness=BIG_ENDIAN, ComSignalInitValue=0, ComSignalType=UINT8, ComSystemTemplateSystemSignalRef=TboxP2PRCHSC4
        TimeDspFmtHSC2_c30fb534: ComBitPosition=46, ComBitSize=1, ComSignalEndianness=BIG_ENDIAN, ComSignalInitValue=0, ComSignalType=BOOLEAN, ComSystemTemplateSystemSignalRef=TimeDspFmtHSC2
        TimeDspFmtHSC4_80f6c9a0: ComBitPosition=46, ComBitSize=1, ComSignalEndianness=BIG_ENDIAN, ComSignalInitValue=0, ComSignalType=BOOLEAN, ComSystemTemplateSystemSignalRef=TimeDspFmtHSC4
        TimeDspFmt_SecCAN2_ee8bd5bd: ComBitPosition=46, ComBitSize=1, ComSignalEndianness=BIG_ENDIAN, ComSignalInitValue=0, ComSignalType=BOOLEAN, ComTransferProperty=PENDING, ComSystemTemplateSystemSignalRef=TimeDspFmt_SecCAN2
        TrShftLvrPosV_h1HSC2_8bd5df01: ComBitPosition=28, ComBitSize=1, ComSignalEndianness=BIG_ENDIAN, ComSignalInitValue=0, ComSignalType=BOOLEAN, ComSystemTemplateSystemSignalRef=TrShftLvrPosV_h1HSC2
        TrShftLvrPosV_h1_SecCAN2_f7a3932f: ComBitPosition=28, ComBitSize=1, ComSignalEndianness=BIG_ENDIAN, ComSignalInitValue=0, ComSignalType=BOOLEAN, ComTransferProperty=PENDING, ComSystemTemplateSystemSignalRef=TrShftLvrPosV_h1_SecCAN2
        TrShftLvrPos_h1HSC2_8bd5df01: ComBitPosition=27, ComBitSize=4, ComSignalEndianness=BIG_ENDIAN, ComSignalInitValue=0, ComSignalType=UINT8, ComSystemTemplateSystemSignalRef=TrShftLvrPos_h1HSC2
        TrShftLvrPos_h1_SecCAN2_f7a3932f: ComBitPosition=27, ComBitSize=4, ComSignalEndianness=BIG_ENDIAN, ComSignalInitValue=0, ComSignalType=UINT8, ComTransferProperty=PENDING, ComSystemTemplateSystemSignalRef=TrShftLvrPos_h1_SecCAN2
        TrlrHitchSwAHSC2_762c2774: ComBitPosition=54, ComBitSize=1, ComSignalEndianness=BIG_ENDIAN, ComSignalInitValue=0, ComSignalType=BOOLEAN, ComSystemTemplateSystemSignalRef=TrlrHitchSwAHSC2
        TrlrHitchSwA_SecCAN2_516d4ee4: ComBitPosition=15, ComBitSize=1, ComSignalEndianness=BIG_ENDIAN, ComSignalInitValue=0, ComSignalType=BOOLEAN, ComTransferProperty=PENDING, ComSystemTemplateSystemSignalRef=TrlrHitchSwA_SecCAN2
        VCUAccReqStsHSC2_cacaa258: ComBitPosition=53, ComBitSize=1, ComSignalEndianness=BIG_ENDIAN, ComSignalInitValue=0, ComSignalType=BOOLEAN, ComSystemTemplateSystemSignalRef=VCUAccReqStsHSC2
        VCUAccReqSts_SecCAN2_e74ec2d1: ComBitPosition=53, ComBitSize=1, ComSignalEndianness=BIG_ENDIAN, ComSignalInitValue=0, ComSignalType=BOOLEAN, ComTransferProperty=PENDING, ComSystemTemplateSystemSignalRef=VCUAccReqSts_SecCAN2
        VCUAccReqValHSC2_cacaa258: ComBitPosition=63, ComBitSize=8, ComSignalEndianness=BIG_ENDIAN, ComSignalInitValue=0, ComSignalType=UINT8, ComSystemTemplateSystemSignalRef=VCUAccReqValHSC2
        VCUAccReqVal_SecCAN2_e74ec2d1: ComBitPosition=63, ComBitSize=8, ComSignalEndianness=BIG_ENDIAN, ComSignalInitValue=0, ComSignalType=UINT8, ComTransferProperty=PENDING, ComSystemTemplateSystemSignalRef=VCUAccReqVal_SecCAN2
        VCUNRCDAvlblHSC2_cacaa258: ComBitPosition=52, ComBitSize=1, ComSignalEndianness=BIG_ENDIAN, ComSignalInitValue=0, ComSignalType=BOOLEAN, ComSystemTemplateSystemSignalRef=VCUNRCDAvlblHSC2
        VCUNRCDAvlbl_SecCAN2_e74ec2d1: ComBitPosition=52, ComBitSize=1, ComSignalEndianness=BIG_ENDIAN, ComSignalInitValue=0, ComSignalType=BOOLEAN, ComTransferProperty=PENDING, ComSystemTemplateSystemSignalRef=VCUNRCDAvlbl_SecCAN2
        VSELatAccHSC2_542766fd: ComBitPosition=19, ComBitSize=12, ComSignalEndianness=BIG_ENDIAN, ComSignalInitValue=0, ComSignalType=SINT16, ComSystemTemplateSystemSignalRef=VSELatAccHSC2
        VSELatAccVHSC2_542766fd: ComBitPosition=3, ComBitSize=1, ComSignalEndianness=BIG_ENDIAN, ComSignalInitValue=0, ComSignalType=BOOLEAN, ComSystemTemplateSystemSignalRef=VSELatAccVHSC2
        VSELatAccV_SecCAN2_78a18899: ComBitPosition=3, ComBitSize=1, ComSignalEndianness=BIG_ENDIAN, ComSignalInitValue=0, ComSignalType=BOOLEAN, ComTransferProperty=PENDING, ComSystemTemplateSystemSignalRef=VSELatAccV_SecCAN2
        VSELatAcc_SecCAN2_78a18899: ComBitPosition=19, ComBitSize=12, ComSignalEndianness=BIG_ENDIAN, ComSignalInitValue=0, ComSignalType=SINT16, ComTransferProperty=PENDING, ComSystemTemplateSystemSignalRef=VSELatAcc_SecCAN2
        VSELongtAccHSC2_542766fd: ComBitPosition=1, ComBitSize=10, ComSignalEndianness=BIG_ENDIAN, ComSignalInitValue=0, ComSignalType=SINT16, ComSystemTemplateSystemSignalRef=VSELongtAccHSC2
        VSELongtAccVHSC2_542766fd: ComBitPosition=2, ComBitSize=1, ComSignalEndianness=BIG_ENDIAN, ComSignalInitValue=0, ComSignalType=BOOLEAN, ComSystemTemplateSystemSignalRef=VSELongtAccVHSC2
        VSELongtAccV_SecCAN2_78a18899: ComBitPosition=2, ComBitSize=1, ComSignalEndianness=BIG_ENDIAN, ComSignalInitValue=0, ComSignalType=BOOLEAN, ComTransferProperty=PENDING, ComSystemTemplateSystemSignalRef=VSELongtAccV_SecCAN2
        VSELongtAcc_SecCAN2_78a18899: ComBitPosition=1, ComBitSize=10, ComSignalEndianness=BIG_ENDIAN, ComSignalInitValue=0, ComSignalType=SINT16, ComTransferProperty=PENDING, ComSystemTemplateSystemSignalRef=VSELongtAcc_SecCAN2
        VSESysAHSC2_5ee26fe4: ComBitPosition=24, ComBitSize=1, ComSignalEndianness=BIG_ENDIAN, ComSignalInitValue=0, ComSignalType=BOOLEAN, ComSystemTemplateSystemSignalRef=VSESysAHSC2
        VSESysA_SecCAN2_72648180: ComBitPosition=24, ComBitSize=1, ComSignalEndianness=BIG_ENDIAN, ComSignalInitValue=0, ComSignalType=BOOLEAN, ComTransferProperty=PENDING, ComSystemTemplateSystemSignalRef=VSESysA_SecCAN2
        VehBkwdSwReqHSC4_09f4c130: ComBitPosition=21, ComBitSize=1, ComSignalEndianness=BIG_ENDIAN, ComSignalInitValue=0, ComSignalType=BOOLEAN, ComSystemTemplateSystemSignalRef=VehBkwdSwReqHSC4
        VehBkwdSwReqVHSC4_09f4c130: ComBitPosition=20, ComBitSize=1, ComSignalEndianness=BIG_ENDIAN, ComSignalInitValue=0, ComSignalType=BOOLEAN, ComSystemTemplateSystemSignalRef=VehBkwdSwReqVHSC4
        VehDynYawRateHSC2_5ee26fe4: ComBitPosition=35, ComBitSize=12, ComSignalEndianness=BIG_ENDIAN, ComSignalInitValue=0, ComSignalType=SINT16, ComSystemTemplateSystemSignalRef=VehDynYawRateHSC2
        VehDynYawRateVHSC2_5ee26fe4: ComBitPosition=36, ComBitSize=1, ComSignalEndianness=BIG_ENDIAN, ComSignalInitValue=0, ComSignalType=BOOLEAN, ComSystemTemplateSystemSignalRef=VehDynYawRateVHSC2
        VehDynYawRateV_SecCAN2_72648180: ComBitPosition=36, ComBitSize=1, ComSignalEndianness=BIG_ENDIAN, ComSignalInitValue=0, ComSignalType=BOOLEAN, ComTransferProperty=PENDING, ComSystemTemplateSystemSignalRef=VehDynYawRateV_SecCAN2
        VehDynYawRate_SecCAN2_72648180: ComBitPosition=35, ComBitSize=12, ComSignalEndianness=BIG_ENDIAN, ComSignalInitValue=0, ComSignalType=SINT16, ComTransferProperty=PENDING, ComSystemTemplateSystemSignalRef=VehDynYawRate_SecCAN2
        VehFwdSwReqHSC4_09f4c130: ComBitPosition=23, ComBitSize=1, ComSignalEndianness=BIG_ENDIAN, ComSignalInitValue=0, ComSignalType=BOOLEAN, ComSystemTemplateSystemSignalRef=VehFwdSwReqHSC4
        VehFwdSwReqVHSC4_09f4c130: ComBitPosition=22, ComBitSize=1, ComSignalEndianness=BIG_ENDIAN, ComSignalInitValue=0, ComSignalType=BOOLEAN, ComSystemTemplateSystemSignalRef=VehFwdSwReqVHSC4
        VehLckngStaHSC4_0f57ab67: ComBitPosition=55, ComBitSize=3, ComSignalEndianness=BIG_ENDIAN, ComSignalInitValue=7, ComSignalType=UINT8, ComSystemTemplateSystemSignalRef=VehLckngStaHSC4
        VehOdoV_h2HSC2_78aeb97b: ComBitPosition=31, ComBitSize=1, ComSignalEndianness=BIG_ENDIAN, ComSignalInitValue=0, ComSignalType=BOOLEAN, ComSystemTemplateSystemSignalRef=VehOdoV_h2HSC2
        VehOdoV_h2_SecCAN2_5b704f9c: ComBitPosition=31, ComBitSize=1, ComSignalEndianness=BIG_ENDIAN, ComSignalInitValue=0, ComSignalType=BOOLEAN, ComTransferProperty=PENDING, ComSystemTemplateSystemSignalRef=VehOdoV_h2_SecCAN2
        VehOdo_h2HSC2_78aeb97b: ComBitPosition=7, ComBitSize=24, ComSignalEndianness=BIG_ENDIAN, ComSignalInitValue=0, ComSignalType=UINT32, ComSystemTemplateSystemSignalRef=VehOdo_h2HSC2
        VehOdo_h2_SecCAN2_5b704f9c: ComBitPosition=7, ComBitSize=24, ComSignalEndianness=BIG_ENDIAN, ComSignalInitValue=0, ComSignalType=UINT32, ComTransferProperty=PENDING, ComSystemTemplateSystemSignalRef=VehOdo_h2_SecCAN2
        VehRoadWhlLReqHSC4_09f4c130: ComBitPosition=19, ComBitSize=1, ComSignalEndianness=BIG_ENDIAN, ComSignalInitValue=0, ComSignalType=BOOLEAN, ComSystemTemplateSystemSignalRef=VehRoadWhlLReqHSC4
        VehRoadWhlLReqVHSC4_09f4c130: ComBitPosition=18, ComBitSize=1, ComSignalEndianness=BIG_ENDIAN, ComSignalInitValue=0, ComSignalType=BOOLEAN, ComSystemTemplateSystemSignalRef=VehRoadWhlLReqVHSC4
        VehRoadWhlRReqHSC4_09f4c130: ComBitPosition=17, ComBitSize=1, ComSignalEndianness=BIG_ENDIAN, ComSignalInitValue=0, ComSignalType=BOOLEAN, ComSystemTemplateSystemSignalRef=VehRoadWhlRReqHSC4
        VehRoadWhlRReqVHSC4_09f4c130: ComBitPosition=16, ComBitSize=1, ComSignalEndianness=BIG_ENDIAN, ComSignalInitValue=0, ComSignalType=BOOLEAN, ComSystemTemplateSystemSignalRef=VehRoadWhlRReqVHSC4
        VehSideLghtStsHSC2_762c2774: ComBitPosition=57, ComBitSize=2, ComSignalEndianness=BIG_ENDIAN, ComSignalInitValue=0, ComSignalType=UINT8, ComSystemTemplateSystemSignalRef=VehSideLghtStsHSC2
        VehSpdAvgDrvnHSC2_49997ba7: ComBitPosition=6, ComBitSize=15, ComSignalEndianness=BIG_ENDIAN, ComSignalInitValue=0, ComSignalType=UINT16, ComSystemTemplateSystemSignalRef=VehSpdAvgDrvnHSC2
        VehSpdAvgDrvnVHSC2_49997ba7: ComBitPosition=7, ComBitSize=1, ComSignalEndianness=BIG_ENDIAN, ComSignalInitValue=0, ComSignalType=BOOLEAN, ComSystemTemplateSystemSignalRef=VehSpdAvgDrvnVHSC2
        VehSpdAvgDrvnV_SecCAN2_651f95c3: ComBitPosition=7, ComBitSize=1, ComSignalEndianness=BIG_ENDIAN, ComSignalInitValue=0, ComSignalType=BOOLEAN, ComTransferProperty=PENDING, ComSystemTemplateSystemSignalRef=VehSpdAvgDrvnV_SecCAN2
        VehSpdAvgDrvn_SecCAN2_651f95c3: ComBitPosition=6, ComBitSize=15, ComSignalEndianness=BIG_ENDIAN, ComSignalInitValue=0, ComSignalType=UINT16, ComTransferProperty=PENDING, ComSystemTemplateSystemSignalRef=VehSpdAvgDrvn_SecCAN2
        VehSpdAvgNonDrvnHSC2_49997ba7: ComBitPosition=38, ComBitSize=15, ComSignalEndianness=BIG_ENDIAN, ComSignalInitValue=0, ComSignalType=UINT16, ComSystemTemplateSystemSignalRef=VehSpdAvgNonDrvnHSC2
        VehSpdAvgNonDrvnVHSC2_49997ba7: ComBitPosition=39, ComBitSize=1, ComSignalEndianness=BIG_ENDIAN, ComSignalInitValue=0, ComSignalType=BOOLEAN, ComSystemTemplateSystemSignalRef=VehSpdAvgNonDrvnVHSC2
        VehSpdAvgNonDrvnV_SecCAN2_651f95c3: ComBitPosition=39, ComBitSize=1, ComSignalEndianness=BIG_ENDIAN, ComSignalInitValue=0, ComSignalType=BOOLEAN, ComTransferProperty=PENDING, ComSystemTemplateSystemSignalRef=VehSpdAvgNonDrvnV_SecCAN2
        VehSpdAvgNonDrvn_SecCAN2_651f95c3: ComBitPosition=38, ComBitSize=15, ComSignalEndianness=BIG_ENDIAN, ComSignalInitValue=0, ComSignalType=UINT16, ComTransferProperty=PENDING, ComSystemTemplateSystemSignalRef=VehSpdAvgNonDrvn_SecCAN2
        WhlGndVelLDrvnHSC2_cdd3755d: ComBitPosition=5, ComBitSize=14, ComSignalEndianness=BIG_ENDIAN, ComSignalInitValue=0, ComSignalType=UINT16, ComSystemTemplateSystemSignalRef=WhlGndVelLDrvnHSC2
        WhlGndVelLDrvnVHSC2_cdd3755d: ComBitPosition=6, ComBitSize=1, ComSignalEndianness=BIG_ENDIAN, ComSignalInitValue=1, ComSignalType=BOOLEAN, ComSystemTemplateSystemSignalRef=WhlGndVelLDrvnVHSC2
        WhlGndVelLDrvnV_SecCAN2_e1559b39: ComBitPosition=6, ComBitSize=1, ComSignalEndianness=BIG_ENDIAN, ComSignalInitValue=1, ComSignalType=BOOLEAN, ComTransferProperty=PENDING, ComSystemTemplateSystemSignalRef=WhlGndVelLDrvnV_SecCAN2
        WhlGndVelLDrvn_SecCAN2_e1559b39: ComBitPosition=5, ComBitSize=14, ComSignalEndianness=BIG_ENDIAN, ComSignalInitValue=0, ComSignalType=UINT16, ComTransferProperty=PENDING, ComSystemTemplateSystemSignalRef=WhlGndVelLDrvn_SecCAN2
        WhlGndVelLNonDrvnHSC2_435c72be: ComBitPosition=5, ComBitSize=14, ComSignalEndianness=BIG_ENDIAN, ComSignalInitValue=0, ComSignalType=UINT16, ComSystemTemplateSystemSignalRef=WhlGndVelLNonDrvnHSC2
        WhlGndVelLNonDrvnVHSC2_435c72be: ComBitPosition=6, ComBitSize=1, ComSignalEndianness=BIG_ENDIAN, ComSignalInitValue=1, ComSignalType=BOOLEAN, ComSystemTemplateSystemSignalRef=WhlGndVelLNonDrvnVHSC2
        WhlGndVelLNonDrvnV_SecCAN2_6fda9cda: ComBitPosition=6, ComBitSize=1, ComSignalEndianness=BIG_ENDIAN, ComSignalInitValue=1, ComSignalType=BOOLEAN, ComTransferProperty=PENDING, ComSystemTemplateSystemSignalRef=WhlGndVelLNonDrvnV_SecCAN2
        WhlGndVelLNonDrvn_SecCAN2_6fda9cda: ComBitPosition=5, ComBitSize=14, ComSignalEndianness=BIG_ENDIAN, ComSignalInitValue=0, ComSignalType=UINT16, ComTransferProperty=PENDING, ComSystemTemplateSystemSignalRef=WhlGndVelLNonDrvn_SecCAN2
        WhlGndVelRDrvnHSC2_cdd3755d: ComBitPosition=21, ComBitSize=14, ComSignalEndianness=BIG_ENDIAN, ComSignalInitValue=0, ComSignalType=UINT16, ComSystemTemplateSystemSignalRef=WhlGndVelRDrvnHSC2
        WhlGndVelRDrvnVHSC2_cdd3755d: ComBitPosition=22, ComBitSize=1, ComSignalEndianness=BIG_ENDIAN, ComSignalInitValue=1, ComSignalType=BOOLEAN, ComSystemTemplateSystemSignalRef=WhlGndVelRDrvnVHSC2
        WhlGndVelRDrvnV_SecCAN2_e1559b39: ComBitPosition=22, ComBitSize=1, ComSignalEndianness=BIG_ENDIAN, ComSignalInitValue=1, ComSignalType=BOOLEAN, ComTransferProperty=PENDING, ComSystemTemplateSystemSignalRef=WhlGndVelRDrvnV_SecCAN2
        WhlGndVelRDrvn_SecCAN2_e1559b39: ComBitPosition=21, ComBitSize=14, ComSignalEndianness=BIG_ENDIAN, ComSignalInitValue=0, ComSignalType=UINT16, ComTransferProperty=PENDING, ComSystemTemplateSystemSignalRef=WhlGndVelRDrvn_SecCAN2
        WhlGndVelRNonDrvnHSC2_435c72be: ComBitPosition=21, ComBitSize=14, ComSignalEndianness=BIG_ENDIAN, ComSignalInitValue=0, ComSignalType=UINT16, ComSystemTemplateSystemSignalRef=WhlGndVelRNonDrvnHSC2
        WhlGndVelRNonDrvnVHSC2_435c72be: ComBitPosition=22, ComBitSize=1, ComSignalEndianness=BIG_ENDIAN, ComSignalInitValue=1, ComSignalType=BOOLEAN, ComSystemTemplateSystemSignalRef=WhlGndVelRNonDrvnVHSC2
        WhlGndVelRNonDrvnV_SecCAN2_6fda9cda: ComBitPosition=22, ComBitSize=1, ComSignalEndianness=BIG_ENDIAN, ComSignalInitValue=1, ComSignalType=BOOLEAN, ComTransferProperty=PENDING, ComSystemTemplateSystemSignalRef=WhlGndVelRNonDrvnV_SecCAN2
        WhlGndVelRNonDrvn_SecCAN2_6fda9cda: ComBitPosition=21, ComBitSize=14, ComSignalEndianness=BIG_ENDIAN, ComSignalInitValue=0, ComSignalType=UINT16, ComTransferProperty=PENDING, ComSystemTemplateSystemSignalRef=WhlGndVelRNonDrvn_SecCAN2
        Width_LRU1_18ef6e8d: ComBitPosition=24, ComBitSize=8, ComSignalEndianness=LITTLE_ENDIAN, ComSignalInitValue=0, ComSignalType=UINT8, ComSystemTemplateSystemSignalRef=Width_LRU1
    ComGeneral
