AUTOSAR XML (schema 4-2-1)
package /ActiveEcuC
  module config CanSM: implementation-config-variant=VARIANT-PRE-COMPILE, module-description=CanSM_Impl
    CanSMConfiguration: CanSMModeRequestRepetitionMax=10, CanSMModeRequestRepetitionTime=0.1
      3 x CanSMManagerNetwork, all with CanSMBorCounterL1ToL2=5, CanSMBorTimeL1=1, CanSMBorTimeL2=3, CanSMBorTimeTxEnsured=5, CanSMBorTxConfirmationPolling=false:
        CHNL_f276589c: CanSMComMNetworkHandleRef=CAN00_f26020e5
          CT_CAN00_388e5969 (CanSMController): CanSMControllerId=CT_CAN00_388e5969
        CHNL_8571680a: CanSMComMNetworkHandleRef=CAN01_f26020e5
          CT_CAN01_388e5969 (CanSMController): CanSMControllerId=CT_CAN01_388e5969
        CHNL_1c7839b0: CanSMComMNetworkHandleRef=CAN02_f26020e5
          CT_CAN02_388e5969 (CanSMController): CanSMControllerId=CT_CAN02_388e5969
    CanSMGeneral:
      CanSMDevErrorDetect = false
      CanSMMainFunctionTimePeriod = 0.01
      CanSMVersionInfoApi = false
      CanSMBorCheckLevel = false
      CanSMSetBaudrateApi = false
      CanSMExtendedRamCheck = false
      CanSMGeneration: CanSMOutOfBoundsWriteSanitizer=false, CanSMOutOfBoundsReadSanitizer=false
