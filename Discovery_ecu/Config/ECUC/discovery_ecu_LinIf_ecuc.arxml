AUTOSAR XML (schema 4-2-1)
package /ActiveEcuC
  module config LinIf: implementation-config-variant=VARIANT-PRE-COMPILE, module-description=LinIf_Impl
    LinIfGeneral:
      LinIfJ2602ResponseToleranceSupport = false
      LinIfCancelTransmitSupported = false
      LinIfDevErrorDetect = false
      LinIfMultipleDriversSupported = false
      LinIfMultipleTrcvDriverSupported = false
      LinIfNcOptionalRequestSupported = true
      LinIfTpSupported = false
      LinIfTrcvDriverSupported = false
      LinIfVersionInfoApi = false
      LinIfEvtFrameSupported = false
      LinIfSporadicFrameSupported = false
      LinIfRuntimeMeasurementSupport = false
      LinIfScheduleEndNotificationSupported = false
      LinIfSafeBswChecks = false
    LinIfGlobalConfig: LinIfTimeBase=0.005
      LIN00_f26020e5 (LinIfChannel):  # CHNL
        LinIfChannelId = 0
        LinIfGotoSleepConfirmationUL = LIN_SM
        LinIfScheduleRequestConfirmationUL = LIN_SM
        LinIfStartupState = NORMAL
        LinIfWakeupConfirmationUL = LIN_SM
        LinIfWakeupDelay = 0.1
        LinIfWakeupDelayExternal = 0.1
        LinIfChannelRef = LIN00_f26020e5
        LinIfComMNetworkHandleRef = LIN00_f26020e5
        4 x LinIfFrame, all with LinIfChecksumType=ENHANCED, LinIfFrameType=UNCONDITIONAL:
          FT_Init_SRU3: LinIfLength=2, LinIfPid=128
            LinIfPduDirection
              FT_Init_SRU3_c348e776 (LinIfTxPdu): LinIfTxPduId=1, LinIfUserTxUL=PDUR, LinIfTxPduRef=PT_Init_SRU3_PP_Init_SRU3_Tx_45618847_8792e7c3  # Init_SRU3
          FT_Read_SRU3: LinIfLength=3, LinIfPid=13
            LinIfPduDirection
              LinIfRxPdu: LinIfUserRxIndicationUL=PDUR, LinIfRxPduRef=PT_Read_SRU3_PP_Read_SRU3_Rx_45618847_8792e7c3
          FT_Init_LRU1: LinIfLength=1, LinIfPid=193
            LinIfPduDirection
              FT_Init_LRU1_c348e776 (LinIfTxPdu): LinIfTxPduId=0, LinIfUserTxUL=PDUR, LinIfTxPduRef=PT_Init_LRU1_PP_Init_LRU1_Tx_45618847_8792e7c3  # Init_LRU1
          FT_Read_LRU1: LinIfLength=8, LinIfPid=31
            LinIfPduDirection
              LinIfRxPdu: LinIfUserRxIndicationUL=PDUR, LinIfRxPduRef=PT_Read_LRU1_PP_Read_LRU1_Rx_45618847_8792e7c3
        CT_LIN00_388e5969 (LinIfMaster): LinIfClusterTimeBase=0.005, LinIfJitter=0, LinIfLoadBalancingOffset=0
        NULLSchedule (LinIfScheduleTable): LinIfResumePosition=CONTINUE_AT_IT_POINT, LinIfRunMode=RUN_CONTINUOUS, LinIfScheduleMode=LINTP_APPLICATIVE_SCHEDULE, LinIfScheduleTableIndex=0
        Normal_45618847 (LinIfScheduleTable):
          LinIfRunMode = RUN_CONTINUOUS
          LinIfScheduleTableIndex = 1
          LinIfScheduleTableName = 
          LinIfResumePosition = START_FROM_BEGINNING
          LinIfScheduleMode = LINTP_APPLICATIVE_SCHEDULE
          4 x LinIfEntry:
            ApplicationEntry_3: LinIfDelay=0.05, LinIfEntryIndex=3, LinIfFrameRef=FT_Read_LRU1
            ApplicationEntry_2: LinIfDelay=0.02, LinIfEntryIndex=2, LinIfFrameRef=FT_Read_SRU3
            ApplicationEntry_1: LinIfDelay=0.05, LinIfEntryIndex=1, LinIfFrameRef=FT_Init_LRU1
            ApplicationEntry_0: LinIfDelay=0.005, LinIfEntryIndex=0, LinIfFrameRef=FT_Init_SRU3
