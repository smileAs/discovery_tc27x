AUTOSAR XML (schema 4-2-1)
package /ActiveEcuC
  module config Uart: implementation-config-variant=VARIANT-POST-BUILD-LOADABLE
    UartGeneral:
      UartDevErrorDetect = false
      UartIndex = 0
      UartVersionInfoApi = false
      UartDeInitApi = false
      UartAbortReadApi = false
      UartAbortWriteApi = false
      UartPBFixedAddress = false
      UartDebugSupport = false
      UartResetSfrAtInit = false
      UartSleepEnable = false
      UartRunningInUser0Mode = false
      UartUserModeInitApiEnable = false
      UartUserModeDeInitApiEnable = false
      UartUserModeRuntimeApiEnable = false
    UartConfigSet: UartSysClockRef=McuClockReferencePoint
      UartChannel_0 (UartChannel):
        UartBaudRate = 115200
        UartHwUnit = ASCLIN0
        UartChannelId = 0
        UartAutoCalcBaudParams = true
        UartRxPinSelection = SELECT_DATALINE_A
        UartDataLength = 8
        UartStopBits = 1
        UartParityBit = NOPARITY
        UartCTSEnable = false
        UartCTSPolarity = HIGH
        UartNotification: UartTransmitNotifPtr=NULL_PTR, UartRecieveNotifPtr=NULL_PTR, UartAbortTransmitNotifPtr=NULL_PTR, UartAbortReceiveNotifPtr=NULL_PTR
    CommonPublishedInformation:
      ArMajorVersion = 0
      ArMinorVersion = 0
      ArPatchVersion = 0
      SwMajorVersion = 1
      SwMinorVersion = 3
      SwPatchVersion = 0
      ModuleId = 255
      VendorId = 17
      Release = _TRICORE_TC277
