AUTOSAR XML (schema 4-2-1)
package /ActiveEcuC
  module config Gpt: implementation-config-variant=VARIANT-POST-BUILD-LOADABLE, module-description=Gpt_Impl
    GptChannelConfigSet
      GptChannelConfiguration:
        GptChannelId = 0
        GptChannelMode = GPT_CH_MODE_CONTINUOUS
        GptChannelTickFrequency = 0
        GptChannelTickValueMax = 0
        GptEnableWakeup = false
        GptSignalType = GPT_QM_SIGNAL
        GptAssignedHwUnit = AtomChannel_0
    GptConfigurationOfOptApiServices:
      GptDeinitApi = false
      GptEnableDisableNotificationApi = false
      GptTimeElapsedApi = false
      GptTimeRemainingApi = false
      GptVersionInfoApi = false
      GptWakeupFunctionalityApi = false
      GptRunningInUser0Mode = false
      GptUserModeInitApiEnable = false
      GptUserModeDeInitApiEnable = false
      GptUserModeRuntimeApiEnable = false
    GptDriverConfiguration: GptDevErrorDetect=false, GptDebugSupport=false, GptPBFixedAddress=false, GptReportWakeupSource=false
      GptClockReferencePoint
    CommonPublishedInformation:
      ArMajorVersion = 3
      ArMinorVersion = 2
      ArPatchVersion = 0
      SwMajorVersion = 3
      SwMinorVersion = 3
      SwPatchVersion = 0
      ModuleId = 100
      VendorId = 17
      Release = _TRICORE_TC277
    GptSafety: GptSafetyEnable=false, GptInitCheckApi=true, GptGetModeApi=true
