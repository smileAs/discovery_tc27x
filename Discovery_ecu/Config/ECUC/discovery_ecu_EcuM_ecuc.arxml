AUTOSAR XML (schema 4-2-1)
package /ActiveEcuC
  module config EcuM: implementation-config-variant=VARIANT-PRE-COMPILE, module-description=EcuM_Impl
    EcuMConfiguration
      EcuMCommonConfiguration: EcuMConfigConsistencyHash=8821948185529778185, EcuMDefaultAppMode=OSDEFAULTAPPMODE, EcuMOSResource=OsResource
        5 x EcuMWakeupSource, all with EcuMValidationTimeout=0, EcuMCheckWakeupTimeout=0, EcuMWakeupSourcePolling=false:
          ECUM_WKSOURCE_POWER: EcuMWakeupSourceId=0
          ECUM_WKSOURCE_RESET: EcuMWakeupSourceId=1
          ECUM_WKSOURCE_INTERNAL_RESET: EcuMWakeupSourceId=2
          ECUM_WKSOURCE_INTERNAL_WDG: EcuMWakeupSourceId=3
          ECUM_WKSOURCE_EXTERNAL_WDG: EcuMWakeupSourceId=4
        EcuMDefaultShutdownTarget: EcuMDefaultState=EcuMStateOff
        EcuMDriverInitListZero
          8 x EcuMDriverInitItem:
            BswM_InitMemory: EcuMModuleID=BswM, EcuMModuleHeader=BswM.h, EcuMModuleService=BswM_InitMemory
            Rte_InitMemory: index=0, EcuMModuleID=Rte, EcuMModuleService=Rte_InitMemory, EcuMModuleHeader=Rte_Main.h
            Can_InitMemory: EcuMModuleID=Can, EcuMModuleHeader=Can.h, EcuMModuleService=Can_InitMemory
            CanIf_InitMemory: EcuMModuleID=CanIf, EcuMModuleService=CanIf_InitMemory
            CanSM_InitMemory: EcuMModuleID=CanSM, EcuMModuleService=CanSM_InitMemory, EcuMModuleHeader=CanSM.h
            Com_InitMemory: EcuMModuleID=Com, EcuMModuleService=Com_InitMemory, EcuMModuleHeader=Com.h
            ComM_InitMemory: EcuMModuleID=ComM, EcuMModuleService=ComM_InitMemory, EcuMModuleHeader=ComM.h
            PduR_InitMemory: EcuMModuleID=PduR, EcuMModuleService=PduR_InitMemory, EcuMModuleHeader=PduR.h
        EcuMDriverInitListOne
          10 x EcuMDriverInitItem:
            Mcu_Init: EcuMModuleID=Mcu, EcuMModuleHeader=Mcu.h, EcuMModuleService=Mcu_Init
            Spi_Init: index=0, EcuMModuleID=Spi, EcuMModuleService=Spi_Init, EcuMModuleHeader=Spi.h
            Dio_Init: index=1, EcuMModuleID=Dio, EcuMModuleService=Dio_Init, EcuMModuleHeader=Dio.h
            Gpt_Init: index=3, EcuMModuleID=Gpt, EcuMModuleService=Gpt_Init, EcuMModuleHeader=Gpt.h
            Port_Init: index=4, EcuMModuleID=Port, EcuMModuleService=Port_Init, EcuMModuleHeader=Port.h
            Pwm_17_Gtm_Init: index=5, EcuMModuleID=Pwm, EcuMModuleService=Pwm_17_Gtm_Init, EcuMModuleHeader=Pwm_17_Gtm.h
            Icu_17_GtmCcu6_Init: index=6, EcuMModuleID=Icu, EcuMModuleService=Icu_17_GtmCcu6_Init, EcuMModuleHeader=Icu_17_GtmCcu6.h
            Uart_Init: EcuMModuleID=Uart, EcuMModuleService=Uart_Init, EcuMModuleHeader=Uart.h
            IrqCan_Init: EcuMModuleID=Can, EcuMModuleService=IrqCan_Init, EcuMModuleHeader=Irq.h
            I2c: EcuMModuleID=I2c, EcuMModuleService=I2c_Init, EcuMModuleHeader=I2c.h
        EcuMDriverRestartList
        4 x EcuMWakeupSource, all with EcuMWakeupSourcePolling=false:
          CAN00_f26020e5: EcuMWakeupSourceId=5, EcuMComMChannelRef=CAN00_f26020e5  # CN_CAN00
          CAN01_f26020e5: EcuMWakeupSourceId=6, EcuMComMChannelRef=CAN01_f26020e5  # CN_CAN01
          CAN02_f26020e5: EcuMWakeupSourceId=7, EcuMComMChannelRef=CAN02_f26020e5  # CN_CAN02
          LIN00_f26020e5: EcuMWakeupSourceId=8, EcuMComMChannelRef=LIN00_f26020e5  # CN_LIN00
      EcuMFlexConfiguration: EcuMFlexModuleConfigurationRef=CanConfigSet, EcuMFlexModuleConfigurationRef=LinGlobalConfig, EcuMNormalMcuModeRef=McuModeSettingConf
        3 x EcuMResetMode:
          ECUM_RESET_MCU: EcuMResetModeId=0
          ECUM_RESET_WDG: EcuMResetModeId=1
          ECUM_RESET_IO: EcuMResetModeId=2
        4 x EcuMShutdownCause:
          ECUM_CAUSE_UNKNOWN: EcuMShutdownCauseId=0
          ECUM_CAUSE_ECU_STATE: EcuMShutdownCauseId=1
          ECUM_CAUSE_WDGM: EcuMShutdownCauseId=2
          ECUM_CAUSE_DCM: EcuMShutdownCauseId=3
        ECUM_RESET_WAKEUP (EcuMResetMode): EcuMResetModeId=3
    EcuMGeneral:
      EcuMDevErrorDetect = false
      EcuMIncludeDem = false
      EcuMIncludeDet = false
      EcuMMainFunctionPeriod = 0.01
      EcuMVersionInfoApi = false
      EcuMDeferredBswMNotification = false
      EcuMSlaveCoreHandling = true
      EcuMEnableFixBehavior = false
      EcuMGeneration: EcuMOutOfBoundsWriteSanitizer=false, EcuMOutOfBoundsReadSanitizer=false, EcuMInterfacesForDeactivatedData=false
    EcuMFlexGeneral
