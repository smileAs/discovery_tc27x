AUTOSAR XML (schema 4-2-1)
package /ActiveEcuC
  module config Com: implementation-config-variant=VARIANT-PRE-COMPILE, module-description=Com_Impl
    ComConfig: ComConfigurationId=0, ComRxDeferredNotificationCacheSize=0, ComRxImmediateNotificationCacheSize=0
      ComTimeBase: ComRxTimeBase=0.01, ComTxTimeBase=0.01, ComGwTimeBase=0.01
      APAMdHSC2_a845052a (ComSignal):
        ComBitPosition = 4
        ComBitSize = 3
        ComSignalEndianness = BIG_ENDIAN
        ComSignalInitValue = 0
        ComSignalType = UINT8
        ComTransferProperty = PENDING
        ComSignalAccess = ACCESS_UNCLEAR
        ComHandleId = 12
        ComSystemTemplateSystemSignalRef = APAMdHSC2
      GW_HSC2_IPK_FrP06_oCAN00_3abd61be (ComIPdu):
        ComIPduDirection = RECEIVE
        ComIPduType = NORMAL
        ComIPduHandleId = 37
        ComIPduSignalProcessing = DEFERRED
        ComIPduCancellationSupport = false
        ComIPduGroupRef = P2P_oCAN00_Rx_fcef2243
        ComIPduSignalRef = CalendarDayHSC2_c30fb534
        ComIPduSignalRef = CalendarMonthHSC2_c30fb534
        ComIPduSignalRef = CalendarYearHSC2_c30fb534
        ComIPduSignalRef = HourOfDayHSC2_c30fb534
        ComIPduSignalRef = MinuteOfHourHSC2_c30fb534
        ComIPduSignalRef = SecsOfMinuteHSC2_c30fb534
        ComIPduSignalRef = TimeDspFmtHSC2_c30fb534
        ComPduIdRef = PT_GW_HSC2_IPK_FrP06_PP_GW_HSC2_IPK_FrP06_Rx_0fb271d2_c07658fd
      StrgWhlAngHSC2_dccc170c (ComSignal):
        ComBitPosition = 15
        ComBitSize = 16
        ComSignalEndianness = BIG_ENDIAN
        ComSignalInitValue = 0
        ComSignalType = UINT16
        ComSignalAccess = ACCESS_UNCLEAR
        ComHandleId = 226
        ComSystemTemplateSystemSignalRef = StrgWhlAngHSC2
      GW_HSC2_FrP01_oCAN00_3abd61be (ComIPdu):
        ComIPduDirection = RECEIVE
        ComIPduType = NORMAL
        ComIPduHandleId = 29
        ComIPduSignalProcessing = DEFERRED
        ComIPduCancellationSupport = false
        ComIPduGroupRef = P2P_oCAN00_Rx_fcef2243
        ComIPduSignalRef = BPMMstrAvlbly_h2HSC2_67e1a250
        ComIPduSignalRef = PwrMdMstrAccryA_h2HSC2_67e1a250
        ComIPduSignalRef = PwrMdMstrRunCrkA_h2HSC2_67e1a250
        ComIPduSignalRef = SysOpnlMd_h2HSC2_67e1a250
        ComIPduSignalRef = SysPwrMd_h2HSC2_67e1a250
        ComIPduSignalRef = SysVolMdV_h2HSC2_67e1a250
        ComIPduSignalRef = SysVolMd_h2HSC2_67e1a250
        ComIPduSignalRef = SysVolV_h2HSC2_67e1a250
        ComIPduSignalRef = SysVol_h2HSC2_67e1a250
        ComPduIdRef = PT_GW_HSC2_FrP01_PP_GW_HSC2_FrP01_Rx_0fb271d2_c07658fd
      8 x ComSignal, all with ComSignalEndianness=BIG_ENDIAN, ComSignalAccess=ACCESS_UNCLEAR:
        SCUDrvrIntrvnAHSC2_efc2a4db: ComBitPosition=2, ComBitSize=1, ComSignalInitValue=0, ComSignalType=BOOLEAN, ComHandleId=216, ComSystemTemplateSystemSignalRef=SCUDrvrIntrvnAHSC2
        APANRCDAvlblHSC2_a845052a: ComBitPosition=38, ComBitSize=1, ComSignalInitValue=0, ComSignalType=BOOLEAN, ComTransferProperty=PENDING, ComHandleId=13, ComSystemTemplateSystemSignalRef=APANRCDAvlblHSC2
        RrMidLObsRngHSC2_ea600257: ComBitPosition=23, ComBitSize=4, ComSignalInitValue=0, ComSignalType=UINT8, ComTransferProperty=PENDING, ComHandleId=142, ComSystemTemplateSystemSignalRef=RrMidLObsRngHSC2
        WhlGndVelRDrvnHSC2_cdd3755d: ComBitPosition=21, ComBitSize=14, ComSignalInitValue=0, ComSignalType=UINT16, ComHandleId=286, ComSystemTemplateSystemSignalRef=WhlGndVelRDrvnHSC2
        VehSideLghtStsHSC2_762c2774: ComBitPosition=57, ComBitSize=2, ComSignalInitValue=0, ComSignalType=UINT8, ComHandleId=277, ComSystemTemplateSystemSignalRef=VehSideLghtStsHSC2
        RDircnIOHSC2_762c2774: ComBitPosition=9, ComBitSize=1, ComSignalInitValue=0, ComSignalType=BOOLEAN, ComHandleId=171, ComSystemTemplateSystemSignalRef=RDircnIOHSC2
        SCUNRCDAvlblHSC2_efc2a4db: ComBitPosition=3, ComBitSize=1, ComSignalInitValue=0, ComSignalType=BOOLEAN, ComHandleId=217, ComSystemTemplateSystemSignalRef=SCUNRCDAvlblHSC2
        WhlGndVelLDrvnVHSC2_cdd3755d: ComBitPosition=6, ComBitSize=1, ComSignalInitValue=1, ComSignalType=BOOLEAN, ComHandleId=283, ComSystemTemplateSystemSignalRef=WhlGndVelLDrvnVHSC2
      GW_HSC2_HCU_FrP13_oCAN00_3abd61be (ComIPdu):
        ComIPduDirection = RECEIVE
        ComIPduType = NORMAL
        ComIPduHandleId = 36
        ComIPduSignalProcessing = DEFERRED
        ComIPduCancellationSupport = false
        ComIPduCallout = MessageRX_GW_HSC2_HCU_FrP13
        ComIPduGroupRef = P2P_oCAN00_Rx_fcef2243
        ComIPduSignalRef = VCUAccReqStsHSC2_cacaa258
        ComIPduSignalRef = VCUAccReqValHSC2_cacaa258
        ComIPduSignalRef = VCUNRCDAvlblHSC2_cacaa258
        ComPduIdRef = PT_GW_HSC2_HCU_FrP13_PP_GW_HSC2_HCU_FrP13_Rx_0fb271d2_c07658fd
      MainBeamLghtOnHSC2_762c2774 (ComSignal):
        ComBitPosition = 15
        ComBitSize = 1
        ComSignalEndianness = BIG_ENDIAN
        ComSignalInitValue = 0
        ComSignalType = BOOLEAN
        ComSignalAccess = ACCESS_UNCLEAR
        ComHandleId = 147
        ComSystemTemplateSystemSignalRef = MainBeamLghtOnHSC2
      SCS_HSC2_FrP03_oCAN00_3abd61be (ComIPdu):
        ComIPduDirection = RECEIVE
        ComIPduType = NORMAL
        ComIPduHandleId = 60
        ComIPduSignalProcessing = DEFERRED
        ComIPduCancellationSupport = false
        ComIPduGroupRef = P2P_oCAN00_Rx_fcef2243
        ComIPduSignalRef = LNonDrvnWhlRotlDircnHSC2_988d6663
        ComIPduSignalRef = RNonDrvnWhlRotlDircnHSC2_988d6663
        ComIPduSignalRef = SCSAPAAcclAHSC2_988d6663
        ComIPduSignalRef = SCSAPAAlvRCHSC2_988d6663
        ComIPduSignalRef = SCSAPAAvlblHSC2_988d6663
        ComIPduSignalRef = SCSNRCDAvlblHSC2_988d6663
        ComPduIdRef = PT_SCS_HSC2_FrP03_PP_SCS_HSC2_FrP03_Rx_0fb271d2_c07658fd
      RLSideObsDistHSC2_e0a50b4e (ComSignal):
        ComBitPosition = 16
        ComBitSize = 9
        ComSignalEndianness = BIG_ENDIAN
        ComSignalInitValue = 0
        ComSignalType = UINT16
        ComTransferProperty = PENDING
        ComSignalAccess = ACCESS_UNCLEAR
        ComHandleId = 127
        ComSystemTemplateSystemSignalRef = RLSideObsDistHSC2
      SCS_HSC2_FrP00_oCAN00_3abd61be (ComIPdu):
        ComIPduDirection = RECEIVE
        ComIPduType = NORMAL
        ComIPduHandleId = 57
        ComIPduSignalProcessing = DEFERRED
        ComIPduCancellationSupport = false
        ComIPduGroupRef = P2P_oCAN00_Rx_fcef2243
        ComIPduSignalRef = LDrvnWhlRotlDistPlsCtrHSC2_16026180
        ComIPduSignalRef = LDrvnWhlRotlDistTRCHSC2_16026180
        ComIPduSignalRef = LDrvnWhlRotlDistTmspHSC2_16026180
        ComIPduSignalRef = LDrvnWhlRotlDistVHSC2_16026180
        ComIPduSignalRef = LDrvnWhlRotlRstOcdHSC2_16026180
        ComIPduSignalRef = LDrvnWhlRotlSeqNumHSC2_16026180
        ComIPduSignalRef = RDrvnWhlRotlDistPlsCtrHSC2_16026180
        ComIPduSignalRef = RDrvnWhlRotlDistTRCHSC2_16026180
        ComIPduSignalRef = RDrvnWhlRotlDistTmspHSC2_16026180
        ComIPduSignalRef = RDrvnWhlRotlDistVHSC2_16026180
        ComIPduSignalRef = RDrvnWhlRotlRstOcdHSC2_16026180
        ComIPduSignalRef = RDrvnWhlRotlSeqNumHSC2_16026180
        ComPduIdRef = PT_SCS_HSC2_FrP00_PP_SCS_HSC2_FrP00_Rx_0fb271d2_c07658fd
      13 x ComSignal, all with ComSignalEndianness=BIG_ENDIAN, ComSignalInitValue=0, ComSignalAccess=ACCESS_UNCLEAR:
        BPMMstrAvlbly_h2HSC2_67e1a250: ComBitPosition=35, ComBitSize=1, ComSignalType=BOOLEAN, ComHandleId=45, ComSystemTemplateSystemSignalRef=BPMMstrAvlbly_h2HSC2
        OtsdAirTemCrValMsk_h2HSC2_bc30b68d: ComBitPosition=51, ComBitSize=1, ComSignalType=BOOLEAN, ComHandleId=154, ComSystemTemplateSystemSignalRef=OtsdAirTemCrValMsk_h2HSC2
        APAEPBReqAlvRCHSC2_a845052a: ComBitPosition=51, ComBitSize=4, ComSignalType=UINT8, ComTransferProperty=PENDING, ComHandleId=9, ComSystemTemplateSystemSignalRef=APAEPBReqAlvRCHSC2
        SysOpnlMd_h2HSC2_67e1a250: ComBitPosition=6, ComBitSize=3, ComSignalType=UINT8, ComHandleId=231, ComSystemTemplateSystemSignalRef=SysOpnlMd_h2HSC2
        EPSAPAAlvRCHSC2_a6919738: ComBitPosition=23, ComBitSize=8, ComSignalType=UINT8, ComHandleId=86, ComSystemTemplateSystemSignalRef=EPSAPAAlvRCHSC2
        PDCSwReqHSC2_46783686: ComBitPosition=61, ComBitSize=2, ComSignalType=UINT8, ComHandleId=161, ComSystemTemplateSystemSignalRef=PDCSwReqHSC2
        DistRCAvgDrvnRstOcdHSC2_49997ba7: ComBitPosition=21, ComBitSize=1, ComSignalType=BOOLEAN, ComHandleId=69, ComSystemTemplateSystemSignalRef=DistRCAvgDrvnRstOcdHSC2
        FrtObsDistHSC2_ea600257: ComBitPosition=55, ComBitSize=8, ComSignalType=UINT8, ComTransferProperty=PENDING, ComHandleId=74, ComSystemTemplateSystemSignalRef=FrtObsDistHSC2
        RNonDrvnWhlRotlDistPCHSC2_daa8611e: ComBitPosition=33, ComBitSize=10, ComSignalType=UINT16, ComHandleId=185, ComSystemTemplateSystemSignalRef=RNonDrvnWhlRotlDistPCHSC2
        APASCSAcclReqValHSC2_a845052a: ComBitPosition=23, ComBitSize=8, ComSignalType=UINT8, ComTransferProperty=PENDING, ComHandleId=18, ComSystemTemplateSystemSignalRef=APASCSAcclReqValHSC2
        DistRCAvgDrvnSrcHSC2_49997ba7: ComBitPosition=55, ComBitSize=1, ComSignalType=BOOLEAN, ComHandleId=70, ComSystemTemplateSystemSignalRef=DistRCAvgDrvnSrcHSC2
        APAReqHSC2_a845052a: ComBitPosition=7, ComBitSize=3, ComSignalType=UINT8, ComTransferProperty=PENDING, ComHandleId=16, ComSystemTemplateSystemSignalRef=APAReqHSC2
        LDrvnWhlRotlSeqNumHSC2_16026180: ComBitPosition=5, ComBitSize=2, ComSignalType=UINT8, ComHandleId=137, ComSystemTemplateSystemSignalRef=LDrvnWhlRotlSeqNumHSC2
      EPB_HSC2_FrP01_oCAN00_3abd61be (ComIPdu):
        ComIPduDirection = RECEIVE
        ComIPduType = NORMAL
        ComIPduHandleId = 13
        ComIPduSignalProcessing = DEFERRED
        ComIPduCancellationSupport = false
        ComIPduGroupRef = P2P_oCAN00_Rx_fcef2243
        ComIPduSignalRef = EPBAppcnStsHSC2_ecbe2b89
        ComIPduSignalRef = EPBAppcnStsPVHSC2_ecbe2b89
        ComIPduSignalRef = EPBAvlblyStsHSC2_ecbe2b89
        ComIPduSignalRef = EPBAvlblyStsPVHSC2_ecbe2b89
        ComPduIdRef = PT_EPB_HSC2_FrP01_PP_EPB_HSC2_FrP01_Rx_0fb271d2_c07658fd
      6 x ComSignal, all with ComSignalEndianness=BIG_ENDIAN, ComSignalAccess=ACCESS_UNCLEAR:
        FrtFogLghtOnHSC2_762c2774: ComBitPosition=14, ComBitSize=1, ComSignalInitValue=0, ComSignalType=BOOLEAN, ComHandleId=118, ComSystemTemplateSystemSignalRef=FrtFogLghtOnHSC2
        WhlGndVelLNonDrvnVHSC2_435c72be: ComBitPosition=6, ComBitSize=1, ComSignalInitValue=1, ComSignalType=BOOLEAN, ComHandleId=285, ComSystemTemplateSystemSignalRef=WhlGndVelLNonDrvnVHSC2
        RLDoorOpenStsHSC2_762c2774: ComBitPosition=41, ComBitSize=2, ComSignalInitValue=0, ComSignalType=UINT8, ComHandleId=178, ComSystemTemplateSystemSignalRef=RLDoorOpenStsHSC2
        APAVehCrdnatAzmthHSC2_26ca02c9: ComBitPosition=24, ComBitSize=9, ComSignalInitValue=0, ComSignalType=UINT16, ComTransferProperty=PENDING, ComHandleId=29, ComSystemTemplateSystemSignalRef=APAVehCrdnatAzmthHSC2
        RstrFctryDeftsReqHSC2_d7b82a4e: ComBitPosition=56, ComBitSize=1, ComSignalInitValue=0, ComSignalType=BOOLEAN, ComHandleId=205, ComSystemTemplateSystemSignalRef=RstrFctryDeftsReqHSC2
        APASCSAlvRCHSC2_a845052a: ComBitPosition=47, ComBitSize=4, ComSignalInitValue=0, ComSignalType=UINT8, ComTransferProperty=PENDING, ComHandleId=20, ComSystemTemplateSystemSignalRef=APASCSAlvRCHSC2
      GW_HSC2_FICM_FrP08_oCAN00_3abd61be (ComIPdu):
        ComIPduDirection = RECEIVE
        ComIPduType = NORMAL
        ComIPduHandleId = 27
        ComIPduSignalProcessing = DEFERRED
        ComIPduCancellationSupport = false
        ComIPduGroupRef = P2P_oCAN00_Rx_fcef2243
        ComIPduSignalRef = APASwReqHSC2_46783686
        ComIPduSignalRef = PDCSwReqHSC2_46783686
        ComPduIdRef = PT_GW_HSC2_FICM_FrP08_PP_GW_HSC2_FICM_FrP08_Rx_0fb271d2_c07658fd
      7 x ComSignal, all with ComSignalEndianness=BIG_ENDIAN, ComSignalInitValue=0, ComSignalAccess=ACCESS_UNCLEAR:
        SCSAPAAlvRCHSC2_988d6663: ComBitPosition=39, ComBitSize=4, ComSignalType=UINT8, ComHandleId=212, ComSystemTemplateSystemSignalRef=SCSAPAAlvRCHSC2
        EPTRdy_h1HSC2_9f94b166: ComBitPosition=38, ComBitSize=1, ComSignalType=BOOLEAN, ComHandleId=94, ComSystemTemplateSystemSignalRef=EPTRdy_h1HSC2
        NRCDSts_h2HSC2_32bfb16e: ComBitPosition=39, ComBitSize=2, ComSignalType=UINT8, ComHandleId=153, ComSystemTemplateSystemSignalRef=NRCDSts_h2HSC2
        RDrvnWhlRotlDistTmspHSC2_16026180: ComBitPosition=55, ComBitSize=16, ComSignalType=UINT16, ComHandleId=174, ComSystemTemplateSystemSignalRef=RDrvnWhlRotlDistTmspHSC2
        TrlrHitchSwAHSC2_762c2774: ComBitPosition=54, ComBitSize=1, ComSignalType=BOOLEAN, ComHandleId=255, ComSystemTemplateSystemSignalRef=TrlrHitchSwAHSC2
        DircnIndLampSwStsHSC2_762c2774: ComBitPosition=3, ComBitSize=2, ComSignalType=UINT8, ComHandleId=67, ComSystemTemplateSystemSignalRef=DircnIndLampSwStsHSC2
        PDCSysStsHSC2_ea600257: ComBitPosition=7, ComBitSize=4, ComSignalType=UINT8, ComTransferProperty=PENDING, ComHandleId=115, ComSystemTemplateSystemSignalRef=PDCSysStsHSC2
      GW_HSC2_FICM_FrP02_oCAN00_3abd61be (ComIPdu):
        ComIPduDirection = RECEIVE
        ComIPduType = NORMAL
        ComIPduHandleId = 26
        ComIPduSignalProcessing = DEFERRED
        ComIPduCancellationSupport = false
        ComIPduGroupRef = P2P_oCAN00_Rx_fcef2243
        ComIPduSignalRef = DrvrSelAPAParkngMdHSC2_d7b82a4e
        ComIPduSignalRef = DrvrSelAPASlotBearngHSC2_d7b82a4e
        ComIPduSignalRef = RstrFctryDeftsReqHSC2_d7b82a4e
        ComPduIdRef = PT_GW_HSC2_FICM_FrP02_PP_GW_HSC2_FICM_FrP02_Rx_0fb271d2_c07658fd
      8 x ComSignal, all with ComSignalEndianness=BIG_ENDIAN, ComSignalInitValue=0, ComSignalAccess=ACCESS_UNCLEAR:
        LNonDrvnWhlRotlDistPCHSC2_daa8611e: ComBitPosition=1, ComBitSize=10, ComSignalType=UINT16, ComHandleId=139, ComSystemTemplateSystemSignalRef=LNonDrvnWhlRotlDistPCHSC2
        BCMSSBFltStsHSC2_34092009: ComBitPosition=7, ComBitSize=3, ComSignalType=UINT8, ComHandleId=42, ComSystemTemplateSystemSignalRef=BCMSSBFltStsHSC2
        APASlotLngthHSC2_26ca02c9: ComBitPosition=2, ComBitSize=11, ComSignalType=UINT16, ComTransferProperty=PENDING, ComHandleId=23, ComSystemTemplateSystemSignalRef=APASlotLngthHSC2
        SCUShifterLvrPosHSC2_efc2a4db: ComBitPosition=23, ComBitSize=4, ComSignalType=UINT8, ComHandleId=218, ComSystemTemplateSystemSignalRef=SCUShifterLvrPosHSC2
        RDrvnWhlRotlSeqNumHSC2_16026180: ComBitPosition=37, ComBitSize=2, ComSignalType=UINT8, ComHandleId=177, ComSystemTemplateSystemSignalRef=RDrvnWhlRotlSeqNumHSC2
        VehDynYawRateVHSC2_5ee26fe4: ComBitPosition=36, ComBitSize=1, ComSignalType=BOOLEAN, ComHandleId=267, ComSystemTemplateSystemSignalRef=VehDynYawRateVHSC2
        WhlGndVelRNonDrvnHSC2_435c72be: ComBitPosition=21, ComBitSize=14, ComSignalType=UINT16, ComHandleId=288, ComSystemTemplateSystemSignalRef=WhlGndVelRNonDrvnHSC2
        OtsdAirTemCrVal_h2HSC2_bc30b68d: ComBitPosition=63, ComBitSize=8, ComSignalType=UINT8, ComHandleId=156, ComSystemTemplateSystemSignalRef=OtsdAirTemCrVal_h2HSC2
      GW_HSC2_SDM_FrP00_oCAN00_3abd61be (ComIPdu):
        ComIPduDirection = RECEIVE
        ComIPduType = NORMAL
        ComIPduHandleId = 39
        ComIPduSignalProcessing = DEFERRED
        ComIPduCancellationSupport = false
        ComIPduGroupRef = P2P_oCAN00_Rx_fcef2243
        ComIPduSignalRef = AirbagDplHSC2_2128899b
        ComIPduSignalRef = AirbagDplInvsnHSC2_2128899b
        ComIPduSignalRef = DrvrSbltAtcHSC2_2128899b
        ComIPduSignalRef = DrvrSbltAtcVHSC2_2128899b
        ComPduIdRef = PT_GW_HSC2_SDM_FrP00_PP_GW_HSC2_SDM_FrP00_Rx_0fb271d2_c07658fd
      EPTBrkPdlDscrtInptStsHSC2_533eb1f8 (ComSignal):
        ComBitPosition = 31
        ComBitSize = 1
        ComSignalEndianness = BIG_ENDIAN
        ComSignalInitValue = 0
        ComSignalType = BOOLEAN
        ComSignalAccess = ACCESS_UNCLEAR
        ComHandleId = 92
        ComSystemTemplateSystemSignalRef = EPTBrkPdlDscrtInptStsHSC2
      LDrvnWhlRotlDistTRCHSC2_16026180 (ComSignal):
        ComBitPosition = 7
        ComBitSize = 2
        ComSignalEndianness = BIG_ENDIAN
        ComSignalInitValue = 0
        ComSignalType = UINT8
        ComSignalAccess = ACCESS_UNCLEAR
        ComHandleId = 133
        ComSystemTemplateSystemSignalRef = LDrvnWhlRotlDistTRCHSC2
      GW_HSC2_HCU_FrP01_oCAN00_3abd61be (ComIPdu):
        ComIPduDirection = RECEIVE
        ComIPduType = NORMAL
        ComIPduHandleId = 35
        ComIPduSignalProcessing = DEFERRED
        ComIPduCancellationSupport = false
        ComIPduGroupRef = P2P_oCAN00_Rx_fcef2243
        ComIPduSignalRef = EPTRdy_h1HSC2_9f94b166
        ComPduIdRef = PT_GW_HSC2_HCU_FrP01_PP_GW_HSC2_HCU_FrP01_Rx_0fb271d2_c07658fd
      11 x ComSignal, all with ComSignalEndianness=BIG_ENDIAN, ComSignalAccess=ACCESS_UNCLEAR:
        APAParkngSchedHSC2_26ca02c9: ComBitPosition=22, ComBitSize=7, ComSignalInitValue=0, ComSignalType=UINT8, ComTransferProperty=PENDING, ComHandleId=14, ComSystemTemplateSystemSignalRef=APAParkngSchedHSC2
        APAStsHSC2_a845052a: ComBitPosition=54, ComBitSize=3, ComSignalInitValue=0, ComSignalType=UINT8, ComTransferProperty=PENDING, ComHandleId=24, ComSystemTemplateSystemSignalRef=APAStsHSC2
        APACrpSpdReqValHSC2_a845052a: ComBitPosition=29, ComBitSize=6, ComSignalInitValue=0, ComSignalType=UINT8, ComTransferProperty=PENDING, ComHandleId=5, ComSystemTemplateSystemSignalRef=APACrpSpdReqValHSC2
        HourOfDayHSC2_c30fb534: ComBitPosition=28, ComBitSize=5, ComSignalInitValue=0, ComSignalType=UINT8, ComHandleId=127, ComSystemTemplateSystemSignalRef=HourOfDayHSC2
        RRObsRngHSC2_ea600257: ComBitPosition=27, ComBitSize=4, ComSignalInitValue=0, ComSignalType=UINT8, ComTransferProperty=PENDING, ComHandleId=136, ComSystemTemplateSystemSignalRef=RRObsRngHSC2
        TrShftLvrPos_h1HSC2_8bd5df01: ComBitPosition=27, ComBitSize=4, ComSignalInitValue=0, ComSignalType=UINT8, ComHandleId=254, ComSystemTemplateSystemSignalRef=TrShftLvrPos_h1HSC2
        VehDynYawRateHSC2_5ee26fe4: ComBitPosition=35, ComBitSize=12, ComSignalInitValue=0, ComSignalType=SINT16, ComHandleId=266, ComSystemTemplateSystemSignalRef=VehDynYawRateHSC2
        SDMAvlbly_h2HSC2_ab4ba2ce: ComBitPosition=5, ComBitSize=1, ComSignalInitValue=0, ComSignalType=BOOLEAN, ComHandleId=221, ComSystemTemplateSystemSignalRef=SDMAvlbly_h2HSC2
        APAToqReqValHSC2_64ef05b4: ComBitPosition=3, ComBitSize=12, ComSignalInitValue=0, ComSignalType=UINT16, ComTransferProperty=PENDING, ComHandleId=27, ComSystemTemplateSystemSignalRef=APAToqReqValHSC2
        EPSAPAStsHSC2_a6919738: ComBitPosition=4, ComBitSize=4, ComSignalInitValue=7, ComSignalType=UINT8, ComHandleId=89, ComSystemTemplateSystemSignalRef=EPSAPAStsHSC2
        RDrvnWhlRotlDistVHSC2_16026180: ComBitPosition=34, ComBitSize=1, ComSignalInitValue=0, ComSignalType=BOOLEAN, ComHandleId=175, ComSystemTemplateSystemSignalRef=RDrvnWhlRotlDistVHSC2
      P2P_oCAN00_Rx_fcef2243 (ComIPduGroup): ComIPduGroupHandleId=0
      VSELatAccVHSC2_542766fd (ComSignal):
        ComBitPosition = 3
        ComBitSize = 1
        ComSignalEndianness = BIG_ENDIAN
        ComSignalInitValue = 0
        ComSignalType = BOOLEAN
        ComSignalAccess = ACCESS_UNCLEAR
        ComHandleId = 260
        ComSystemTemplateSystemSignalRef = VSELatAccVHSC2
      FrtPDCAudWrnngHSC2_ea600257 (ComSignal):
        ComBitPosition = 15
        ComBitSize = 4
        ComSignalEndianness = BIG_ENDIAN
        ComSignalInitValue = 0
        ComSignalType = UINT8
        ComTransferProperty = PENDING
        ComSignalAccess = ACCESS_UNCLEAR
        ComHandleId = 75
        ComSystemTemplateSystemSignalRef = FrtPDCAudWrnngHSC2
      P2P_HSC2_FrP01_oCAN00_3abd61be (ComIPdu):
        ComIPduDirection = SEND
        ComIPduType = NORMAL
        ComIPduHandleId = 5
        ComIPduSignalProcessing = DEFERRED
        ComIPduCancellationSupport = false
        ComIPduGroupRef = P2P_oCAN00_Tx_fcef2243
        ComIPduSignalRef = APACrpSpdReqStsHSC2_a845052a
        ComIPduSignalRef = APACrpSpdReqValHSC2_a845052a
        ComIPduSignalRef = APAEPBOPReqHSC2_a845052a
        ComIPduSignalRef = APAEPBOpReqValPVHSC2_a845052a
        ComIPduSignalRef = APAEPBReqAlvRCHSC2_a845052a
        ComIPduSignalRef = APAInfoDispReqHSC2_a845052a
        ComIPduSignalRef = APAMdHSC2_a845052a
        ComIPduSignalRef = APANRCDAvlblHSC2_a845052a
        ComIPduSignalRef = APAReqHSC2_a845052a
        ComIPduSignalRef = APASCSAcclReqStsHSC2_a845052a
        ComIPduSignalRef = APASCSAcclReqValHSC2_a845052a
        ComIPduSignalRef = APASCSAcclReqValPVHSC2_a845052a
        ComIPduSignalRef = APASCSAlvRCHSC2_a845052a
        ComIPduSignalRef = APAShifterPosReqdHSC2_a845052a
        ComIPduSignalRef = APAStsHSC2_a845052a
        ComPduIdRef = PT_P2P_HSC2_FrP01_PP_P2P_HSC2_FrP01_Tx_0fb271d2_c07658fd
        ComTxIPdu: ComTxIPduUnusedAreasDefault=0, ComMinimumDelayTime=0
          ComTxModeTrue
            ComTxMode: ComTxModeMode=PERIODIC, ComTxModeTimePeriod=0.1, ComTxModeTimeOffset=0
          ComTxModeFalse
            ComTxMode: ComTxModeMode=PERIODIC, ComTxModeTimePeriod=0.1, ComTxModeTimeOffset=0
      SysVolMd_h2HSC2_67e1a250 (ComSignal):
        ComBitPosition = 58
        ComBitSize = 2
        ComSignalEndianness = BIG_ENDIAN
        ComSignalInitValue = 0
        ComSignalType = UINT8
        ComSignalAccess = ACCESS_UNCLEAR
        ComHandleId = 234
        ComSystemTemplateSystemSignalRef = SysVolMd_h2HSC2
      GW_HSC2_HCU_FrP00_oCAN00_3abd61be (ComIPdu):
        ComIPduDirection = RECEIVE
        ComIPduType = NORMAL
        ComIPduHandleId = 34
        ComIPduSignalProcessing = DEFERRED
        ComIPduCancellationSupport = false
        ComIPduGroupRef = P2P_oCAN00_Rx_fcef2243
        ComIPduSignalRef = EPTAccelActuPosHSC2_533eb1f8
        ComIPduSignalRef = EPTAccelActuPosVHSC2_533eb1f8
        ComIPduSignalRef = EPTBrkPdlDscrtInptStsHSC2_533eb1f8
        ComIPduSignalRef = EPTBrkPdlDscrtInptStsVHSC2_533eb1f8
        ComIPduSignalRef = EPTStCmdOn_h1HSC2_533eb1f8
        ComPduIdRef = PT_GW_HSC2_HCU_FrP00_PP_GW_HSC2_HCU_FrP00_Rx_0fb271d2_c07658fd
      3 x ComSignal, all with ComSignalEndianness=BIG_ENDIAN, ComSignalInitValue=0, ComSignalAccess=ACCESS_UNCLEAR:
        LDircnIOHSC2_762c2774: ComBitPosition=11, ComBitSize=1, ComSignalType=BOOLEAN, ComHandleId=131, ComSystemTemplateSystemSignalRef=LDircnIOHSC2
        RNonDrvnWhlRotlDistTRCHSC2_daa8611e: ComBitPosition=39, ComBitSize=2, ComSignalType=UINT8, ComHandleId=187, ComSystemTemplateSystemSignalRef=RNonDrvnWhlRotlDistTRCHSC2
        SCSAPAAvlblHSC2_988d6663: ComBitPosition=47, ComBitSize=1, ComSignalType=BOOLEAN, ComHandleId=213, ComSystemTemplateSystemSignalRef=SCSAPAAvlblHSC2
      GW_HSC2_BCM_FrP04_oCAN00_3abd61be (ComIPdu):
        ComIPduDirection = RECEIVE
        ComIPduType = NORMAL
        ComIPduHandleId = 21
        ComIPduSignalProcessing = DEFERRED
        ComIPduCancellationSupport = false
        ComIPduGroupRef = P2P_oCAN00_Rx_fcef2243
        ComIPduSignalRef = BntOpenStsHSC2_762c2774
        ComIPduSignalRef = DipdBeamLghtOnHSC2_762c2774
        ComIPduSignalRef = DircnIndLampSwStsHSC2_762c2774
        ComIPduSignalRef = DrvrDoorOpenStsHSC2_762c2774
        ComIPduSignalRef = FrtFogLghtOnHSC2_762c2774
        ComIPduSignalRef = FrtPsngDoorOpenStsHSC2_762c2774
        ComIPduSignalRef = LDircnIOHSC2_762c2774
        ComIPduSignalRef = LdspcOpenStsHSC2_762c2774
        ComIPduSignalRef = MainBeamLghtOnHSC2_762c2774
        ComIPduSignalRef = RDircnIOHSC2_762c2774
        ComIPduSignalRef = RLDoorOpenStsHSC2_762c2774
        ComIPduSignalRef = RRDoorOpenStsHSC2_762c2774
        ComIPduSignalRef = RrFogLghtOnHSC2_762c2774
        ComIPduSignalRef = TrlrHitchSwAHSC2_762c2774
        ComIPduSignalRef = VehSideLghtStsHSC2_762c2774
        ComPduIdRef = PT_GW_HSC2_BCM_FrP04_PP_GW_HSC2_BCM_FrP04_Rx_0fb271d2_c07658fd
      GW_HSC2_BCM_FrP07_oCAN00_3abd61be (ComIPdu):
        ComIPduDirection = RECEIVE
        ComIPduType = NORMAL
        ComIPduHandleId = 23
        ComIPduSignalProcessing = DEFERRED
        ComIPduCancellationSupport = false
        ComIPduGroupRef = P2P_oCAN00_Rx_fcef2243
        ComIPduSignalRef = BCMSSBAHSC2_f8a32097
        ComIPduSignalRef = BCMSSBAVHSC2_f8a32097
        ComIPduSignalRef = PwrMdAutoCtrlAvlblHSC2_f8a32097
        ComIPduSignalRef = SysBPMEnbdHSC2_f8a32097
        ComIPduSignalRef = SysBPMHSC2_f8a32097
        ComPduIdRef = PT_GW_HSC2_BCM_FrP07_PP_GW_HSC2_BCM_FrP07_Rx_0fb271d2_c07658fd
      4 x ComSignal, all with ComSignalEndianness=BIG_ENDIAN, ComSignalInitValue=0, ComSignalAccess=ACCESS_UNCLEAR:
        LNonDrvnWhlRotlRstOcdHSC2_daa8611e: ComBitPosition=3, ComBitSize=1, ComSignalType=BOOLEAN, ComHandleId=143, ComSystemTemplateSystemSignalRef=LNonDrvnWhlRotlRstOcdHSC2
        APACmdEPSStsHSC2_64ef05b4: ComBitPosition=7, ComBitSize=2, ComSignalType=UINT8, ComTransferProperty=PENDING, ComHandleId=3, ComSystemTemplateSystemSignalRef=APACmdEPSStsHSC2
        SysPwrMd_h2HSC2_67e1a250: ComBitPosition=1, ComBitSize=2, ComSignalType=UINT8, ComHandleId=232, ComSystemTemplateSystemSignalRef=SysPwrMd_h2HSC2
        VCUAccReqValHSC2_cacaa258: ComBitPosition=63, ComBitSize=8, ComSignalType=UINT8, ComHandleId=257, ComSystemTemplateSystemSignalRef=VCUAccReqValHSC2
      P2P_HSC2_FrP04_oCAN00_3abd61be (ComIPdu):
        ComIPduDirection = SEND
        ComIPduType = NORMAL
        ComIPduHandleId = 8
        ComIPduSignalProcessing = DEFERRED
        ComIPduCancellationSupport = false
        ComIPduGroupRef = P2P_oCAN00_Tx_fcef2243
        ComIPduSignalRef = FLSideObsDistHSC2_e0a50b4e
        ComIPduSignalRef = FRSideObsDistHSC2_e0a50b4e
        ComIPduSignalRef = RLSideObsDistHSC2_e0a50b4e
        ComIPduSignalRef = RRSideObsDistHSC2_e0a50b4e
        ComPduIdRef = PT_P2P_HSC2_FrP04_PP_P2P_HSC2_FrP04_Tx_0fb271d2_c07658fd
        ComTxIPdu: ComTxIPduUnusedAreasDefault=0, ComMinimumDelayTime=0
          ComTxModeTrue
            ComTxMode: ComTxModeMode=PERIODIC, ComTxModeTimePeriod=0.1, ComTxModeTimeOffset=0
          ComTxModeFalse
            ComTxMode: ComTxModeMode=PERIODIC, ComTxModeTimePeriod=0.1, ComTxModeTimeOffset=0
      6 x ComSignal, all with ComSignalAccess=ACCESS_UNCLEAR:
        VehSpdAvgDrvnHSC2_49997ba7: ComBitPosition=6, ComBitSize=15, ComSignalEndianness=BIG_ENDIAN, ComSignalInitValue=0, ComSignalType=UINT16, ComHandleId=278, ComSystemTemplateSystemSignalRef=VehSpdAvgDrvnHSC2
        SysVolMdV_h2HSC2_67e1a250: ComBitPosition=7, ComBitSize=1, ComSignalEndianness=BIG_ENDIAN, ComSignalInitValue=0, ComSignalType=BOOLEAN, ComHandleId=233, ComSystemTemplateSystemSignalRef=SysVolMdV_h2HSC2
        IECUToBCMRmtCtrlPotclHSC2_4372be29: ComBitPosition=0, ComSignalEndianness=opaque, ComSignalInitValue=0 0 0 0 0 0 0 0, ComSignalLength=8, ComSignalType=UINT8_N, ComTransferProperty=PENDING, ComHandleId=84, ComSystemTemplateSystemSignalRef=IECUToBCMRmtCtrlPotclHSC2
        WhlGndVelRNonDrvnVHSC2_435c72be: ComBitPosition=22, ComBitSize=1, ComSignalEndianness=BIG_ENDIAN, ComSignalInitValue=1, ComSignalType=BOOLEAN, ComHandleId=289, ComSystemTemplateSystemSignalRef=WhlGndVelRNonDrvnVHSC2
        VehSpdAvgDrvnVHSC2_49997ba7: ComBitPosition=7, ComBitSize=1, ComSignalEndianness=BIG_ENDIAN, ComSignalInitValue=0, ComSignalType=BOOLEAN, ComHandleId=279, ComSystemTemplateSystemSignalRef=VehSpdAvgDrvnVHSC2
        RNonDrvnWhlRotlDircnHSC2_988d6663: ComBitPosition=35, ComBitSize=2, ComSignalEndianness=BIG_ENDIAN, ComSignalInitValue=3, ComSignalType=UINT8, ComHandleId=184, ComSystemTemplateSystemSignalRef=RNonDrvnWhlRotlDircnHSC2
      GW_HSC2_FrP08_oCAN00_3abd61be (ComIPdu):
        ComIPduDirection = RECEIVE
        ComIPduType = NORMAL
        ComIPduHandleId = 30
        ComIPduSignalProcessing = DEFERRED
        ComIPduCancellationSupport = false
        ComIPduGroupRef = P2P_oCAN00_Rx_fcef2243
        ComIPduSignalRef = VehOdoV_h2HSC2_78aeb97b
        ComIPduSignalRef = VehOdo_h2HSC2_78aeb97b
        ComPduIdRef = PT_GW_HSC2_FrP08_PP_GW_HSC2_FrP08_Rx_0fb271d2_c07658fd
      8 x ComSignal, all with ComSignalAccess=ACCESS_UNCLEAR:
        DipdBeamLghtOnHSC2_762c2774: ComBitPosition=13, ComBitSize=1, ComSignalEndianness=BIG_ENDIAN, ComSignalInitValue=0, ComSignalType=BOOLEAN, ComHandleId=66, ComSystemTemplateSystemSignalRef=DipdBeamLghtOnHSC2
        EPBSwStsVHSC2_20142b17: ComBitPosition=5, ComBitSize=1, ComSignalEndianness=BIG_ENDIAN, ComSignalInitValue=0, ComSignalType=BOOLEAN, ComHandleId=85, ComSystemTemplateSystemSignalRef=EPBSwStsVHSC2
        VehOdo_h2HSC2_78aeb97b: ComBitPosition=7, ComBitSize=24, ComSignalEndianness=BIG_ENDIAN, ComSignalInitValue=0, ComSignalType=UINT32, ComHandleId=272, ComSystemTemplateSystemSignalRef=VehOdo_h2HSC2
        RrMidRObsRngHSC2_ea600257: ComBitPosition=11, ComBitSize=4, ComSignalEndianness=BIG_ENDIAN, ComSignalInitValue=0, ComSignalType=UINT8, ComTransferProperty=PENDING, ComHandleId=143, ComSystemTemplateSystemSignalRef=RrMidRObsRngHSC2
        StrgWhlAngVHSC2_dccc170c: ComBitPosition=7, ComBitSize=1, ComSignalEndianness=BIG_ENDIAN, ComSignalInitValue=0, ComSignalType=BOOLEAN, ComHandleId=227, ComSystemTemplateSystemSignalRef=StrgWhlAngVHSC2
        APAChksmHSC2_64ef05b4: ComBitPosition=47, ComBitSize=8, ComSignalEndianness=BIG_ENDIAN, ComSignalInitValue=0, ComSignalType=UINT8, ComTransferProperty=PENDING, ComHandleId=2, ComSystemTemplateSystemSignalRef=APAChksmHSC2
        NRCDMstrChlg_h2HSC2_407c19cd: ComBitPosition=0, ComSignalEndianness=opaque, ComSignalInitValue=0 0 0 0 0 0 0 0, ComSignalLength=8, ComSignalType=UINT8_N, ComHandleId=152, ComSystemTemplateSystemSignalRef=NRCDMstrChlg_h2HSC2
        DrvrSbltAtcHSC2_2128899b: ComBitPosition=12, ComBitSize=1, ComSignalEndianness=BIG_ENDIAN, ComSignalInitValue=0, ComSignalType=BOOLEAN, ComHandleId=73, ComSystemTemplateSystemSignalRef=DrvrSbltAtcHSC2
      SAS_HSC2_FrP00_oCAN00_3abd61be (ComIPdu):
        ComIPduDirection = RECEIVE
        ComIPduType = NORMAL
        ComIPduHandleId = 56
        ComIPduSignalProcessing = DEFERRED
        ComIPduCancellationSupport = false
        ComIPduCallout = MessageRX_0x1E5_SAS_HSC2_FrP00
        ComIPduGroupRef = P2P_oCAN00_Rx_fcef2243
        ComIPduSignalRef = StrgWhlAngHSC2_dccc170c
        ComIPduSignalRef = StrgWhlAngVHSC2_dccc170c
        ComPduIdRef = PT_SAS_HSC2_FrP00_PP_SAS_HSC2_FrP00_Rx_0fb271d2_c07658fd
      DIAG_FuncReq_HSC2_oCAN00_3abd61be (ComIPdu):
        ComIPduDirection = RECEIVE
        ComIPduType = NORMAL
        ComIPduHandleId = 9
        ComIPduSignalProcessing = DEFERRED
        ComIPduCancellationSupport = false
        ComIPduGroupRef = P2P_oCAN00_Rx_fcef2243
        ComIPduSignalRef = DiagnosticFuncAddrReq_h2_a8412cb3
        ComPduIdRef = PT_DIAG_FuncReq_HSC2_PP_DIAG_FuncReq_HSC2_Rx_0fb271d2_c07658fd
      4 x ComSignal, all with ComSignalAccess=ACCESS_UNCLEAR:
        BCMToIECURmtCtrlPotclHSC2_c8458f49: ComBitPosition=0, ComSignalEndianness=opaque, ComSignalInitValue=0 0 0 0 0 0 0 0, ComSignalLength=8, ComSignalType=UINT8_N, ComHandleId=43, ComSystemTemplateSystemSignalRef=BCMToIECURmtCtrlPotclHSC2
        CalendarMonthHSC2_c30fb534: ComBitPosition=11, ComBitSize=4, ComSignalEndianness=BIG_ENDIAN, ComSignalInitValue=0, ComSignalType=UINT8, ComHandleId=50, ComSystemTemplateSystemSignalRef=CalendarMonthHSC2
        RNonDrvnWhlRotlDistVHSC2_daa8611e: ComBitPosition=34, ComBitSize=1, ComSignalEndianness=BIG_ENDIAN, ComSignalInitValue=0, ComSignalType=BOOLEAN, ComHandleId=188, ComSystemTemplateSystemSignalRef=RNonDrvnWhlRotlDistVHSC2
        HCUAvlbly_h2HSC2_ab4ba2ce: ComBitPosition=12, ComBitSize=1, ComSignalEndianness=BIG_ENDIAN, ComSignalInitValue=0, ComSignalType=BOOLEAN, ComHandleId=126, ComSystemTemplateSystemSignalRef=HCUAvlbly_h2HSC2
      P2P_oCAN00_Tx_fcef2243 (ComIPduGroup): ComIPduGroupHandleId=1
      14 x ComSignal, all with ComSignalEndianness=BIG_ENDIAN, ComSignalAccess=ACCESS_UNCLEAR:
        BCMSSBAVHSC2_f8a32097: ComBitPosition=1, ComBitSize=1, ComSignalInitValue=0, ComSignalType=BOOLEAN, ComHandleId=41, ComSystemTemplateSystemSignalRef=BCMSSBAVHSC2
        LNonDrvnWhlRotlDistTHSC2_daa8611e: ComBitPosition=23, ComBitSize=16, ComSignalInitValue=0, ComSignalType=UINT16, ComHandleId=140, ComSystemTemplateSystemSignalRef=LNonDrvnWhlRotlDistTHSC2
        WhlGndVelLDrvnHSC2_cdd3755d: ComBitPosition=5, ComBitSize=14, ComSignalInitValue=0, ComSignalType=UINT16, ComHandleId=282, ComSystemTemplateSystemSignalRef=WhlGndVelLDrvnHSC2
        RrObsDistHSC2_ea600257: ComBitPosition=63, ComBitSize=8, ComSignalInitValue=0, ComSignalType=UINT8, ComTransferProperty=PENDING, ComHandleId=144, ComSystemTemplateSystemSignalRef=RrObsDistHSC2
        APASCSAcclReqStsHSC2_a845052a: ComBitPosition=55, ComBitSize=1, ComSignalInitValue=0, ComSignalType=BOOLEAN, ComTransferProperty=PENDING, ComHandleId=17, ComSystemTemplateSystemSignalRef=APASCSAcclReqStsHSC2
        PwrMdMstrRunCrkA_h2HSC2_67e1a250: ComBitPosition=3, ComBitSize=1, ComSignalInitValue=0, ComSignalType=BOOLEAN, ComHandleId=170, ComSystemTemplateSystemSignalRef=PwrMdMstrRunCrkA_h2HSC2
        DistRCAvgDrvnVHSC2_49997ba7: ComBitPosition=22, ComBitSize=1, ComSignalInitValue=0, ComSignalType=BOOLEAN, ComHandleId=71, ComSystemTemplateSystemSignalRef=DistRCAvgDrvnVHSC2
        APAEPBOpReqValPVHSC2_a845052a: ComBitPosition=63, ComBitSize=8, ComSignalInitValue=0, ComSignalType=UINT8, ComTransferProperty=PENDING, ComHandleId=8, ComSystemTemplateSystemSignalRef=APAEPBOpReqValPVHSC2
        EPTBrkPdlDscrtInptStsVHSC2_533eb1f8: ComBitPosition=16, ComBitSize=1, ComSignalInitValue=1, ComSignalType=BOOLEAN, ComHandleId=93, ComSystemTemplateSystemSignalRef=EPTBrkPdlDscrtInptStsVHSC2
        FRSideObsDistHSC2_e0a50b4e: ComBitPosition=32, ComBitSize=9, ComSignalInitValue=0, ComSignalType=UINT16, ComTransferProperty=PENDING, ComHandleId=71, ComSystemTemplateSystemSignalRef=FRSideObsDistHSC2
        BntOpenStsHSC2_762c2774: ComBitPosition=47, ComBitSize=2, ComSignalInitValue=0, ComSignalType=UINT8, ComHandleId=46, ComSystemTemplateSystemSignalRef=BntOpenStsHSC2
        NRCDFHSC2_6ae5c0ff: ComBitPosition=5, ComBitSize=1, ComSignalInitValue=0, ComSignalType=BOOLEAN, ComHandleId=151, ComSystemTemplateSystemSignalRef=NRCDFHSC2
        APASlotBearngHSC2_26ca02c9: ComBitPosition=47, ComBitSize=2, ComSignalInitValue=0, ComSignalType=UINT8, ComTransferProperty=PENDING, ComHandleId=22, ComSystemTemplateSystemSignalRef=APASlotBearngHSC2
        ABSAHSC2_5ee26fe4: ComBitPosition=30, ComBitSize=1, ComSignalInitValue=0, ComSignalType=BOOLEAN, ComHandleId=0, ComSystemTemplateSystemSignalRef=ABSAHSC2
      3 x ComIPdu, all with ComIPduDirection=RECEIVE, ComIPduType=NORMAL, ComIPduSignalProcessing=DEFERRED, ComIPduCancellationSupport=false, ComIPduGroupRef=P2P_oCAN00_Rx_fcef2243:
        EPB_HSC2_FrP00_oCAN00_3abd61be: ComIPduHandleId=12, ComIPduSignalRef=EPBSwStsHSC2_20142b17, ComIPduSignalRef=EPBSwStsVHSC2_20142b17, ComPduIdRef=PT_EPB_HSC2_FrP00_PP_EPB_HSC2_FrP00_Rx_0fb271d2_c07658fd
        SCS_HSC2_FrP15_oCAN00_3abd61be: ComIPduHandleId=64, ComIPduSignalRef=DistRCAvgDrvnHSC2_49997ba7, ComIPduSignalRef=DistRCAvgDrvnRstOcdHSC2_49997ba7, ComIPduSignalRef=DistRCAvgDrvnSrcHSC2_49997ba7, ComIPduSignalRef=DistRCAvgDrvnVHSC2_49997ba7, ComIPduSignalRef=VehSpdAvgDrvnHSC2_49997ba7, ComIPduSignalRef=VehSpdAvgDrvnVHSC2_49997ba7, ComIPduSignalRef=VehSpdAvgNonDrvnHSC2_49997ba7, ComIPduSignalRef=VehSpdAvgNonDrvnVHSC2_49997ba7, ComPduIdRef=PT_SCS_HSC2_FrP15_PP_SCS_HSC2_FrP15_Rx_0fb271d2_c07658fd
        SCS_HSC2_FrP12_oCAN00_3abd61be: ComIPduHandleId=63, ComIPduCallout=MessageRx_0x34A_SCS_HSC2_FrP12, ComIPduSignalRef=WhlGndVelLNonDrvnHSC2_435c72be, ComIPduSignalRef=WhlGndVelLNonDrvnVHSC2_435c72be, ComIPduSignalRef=WhlGndVelRNonDrvnHSC2_435c72be, ComIPduSignalRef=WhlGndVelRNonDrvnVHSC2_435c72be, ComPduIdRef=PT_SCS_HSC2_FrP12_PP_SCS_HSC2_FrP12_Rx_0fb271d2_c07658fd
      EPSAPAChksmHSC2_a6919738 (ComSignal):
        ComBitPosition = 31
        ComBitSize = 8
        ComSignalEndianness = BIG_ENDIAN
        ComSignalInitValue = 0
        ComSignalType = UINT8
        ComSignalAccess = ACCESS_UNCLEAR
        ComHandleId = 87
        ComSystemTemplateSystemSignalRef = EPSAPAChksmHSC2
      VehSpdAvgNonDrvnVHSC2_49997ba7 (ComSignal):
        ComBitPosition = 39
        ComBitSize = 1
        ComSignalEndianness = BIG_ENDIAN
        ComSignalInitValue = 0
        ComSignalType = BOOLEAN
        ComSignalAccess = ACCESS_UNCLEAR
        ComHandleId = 281
        ComSystemTemplateSystemSignalRef = VehSpdAvgNonDrvnVHSC2
      P2P_DIAG_DTCInfo_APA_oCAN00_3abd61be (ComIPdu):
        ComIPduDirection = SEND
        ComIPduType = NORMAL
        ComIPduHandleId = 3
        ComIPduSignalProcessing = DEFERRED
        ComIPduCancellationSupport = false
        ComIPduGroupRef = P2P_oCAN00_Tx_fcef2243
        ComIPduSignalRef = DTCInfomationAPAHSC2_c3e0343e
        ComPduIdRef = PT_P2P_DIAG_DTCInfo_APA_PP_P2P_DIAG_DTCInfo_APA_Tx_0fb271d2_c07658fd
        ComTxIPdu: ComTxIPduUnusedAreasDefault=0, ComMinimumDelayTime=0
          ComTxModeTrue
            ComTxMode: ComTxModeMode=NONE
          ComTxModeFalse
            ComTxMode: ComTxModeMode=NONE
      VCUAccReqStsHSC2_cacaa258 (ComSignal):
        ComBitPosition = 53
        ComBitSize = 1
        ComSignalEndianness = BIG_ENDIAN
        ComSignalInitValue = 0
        ComSignalType = BOOLEAN
        ComSignalAccess = ACCESS_UNCLEAR
        ComHandleId = 256
        ComSystemTemplateSystemSignalRef = VCUAccReqStsHSC2
      Tester_HSC2_GW_FrP14_oCAN00_3abd61be (ComIPdu):
        ComIPduDirection = RECEIVE
        ComIPduType = NORMAL
        ComIPduHandleId = 68
        ComIPduSignalProcessing = DEFERRED
        ComIPduCancellationSupport = false
        ComIPduGroupRef = P2P_oCAN00_Rx_fcef2243
        ComIPduSignalRef = NRCDAlvRCHSC2_6ae5c0ff
        ComIPduSignalRef = NRCDFHSC2_6ae5c0ff
        ComPduIdRef = PT_Tester_HSC2_GW_FrP14_PP_Tester_HSC2_GW_FrP14_Rx_0fb271d2_c07658fd
      6 x ComSignal, all with ComSignalAccess=ACCESS_UNCLEAR:
        TCSAHSC2_5ee26fe4: ComBitPosition=28, ComBitSize=1, ComSignalEndianness=BIG_ENDIAN, ComSignalInitValue=0, ComSignalType=BOOLEAN, ComHandleId=241, ComSystemTemplateSystemSignalRef=TCSAHSC2
        EPTStCmdOn_h1HSC2_533eb1f8: ComBitPosition=17, ComBitSize=1, ComSignalEndianness=BIG_ENDIAN, ComSignalInitValue=0, ComSignalType=BOOLEAN, ComHandleId=95, ComSystemTemplateSystemSignalRef=EPTStCmdOn_h1HSC2
        DTCInfomationAPAHSC2_c3e0343e: ComBitPosition=0, ComSignalEndianness=opaque, ComSignalInitValue=0 0 0 0 0 0 0, ComSignalLength=7, ComSignalType=UINT8_N, ComTransferProperty=PENDING, ComHandleId=39, ComSystemTemplateSystemSignalRef=DTCInfomationAPAHSC2
        RDrvnWhlRotlRstOcdHSC2_16026180: ComBitPosition=35, ComBitSize=1, ComSignalEndianness=BIG_ENDIAN, ComSignalInitValue=0, ComSignalType=BOOLEAN, ComHandleId=176, ComSystemTemplateSystemSignalRef=RDrvnWhlRotlRstOcdHSC2
        APAVehCrdnatPosYHSC2_26ca02c9: ComBitPosition=49, ComBitSize=10, ComSignalEndianness=BIG_ENDIAN, ComSignalInitValue=0, ComSignalType=UINT16, ComTransferProperty=PENDING, ComHandleId=31, ComSystemTemplateSystemSignalRef=APAVehCrdnatPosYHSC2
        DrvrSelAPAParkngMdHSC2_d7b82a4e: ComBitPosition=10, ComBitSize=3, ComSignalEndianness=BIG_ENDIAN, ComSignalInitValue=0, ComSignalType=UINT8, ComHandleId=75, ComSystemTemplateSystemSignalRef=DrvrSelAPAParkngMdHSC2
      GW_HSC2_BCM_FrS16_oCAN00_3abd61be (ComIPdu):
        ComIPduDirection = RECEIVE
        ComIPduType = NORMAL
        ComIPduHandleId = 24
        ComIPduSignalProcessing = DEFERRED
        ComIPduCancellationSupport = false
        ComIPduGroupRef = P2P_oCAN00_Rx_fcef2243
        ComIPduSignalRef = BCMToIECURmtCtrlPotclHSC2_c8458f49
        ComPduIdRef = PT_GW_HSC2_BCM_FrS16_PP_GW_HSC2_BCM_FrS16_Rx_0fb271d2_c07658fd
      7 x ComSignal, all with ComSignalEndianness=BIG_ENDIAN, ComSignalInitValue=0, ComSignalAccess=ACCESS_UNCLEAR:
        APAShifterPosReqdHSC2_a845052a: ComBitPosition=43, ComBitSize=4, ComSignalType=UINT8, ComTransferProperty=PENDING, ComHandleId=21, ComSystemTemplateSystemSignalRef=APAShifterPosReqdHSC2
        EPBSwStsHSC2_20142b17: ComBitPosition=7, ComBitSize=2, ComSignalType=UINT8, ComHandleId=84, ComSystemTemplateSystemSignalRef=EPBSwStsHSC2
        VehSpdAvgNonDrvnHSC2_49997ba7: ComBitPosition=38, ComBitSize=15, ComSignalType=UINT16, ComHandleId=280, ComSystemTemplateSystemSignalRef=VehSpdAvgNonDrvnHSC2
        APASwReqHSC2_46783686: ComBitPosition=59, ComBitSize=2, ComSignalType=UINT8, ComHandleId=25, ComSystemTemplateSystemSignalRef=APASwReqHSC2
        RRSideObsDistHSC2_e0a50b4e: ComBitPosition=0, ComBitSize=9, ComSignalType=UINT16, ComTransferProperty=PENDING, ComHandleId=137, ComSystemTemplateSystemSignalRef=RRSideObsDistHSC2
        LdspcOpenStsHSC2_762c2774: ComBitPosition=7, ComBitSize=2, ComSignalType=UINT8, ComHandleId=146, ComSystemTemplateSystemSignalRef=LdspcOpenStsHSC2
        LDrvnWhlRotlDistTmspHSC2_16026180: ComBitPosition=23, ComBitSize=16, ComSignalType=UINT16, ComHandleId=134, ComSystemTemplateSystemSignalRef=LDrvnWhlRotlDistTmspHSC2
      GW_HSC2_FrS00_oCAN00_3abd61be (ComIPdu):
        ComIPduDirection = RECEIVE
        ComIPduType = NORMAL
        ComIPduHandleId = 33
        ComIPduSignalProcessing = DEFERRED
        ComIPduCancellationSupport = false
        ComIPduGroupRef = P2P_oCAN00_Rx_fcef2243
        ComIPduSignalRef = NRCDMstrChlg_h2HSC2_407c19cd
        ComPduIdRef = PT_GW_HSC2_FrS00_PP_GW_HSC2_FrS00_Rx_0fb271d2_c07658fd
      11 x ComSignal, all with ComSignalEndianness=BIG_ENDIAN, ComSignalInitValue=0, ComSignalAccess=ACCESS_UNCLEAR:
        DrvrDoorOpenStsHSC2_762c2774: ComBitPosition=1, ComBitSize=2, ComSignalType=UINT8, ComHandleId=72, ComSystemTemplateSystemSignalRef=DrvrDoorOpenStsHSC2
        EPBAppcnStsHSC2_ecbe2b89: ComBitPosition=15, ComBitSize=2, ComSignalType=UINT8, ComHandleId=80, ComSystemTemplateSystemSignalRef=EPBAppcnStsHSC2
        RrPDCAudWrnngHSC2_ea600257: ComBitPosition=3, ComBitSize=4, ComSignalType=UINT8, ComTransferProperty=PENDING, ComHandleId=145, ComSystemTemplateSystemSignalRef=RrPDCAudWrnngHSC2
        SysVol_h2HSC2_67e1a250: ComBitPosition=47, ComBitSize=8, ComSignalType=UINT8, ComHandleId=236, ComSystemTemplateSystemSignalRef=SysVol_h2HSC2
        TimeDspFmtHSC2_c30fb534: ComBitPosition=46, ComBitSize=1, ComSignalType=BOOLEAN, ComHandleId=251, ComSystemTemplateSystemSignalRef=TimeDspFmtHSC2
        APATrgtEPSStrgWhlAngHSC2_64ef05b4: ComBitPosition=23, ComBitSize=16, ComSignalType=UINT16, ComTransferProperty=PENDING, ComHandleId=28, ComSystemTemplateSystemSignalRef=APATrgtEPSStrgWhlAngHSC2
        EPTAccelActuPosHSC2_533eb1f8: ComBitPosition=7, ComBitSize=8, ComSignalType=UINT8, ComHandleId=90, ComSystemTemplateSystemSignalRef=EPTAccelActuPosHSC2
        WhlGndVelLNonDrvnHSC2_435c72be: ComBitPosition=5, ComBitSize=14, ComSignalType=UINT16, ComHandleId=284, ComSystemTemplateSystemSignalRef=WhlGndVelLNonDrvnHSC2
        OtsdAirTemCrValV_h2HSC2_bc30b68d: ComBitPosition=48, ComBitSize=1, ComSignalType=BOOLEAN, ComHandleId=155, ComSystemTemplateSystemSignalRef=OtsdAirTemCrValV_h2HSC2
        VSELatAccHSC2_542766fd: ComBitPosition=19, ComBitSize=12, ComSignalType=SINT16, ComHandleId=259, ComSystemTemplateSystemSignalRef=VSELatAccHSC2
        BCMAvlbly_h2HSC2_ab4ba2ce: ComBitPosition=31, ComBitSize=1, ComSignalType=BOOLEAN, ComHandleId=37, ComSystemTemplateSystemSignalRef=BCMAvlbly_h2HSC2
      EPS_HSC2_FrP02_oCAN00_3abd61be (ComIPdu):
        ComIPduDirection = RECEIVE
        ComIPduType = NORMAL
        ComIPduHandleId = 14
        ComIPduSignalProcessing = DEFERRED
        ComIPduCancellationSupport = false
        ComIPduGroupRef = P2P_oCAN00_Rx_fcef2243
        ComIPduSignalRef = EPSAPAAlvRCHSC2_a6919738
        ComIPduSignalRef = EPSAPAChksmHSC2_a6919738
        ComIPduSignalRef = EPSAPAInhHSC2_a6919738
        ComIPduSignalRef = EPSAPAStsHSC2_a6919738
        ComPduIdRef = PT_EPS_HSC2_FrP02_PP_EPS_HSC2_FrP02_Rx_0fb271d2_c07658fd
      7 x ComSignal, all with ComSignalEndianness=BIG_ENDIAN, ComSignalInitValue=0, ComSignalAccess=ACCESS_UNCLEAR:
        SysVolV_h2HSC2_67e1a250: ComBitPosition=32, ComBitSize=1, ComSignalType=BOOLEAN, ComHandleId=235, ComSystemTemplateSystemSignalRef=SysVolV_h2HSC2
        SCSAPAAcclAHSC2_988d6663: ComBitPosition=46, ComBitSize=1, ComSignalType=BOOLEAN, ComHandleId=211, ComSystemTemplateSystemSignalRef=SCSAPAAcclAHSC2
        APAAlvRCHSC2_64ef05b4: ComBitPosition=39, ComBitSize=8, ComSignalType=UINT8, ComTransferProperty=PENDING, ComHandleId=1, ComSystemTemplateSystemSignalRef=APAAlvRCHSC2
        SCSNRCDAvlblHSC2_988d6663: ComBitPosition=45, ComBitSize=1, ComSignalType=BOOLEAN, ComHandleId=214, ComSystemTemplateSystemSignalRef=SCSNRCDAvlblHSC2
        CalendarDayHSC2_c30fb534: ComBitPosition=20, ComBitSize=5, ComSignalType=UINT8, ComHandleId=48, ComSystemTemplateSystemSignalRef=CalendarDayHSC2
        FLSideObsDistHSC2_e0a50b4e: ComBitPosition=48, ComBitSize=9, ComSignalType=UINT16, ComTransferProperty=PENDING, ComHandleId=69, ComSystemTemplateSystemSignalRef=FLSideObsDistHSC2
        RrFogLghtOnHSC2_762c2774: ComBitPosition=8, ComBitSize=1, ComSignalType=BOOLEAN, ComHandleId=198, ComSystemTemplateSystemSignalRef=RrFogLghtOnHSC2
      SCS_HSC2_FrP11_oCAN00_3abd61be (ComIPdu):
        ComIPduDirection = RECEIVE
        ComIPduType = NORMAL
        ComIPduHandleId = 62
        ComIPduSignalProcessing = DEFERRED
        ComIPduCancellationSupport = false
        ComIPduCallout = MessageRx_0x348_SCS_HSC2_FrP11
        ComIPduGroupRef = P2P_oCAN00_Rx_fcef2243
        ComIPduSignalRef = WhlGndVelLDrvnHSC2_cdd3755d
        ComIPduSignalRef = WhlGndVelLDrvnVHSC2_cdd3755d
        ComIPduSignalRef = WhlGndVelRDrvnHSC2_cdd3755d
        ComIPduSignalRef = WhlGndVelRDrvnVHSC2_cdd3755d
        ComPduIdRef = PT_SCS_HSC2_FrP11_PP_SCS_HSC2_FrP11_Rx_0fb271d2_c07658fd
      SysBPMEnbdHSC2_f8a32097 (ComSignal):
        ComBitPosition = 6
        ComBitSize = 1
        ComSignalEndianness = BIG_ENDIAN
        ComSignalInitValue = 0
        ComSignalType = BOOLEAN
        ComSignalAccess = ACCESS_UNCLEAR
        ComHandleId = 229
        ComSystemTemplateSystemSignalRef = SysBPMEnbdHSC2
      GW_HSC2_BCM_FrP06_oCAN00_3abd61be (ComIPdu):
        ComIPduDirection = RECEIVE
        ComIPduType = NORMAL
        ComIPduHandleId = 22
        ComIPduSignalProcessing = DEFERRED
        ComIPduCancellationSupport = false
        ComIPduGroupRef = P2P_oCAN00_Rx_fcef2243
        ComIPduSignalRef = BCMSSBFltStsHSC2_34092009
        ComIPduSignalRef = DayTimeRunningLampOnHSC2_34092009
        ComPduIdRef = PT_GW_HSC2_BCM_FrP06_PP_GW_HSC2_BCM_FrP06_Rx_0fb271d2_c07658fd
      8 x ComSignal, all with ComSignalEndianness=BIG_ENDIAN, ComSignalInitValue=0, ComSignalAccess=ACCESS_UNCLEAR:
        DayTimeRunningLampOnHSC2_34092009: ComBitPosition=29, ComBitSize=1, ComSignalType=BOOLEAN, ComHandleId=63, ComSystemTemplateSystemSignalRef=DayTimeRunningLampOnHSC2
        LNonDrvnWhlRotlDistTRCHSC2_daa8611e: ComBitPosition=7, ComBitSize=2, ComSignalType=UINT8, ComHandleId=141, ComSystemTemplateSystemSignalRef=LNonDrvnWhlRotlDistTRCHSC2
        FRObsRngHSC2_ea600257: ComBitPosition=35, ComBitSize=4, ComSignalType=UINT8, ComTransferProperty=PENDING, ComHandleId=70, ComSystemTemplateSystemSignalRef=FRObsRngHSC2
        HydBstrCmpstnReqHSC2_70a619c8: ComBitPosition=54, ComBitSize=1, ComSignalType=BOOLEAN, ComHandleId=129, ComSystemTemplateSystemSignalRef=HydBstrCmpstnReqHSC2
        LDrvnWhlRotlDistVHSC2_16026180: ComBitPosition=2, ComBitSize=1, ComSignalType=BOOLEAN, ComHandleId=135, ComSystemTemplateSystemSignalRef=LDrvnWhlRotlDistVHSC2
        NRCDAlvRCHSC2_6ae5c0ff: ComBitPosition=39, ComBitSize=8, ComSignalType=UINT8, ComHandleId=150, ComSystemTemplateSystemSignalRef=NRCDAlvRCHSC2
        RRDoorOpenStsHSC2_762c2774: ComBitPosition=5, ComBitSize=2, ComSignalType=UINT8, ComHandleId=192, ComSystemTemplateSystemSignalRef=RRDoorOpenStsHSC2
        EnRunAHSC2_235f8f9b: ComBitPosition=7, ComBitSize=1, ComSignalType=BOOLEAN, ComHandleId=96, ComSystemTemplateSystemSignalRef=EnRunAHSC2
      P2P_HSC2_FrS01_oCAN00_3abd61be (ComIPdu):
        ComIPduDirection = SEND
        ComIPduType = NORMAL
        ComIPduHandleId = 9
        ComIPduSignalProcessing = DEFERRED
        ComIPduCancellationSupport = false
        ComIPduGroupRef = P2P_oCAN00_Tx_fcef2243
        ComIPduSignalRef = IECUToBCMRmtCtrlPotclHSC2_4372be29
        ComPduIdRef = PT_P2P_HSC2_FrS01_PP_P2P_HSC2_FrS01_Tx_0fb271d2_c07658fd
        ComTxIPdu: ComTxIPduUnusedAreasDefault=0, ComMinimumDelayTime=0
          ComTxModeTrue
            ComTxMode: ComTxModeMode=NONE
          ComTxModeFalse
            ComTxMode: ComTxModeMode=NONE
      5 x ComSignal, all with ComSignalEndianness=BIG_ENDIAN, ComSignalInitValue=0, ComSignalAccess=ACCESS_UNCLEAR:
        IPCAvlbly_h2HSC2_ab4ba2ce: ComBitPosition=30, ComBitSize=1, ComSignalType=BOOLEAN, ComHandleId=130, ComSystemTemplateSystemSignalRef=IPCAvlbly_h2HSC2
        APASCSAcclReqValPVHSC2_a845052a: ComBitPosition=1, ComBitSize=10, ComSignalType=UINT16, ComTransferProperty=PENDING, ComHandleId=19, ComSystemTemplateSystemSignalRef=APASCSAcclReqValPVHSC2
        APAEPBOPReqHSC2_a845052a: ComBitPosition=31, ComBitSize=2, ComSignalType=UINT8, ComTransferProperty=PENDING, ComHandleId=7, ComSystemTemplateSystemSignalRef=APAEPBOPReqHSC2
        APACrpSpdReqStsHSC2_a845052a: ComBitPosition=39, ComBitSize=1, ComSignalType=BOOLEAN, ComTransferProperty=PENDING, ComHandleId=4, ComSystemTemplateSystemSignalRef=APACrpSpdReqStsHSC2
        RDrvnWhlRotlDistPlsCtrHSC2_16026180: ComBitPosition=33, ComBitSize=10, ComSignalType=UINT16, ComHandleId=172, ComSystemTemplateSystemSignalRef=RDrvnWhlRotlDistPlsCtrHSC2
      GW_HSC2_FrP00_oCAN00_3abd61be (ComIPdu):
        ComIPduDirection = RECEIVE
        ComIPduType = NORMAL
        ComIPduHandleId = 28
        ComIPduSignalProcessing = DEFERRED
        ComIPduCancellationSupport = false
        ComIPduGroupRef = P2P_oCAN00_Rx_fcef2243
        ComIPduSignalRef = BCMAvlbly_h2HSC2_ab4ba2ce
        ComIPduSignalRef = ECMAvlbly_h2HSC2_ab4ba2ce
        ComIPduSignalRef = FICMAvlbly_h2HSC2_ab4ba2ce
        ComIPduSignalRef = HCUAvlbly_h2HSC2_ab4ba2ce
        ComIPduSignalRef = IPCAvlbly_h2HSC2_ab4ba2ce
        ComIPduSignalRef = SCUAvlbly_h2HSC2_ab4ba2ce
        ComIPduSignalRef = SDMAvlbly_h2HSC2_ab4ba2ce
        ComIPduSignalRef = TCAvlbly_h2HSC2_ab4ba2ce
        ComPduIdRef = PT_GW_HSC2_FrP00_PP_GW_HSC2_FrP00_Rx_0fb271d2_c07658fd
      4 x ComSignal, all with ComSignalEndianness=BIG_ENDIAN, ComSignalInitValue=0, ComSignalAccess=ACCESS_UNCLEAR:
        RLObsRngHSC2_ea600257: ComBitPosition=39, ComBitSize=4, ComSignalType=UINT8, ComTransferProperty=PENDING, ComHandleId=126, ComSystemTemplateSystemSignalRef=RLObsRngHSC2
        FrtPsngDoorOpenStsHSC2_762c2774: ComBitPosition=43, ComBitSize=2, ComSignalType=UINT8, ComHandleId=125, ComSystemTemplateSystemSignalRef=FrtPsngDoorOpenStsHSC2
        MinuteOfHourHSC2_c30fb534: ComBitPosition=37, ComBitSize=6, ComSignalType=UINT8, ComHandleId=148, ComSystemTemplateSystemSignalRef=MinuteOfHourHSC2
        BCMSSBAHSC2_f8a32097: ComBitPosition=0, ComBitSize=1, ComSignalType=BOOLEAN, ComHandleId=40, ComSystemTemplateSystemSignalRef=BCMSSBAHSC2
      P2P_HSC2_FrP00_oCAN00_3abd61be (ComIPdu):
        ComIPduDirection = SEND
        ComIPduType = NORMAL
        ComIPduHandleId = 4
        ComIPduSignalProcessing = DEFERRED
        ComIPduCancellationSupport = false
        ComIPduCallout = MessageTX_P2P_HSC2_FrP00
        ComIPduGroupRef = P2P_oCAN00_Tx_fcef2243
        ComIPduSignalRef = APAAlvRCHSC2_64ef05b4
        ComIPduSignalRef = APAChksmHSC2_64ef05b4
        ComIPduSignalRef = APACmdEPSStsHSC2_64ef05b4
        ComIPduSignalRef = APAFHSC2_64ef05b4
        ComIPduSignalRef = APAToqReqStsHSC2_64ef05b4
        ComIPduSignalRef = APAToqReqValHSC2_64ef05b4
        ComIPduSignalRef = APATrgtEPSStrgWhlAngHSC2_64ef05b4
        ComPduIdRef = PT_P2P_HSC2_FrP00_PP_P2P_HSC2_FrP00_Tx_0fb271d2_c07658fd
        ComTxIPdu: ComTxIPduUnusedAreasDefault=0, ComMinimumDelayTime=0
          ComTxModeTrue
            ComTxMode: ComTxModeMode=PERIODIC, ComTxModeTimePeriod=0.02, ComTxModeTimeOffset=0
          ComTxModeFalse
            ComTxMode: ComTxModeMode=PERIODIC, ComTxModeTimePeriod=0.02, ComTxModeTimeOffset=0
      EPBAppcnStsPVHSC2_ecbe2b89 (ComSignal):
        ComBitPosition = 13
        ComBitSize = 2
        ComSignalEndianness = BIG_ENDIAN
        ComSignalInitValue = 0
        ComSignalType = UINT8
        ComSignalAccess = ACCESS_UNCLEAR
        ComHandleId = 81
        ComSystemTemplateSystemSignalRef = EPBAppcnStsPVHSC2
      GW_HSC2_ECM_FrP04_oCAN00_3abd61be (ComIPdu):
        ComIPduDirection = RECEIVE
        ComIPduType = NORMAL
        ComIPduHandleId = 25
        ComIPduSignalProcessing = DEFERRED
        ComIPduCancellationSupport = false
        ComIPduCallout = MessageRX_0x194_HSC2_ECM_FrP04
        ComIPduGroupRef = P2P_oCAN00_Rx_fcef2243
        ComIPduSignalRef = TrShftLvrPosV_h1HSC2_8bd5df01
        ComIPduSignalRef = TrShftLvrPos_h1HSC2_8bd5df01
        ComPduIdRef = PT_GW_HSC2_ECM_FrP04_PP_GW_HSC2_ECM_FrP04_Rx_0fb271d2_c07658fd
      P2P_HSC2_FrP03_oCAN00_3abd61be (ComIPdu):
        ComIPduDirection = SEND
        ComIPduType = NORMAL
        ComIPduHandleId = 7
        ComIPduSignalProcessing = DEFERRED
        ComIPduCancellationSupport = false
        ComIPduGroupRef = P2P_oCAN00_Tx_fcef2243
        ComIPduSignalRef = FLObsRngHSC2_ea600257
        ComIPduSignalRef = FRObsRngHSC2_ea600257
        ComIPduSignalRef = FrtMidLObsRngHSC2_ea600257
        ComIPduSignalRef = FrtMidRObsRngHSC2_ea600257
        ComIPduSignalRef = FrtObsDistHSC2_ea600257
        ComIPduSignalRef = FrtPDCAudWrnngHSC2_ea600257
        ComIPduSignalRef = PDCCofignStsHSC2_ea600257
        ComIPduSignalRef = PDCSysStsHSC2_ea600257
        ComIPduSignalRef = RLObsRngHSC2_ea600257
        ComIPduSignalRef = RRObsRngHSC2_ea600257
        ComIPduSignalRef = RrMidLObsRngHSC2_ea600257
        ComIPduSignalRef = RrMidRObsRngHSC2_ea600257
        ComIPduSignalRef = RrObsDistHSC2_ea600257
        ComIPduSignalRef = RrPDCAudWrnngHSC2_ea600257
        ComPduIdRef = PT_P2P_HSC2_FrP03_PP_P2P_HSC2_FrP03_Tx_0fb271d2_c07658fd
        ComTxIPdu: ComTxIPduUnusedAreasDefault=0, ComMinimumDelayTime=0
          ComTxModeTrue
            ComTxMode: ComTxModeMode=PERIODIC, ComTxModeTimePeriod=0.1, ComTxModeTimeOffset=0
          ComTxModeFalse
            ComTxMode: ComTxModeMode=PERIODIC, ComTxModeTimePeriod=0.1, ComTxModeTimeOffset=0
      APAVehCrdnatPosXHSC2_26ca02c9 (ComSignal):
        ComBitPosition = 45
        ComBitSize = 12
        ComSignalEndianness = BIG_ENDIAN
        ComSignalInitValue = 0
        ComSignalType = UINT16
        ComTransferProperty = PENDING
        ComSignalAccess = ACCESS_UNCLEAR
        ComHandleId = 30
        ComSystemTemplateSystemSignalRef = APAVehCrdnatPosXHSC2
      SCS_HSC2_FrP01_oCAN00_3abd61be (ComIPdu):
        ComIPduDirection = RECEIVE
        ComIPduType = NORMAL
        ComIPduHandleId = 58
        ComIPduSignalProcessing = DEFERRED
        ComIPduCancellationSupport = false
        ComIPduGroupRef = P2P_oCAN00_Rx_fcef2243
        ComIPduSignalRef = LNonDrvnWhlRotlDistPCHSC2_daa8611e
        ComIPduSignalRef = LNonDrvnWhlRotlDistTHSC2_daa8611e
        ComIPduSignalRef = LNonDrvnWhlRotlDistTRCHSC2_daa8611e
        ComIPduSignalRef = LNonDrvnWhlRotlDistVHSC2_daa8611e
        ComIPduSignalRef = LNonDrvnWhlRotlRstOcdHSC2_daa8611e
        ComIPduSignalRef = LNonDrvnWhlRotlSeqNumHSC2_daa8611e
        ComIPduSignalRef = RNonDrvnWhlRotlDistPCHSC2_daa8611e
        ComIPduSignalRef = RNonDrvnWhlRotlDistTHSC2_daa8611e
        ComIPduSignalRef = RNonDrvnWhlRotlDistTRCHSC2_daa8611e
        ComIPduSignalRef = RNonDrvnWhlRotlDistVHSC2_daa8611e
        ComIPduSignalRef = RNonDrvnWhlRotlRstOcdHSC2_daa8611e
        ComIPduSignalRef = RNonDrvnWhlRotlSeqNumHSC2_daa8611e
        ComPduIdRef = PT_SCS_HSC2_FrP01_PP_SCS_HSC2_FrP01_Rx_0fb271d2_c07658fd
      5 x ComSignal, all with ComSignalEndianness=BIG_ENDIAN, ComSignalAccess=ACCESS_UNCLEAR:
        RNonDrvnWhlRotlRstOcdHSC2_daa8611e: ComBitPosition=35, ComBitSize=1, ComSignalInitValue=0, ComSignalType=BOOLEAN, ComHandleId=189, ComSystemTemplateSystemSignalRef=RNonDrvnWhlRotlRstOcdHSC2
        DrvrSbltAtcVHSC2_2128899b: ComBitPosition=13, ComBitSize=1, ComSignalInitValue=0, ComSignalType=BOOLEAN, ComHandleId=74, ComSystemTemplateSystemSignalRef=DrvrSbltAtcVHSC2
        LNonDrvnWhlRotlSeqNumHSC2_daa8611e: ComBitPosition=5, ComBitSize=2, ComSignalInitValue=0, ComSignalType=UINT8, ComHandleId=144, ComSystemTemplateSystemSignalRef=LNonDrvnWhlRotlSeqNumHSC2
        DistRCAvgDrvnHSC2_49997ba7: ComBitPosition=20, ComBitSize=13, ComSignalInitValue=0, ComSignalType=UINT16, ComHandleId=68, ComSystemTemplateSystemSignalRef=DistRCAvgDrvnHSC2
        WhlGndVelRDrvnVHSC2_cdd3755d: ComBitPosition=22, ComBitSize=1, ComSignalInitValue=1, ComSignalType=BOOLEAN, ComHandleId=287, ComSystemTemplateSystemSignalRef=WhlGndVelRDrvnVHSC2
      GW_HSC2_SCU_FrP00_oCAN00_3abd61be (ComIPdu):
        ComIPduDirection = RECEIVE
        ComIPduType = NORMAL
        ComIPduHandleId = 38
        ComIPduSignalProcessing = DEFERRED
        ComIPduCancellationSupport = false
        ComIPduGroupRef = P2P_oCAN00_Rx_fcef2243
        ComIPduSignalRef = SCUDrvrIntrvnAHSC2_efc2a4db
        ComIPduSignalRef = SCUNRCDAvlblHSC2_efc2a4db
        ComIPduSignalRef = SCUShifterLvrPosHSC2_efc2a4db
        ComIPduSignalRef = SCUShifterPosInvsnHSC2_efc2a4db
        ComIPduSignalRef = SCUShifterPosRCHSC2_efc2a4db
        ComPduIdRef = PT_GW_HSC2_SCU_FrP00_PP_GW_HSC2_SCU_FrP00_Rx_0fb271d2_c07658fd
      15 x ComSignal, all with ComSignalAccess=ACCESS_UNCLEAR:
        SCUShifterPosInvsnHSC2_efc2a4db: ComBitPosition=31, ComBitSize=4, ComSignalEndianness=BIG_ENDIAN, ComSignalInitValue=15, ComSignalType=UINT8, ComHandleId=219, ComSystemTemplateSystemSignalRef=SCUShifterPosInvsnHSC2
        VSESysAHSC2_5ee26fe4: ComBitPosition=24, ComBitSize=1, ComSignalEndianness=BIG_ENDIAN, ComSignalInitValue=0, ComSignalType=BOOLEAN, ComHandleId=263, ComSystemTemplateSystemSignalRef=VSESysAHSC2
        APAToqReqStsHSC2_64ef05b4: ComBitPosition=4, ComBitSize=1, ComSignalEndianness=BIG_ENDIAN, ComSignalInitValue=0, ComSignalType=BOOLEAN, ComTransferProperty=PENDING, ComHandleId=26, ComSystemTemplateSystemSignalRef=APAToqReqStsHSC2
        AirbagDplHSC2_2128899b: ComBitPosition=11, ComBitSize=1, ComSignalEndianness=BIG_ENDIAN, ComSignalInitValue=0, ComSignalType=BOOLEAN, ComHandleId=34, ComSystemTemplateSystemSignalRef=AirbagDplHSC2
        PDCCofignStsHSC2_ea600257: ComBitPosition=42, ComBitSize=3, ComSignalEndianness=BIG_ENDIAN, ComSignalInitValue=1, ComSignalType=UINT8, ComTransferProperty=PENDING, ComHandleId=113, ComSystemTemplateSystemSignalRef=PDCCofignStsHSC2
        EPSAPAInhHSC2_a6919738: ComBitPosition=15, ComBitSize=8, ComSignalEndianness=BIG_ENDIAN, ComSignalInitValue=0, ComSignalType=UINT8, ComHandleId=88, ComSystemTemplateSystemSignalRef=EPSAPAInhHSC2
        SCUShifterPosRCHSC2_efc2a4db: ComBitPosition=11, ComBitSize=4, ComSignalEndianness=BIG_ENDIAN, ComSignalInitValue=0, ComSignalType=UINT8, ComHandleId=220, ComSystemTemplateSystemSignalRef=SCUShifterPosRCHSC2
        VSELongtAccHSC2_542766fd: ComBitPosition=1, ComBitSize=10, ComSignalEndianness=BIG_ENDIAN, ComSignalInitValue=0, ComSignalType=SINT16, ComHandleId=261, ComSystemTemplateSystemSignalRef=VSELongtAccHSC2
        BrkPdlAppdHSC2_70a619c8: ComBitPosition=10, ComBitSize=1, ComSignalEndianness=BIG_ENDIAN, ComSignalInitValue=0, ComSignalType=BOOLEAN, ComHandleId=47, ComSystemTemplateSystemSignalRef=BrkPdlAppdHSC2
        DTCInfomationP2PHSC2_daa1a8e8: ComBitPosition=0, ComSignalEndianness=opaque, ComSignalInitValue=0 0 0 0 0 0 0, ComSignalLength=7, ComSignalType=UINT8_N, ComTransferProperty=PENDING, ComHandleId=40, ComSystemTemplateSystemSignalRef=DTCInfomationP2PHSC2
        SysBPMHSC2_f8a32097: ComBitPosition=5, ComBitSize=2, ComSignalEndianness=BIG_ENDIAN, ComSignalInitValue=0, ComSignalType=UINT8, ComHandleId=230, ComSystemTemplateSystemSignalRef=SysBPMHSC2
        VCUNRCDAvlblHSC2_cacaa258: ComBitPosition=52, ComBitSize=1, ComSignalEndianness=BIG_ENDIAN, ComSignalInitValue=0, ComSignalType=BOOLEAN, ComHandleId=258, ComSystemTemplateSystemSignalRef=VCUNRCDAvlblHSC2
        CalendarYearHSC2_c30fb534: ComBitPosition=7, ComBitSize=8, ComSignalEndianness=BIG_ENDIAN, ComSignalInitValue=0, ComSignalType=UINT8, ComHandleId=52, ComSystemTemplateSystemSignalRef=CalendarYearHSC2
        PwrMdMstrAccryA_h2HSC2_67e1a250: ComBitPosition=2, ComBitSize=1, ComSignalEndianness=BIG_ENDIAN, ComSignalInitValue=0, ComSignalType=BOOLEAN, ComHandleId=169, ComSystemTemplateSystemSignalRef=PwrMdMstrAccryA_h2HSC2
        LNonDrvnWhlRotlDircnHSC2_988d6663: ComBitPosition=33, ComBitSize=2, ComSignalEndianness=BIG_ENDIAN, ComSignalInitValue=3, ComSignalType=UINT8, ComHandleId=138, ComSystemTemplateSystemSignalRef=LNonDrvnWhlRotlDircnHSC2
      SCS_HSC2_FrP02_oCAN00_3abd61be (ComIPdu):
        ComIPduDirection = RECEIVE
        ComIPduType = NORMAL
        ComIPduHandleId = 59
        ComIPduSignalProcessing = DEFERRED
        ComIPduCancellationSupport = false
        ComIPduCallout = MessageRx_0x185_SCS_HSC2_FrP02
        ComIPduGroupRef = P2P_oCAN00_Rx_fcef2243
        ComIPduSignalRef = VSELatAccHSC2_542766fd
        ComIPduSignalRef = VSELatAccVHSC2_542766fd
        ComIPduSignalRef = VSELongtAccHSC2_542766fd
        ComIPduSignalRef = VSELongtAccVHSC2_542766fd
        ComPduIdRef = PT_SCS_HSC2_FrP02_PP_SCS_HSC2_FrP02_Rx_0fb271d2_c07658fd
      APAParkngSchedVHSC2_26ca02c9 (ComSignal):
        ComBitPosition = 25
        ComBitSize = 1
        ComSignalEndianness = BIG_ENDIAN
        ComSignalInitValue = 0
        ComSignalType = BOOLEAN
        ComTransferProperty = PENDING
        ComSignalAccess = ACCESS_UNCLEAR
        ComHandleId = 15
        ComSystemTemplateSystemSignalRef = APAParkngSchedVHSC2
      SCS_HSC2_FrP05_oCAN00_3abd61be (ComIPdu):
        ComIPduDirection = RECEIVE
        ComIPduType = NORMAL
        ComIPduHandleId = 61
        ComIPduSignalProcessing = DEFERRED
        ComIPduCancellationSupport = false
        ComIPduCallout = MessageRX_0x1E9_SCS_HSC2_FrP05
        ComIPduGroupRef = P2P_oCAN00_Rx_fcef2243
        ComIPduSignalRef = ABSAHSC2_5ee26fe4
        ComIPduSignalRef = TCSAHSC2_5ee26fe4
        ComIPduSignalRef = VSESysAHSC2_5ee26fe4
        ComIPduSignalRef = VehDynYawRateHSC2_5ee26fe4
        ComIPduSignalRef = VehDynYawRateVHSC2_5ee26fe4
        ComPduIdRef = PT_SCS_HSC2_FrP05_PP_SCS_HSC2_FrP05_Rx_0fb271d2_c07658fd
      10 x ComSignal, all with ComSignalAccess=ACCESS_UNCLEAR:
        EPBAvlblyStsHSC2_ecbe2b89: ComBitPosition=5, ComBitSize=3, ComSignalEndianness=BIG_ENDIAN, ComSignalInitValue=0, ComSignalType=UINT8, ComHandleId=82, ComSystemTemplateSystemSignalRef=EPBAvlblyStsHSC2
        FLObsRngHSC2_ea600257: ComBitPosition=47, ComBitSize=4, ComSignalEndianness=BIG_ENDIAN, ComSignalInitValue=0, ComSignalType=UINT8, ComTransferProperty=PENDING, ComHandleId=68, ComSystemTemplateSystemSignalRef=FLObsRngHSC2
        APAFHSC2_64ef05b4: ComBitPosition=5, ComBitSize=1, ComSignalEndianness=BIG_ENDIAN, ComSignalInitValue=0, ComSignalType=BOOLEAN, ComTransferProperty=PENDING, ComHandleId=10, ComSystemTemplateSystemSignalRef=APAFHSC2
        RNonDrvnWhlRotlSeqNumHSC2_daa8611e: ComBitPosition=37, ComBitSize=2, ComSignalEndianness=BIG_ENDIAN, ComSignalInitValue=0, ComSignalType=UINT8, ComHandleId=190, ComSystemTemplateSystemSignalRef=RNonDrvnWhlRotlSeqNumHSC2
        DiagnosticReqP2P_h2_2483449d: ComBitPosition=0, ComSignalEndianness=opaque, ComSignalInitValue=0 0 0 0 0 0 0 0, ComSignalLength=8, ComSignalType=UINT8_N, ComHandleId=65, ComSystemTemplateSystemSignalRef=DiagnosticReqP2P_h2
        DrvrSelAPASlotBearngHSC2_d7b82a4e: ComBitPosition=12, ComBitSize=2, ComSignalEndianness=BIG_ENDIAN, ComSignalInitValue=0, ComSignalType=UINT8, ComHandleId=77, ComSystemTemplateSystemSignalRef=DrvrSelAPASlotBearngHSC2
        RNonDrvnWhlRotlDistTHSC2_daa8611e: ComBitPosition=55, ComBitSize=16, ComSignalEndianness=BIG_ENDIAN, ComSignalInitValue=0, ComSignalType=UINT16, ComHandleId=186, ComSystemTemplateSystemSignalRef=RNonDrvnWhlRotlDistTHSC2
        LDrvnWhlRotlDistPlsCtrHSC2_16026180: ComBitPosition=1, ComBitSize=10, ComSignalEndianness=BIG_ENDIAN, ComSignalInitValue=0, ComSignalType=UINT16, ComHandleId=132, ComSystemTemplateSystemSignalRef=LDrvnWhlRotlDistPlsCtrHSC2
        SCUAvlbly_h2HSC2_ab4ba2ce: ComBitPosition=3, ComBitSize=1, ComSignalEndianness=BIG_ENDIAN, ComSignalInitValue=0, ComSignalType=BOOLEAN, ComHandleId=215, ComSystemTemplateSystemSignalRef=SCUAvlbly_h2HSC2
        APAInfoDispReqHSC2_a845052a: ComBitPosition=37, ComBitSize=6, ComSignalEndianness=BIG_ENDIAN, ComSignalInitValue=0, ComSignalType=UINT8, ComTransferProperty=PENDING, ComHandleId=11, ComSystemTemplateSystemSignalRef=APAInfoDispReqHSC2
      GW_HSC2_FrP13_oCAN00_3abd61be (ComIPdu):
        ComIPduDirection = RECEIVE
        ComIPduType = NORMAL
        ComIPduHandleId = 32
        ComIPduSignalProcessing = DEFERRED
        ComIPduCancellationSupport = false
        ComIPduCallout = MessageRX_GW_HSC2_FrP13
        ComIPduGroupRef = P2P_oCAN00_Rx_fcef2243
        ComIPduSignalRef = APACtrlAbotdRsnHSC2_32bfb16e
        ComIPduSignalRef = NRCDSts_h2HSC2_32bfb16e
        ComPduIdRef = PT_GW_HSC2_FrP13_PP_GW_HSC2_FrP13_Rx_0fb271d2_c07658fd
      AirbagDplInvsnHSC2_2128899b (ComSignal):
        ComBitPosition = 10
        ComBitSize = 1
        ComSignalEndianness = BIG_ENDIAN
        ComSignalInitValue = 1
        ComSignalType = BOOLEAN
        ComSignalAccess = ACCESS_UNCLEAR
        ComHandleId = 35
        ComSystemTemplateSystemSignalRef = AirbagDplInvsnHSC2
      DIAG_PhysReq_P2P_oCAN00_3abd61be (ComIPdu):
        ComIPduDirection = RECEIVE
        ComIPduType = NORMAL
        ComIPduHandleId = 10
        ComIPduSignalProcessing = DEFERRED
        ComIPduCancellationSupport = false
        ComIPduGroupRef = P2P_oCAN00_Rx_fcef2243
        ComIPduSignalRef = DiagnosticReqP2P_h2_2483449d
        ComPduIdRef = PT_DIAG_PhysReq_P2P_PP_DIAG_PhysReq_P2P_Rx_0fb271d2_c07658fd
      APACtrlAbotdRsnHSC2_32bfb16e (ComSignal):
        ComBitPosition = 47
        ComBitSize = 4
        ComSignalEndianness = BIG_ENDIAN
        ComSignalInitValue = 0
        ComSignalType = UINT8
        ComSignalAccess = ACCESS_UNCLEAR
        ComHandleId = 6
        ComSystemTemplateSystemSignalRef = APACtrlAbotdRsnHSC2
      DIAG_DTCInfo_P2P_oCAN00_3abd61be (ComIPdu):
        ComIPduDirection = SEND
        ComIPduType = NORMAL
        ComIPduHandleId = 0
        ComIPduSignalProcessing = DEFERRED
        ComIPduCancellationSupport = false
        ComIPduGroupRef = P2P_oCAN00_Tx_fcef2243
        ComIPduSignalRef = DTCInfomationP2PHSC2_daa1a8e8
        ComPduIdRef = PT_DIAG_DTCInfo_P2P_PP_DIAG_DTCInfo_P2P_Tx_0fb271d2_c07658fd
        ComTxIPdu: ComTxIPduUnusedAreasDefault=0, ComMinimumDelayTime=0
          ComTxModeTrue
            ComTxMode: ComTxModeMode=NONE
          ComTxModeFalse
            ComTxMode: ComTxModeMode=NONE
      3 x ComSignal, all with ComSignalAccess=ACCESS_UNCLEAR:
        PwrMdAutoCtrlAvlblHSC2_f8a32097: ComBitPosition=2, ComBitSize=1, ComSignalEndianness=BIG_ENDIAN, ComSignalInitValue=0, ComSignalType=BOOLEAN, ComHandleId=168, ComSystemTemplateSystemSignalRef=PwrMdAutoCtrlAvlblHSC2
        FrtMidLObsRngHSC2_ea600257: ComBitPosition=31, ComBitSize=4, ComSignalEndianness=BIG_ENDIAN, ComSignalInitValue=0, ComSignalType=UINT8, ComTransferProperty=PENDING, ComHandleId=72, ComSystemTemplateSystemSignalRef=FrtMidLObsRngHSC2
        DiagnosticFuncAddrReq_h2_a8412cb3: ComBitPosition=0, ComSignalEndianness=opaque, ComSignalInitValue=0 0 0 0 0 0 0 0, ComSignalLength=8, ComSignalType=UINT8_N, ComHandleId=64, ComSystemTemplateSystemSignalRef=DiagnosticFuncAddrReq_h2
      P2P_HSC2_FrP02_oCAN00_3abd61be (ComIPdu):
        ComIPduDirection = SEND
        ComIPduType = NORMAL
        ComIPduHandleId = 6
        ComIPduSignalProcessing = DEFERRED
        ComIPduCancellationSupport = false
        ComIPduGroupRef = P2P_oCAN00_Tx_fcef2243
        ComIPduSignalRef = APAParkngSchedHSC2_26ca02c9
        ComIPduSignalRef = APAParkngSchedVHSC2_26ca02c9
        ComIPduSignalRef = APASlotBearngHSC2_26ca02c9
        ComIPduSignalRef = APASlotLngthHSC2_26ca02c9
        ComIPduSignalRef = APAVehCrdnatAzmthHSC2_26ca02c9
        ComIPduSignalRef = APAVehCrdnatPosXHSC2_26ca02c9
        ComIPduSignalRef = APAVehCrdnatPosYHSC2_26ca02c9
        ComPduIdRef = PT_P2P_HSC2_FrP02_PP_P2P_HSC2_FrP02_Tx_0fb271d2_c07658fd
        ComTxIPdu: ComTxIPduUnusedAreasDefault=0, ComMinimumDelayTime=0
          ComTxModeTrue
            ComTxMode: ComTxModeMode=PERIODIC, ComTxModeTimePeriod=0.1, ComTxModeTimeOffset=0
          ComTxModeFalse
            ComTxMode: ComTxModeMode=PERIODIC, ComTxModeTimePeriod=0.1, ComTxModeTimeOffset=0
      8 x ComSignal, all with ComSignalEndianness=BIG_ENDIAN, ComSignalInitValue=0, ComSignalAccess=ACCESS_UNCLEAR:
        LNonDrvnWhlRotlDistVHSC2_daa8611e: ComBitPosition=2, ComBitSize=1, ComSignalType=BOOLEAN, ComHandleId=142, ComSystemTemplateSystemSignalRef=LNonDrvnWhlRotlDistVHSC2
        ECMAvlbly_h2HSC2_ab4ba2ce: ComBitPosition=7, ComBitSize=1, ComSignalType=BOOLEAN, ComHandleId=79, ComSystemTemplateSystemSignalRef=ECMAvlbly_h2HSC2
        EPBAvlblyStsPVHSC2_ecbe2b89: ComBitPosition=2, ComBitSize=3, ComSignalType=UINT8, ComHandleId=83, ComSystemTemplateSystemSignalRef=EPBAvlblyStsPVHSC2
        VehOdoV_h2HSC2_78aeb97b: ComBitPosition=31, ComBitSize=1, ComSignalType=BOOLEAN, ComHandleId=271, ComSystemTemplateSystemSignalRef=VehOdoV_h2HSC2
        FrtMidRObsRngHSC2_ea600257: ComBitPosition=19, ComBitSize=4, ComSignalType=UINT8, ComTransferProperty=PENDING, ComHandleId=73, ComSystemTemplateSystemSignalRef=FrtMidRObsRngHSC2
        FICMAvlbly_h2HSC2_ab4ba2ce: ComBitPosition=25, ComBitSize=1, ComSignalType=BOOLEAN, ComHandleId=97, ComSystemTemplateSystemSignalRef=FICMAvlbly_h2HSC2
        VSELongtAccVHSC2_542766fd: ComBitPosition=2, ComBitSize=1, ComSignalType=BOOLEAN, ComHandleId=262, ComSystemTemplateSystemSignalRef=VSELongtAccVHSC2
        SecsOfMinuteHSC2_c30fb534: ComBitPosition=45, ComBitSize=6, ComSignalType=UINT8, ComHandleId=222, ComSystemTemplateSystemSignalRef=SecsOfMinuteHSC2
      EHBS_HSC2_FrP00_oCAN00_3abd61be (ComIPdu):
        ComIPduDirection = RECEIVE
        ComIPduType = NORMAL
        ComIPduHandleId = 11
        ComIPduSignalProcessing = DEFERRED
        ComIPduCancellationSupport = false
        ComIPduGroupRef = P2P_oCAN00_Rx_fcef2243
        ComIPduSignalRef = BrkPdlAppdHSC2_70a619c8
        ComIPduSignalRef = HydBstrCmpstnReqHSC2_70a619c8
        ComPduIdRef = PT_EHBS_HSC2_FrP00_PP_EHBS_HSC2_FrP00_Rx_0fb271d2_c07658fd
      GW_HSC2_FrP10_oCAN00_3abd61be (ComIPdu):
        ComIPduDirection = RECEIVE
        ComIPduType = NORMAL
        ComIPduHandleId = 31
        ComIPduSignalProcessing = DEFERRED
        ComIPduCancellationSupport = false
        ComIPduGroupRef = P2P_oCAN00_Rx_fcef2243
        ComIPduSignalRef = OtsdAirTemCrValMsk_h2HSC2_bc30b68d
        ComIPduSignalRef = OtsdAirTemCrValV_h2HSC2_bc30b68d
        ComIPduSignalRef = OtsdAirTemCrVal_h2HSC2_bc30b68d
        ComPduIdRef = PT_GW_HSC2_FrP10_PP_GW_HSC2_FrP10_Rx_0fb271d2_c07658fd
      5 x ComSignal, all with ComSignalEndianness=BIG_ENDIAN, ComSignalInitValue=0, ComSignalAccess=ACCESS_UNCLEAR:
        EPTAccelActuPosVHSC2_533eb1f8: ComBitPosition=43, ComBitSize=1, ComSignalType=BOOLEAN, ComHandleId=91, ComSystemTemplateSystemSignalRef=EPTAccelActuPosVHSC2
        TrShftLvrPosV_h1HSC2_8bd5df01: ComBitPosition=28, ComBitSize=1, ComSignalType=BOOLEAN, ComHandleId=253, ComSystemTemplateSystemSignalRef=TrShftLvrPosV_h1HSC2
        LDrvnWhlRotlRstOcdHSC2_16026180: ComBitPosition=3, ComBitSize=1, ComSignalType=BOOLEAN, ComHandleId=136, ComSystemTemplateSystemSignalRef=LDrvnWhlRotlRstOcdHSC2
        TCAvlbly_h2HSC2_ab4ba2ce: ComBitPosition=8, ComBitSize=1, ComSignalType=BOOLEAN, ComHandleId=240, ComSystemTemplateSystemSignalRef=TCAvlbly_h2HSC2
        RDrvnWhlRotlDistTRCHSC2_16026180: ComBitPosition=39, ComBitSize=2, ComSignalType=UINT8, ComHandleId=173, ComSystemTemplateSystemSignalRef=RDrvnWhlRotlDistTRCHSC2
      Tester_HSC2_ECM_FrP00_oCAN00_3abd61be (ComIPdu):
        ComIPduDirection = RECEIVE
        ComIPduType = NORMAL
        ComIPduHandleId = 67
        ComIPduSignalProcessing = DEFERRED
        ComIPduCancellationSupport = false
        ComIPduGroupRef = P2P_oCAN00_Rx_fcef2243
        ComIPduSignalRef = EnRunAHSC2_235f8f9b
        ComPduIdRef = PT_Tester_HSC2_ECM_FrP00_PP_Tester_HSC2_ECM_FrP00_Rx_0fb271d2_c07658fd
      TPMS_HSC3_FrP01_oCAN01_3abd61be (ComIPdu):
        ComIPduDirection = RECEIVE
        ComIPduType = NORMAL
        ComIPduHandleId = 65
        ComIPduSignalProcessing = DEFERRED
        ComIPduCancellationSupport = false
        ComIPduGroupRef = P2P_oCAN01_Rx_fcef2243
        ComIPduSignalRef = FLTirePrsHSC4_fa528d8c
        ComIPduSignalRef = FLTirePrsVHSC4_fa528d8c
        ComIPduSignalRef = FRTirePrsHSC4_fa528d8c
        ComIPduSignalRef = FRTirePrsVHSC4_fa528d8c
        ComIPduSignalRef = RLTirePrsHSC4_fa528d8c
        ComIPduSignalRef = RLTirePrsVHSC4_fa528d8c
        ComIPduSignalRef = RRTirePrsHSC4_fa528d8c
        ComIPduSignalRef = RRTirePrsVHSC4_fa528d8c
        ComPduIdRef = PT_TPMS_HSC3_FrP01_PP_TPMS_HSC3_FrP01_Rx_c4eea277_b771686b
      7 x ComSignal, all with ComSignalEndianness=BIG_ENDIAN, ComSignalInitValue=0, ComSignalAccess=ACCESS_UNCLEAR:
        HD_AVMVideoFmtStaHSC4_4337a868: ComBitPosition=55, ComBitSize=4, ComSignalType=UINT8, ComTransferProperty=PENDING, ComHandleId=81, ComSystemTemplateSystemSignalRef=HD_AVMVideoFmtStaHSC4
        TBOXAccelZVHSC4_09f4c130: ComBitPosition=36, ComBitSize=1, ComSignalType=BOOLEAN, ComHandleId=238, ComSystemTemplateSystemSignalRef=TBOXAccelZVHSC4
        VehRoadWhlRReqVHSC4_09f4c130: ComBitPosition=16, ComBitSize=1, ComSignalType=BOOLEAN, ComHandleId=276, ComSystemTemplateSystemSignalRef=VehRoadWhlRReqVHSC4
        TOUCH_SCREEN_ACMDHSC4_c0316154: ComBitPosition=23, ComBitSize=4, ComSignalType=UINT8, ComHandleId=246, ComSystemTemplateSystemSignalRef=TOUCH_SCREEN_ACMDHSC4
        FICMSilentSearchReqHSC4_0c9b61ca: ComBitPosition=9, ComBitSize=2, ComSignalType=UINT8, ComHandleId=105, ComSystemTemplateSystemSignalRef=FICMSilentSearchReqHSC4
        FLTirePrsVHSC4_fa528d8c: ComBitPosition=63, ComBitSize=1, ComSignalType=BOOLEAN, ComHandleId=111, ComSystemTemplateSystemSignalRef=FLTirePrsVHSC4
        VehBkwdSwReqVHSC4_09f4c130: ComBitPosition=20, ComBitSize=1, ComSignalType=BOOLEAN, ComHandleId=265, ComSystemTemplateSystemSignalRef=VehBkwdSwReqVHSC4
      P2P_HSC4_FrP03_oCAN01_3abd61be (ComIPdu):
        ComIPduDirection = SEND
        ComIPduType = NORMAL
        ComIPduHandleId = 10
        ComIPduSignalProcessing = DEFERRED
        ComIPduCancellationSupport = false
        ComIPduGroupRef = P2P_oCAN01_Tx_fcef2243
        ComIPduSignalRef = P2PACTMdChngTmotHSC4_65a57977
        ComIPduSignalRef = P2PDisplayHSC4_65a57977
        ComIPduSignalRef = P2PProgressHSC4_65a57977
        ComIPduSignalRef = Route1SavePercentageHSC4_65a57977
        ComIPduSignalRef = Route1StateHSC4_65a57977
        ComIPduSignalRef = Route2SavePercentageHSC4_65a57977
        ComIPduSignalRef = Route2StateHSC4_65a57977
        ComPduIdRef = PT_P2P_HSC4_FrP03_PP_P2P_HSC4_FrP03_Tx_c4eea277_b771686b
        ComTxIPdu: ComTxIPduUnusedAreasDefault=0, ComMinimumDelayTime=0
          ComTxModeTrue
            ComTxMode: ComTxModeMode=PERIODIC, ComTxModeTimePeriod=0.1, ComTxModeTimeOffset=0
          ComTxModeFalse
            ComTxMode: ComTxModeMode=PERIODIC, ComTxModeTimePeriod=0.1, ComTxModeTimeOffset=0
      3 x ComSignal, all with ComSignalEndianness=BIG_ENDIAN, ComSignalInitValue=0, ComSignalType=UINT8, ComSignalAccess=ACCESS_UNCLEAR:
        SecsOfMinuteHSC4_80f6c9a0: ComBitPosition=45, ComBitSize=6, ComHandleId=223, ComSystemTemplateSystemSignalRef=SecsOfMinuteHSC4
        TOUCH_SCREEN_STATUS_h4HSC4_c0316154: ComBitPosition=39, ComBitSize=4, ComHandleId=248, ComSystemTemplateSystemSignalRef=TOUCH_SCREEN_STATUS_h4HSC4
        P2PACTMdChngTmotHSC4_65a57977: ComBitPosition=7, ComBitSize=8, ComTransferProperty=PENDING, ComHandleId=110, ComSystemTemplateSystemSignalRef=P2PACTMdChngTmotHSC4
      GW_HSC4_TBOX_FrP05_oCAN01_3abd61be (ComIPdu):
        ComIPduDirection = RECEIVE
        ComIPduType = NORMAL
        ComIPduHandleId = 47
        ComIPduSignalProcessing = DEFERRED
        ComIPduCancellationSupport = false
        ComIPduGroupRef = P2P_oCAN01_Rx_fcef2243
        ComIPduSignalRef = P2PExeAvlblHSC4_09f4c130
        ComIPduSignalRef = P2PExeAvlblVHSC4_09f4c130
        ComIPduSignalRef = TBOXAccelZHSC4_09f4c130
        ComIPduSignalRef = TBOXAccelZVHSC4_09f4c130
        ComIPduSignalRef = TboxP2PRCHSC4_09f4c130
        ComIPduSignalRef = VehBkwdSwReqHSC4_09f4c130
        ComIPduSignalRef = VehBkwdSwReqVHSC4_09f4c130
        ComIPduSignalRef = VehFwdSwReqHSC4_09f4c130
        ComIPduSignalRef = VehFwdSwReqVHSC4_09f4c130
        ComIPduSignalRef = VehRoadWhlLReqHSC4_09f4c130
        ComIPduSignalRef = VehRoadWhlLReqVHSC4_09f4c130
        ComIPduSignalRef = VehRoadWhlRReqHSC4_09f4c130
        ComIPduSignalRef = VehRoadWhlRReqVHSC4_09f4c130
        ComPduIdRef = PT_GW_HSC4_TBOX_FrP05_PP_GW_HSC4_TBOX_FrP05_Rx_c4eea277_b771686b
      HD_AVMCurViewHSC4_4337a868 (ComSignal):
        ComBitPosition = 51
        ComBitSize = 4
        ComSignalEndianness = BIG_ENDIAN
        ComSignalInitValue = 0
        ComSignalType = UINT8
        ComTransferProperty = PENDING
        ComSignalAccess = ACCESS_UNCLEAR
        ComHandleId = 78
        ComSystemTemplateSystemSignalRef = HD_AVMCurViewHSC4
      TMSpd_h1HSC4_d68cf0b9 (ComSignal):
        ComBitPosition = 7
        ComBitSize = 16
        ComSignalEndianness = BIG_ENDIAN
        ComSignalInitValue = 32768
        ComSignalType = UINT16
        ComSignalAccess = ACCESS_UNCLEAR
        ComHandleId = 243
        ComSystemTemplateSystemSignalRef = TMSpd_h1HSC4
      FICM_HSC4_FrP33_oCAN01_3abd61be (ComIPdu):
        ComIPduDirection = RECEIVE
        ComIPduType = NORMAL
        ComIPduHandleId = 20
        ComIPduSignalProcessing = DEFERRED
        ComIPduCancellationSupport = false
        ComIPduGroupRef = P2P_oCAN01_Rx_fcef2243
        ComIPduSignalRef = AVMAutoViewChgHSC4_0c9b61ca
        ComIPduSignalRef = FICMP2PQuitReqHSC4_0c9b61ca
        ComIPduSignalRef = FICMPLCRtCoverSwReqHSC4_0c9b61ca
        ComIPduSignalRef = FICMPLCRtEndSwReqHSC4_0c9b61ca
        ComIPduSignalRef = FICMPLCSwReqHSC4_0c9b61ca
        ComIPduSignalRef = FICMRouteChangeCheckHSC4_0c9b61ca
        ComIPduSignalRef = FICMRouteReqHSC4_0c9b61ca
        ComIPduSignalRef = FICMSilentSearchCheckHSC4_0c9b61ca
        ComIPduSignalRef = FICMSilentSearchReqHSC4_0c9b61ca
        ComPduIdRef = PT_FICM_HSC4_FrP33_PP_FICM_HSC4_FrP33_Rx_c4eea277_b771686b
      GW_HSC4_BCM_FrP04_oCAN01_3abd61be (ComIPdu):
        ComIPduDirection = RECEIVE
        ComIPduType = NORMAL
        ComIPduHandleId = 40
        ComIPduSignalProcessing = DEFERRED
        ComIPduCancellationSupport = false
        ComIPduGroupRef = P2P_oCAN01_Rx_fcef2243
        ComIPduSignalRef = VehLckngStaHSC4_0f57ab67
        ComPduIdRef = PT_GW_HSC4_BCM_FrP04_PP_GW_HSC4_BCM_FrP04_Rx_c4eea277_b771686b
      P2PProgressHSC4_65a57977 (ComSignal):
        ComBitPosition = 23
        ComBitSize = 4
        ComSignalEndianness = BIG_ENDIAN
        ComSignalInitValue = 0
        ComSignalType = UINT8
        ComTransferProperty = PENDING
        ComSignalAccess = ACCESS_UNCLEAR
        ComHandleId = 112
        ComSystemTemplateSystemSignalRef = P2PProgressHSC4
      GW_HSC4_PEPS_FrP01_oCAN01_3abd61be (ComIPdu):
        ComIPduDirection = RECEIVE
        ComIPduType = NORMAL
        ComIPduHandleId = 44
        ComIPduSignalProcessing = DEFERRED
        ComIPduCancellationSupport = false
        ComIPduGroupRef = P2P_oCAN01_Rx_fcef2243
        ComIPduSignalRef = FLDoorHadlSwAHSC4_5c9d774f
        ComIPduSignalRef = FRDoorHadlSwAHSC4_5c9d774f
        ComIPduSignalRef = PEPSSSBAHSC4_5c9d774f
        ComIPduSignalRef = PEPSSSBAVHSC4_5c9d774f
        ComPduIdRef = PT_GW_HSC4_PEPS_FrP01_PP_GW_HSC4_PEPS_FrP01_Rx_c4eea277_b771686b
      5 x ComSignal, all with ComSignalEndianness=BIG_ENDIAN, ComSignalAccess=ACCESS_UNCLEAR:
        VehBkwdSwReqHSC4_09f4c130: ComBitPosition=21, ComBitSize=1, ComSignalInitValue=0, ComSignalType=BOOLEAN, ComHandleId=264, ComSystemTemplateSystemSignalRef=VehBkwdSwReqHSC4
        RLTirePrsHSC4_fa528d8c: ComBitPosition=30, ComBitSize=7, ComSignalInitValue=55, ComSignalType=UINT8, ComHandleId=182, ComSystemTemplateSystemSignalRef=RLTirePrsHSC4
        Route1SavePercentageHSC4_65a57977: ComBitPosition=30, ComBitSize=7, ComSignalInitValue=0, ComSignalType=UINT8, ComTransferProperty=PENDING, ComHandleId=138, ComSystemTemplateSystemSignalRef=Route1SavePercentageHSC4
        TPMSFHSC4_74dd8a6f: ComBitPosition=0, ComBitSize=1, ComSignalInitValue=0, ComSignalType=BOOLEAN, ComHandleId=249, ComSystemTemplateSystemSignalRef=TPMSFHSC4
        TimeDspFmtHSC4_80f6c9a0: ComBitPosition=46, ComBitSize=1, ComSignalInitValue=0, ComSignalType=BOOLEAN, ComHandleId=252, ComSystemTemplateSystemSignalRef=TimeDspFmtHSC4
      P2P_oCAN01_Rx_fcef2243 (ComIPduGroup): ComIPduGroupHandleId=2
      4 x ComSignal, all with ComSignalAccess=ACCESS_UNCLEAR:
        FICMSilentSearchCheckHSC4_0c9b61ca: ComBitPosition=11, ComBitSize=2, ComSignalEndianness=BIG_ENDIAN, ComSignalInitValue=0, ComSignalType=UINT8, ComHandleId=104, ComSystemTemplateSystemSignalRef=FICMSilentSearchCheckHSC4
        FLDoorHadlSwAHSC4_5c9d774f: ComBitPosition=59, ComBitSize=1, ComSignalEndianness=BIG_ENDIAN, ComSignalInitValue=0, ComSignalType=BOOLEAN, ComHandleId=106, ComSystemTemplateSystemSignalRef=FLDoorHadlSwAHSC4
        IECUToTBOXCtrlPotclHSC4_ccb7c509: ComBitPosition=0, ComSignalEndianness=opaque, ComSignalInitValue=0 0 0 0 0 0 0 0, ComSignalLength=8, ComSignalType=UINT8_N, ComTransferProperty=PENDING, ComHandleId=85, ComSystemTemplateSystemSignalRef=IECUToTBOXCtrlPotclHSC4
        HourOfDayHSC4_80f6c9a0: ComBitPosition=28, ComBitSize=5, ComSignalEndianness=BIG_ENDIAN, ComSignalInitValue=0, ComSignalType=UINT8, ComHandleId=128, ComSystemTemplateSystemSignalRef=HourOfDayHSC4
      GW_HSC4_TBOX_FrS10_oCAN01_3abd61be (ComIPdu):
        ComIPduDirection = RECEIVE
        ComIPduType = NORMAL
        ComIPduHandleId = 48
        ComIPduSignalProcessing = DEFERRED
        ComIPduCancellationSupport = false
        ComIPduGroupRef = P2P_oCAN01_Rx_fcef2243
        ComIPduSignalRef = TBOXToIECUCtrlPotclHSC4_bd586014
        ComPduIdRef = PT_GW_HSC4_TBOX_FrS10_PP_GW_HSC4_TBOX_FrS10_Rx_c4eea277_b771686b
      FICM_HSC4_FrP13_oCAN01_3abd61be (ComIPdu):
        ComIPduDirection = RECEIVE
        ComIPduType = NORMAL
        ComIPduHandleId = 17
        ComIPduSignalProcessing = DEFERRED
        ComIPduCancellationSupport = false
        ComIPduGroupRef = P2P_oCAN01_Rx_fcef2243
        ComIPduSignalRef = AlisysrdyHSC4_226d494c
        ComPduIdRef = PT_FICM_HSC4_FrP13_PP_FICM_HSC4_FrP13_Rx_c4eea277_b771686b
      SCREEN_COORD_AXHSC4_c0316154 (ComSignal):
        ComBitPosition = 3
        ComBitSize = 12
        ComSignalEndianness = BIG_ENDIAN
        ComSignalInitValue = 0
        ComSignalType = UINT16
        ComSignalAccess = ACCESS_UNCLEAR
        ComHandleId = 207
        ComSystemTemplateSystemSignalRef = SCREEN_COORD_AXHSC4
      SCREEN_COORD_AYHSC4_c0316154 (ComSignal):
        ComBitPosition = 19
        ComBitSize = 12
        ComSignalEndianness = BIG_ENDIAN
        ComSignalInitValue = 0
        ComSignalType = UINT16
        ComSignalAccess = ACCESS_UNCLEAR
        ComHandleId = 208
        ComSystemTemplateSystemSignalRef = SCREEN_COORD_AYHSC4
      GW_HSC4_BCM_FrS10_oCAN01_3abd61be (ComIPdu):
        ComIPduDirection = RECEIVE
        ComIPduType = NORMAL
        ComIPduHandleId = 42
        ComIPduSignalProcessing = DEFERRED
        ComIPduCancellationSupport = false
        ComIPduGroupRef = P2P_oCAN01_Rx_fcef2243
        ComIPduSignalRef = BCMImmoData5HSC4_77510add
        ComPduIdRef = PT_GW_HSC4_BCM_FrS10_PP_GW_HSC4_BCM_FrS10_Rx_c4eea277_b771686b
      9 x ComSignal, all with ComSignalAccess=ACCESS_UNCLEAR:
        P2PSwReqHSC4_8dbecfca: ComBitPosition=15, ComBitSize=1, ComSignalEndianness=BIG_ENDIAN, ComSignalInitValue=0, ComSignalType=BOOLEAN, ComHandleId=159, ComSystemTemplateSystemSignalRef=P2PSwReqHSC4
        RstrFctryDeftsReqHSC4_f9bc5d91: ComBitPosition=56, ComBitSize=1, ComSignalEndianness=BIG_ENDIAN, ComSignalInitValue=0, ComSignalType=BOOLEAN, ComHandleId=206, ComSystemTemplateSystemSignalRef=RstrFctryDeftsReqHSC4
        RLTirePrsVHSC4_fa528d8c: ComBitPosition=31, ComBitSize=1, ComSignalEndianness=BIG_ENDIAN, ComSignalInitValue=0, ComSignalType=BOOLEAN, ComHandleId=183, ComSystemTemplateSystemSignalRef=RLTirePrsVHSC4
        PDCSwReqHSC4_687c4159: ComBitPosition=61, ComBitSize=2, ComSignalEndianness=BIG_ENDIAN, ComSignalInitValue=0, ComSignalType=UINT8, ComHandleId=162, ComSystemTemplateSystemSignalRef=PDCSwReqHSC4
        BCMImmoData4HSC4_7f6505b5: ComBitPosition=0, ComSignalEndianness=opaque, ComSignalInitValue=0 0 0 0 0 0 0 0, ComSignalLength=8, ComSignalType=UINT8_N, ComHandleId=38, ComSystemTemplateSystemSignalRef=BCMImmoData4HSC4
        CalendarDayHSC4_80f6c9a0: ComBitPosition=20, ComBitSize=5, ComSignalEndianness=BIG_ENDIAN, ComSignalInitValue=0, ComSignalType=UINT8, ComHandleId=49, ComSystemTemplateSystemSignalRef=CalendarDayHSC4
        SCREEN_COORD_BYHSC4_c0316154: ComBitPosition=51, ComBitSize=12, ComSignalEndianness=BIG_ENDIAN, ComSignalInitValue=0, ComSignalType=UINT16, ComHandleId=210, ComSystemTemplateSystemSignalRef=SCREEN_COORD_BYHSC4
        RRTirePrsHSC4_fa528d8c: ComBitPosition=14, ComBitSize=7, ComSignalEndianness=BIG_ENDIAN, ComSignalInitValue=55, ComSignalType=UINT8, ComHandleId=196, ComSystemTemplateSystemSignalRef=RRTirePrsHSC4
        PEPSSSBAVHSC4_5c9d774f: ComBitPosition=61, ComBitSize=1, ComSignalEndianness=BIG_ENDIAN, ComSignalInitValue=0, ComSignalType=BOOLEAN, ComHandleId=165, ComSystemTemplateSystemSignalRef=PEPSSSBAVHSC4
      GW_HSC4_TBOX_FrP01_oCAN01_3abd61be (ComIPdu):
        ComIPduDirection = RECEIVE
        ComIPduType = NORMAL
        ComIPduHandleId = 46
        ComIPduSignalProcessing = DEFERRED
        ComIPduCancellationSupport = false
        ComIPduGroupRef = P2P_oCAN01_Rx_fcef2243
        ComIPduSignalRef = P2PSwReqHSC4_8dbecfca
        ComPduIdRef = PT_GW_HSC4_TBOX_FrP01_PP_GW_HSC4_TBOX_FrP01_Rx_c4eea277_b771686b
      GW_HSC4_PEPS_FrP02_oCAN01_3abd61be (ComIPdu):
        ComIPduDirection = RECEIVE
        ComIPduType = NORMAL
        ComIPduHandleId = 45
        ComIPduSignalProcessing = DEFERRED
        ComIPduCancellationSupport = false
        ComIPduGroupRef = P2P_oCAN01_Rx_fcef2243
        ComIPduSignalRef = PEPSSSBFltStsHSC4_d21270ac
        ComPduIdRef = PT_GW_HSC4_PEPS_FrP02_PP_GW_HSC4_PEPS_FrP02_Rx_c4eea277_b771686b
      FICMPLCRtEndSwReqHSC4_0c9b61ca (ComSignal):
        ComBitPosition = 1
        ComBitSize = 2
        ComSignalEndianness = BIG_ENDIAN
        ComSignalInitValue = 0
        ComSignalType = UINT8
        ComSignalAccess = ACCESS_UNCLEAR
        ComHandleId = 100
        ComSystemTemplateSystemSignalRef = FICMPLCRtEndSwReqHSC4
      VehFwdSwReqHSC4_09f4c130 (ComSignal):
        ComBitPosition = 23
        ComBitSize = 1
        ComSignalEndianness = BIG_ENDIAN
        ComSignalInitValue = 0
        ComSignalType = BOOLEAN
        ComSignalAccess = ACCESS_UNCLEAR
        ComHandleId = 268
        ComSystemTemplateSystemSignalRef = VehFwdSwReqHSC4
      P2P_IECU_HSC4_FrP02_oCAN01_3abd61be (ComIPdu):
        ComIPduDirection = SEND
        ComIPduType = NORMAL
        ComIPduHandleId = 13
        ComIPduSignalProcessing = DEFERRED
        ComIPduCancellationSupport = false
        ComIPduGroupRef = P2P_oCAN01_Tx_fcef2243
        ComIPduSignalRef = AutoDrvngSysStsHSC4_cdb8af8b
        ComPduIdRef = PT_P2P_IECU_HSC4_FrP02_PP_P2P_IECU_HSC4_FrP02_Tx_c4eea277_b771686b
        ComTxIPdu: ComTxIPduUnusedAreasDefault=0, ComMinimumDelayTime=0
          ComTxModeTrue
            ComTxMode: ComTxModeMode=PERIODIC, ComTxModeTimePeriod=0.1, ComTxModeTimeOffset=0
          ComTxModeFalse
            ComTxMode: ComTxModeMode=PERIODIC, ComTxModeTimePeriod=0.1, ComTxModeTimeOffset=0
      5 x ComSignal, all with ComSignalEndianness=BIG_ENDIAN, ComSignalInitValue=0, ComSignalAccess=ACCESS_UNCLEAR:
        P2PExeAvlblHSC4_09f4c130: ComBitPosition=28, ComBitSize=1, ComSignalType=BOOLEAN, ComHandleId=157, ComSystemTemplateSystemSignalRef=P2PExeAvlblHSC4
        BMSBscSta_h1HSC4_c182dd1d: ComBitPosition=5, ComBitSize=5, ComSignalType=UINT8, ComHandleId=44, ComSystemTemplateSystemSignalRef=BMSBscSta_h1HSC4
        RRCTAWrnngHSC4_693ba2af: ComBitPosition=1, ComBitSize=2, ComSignalType=UINT8, ComHandleId=191, ComSystemTemplateSystemSignalRef=RRCTAWrnngHSC4
        DrvrSelAPAParkngMdHSC4_7f07551a: ComBitPosition=0, ComBitSize=3, ComSignalType=UINT8, ComHandleId=76, ComSystemTemplateSystemSignalRef=DrvrSelAPAParkngMdHSC4
        CalendarMonthHSC4_80f6c9a0: ComBitPosition=11, ComBitSize=4, ComSignalType=UINT8, ComHandleId=51, ComSystemTemplateSystemSignalRef=CalendarMonthHSC4
      GW_HSC4_TC_FrP01_oCAN01_3abd61be (ComIPdu):
        ComIPduDirection = RECEIVE
        ComIPduType = NORMAL
        ComIPduHandleId = 49
        ComIPduSignalProcessing = DEFERRED
        ComIPduCancellationSupport = false
        ComIPduGroupRef = P2P_oCAN01_Rx_fcef2243
        ComIPduSignalRef = TMSpdV_h1HSC4_d68cf0b9
        ComIPduSignalRef = TMSpd_h1HSC4_d68cf0b9
        ComPduIdRef = PT_GW_HSC4_TC_FrP01_PP_GW_HSC4_TC_FrP01_Rx_c4eea277_b771686b
      15 x ComSignal, all with ComSignalAccess=ACCESS_UNCLEAR:
        APASwReqHSC4_687c4159: ComBitPosition=59, ComBitSize=2, ComSignalEndianness=BIG_ENDIAN, ComSignalInitValue=0, ComSignalType=UINT8, ComHandleId=26, ComSystemTemplateSystemSignalRef=APASwReqHSC4
        AutoDrvngSysStsHSC4_cdb8af8b: ComBitPosition=23, ComBitSize=8, ComSignalEndianness=BIG_ENDIAN, ComSignalInitValue=0, ComSignalType=UINT8, ComTransferProperty=PENDING, ComHandleId=32, ComSystemTemplateSystemSignalRef=AutoDrvngSysStsHSC4
        VehLckngStaHSC4_0f57ab67: ComBitPosition=55, ComBitSize=3, ComSignalEndianness=BIG_ENDIAN, ComSignalInitValue=7, ComSignalType=UINT8, ComHandleId=270, ComSystemTemplateSystemSignalRef=VehLckngStaHSC4
        AVMAutoViewChgHSC4_0c9b61ca: ComBitPosition=22, ComBitSize=1, ComSignalEndianness=BIG_ENDIAN, ComSignalInitValue=0, ComSignalType=BOOLEAN, ComHandleId=33, ComSystemTemplateSystemSignalRef=AVMAutoViewChgHSC4
        BCMImmoData5HSC4_77510add: ComBitPosition=0, ComSignalEndianness=opaque, ComSignalInitValue=0 0 0 0 0 0 0 0, ComSignalLength=8, ComSignalType=UINT8_N, ComHandleId=39, ComSystemTemplateSystemSignalRef=BCMImmoData5HSC4
        FLTirePrsHSC4_fa528d8c: ComBitPosition=62, ComBitSize=7, ComSignalEndianness=BIG_ENDIAN, ComSignalInitValue=55, ComSignalType=UINT8, ComHandleId=110, ComSystemTemplateSystemSignalRef=FLTirePrsHSC4
        P2PExeAvlblVHSC4_09f4c130: ComBitPosition=29, ComBitSize=1, ComSignalEndianness=BIG_ENDIAN, ComSignalInitValue=0, ComSignalType=BOOLEAN, ComHandleId=158, ComSystemTemplateSystemSignalRef=P2PExeAvlblVHSC4
        MinuteOfHourHSC4_80f6c9a0: ComBitPosition=37, ComBitSize=6, ComSignalEndianness=BIG_ENDIAN, ComSignalInitValue=0, ComSignalType=UINT8, ComHandleId=149, ComSystemTemplateSystemSignalRef=MinuteOfHourHSC4
        HD_AVMInfoDisplayHSC4_4337a868: ComBitPosition=63, ComBitSize=4, ComSignalEndianness=BIG_ENDIAN, ComSignalInitValue=0, ComSignalType=UINT8, ComTransferProperty=PENDING, ComHandleId=80, ComSystemTemplateSystemSignalRef=HD_AVMInfoDisplayHSC4
        VehRoadWhlLReqVHSC4_09f4c130: ComBitPosition=18, ComBitSize=1, ComSignalEndianness=BIG_ENDIAN, ComSignalInitValue=0, ComSignalType=BOOLEAN, ComHandleId=274, ComSystemTemplateSystemSignalRef=VehRoadWhlLReqVHSC4
        FRTirePrsHSC4_fa528d8c: ComBitPosition=46, ComBitSize=7, ComSignalEndianness=BIG_ENDIAN, ComSignalInitValue=55, ComSignalType=UINT8, ComHandleId=116, ComSystemTemplateSystemSignalRef=FRTirePrsHSC4
        TBOXAccelZHSC4_09f4c130: ComBitPosition=35, ComBitSize=12, ComSignalEndianness=BIG_ENDIAN, ComSignalInitValue=0, ComSignalType=SINT16, ComHandleId=237, ComSystemTemplateSystemSignalRef=TBOXAccelZHSC4
        FICMPLCRtCoverSwReqHSC4_0c9b61ca: ComBitPosition=3, ComBitSize=2, ComSignalEndianness=BIG_ENDIAN, ComSignalInitValue=0, ComSignalType=UINT8, ComHandleId=99, ComSystemTemplateSystemSignalRef=FICMPLCRtCoverSwReqHSC4
        SCREEN_COORD_BXHSC4_c0316154: ComBitPosition=35, ComBitSize=12, ComSignalEndianness=BIG_ENDIAN, ComSignalInitValue=0, ComSignalType=UINT16, ComHandleId=209, ComSystemTemplateSystemSignalRef=SCREEN_COORD_BXHSC4
        PEPSSSBAHSC4_5c9d774f: ComBitPosition=56, ComBitSize=1, ComSignalEndianness=BIG_ENDIAN, ComSignalInitValue=0, ComSignalType=BOOLEAN, ComHandleId=164, ComSystemTemplateSystemSignalRef=PEPSSSBAHSC4
      FICM_HSC4_FrP18_oCAN01_3abd61be (ComIPdu):
        ComIPduDirection = RECEIVE
        ComIPduType = NORMAL
        ComIPduHandleId = 18
        ComIPduSignalProcessing = DEFERRED
        ComIPduCancellationSupport = false
        ComIPduGroupRef = P2P_oCAN01_Rx_fcef2243
        ComIPduSignalRef = DrvrSelAPAParkngMdHSC4_7f07551a
        ComIPduSignalRef = DrvrSelAPASlotBearngHSC4_7f07551a
        ComPduIdRef = PT_FICM_HSC4_FrP18_PP_FICM_HSC4_FrP18_Rx_c4eea277_b771686b
      3 x ComSignal, all with ComSignalEndianness=BIG_ENDIAN, ComSignalAccess=ACCESS_UNCLEAR:
        HD_AVMErrorDisplay_h4HSC4_4337a868: ComBitPosition=59, ComBitSize=4, ComSignalInitValue=0, ComSignalType=UINT8, ComTransferProperty=PENDING, ComHandleId=79, ComSystemTemplateSystemSignalRef=HD_AVMErrorDisplay_h4HSC4
        FRTirePrsVHSC4_fa528d8c: ComBitPosition=47, ComBitSize=1, ComSignalInitValue=0, ComSignalType=BOOLEAN, ComHandleId=117, ComSystemTemplateSystemSignalRef=FRTirePrsVHSC4
        TMSpdV_h1HSC4_d68cf0b9: ComBitPosition=23, ComBitSize=1, ComSignalInitValue=1, ComSignalType=BOOLEAN, ComHandleId=242, ComSystemTemplateSystemSignalRef=TMSpdV_h1HSC4
      IPK_HSC4_FrP06_oCAN01_3abd61be (ComIPdu):
        ComIPduDirection = RECEIVE
        ComIPduType = NORMAL
        ComIPduHandleId = 50
        ComIPduSignalProcessing = DEFERRED
        ComIPduCancellationSupport = false
        ComIPduGroupRef = P2P_oCAN01_Rx_fcef2243
        ComIPduSignalRef = CalendarDayHSC4_80f6c9a0
        ComIPduSignalRef = CalendarMonthHSC4_80f6c9a0
        ComIPduSignalRef = CalendarYearHSC4_80f6c9a0
        ComIPduSignalRef = HourOfDayHSC4_80f6c9a0
        ComIPduSignalRef = MinuteOfHourHSC4_80f6c9a0
        ComIPduSignalRef = SecsOfMinuteHSC4_80f6c9a0
        ComIPduSignalRef = TimeDspFmtHSC4_80f6c9a0
        ComPduIdRef = PT_IPK_HSC4_FrP06_PP_IPK_HSC4_FrP06_Rx_c4eea277_b771686b
      10 x ComSignal, all with ComSignalEndianness=BIG_ENDIAN, ComSignalInitValue=0, ComSignalAccess=ACCESS_UNCLEAR:
        FICMPLCSwReqHSC4_0c9b61ca: ComBitPosition=7, ComBitSize=4, ComSignalType=UINT8, ComHandleId=101, ComSystemTemplateSystemSignalRef=FICMPLCSwReqHSC4
        Route1StateHSC4_65a57977: ComBitPosition=19, ComBitSize=2, ComSignalType=UINT8, ComTransferProperty=PENDING, ComHandleId=139, ComSystemTemplateSystemSignalRef=Route1StateHSC4
        LRCTAWrnngHSC4_693ba2af: ComBitPosition=3, ComBitSize=2, ComSignalType=UINT8, ComHandleId=145, ComSystemTemplateSystemSignalRef=LRCTAWrnngHSC4
        DrvrSelAPASlotBearngHSC4_7f07551a: ComBitPosition=6, ComBitSize=2, ComSignalType=UINT8, ComHandleId=78, ComSystemTemplateSystemSignalRef=DrvrSelAPASlotBearngHSC4
        VehRoadWhlLReqHSC4_09f4c130: ComBitPosition=19, ComBitSize=1, ComSignalType=BOOLEAN, ComHandleId=273, ComSystemTemplateSystemSignalRef=VehRoadWhlLReqHSC4
        Route2SavePercentageHSC4_65a57977: ComBitPosition=38, ComBitSize=7, ComSignalType=UINT8, ComTransferProperty=PENDING, ComHandleId=140, ComSystemTemplateSystemSignalRef=Route2SavePercentageHSC4
        FICMRouteChangeCheckHSC4_0c9b61ca: ComBitPosition=15, ComBitSize=2, ComSignalType=UINT8, ComHandleId=102, ComSystemTemplateSystemSignalRef=FICMRouteChangeCheckHSC4
        Route2StateHSC4_65a57977: ComBitPosition=17, ComBitSize=2, ComSignalType=UINT8, ComTransferProperty=PENDING, ComHandleId=141, ComSystemTemplateSystemSignalRef=Route2StateHSC4
        CalendarYearHSC4_80f6c9a0: ComBitPosition=7, ComBitSize=8, ComSignalType=UINT8, ComHandleId=53, ComSystemTemplateSystemSignalRef=CalendarYearHSC4
        VehFwdSwReqVHSC4_09f4c130: ComBitPosition=22, ComBitSize=1, ComSignalType=BOOLEAN, ComHandleId=269, ComSystemTemplateSystemSignalRef=VehFwdSwReqVHSC4
      P2P_IECU_HSC4_FrP01_oCAN01_3abd61be (ComIPdu):
        ComIPduDirection = SEND
        ComIPduType = NORMAL
        ComIPduHandleId = 12
        ComIPduSignalProcessing = DEFERRED
        ComIPduCancellationSupport = false
        ComIPduGroupRef = P2P_oCAN01_Tx_fcef2243
        ComIPduSignalRef = HD_AVMCurViewHSC4_4337a868
        ComIPduSignalRef = HD_AVMErrorDisplay_h4HSC4_4337a868
        ComIPduSignalRef = HD_AVMInfoDisplayHSC4_4337a868
        ComIPduSignalRef = HD_AVMVideoFmtStaHSC4_4337a868
        ComIPduSignalRef = HD_AVMsysrdyHSC4_4337a868
        ComPduIdRef = PT_P2P_IECU_HSC4_FrP01_PP_P2P_IECU_HSC4_FrP01_Tx_c4eea277_b771686b
        ComTxIPdu: ComTxIPduUnusedAreasDefault=0, ComMinimumDelayTime=0
          ComTxModeTrue
            ComTxMode: ComTxModeMode=PERIODIC, ComTxModeTimePeriod=0.05, ComTxModeTimeOffset=0
          ComTxModeFalse
            ComTxMode: ComTxModeMode=PERIODIC, ComTxModeTimePeriod=0.05, ComTxModeTimeOffset=0
      4 x ComSignal, all with ComSignalEndianness=BIG_ENDIAN, ComSignalInitValue=0, ComSignalAccess=ACCESS_UNCLEAR:
        TboxP2PRCHSC4_09f4c130: ComBitPosition=27, ComBitSize=4, ComSignalType=UINT8, ComHandleId=250, ComSystemTemplateSystemSignalRef=TboxP2PRCHSC4
        VehRoadWhlRReqHSC4_09f4c130: ComBitPosition=17, ComBitSize=1, ComSignalType=BOOLEAN, ComHandleId=275, ComSystemTemplateSystemSignalRef=VehRoadWhlRReqHSC4
        P2PDisplayHSC4_65a57977: ComBitPosition=15, ComBitSize=8, ComSignalType=UINT8, ComTransferProperty=PENDING, ComHandleId=111, ComSystemTemplateSystemSignalRef=P2PDisplayHSC4
        TOUCH_SCREEN_BCMDHSC4_c0316154: ComBitPosition=55, ComBitSize=4, ComSignalType=UINT8, ComHandleId=247, ComSystemTemplateSystemSignalRef=TOUCH_SCREEN_BCMDHSC4
      P2P_HSC4_FrS01_oCAN01_3abd61be (ComIPdu):
        ComIPduDirection = SEND
        ComIPduType = NORMAL
        ComIPduHandleId = 11
        ComIPduSignalProcessing = DEFERRED
        ComIPduCancellationSupport = false
        ComIPduGroupRef = P2P_oCAN01_Tx_fcef2243
        ComIPduSignalRef = IECUToTBOXCtrlPotclHSC4_ccb7c509
        ComPduIdRef = PT_P2P_HSC4_FrS01_PP_P2P_HSC4_FrS01_Tx_c4eea277_b771686b
        ComTxIPdu: ComTxIPduUnusedAreasDefault=0, ComMinimumDelayTime=0
          ComTxModeTrue
            ComTxMode: ComTxModeMode=NONE
          ComTxModeFalse
            ComTxMode: ComTxModeMode=NONE
      FICMRouteReqHSC4_0c9b61ca (ComSignal):
        ComBitPosition = 13
        ComBitSize = 2
        ComSignalEndianness = BIG_ENDIAN
        ComSignalInitValue = 0
        ComSignalType = UINT8
        ComSignalAccess = ACCESS_UNCLEAR
        ComHandleId = 103
        ComSystemTemplateSystemSignalRef = FICMRouteReqHSC4
      AlisysrdyHSC4_226d494c (ComSignal):
        ComBitPosition = 50
        ComBitSize = 1
        ComSignalEndianness = BIG_ENDIAN
        ComSignalInitValue = 0
        ComSignalType = BOOLEAN
        ComSignalAccess = ACCESS_UNCLEAR
        ComHandleId = 36
        ComSystemTemplateSystemSignalRef = AlisysrdyHSC4
      RDA_HSC4_P02_oCAN01_3abd61be (ComIPdu):
        ComIPduDirection = RECEIVE
        ComIPduType = NORMAL
        ComIPduHandleId = 53
        ComIPduSignalProcessing = DEFERRED
        ComIPduCancellationSupport = false
        ComIPduGroupRef = P2P_oCAN01_Rx_fcef2243
        ComIPduSignalRef = LRCTAWrnngHSC4_693ba2af
        ComIPduSignalRef = RRCTAWrnngHSC4_693ba2af
        ComPduIdRef = PT_RDA_HSC4_P02_PP_RDA_HSC4_P02_Rx_c4eea277_b771686b
      P2P_oCAN01_Tx_fcef2243 (ComIPduGroup): ComIPduGroupHandleId=3
      3 x ComIPdu, all with ComIPduDirection=RECEIVE, ComIPduType=NORMAL, ComIPduSignalProcessing=DEFERRED, ComIPduCancellationSupport=false, ComIPduGroupRef=P2P_oCAN01_Rx_fcef2243:
        GW_HSC4_BMS_FrP07_oCAN01_3abd61be: ComIPduHandleId=43, ComIPduSignalRef=BMSBscSta_h1HSC4_c182dd1d, ComPduIdRef=PT_GW_HSC4_BMS_FrP07_PP_GW_HSC4_BMS_FrP07_Rx_c4eea277_b771686b
        FICM_HSC4_FrP08_oCAN01_3abd61be: ComIPduHandleId=16, ComIPduSignalRef=APASwReqHSC4_687c4159, ComIPduSignalRef=PDCSwReqHSC4_687c4159, ComPduIdRef=PT_FICM_HSC4_FrP08_PP_FICM_HSC4_FrP08_Rx_c4eea277_b771686b
        FICM_HSC4_FrP02_oCAN01_3abd61be: ComIPduHandleId=15, ComIPduSignalRef=RstrFctryDeftsReqHSC4_f9bc5d91, ComPduIdRef=PT_FICM_HSC4_FrP02_PP_FICM_HSC4_FrP02_Rx_c4eea277_b771686b
      3 x ComSignal, all with ComBitSize=1, ComSignalEndianness=BIG_ENDIAN, ComSignalInitValue=0, ComSignalType=BOOLEAN, ComSignalAccess=ACCESS_UNCLEAR:
        HD_AVMsysrdyHSC4_4337a868: ComBitPosition=40, ComTransferProperty=PENDING, ComHandleId=82, ComSystemTemplateSystemSignalRef=HD_AVMsysrdyHSC4
        FICMP2PQuitReqHSC4_0c9b61ca: ComBitPosition=23, ComHandleId=98, ComSystemTemplateSystemSignalRef=FICMP2PQuitReqHSC4
        RRTirePrsVHSC4_fa528d8c: ComBitPosition=15, ComHandleId=197, ComSystemTemplateSystemSignalRef=RRTirePrsVHSC4
      FICM_HSC4_FrP32_oCAN01_3abd61be (ComIPdu):
        ComIPduDirection = RECEIVE
        ComIPduType = NORMAL
        ComIPduHandleId = 19
        ComIPduSignalProcessing = DEFERRED
        ComIPduCancellationSupport = false
        ComIPduGroupRef = P2P_oCAN01_Rx_fcef2243
        ComIPduSignalRef = SCREEN_COORD_AXHSC4_c0316154
        ComIPduSignalRef = SCREEN_COORD_AYHSC4_c0316154
        ComIPduSignalRef = SCREEN_COORD_BXHSC4_c0316154
        ComIPduSignalRef = SCREEN_COORD_BYHSC4_c0316154
        ComIPduSignalRef = SurndViewSelnHSC4_c0316154
        ComIPduSignalRef = TOUCH_SCREEN_ACMDHSC4_c0316154
        ComIPduSignalRef = TOUCH_SCREEN_BCMDHSC4_c0316154
        ComIPduSignalRef = TOUCH_SCREEN_STATUS_h4HSC4_c0316154
        ComPduIdRef = PT_FICM_HSC4_FrP32_PP_FICM_HSC4_FrP32_Rx_c4eea277_b771686b
      TPMS_HSC3_FrP02_oCAN01_3abd61be (ComIPdu):
        ComIPduDirection = RECEIVE
        ComIPduType = NORMAL
        ComIPduHandleId = 66
        ComIPduSignalProcessing = DEFERRED
        ComIPduCancellationSupport = false
        ComIPduGroupRef = P2P_oCAN01_Rx_fcef2243
        ComIPduSignalRef = TPMSFHSC4_74dd8a6f
        ComPduIdRef = PT_TPMS_HSC3_FrP02_PP_TPMS_HSC3_FrP02_Rx_c4eea277_b771686b
      3 x ComSignal, all with ComSignalAccess=ACCESS_UNCLEAR:
        TBOXToIECUCtrlPotclHSC4_bd586014: ComBitPosition=0, ComSignalEndianness=opaque, ComSignalInitValue=0 0 0 0 0 0 0 0, ComSignalLength=8, ComSignalType=UINT8_N, ComHandleId=239, ComSystemTemplateSystemSignalRef=TBOXToIECUCtrlPotclHSC4
        FRDoorHadlSwAHSC4_5c9d774f: ComBitPosition=58, ComBitSize=1, ComSignalEndianness=BIG_ENDIAN, ComSignalInitValue=0, ComSignalType=BOOLEAN, ComHandleId=112, ComSystemTemplateSystemSignalRef=FRDoorHadlSwAHSC4
        SurndViewSelnHSC4_c0316154: ComBitPosition=7, ComBitSize=4, ComSignalEndianness=BIG_ENDIAN, ComSignalInitValue=0, ComSignalType=UINT8, ComHandleId=228, ComSystemTemplateSystemSignalRef=SurndViewSelnHSC4
      GW_HSC4_BCM_FrS09_oCAN01_3abd61be (ComIPdu):
        ComIPduDirection = RECEIVE
        ComIPduType = NORMAL
        ComIPduHandleId = 41
        ComIPduSignalProcessing = DEFERRED
        ComIPduCancellationSupport = false
        ComIPduGroupRef = P2P_oCAN01_Rx_fcef2243
        ComIPduSignalRef = BCMImmoData4HSC4_7f6505b5
        ComPduIdRef = PT_GW_HSC4_BCM_FrS09_PP_GW_HSC4_BCM_FrS09_Rx_c4eea277_b771686b
      4 x ComSignal, all with ComSignalEndianness=BIG_ENDIAN, ComSignalInitValue=0, ComSignalAccess=ACCESS_UNCLEAR:
        PEPSSSBFltStsHSC4_d21270ac: ComBitPosition=54, ComBitSize=3, ComSignalType=UINT8, ComHandleId=166, ComSystemTemplateSystemSignalRef=PEPSSSBFltStsHSC4
        VCUAccReqVal_SecCAN2_e74ec2d1: ComBitPosition=63, ComBitSize=8, ComSignalType=UINT8, ComTransferProperty=PENDING, ComHandleId=177, ComSystemTemplateSystemSignalRef=VCUAccReqVal_SecCAN2
        TCSA_SecCAN2_72648180: ComBitPosition=28, ComBitSize=1, ComSignalType=BOOLEAN, ComTransferProperty=PENDING, ComHandleId=169, ComSystemTemplateSystemSignalRef=TCSA_SecCAN2
        FRObsDist_sech2_SecCAN2_84546eef: ComBitPosition=21, ComBitSize=9, ComSignalType=UINT16, ComHandleId=113, ComSystemTemplateSystemSignalRef=FRObsDist_sech2_SecCAN2
      APA_SecCH_FrP02_oCAN02_3abd61be (ComIPdu):
        ComIPduDirection = RECEIVE
        ComIPduType = NORMAL
        ComIPduHandleId = 2
        ComIPduSignalProcessing = DEFERRED
        ComIPduCancellationSupport = false
        ComIPduGroupRef = P2P_oCAN02_Rx_fcef2243
        ComIPduSignalRef = APAParkngSchedV_sech2_SecCAN2_48fe6e71
        ComIPduSignalRef = APAParkngSched_sech2_SecCAN2_48fe6e71
        ComIPduSignalRef = APASlotBearng_sech2_SecCAN2_48fe6e71
        ComIPduSignalRef = APASlotLngth_sech2_SecCAN2_48fe6e71
        ComIPduSignalRef = APAVehCrdnatAzmth_sech2_SecCAN2_48fe6e71
        ComIPduSignalRef = APAVehCrdnatPosX_sech2_SecCAN2_48fe6e71
        ComIPduSignalRef = APAVehCrdnatPosY_sech2_SecCAN2_48fe6e71
        ComPduIdRef = PT_APA_SecCH_FrP02_PP_APA_SecCH_FrP02_Rx_427ad0d9_2e7839d1
      5 x ComSignal, all with ComSignalEndianness=BIG_ENDIAN, ComSignalAccess=ACCESS_UNCLEAR:
        CalendarMonth_SecCAN2_ee8bd5bd: ComBitPosition=11, ComBitSize=4, ComSignalInitValue=0, ComSignalType=UINT8, ComTransferProperty=PENDING, ComHandleId=37, ComSystemTemplateSystemSignalRef=CalendarMonth_SecCAN2
        ABSA_SecCAN2_72648180: ComBitPosition=30, ComBitSize=1, ComSignalInitValue=0, ComSignalType=BOOLEAN, ComTransferProperty=PENDING, ComHandleId=0, ComSystemTemplateSystemSignalRef=ABSA_SecCAN2
        FLObsDist_sech2_SecCAN2_84546eef: ComBitPosition=24, ComBitSize=9, ComSignalInitValue=0, ComSignalType=UINT16, ComHandleId=107, ComSystemTemplateSystemSignalRef=FLObsDist_sech2_SecCAN2
        PDCCofignSts_sech2_SecCAN2_27d72756: ComBitPosition=42, ComBitSize=3, ComSignalInitValue=1, ComSignalType=UINT8, ComHandleId=160, ComSystemTemplateSystemSignalRef=PDCCofignSts_sech2_SecCAN2
        APAVehCrdnatPosY_sech2_SecCAN2_48fe6e71: ComBitPosition=49, ComBitSize=10, ComSignalInitValue=0, ComSignalType=UINT16, ComHandleId=32, ComSystemTemplateSystemSignalRef=APAVehCrdnatPosY_sech2_SecCAN2
      P2P_SecCH_GW_FrS00_oCAN02_3abd61be (ComIPdu):
        ComIPduDirection = SEND
        ComIPduType = NORMAL
        ComIPduHandleId = 29
        ComIPduSignalProcessing = DEFERRED
        ComIPduCancellationSupport = false
        ComIPduGroupRef = P2P_oCAN02_Tx_fcef2243
        ComIPduSignalRef = NRCDMstrChlg_h2_SecCAN2_63a2ef2a
        ComPduIdRef = PT_P2P_SecCH_GW_FrS00_PP_P2P_SecCH_GW_FrS00_Tx_427ad0d9_2e7839d1
        ComTxIPdu: ComTxIPduUnusedAreasDefault=0, ComMinimumDelayTime=0
          ComTxModeTrue
            ComTxMode: ComTxModeMode=NONE
          ComTxModeFalse
            ComTxMode: ComTxModeMode=NONE
      9 x ComSignal, all with ComSignalEndianness=BIG_ENDIAN, ComSignalAccess=ACCESS_UNCLEAR:
        RLObsDist_sech2_SecCAN2_84546eef: ComBitPosition=14, ComBitSize=9, ComSignalInitValue=0, ComSignalType=UINT16, ComHandleId=179, ComSystemTemplateSystemSignalRef=RLObsDist_sech2_SecCAN2
        RRObsDist_sech2_SecCAN2_84546eef: ComBitPosition=7, ComBitSize=9, ComSignalInitValue=0, ComSignalType=UINT16, ComHandleId=193, ComSystemTemplateSystemSignalRef=RRObsDist_sech2_SecCAN2
        HCUAvlbly_h2_SecCAN2_88955429: ComBitPosition=12, ComBitSize=1, ComSignalInitValue=0, ComSignalType=BOOLEAN, ComTransferProperty=PENDING, ComHandleId=77, ComSystemTemplateSystemSignalRef=HCUAvlbly_h2_SecCAN2
        TCAvlbly_h2_SecCAN2_88955429: ComBitPosition=8, ComBitSize=1, ComSignalInitValue=0, ComSignalType=BOOLEAN, ComTransferProperty=PENDING, ComHandleId=168, ComSystemTemplateSystemSignalRef=TCAvlbly_h2_SecCAN2
        VSESysA_SecCAN2_72648180: ComBitPosition=24, ComBitSize=1, ComSignalInitValue=0, ComSignalType=BOOLEAN, ComTransferProperty=PENDING, ComHandleId=183, ComSystemTemplateSystemSignalRef=VSESysA_SecCAN2
        RNonDrvnWhlRotlDircn_SecCAN2_b40b8807: ComBitPosition=35, ComBitSize=2, ComSignalInitValue=3, ComSignalType=UINT8, ComTransferProperty=PENDING, ComHandleId=128, ComSystemTemplateSystemSignalRef=RNonDrvnWhlRotlDircn_SecCAN2
        APANRCDAvlbl_sech2_SecCAN2_c6716992: ComBitPosition=38, ComBitSize=1, ComSignalInitValue=0, ComSignalType=BOOLEAN, ComHandleId=13, ComSystemTemplateSystemSignalRef=APANRCDAvlbl_sech2_SecCAN2
        WhlGndVelLDrvnV_SecCAN2_e1559b39: ComBitPosition=6, ComBitSize=1, ComSignalInitValue=1, ComSignalType=BOOLEAN, ComTransferProperty=PENDING, ComHandleId=192, ComSystemTemplateSystemSignalRef=WhlGndVelLDrvnV_SecCAN2
        APAChksm_sech2_SecCAN2_0adb690c: ComBitPosition=47, ComBitSize=8, ComSignalInitValue=0, ComSignalType=UINT8, ComHandleId=2, ComSystemTemplateSystemSignalRef=APAChksm_sech2_SecCAN2
      3 x ComIPdu, all with ComIPduType=NORMAL, ComIPduSignalProcessing=DEFERRED, ComIPduCancellationSupport=false:
        PDC_SecCH_FrP01_oCAN02_3abd61be: ComIPduDirection=RECEIVE, ComIPduHandleId=52, ComIPduGroupRef=P2P_oCAN02_Rx_fcef2243, ComIPduSignalRef=FLSideObsDist_sech2_SecCAN2_eb7d27c8, ComIPduSignalRef=FRSideObsDist_sech2_SecCAN2_eb7d27c8, ComIPduSignalRef=RLSideObsDist_sech2_SecCAN2_eb7d27c8, ComIPduSignalRef=RRSideObsDist_sech2_SecCAN2_eb7d27c8, ComPduIdRef=PT_PDC_SecCH_FrP01_PP_PDC_SecCH_FrP01_Rx_427ad0d9_2e7839d1
        P2P_SecCH_GW_FrP00_oCAN02_3abd61be: ComIPduDirection=SEND, ComIPduHandleId=24, ComIPduGroupRef=P2P_oCAN02_Tx_fcef2243, ComIPduSignalRef=BCMAvlbly_h2_SecCAN2_88955429, ComIPduSignalRef=ECMAvlbly_h2_SecCAN2_88955429, ComIPduSignalRef=FICMAvlbly_h2_SecCAN2_88955429, ComIPduSignalRef=HCUAvlbly_h2_SecCAN2_88955429, ComIPduSignalRef=IPCAvlbly_h2_SecCAN2_88955429, ComIPduSignalRef=SCUAvlbly_h2_SecCAN2_88955429, ComIPduSignalRef=SDMAvlbly_h2_SecCAN2_88955429, ComIPduSignalRef=TCAvlbly_h2_SecCAN2_88955429, ComPduIdRef=PT_P2P_SecCH_GW_FrP00_PP_P2P_SecCH_GW_FrP00_Tx_427ad0d9_2e7839d1
          ComTxIPdu: ComTxIPduUnusedAreasDefault=0, ComMinimumDelayTime=0
            ComTxModeTrue
              ComTxMode: ComTxModeMode=PERIODIC, ComTxModeTimePeriod=0.02, ComTxModeTimeOffset=0
            ComTxModeFalse
              ComTxMode: ComTxModeMode=PERIODIC, ComTxModeTimePeriod=0.02, ComTxModeTimeOffset=0
        P2P_SecCH_SCU_FrP00_oCAN02_3abd61be: ComIPduDirection=SEND, ComIPduHandleId=44, ComIPduGroupRef=P2P_oCAN02_Tx_fcef2243, ComIPduSignalRef=SCUDrvrIntrvnA_SecCAN2_c246c452, ComIPduSignalRef=SCUNRCDAvlbl_SecCAN2_c246c452, ComPduIdRef=PT_P2P_SecCH_SCU_FrP00_PP_P2P_SecCH_SCU_FrP00_Tx_427ad0d9_2e7839d1
          ComTxIPdu: ComTxIPduUnusedAreasDefault=0, ComMinimumDelayTime=0
            ComTxModeTrue
              ComTxMode: ComTxModeMode=PERIODIC, ComTxModeTimePeriod=0.01, ComTxModeTimeOffset=0
            ComTxModeFalse
              ComTxMode: ComTxModeMode=PERIODIC, ComTxModeTimePeriod=0.01, ComTxModeTimeOffset=0
      3 x ComSignal, all with ComSignalEndianness=BIG_ENDIAN, ComSignalInitValue=0, ComSignalAccess=ACCESS_UNCLEAR:
        APAParkngSchedV_sech2_SecCAN2_48fe6e71: ComBitPosition=25, ComBitSize=1, ComSignalType=BOOLEAN, ComHandleId=14, ComSystemTemplateSystemSignalRef=APAParkngSchedV_sech2_SecCAN2
        FrtPDCAudWrnng_sech2_SecCAN2_27d72756: ComBitPosition=15, ComBitSize=4, ComSignalType=UINT8, ComHandleId=124, ComSystemTemplateSystemSignalRef=FrtPDCAudWrnng_sech2_SecCAN2
        TrShftLvrPos_h1_SecCAN2_f7a3932f: ComBitPosition=27, ComBitSize=4, ComSignalType=UINT8, ComTransferProperty=PENDING, ComHandleId=174, ComSystemTemplateSystemSignalRef=TrShftLvrPos_h1_SecCAN2
      P2P_SecCH_EPB_FrP00_oCAN02_3abd61be (ComIPdu):
        ComIPduDirection = SEND
        ComIPduType = NORMAL
        ComIPduHandleId = 18
        ComIPduSignalProcessing = DEFERRED
        ComIPduCancellationSupport = false
        ComIPduGroupRef = P2P_oCAN02_Tx_fcef2243
        ComIPduSignalRef = EPBSwStsV_SecCAN2_2190f0b2
        ComIPduSignalRef = EPBSwSts_SecCAN2_2190f0b2
        ComPduIdRef = PT_P2P_SecCH_EPB_FrP00_PP_P2P_SecCH_EPB_FrP00_Tx_427ad0d9_2e7839d1
        ComTxIPdu: ComTxIPduUnusedAreasDefault=0, ComMinimumDelayTime=0
          ComTxModeTrue
            ComTxMode: ComTxModeMode=PERIODIC, ComTxModeTimePeriod=0.02, ComTxModeTimeOffset=0
          ComTxModeFalse
            ComTxMode: ComTxModeMode=PERIODIC, ComTxModeTimePeriod=0.02, ComTxModeTimeOffset=0
      8 x ComSignal, all with ComSignalEndianness=BIG_ENDIAN, ComSignalAccess=ACCESS_UNCLEAR:
        VCUAccReqSts_SecCAN2_e74ec2d1: ComBitPosition=53, ComBitSize=1, ComSignalInitValue=0, ComSignalType=BOOLEAN, ComTransferProperty=PENDING, ComHandleId=176, ComSystemTemplateSystemSignalRef=VCUAccReqSts_SecCAN2
        DrvrSbltAtc_SecCAN2_0cace912: ComBitPosition=12, ComBitSize=1, ComSignalInitValue=0, ComSignalType=BOOLEAN, ComTransferProperty=PENDING, ComHandleId=47, ComSystemTemplateSystemSignalRef=DrvrSbltAtc_SecCAN2
        EPSAPASts_SecCAN2_98082ad5: ComBitPosition=4, ComBitSize=4, ComSignalInitValue=7, ComSignalType=UINT8, ComTransferProperty=PENDING, ComHandleId=59, ComSystemTemplateSystemSignalRef=EPSAPASts_SecCAN2
        StrgWhlAng_SecCAN2_92023e75: ComBitPosition=15, ComBitSize=16, ComSignalInitValue=0, ComSignalType=UINT16, ComTransferProperty=PENDING, ComHandleId=159, ComSystemTemplateSystemSignalRef=StrgWhlAng_SecCAN2
        VehSpdAvgDrvnV_SecCAN2_651f95c3: ComBitPosition=7, ComBitSize=1, ComSignalInitValue=0, ComSignalType=BOOLEAN, ComTransferProperty=PENDING, ComHandleId=188, ComSystemTemplateSystemSignalRef=VehSpdAvgDrvnV_SecCAN2
        EPTAccelActuPosV_SecCAN2_7ebad171: ComBitPosition=43, ComBitSize=1, ComSignalInitValue=0, ComSignalType=BOOLEAN, ComTransferProperty=PENDING, ComHandleId=60, ComSystemTemplateSystemSignalRef=EPTAccelActuPosV_SecCAN2
        APASCSAlvRC_sech2_SecCAN2_c6716992: ComBitPosition=47, ComBitSize=4, ComSignalInitValue=0, ComSignalType=UINT8, ComHandleId=20, ComSystemTemplateSystemSignalRef=APASCSAlvRC_sech2_SecCAN2
        RrObsDist_sech2_SecCAN2_27d72756: ComBitPosition=63, ComBitSize=8, ComSignalInitValue=0, ComSignalType=UINT8, ComHandleId=203, ComSystemTemplateSystemSignalRef=RrObsDist_sech2_SecCAN2
      P2P_SecCH_HCU_FrP01_oCAN02_3abd61be (ComIPdu):
        ComIPduDirection = SEND
        ComIPduType = NORMAL
        ComIPduHandleId = 32
        ComIPduSignalProcessing = DEFERRED
        ComIPduCancellationSupport = false
        ComIPduGroupRef = P2P_oCAN02_Tx_fcef2243
        ComIPduSignalRef = EPTRdy_h1_SecCAN2_b210d1ef
        ComPduIdRef = PT_P2P_SecCH_HCU_FrP01_PP_P2P_SecCH_HCU_FrP01_Tx_427ad0d9_2e7839d1
        ComTxIPdu: ComTxIPduUnusedAreasDefault=0, ComMinimumDelayTime=0
          ComTxModeTrue
            ComTxMode: ComTxModeMode=PERIODIC, ComTxModeTimePeriod=0.02, ComTxModeTimeOffset=0
          ComTxModeFalse
            ComTxMode: ComTxModeMode=PERIODIC, ComTxModeTimePeriod=0.02, ComTxModeTimeOffset=0
      9 x ComSignal, all with ComSignalEndianness=BIG_ENDIAN, ComSignalInitValue=0, ComSignalAccess=ACCESS_UNCLEAR:
        RRSideObsDist_sech2_SecCAN2_eb7d27c8: ComBitPosition=0, ComBitSize=9, ComSignalType=UINT16, ComHandleId=195, ComSystemTemplateSystemSignalRef=RRSideObsDist_sech2_SecCAN2
        SCUDrvrIntrvnA_SecCAN2_c246c452: ComBitPosition=2, ComBitSize=1, ComSignalType=BOOLEAN, ComTransferProperty=PENDING, ComHandleId=152, ComSystemTemplateSystemSignalRef=SCUDrvrIntrvnA_SecCAN2
        HourOfDay_SecCAN2_ee8bd5bd: ComBitPosition=28, ComBitSize=5, ComSignalType=UINT8, ComTransferProperty=PENDING, ComHandleId=83, ComSystemTemplateSystemSignalRef=HourOfDay_SecCAN2
        RNonDrvnWhlRotlSeqNum_SecCAN2_f62e8f7a: ComBitPosition=37, ComBitSize=2, ComSignalType=UINT8, ComTransferProperty=PENDING, ComHandleId=134, ComSystemTemplateSystemSignalRef=RNonDrvnWhlRotlSeqNum_SecCAN2
        SysBPM_SecCAN2_d527401e: ComBitPosition=5, ComBitSize=2, ComSignalType=UINT8, ComTransferProperty=PENDING, ComHandleId=161, ComSystemTemplateSystemSignalRef=SysBPM_SecCAN2
        FLObsRng_sech2_SecCAN2_27d72756: ComBitPosition=47, ComBitSize=4, ComSignalType=UINT8, ComHandleId=108, ComSystemTemplateSystemSignalRef=FLObsRng_sech2_SecCAN2
        APASwReq_SecCAN2_0e098acc: ComBitPosition=59, ComBitSize=2, ComSignalType=UINT8, ComTransferProperty=PENDING, ComHandleId=25, ComSystemTemplateSystemSignalRef=APASwReq_SecCAN2
        RstrFctryDeftsReq_SecCAN2_9fc99604: ComBitPosition=56, ComBitSize=1, ComSignalType=BOOLEAN, ComTransferProperty=PENDING, ComHandleId=146, ComSystemTemplateSystemSignalRef=RstrFctryDeftsReq_SecCAN2
        SysOpnlMd_h2_SecCAN2_443f54b7: ComBitPosition=6, ComBitSize=3, ComSignalType=UINT8, ComTransferProperty=PENDING, ComHandleId=162, ComSystemTemplateSystemSignalRef=SysOpnlMd_h2_SecCAN2
      P2P_SecCH_SAS_FrP00_oCAN02_3abd61be (ComIPdu):
        ComIPduDirection = SEND
        ComIPduType = NORMAL
        ComIPduHandleId = 35
        ComIPduSignalProcessing = DEFERRED
        ComIPduCancellationSupport = false
        ComIPduGroupRef = P2P_oCAN02_Tx_fcef2243
        ComIPduSignalRef = StrgWhlAngV_SecCAN2_92023e75
        ComIPduSignalRef = StrgWhlAng_SecCAN2_92023e75
        ComPduIdRef = PT_P2P_SecCH_SAS_FrP00_PP_P2P_SecCH_SAS_FrP00_Tx_427ad0d9_2e7839d1
        ComTxIPdu: ComTxIPduUnusedAreasDefault=0, ComMinimumDelayTime=0
          ComTxModeTrue
            ComTxMode: ComTxModeMode=PERIODIC, ComTxModeTimePeriod=0.01, ComTxModeTimeOffset=0
          ComTxModeFalse
            ComTxMode: ComTxModeMode=PERIODIC, ComTxModeTimePeriod=0.01, ComTxModeTimeOffset=0
      RLObsRng_sech2_SecCAN2_27d72756 (ComSignal):
        ComBitPosition = 39
        ComBitSize = 4
        ComSignalEndianness = BIG_ENDIAN
        ComSignalInitValue = 0
        ComSignalType = UINT8
        ComSignalAccess = ACCESS_UNCLEAR
        ComHandleId = 180
        ComSystemTemplateSystemSignalRef = RLObsRng_sech2_SecCAN2
      P2P_SecCH_ECM_FrP00_oCAN02_3abd61be (ComIPdu):
        ComIPduDirection = SEND
        ComIPduType = NORMAL
        ComIPduHandleId = 17
        ComIPduSignalProcessing = DEFERRED
        ComIPduCancellationSupport = false
        ComIPduGroupRef = P2P_oCAN02_Tx_fcef2243
        ComIPduSignalRef = EnRunA_SecCAN2_221bb172
        ComPduIdRef = PT_P2P_SecCH_ECM_FrP00_PP_P2P_SecCH_ECM_FrP00_Tx_427ad0d9_2e7839d1
        ComTxIPdu: ComTxIPduUnusedAreasDefault=0, ComMinimumDelayTime=0
          ComTxModeTrue
            ComTxMode: ComTxModeMode=PERIODIC, ComTxModeTimePeriod=0.01, ComTxModeTimeOffset=0
          ComTxModeFalse
            ComTxMode: ComTxModeMode=PERIODIC, ComTxModeTimePeriod=0.01, ComTxModeTimeOffset=0
      P2P_SecCH_HCU_FrP13_oCAN02_3abd61be (ComIPdu):
        ComIPduDirection = SEND
        ComIPduType = NORMAL
        ComIPduHandleId = 33
        ComIPduSignalProcessing = DEFERRED
        ComIPduCancellationSupport = false
        ComIPduGroupRef = P2P_oCAN02_Tx_fcef2243
        ComIPduSignalRef = VCUAccReqSts_SecCAN2_e74ec2d1
        ComIPduSignalRef = VCUAccReqVal_SecCAN2_e74ec2d1
        ComIPduSignalRef = VCUNRCDAvlbl_SecCAN2_e74ec2d1
        ComPduIdRef = PT_P2P_SecCH_HCU_FrP13_PP_P2P_SecCH_HCU_FrP13_Tx_427ad0d9_2e7839d1
        ComTxIPdu: ComTxIPduUnusedAreasDefault=0, ComMinimumDelayTime=0
          ComTxModeTrue
            ComTxMode: ComTxModeMode=PERIODIC, ComTxModeTimePeriod=0.01, ComTxModeTimeOffset=0
          ComTxModeFalse
            ComTxMode: ComTxModeMode=PERIODIC, ComTxModeTimePeriod=0.01, ComTxModeTimeOffset=0
      APACmdEPSSts_sech2_SecCAN2_0adb690c (ComSignal):
        ComBitPosition = 7
        ComBitSize = 2
        ComSignalEndianness = BIG_ENDIAN
        ComSignalInitValue = 0
        ComSignalType = UINT8
        ComSignalAccess = ACCESS_UNCLEAR
        ComHandleId = 3
        ComSystemTemplateSystemSignalRef = APACmdEPSSts_sech2_SecCAN2
      FrtPsngDoorOpenSts_SecCAN2_5ba847fd (ComSignal):
        ComBitPosition = 43
        ComBitSize = 2
        ComSignalEndianness = BIG_ENDIAN
        ComSignalInitValue = 0
        ComSignalType = UINT8
        ComTransferProperty = PENDING
        ComSignalAccess = ACCESS_UNCLEAR
        ComHandleId = 76
        ComSystemTemplateSystemSignalRef = FrtPsngDoorOpenSts_SecCAN2
      P2P_SecCH_SCS_FrP01_oCAN02_3abd61be (ComIPdu):
        ComIPduDirection = SEND
        ComIPduType = NORMAL
        ComIPduHandleId = 37
        ComIPduSignalProcessing = DEFERRED
        ComIPduCancellationSupport = false
        ComIPduGroupRef = P2P_oCAN02_Tx_fcef2243
        ComIPduSignalRef = LNonDrvnWhlRotlDistPC_SecCAN2_f62e8f7a
        ComIPduSignalRef = LNonDrvnWhlRotlDistTRC_SecCAN2_f62e8f7a
        ComIPduSignalRef = LNonDrvnWhlRotlDistT_SecCAN2_f62e8f7a
        ComIPduSignalRef = LNonDrvnWhlRotlDistV_SecCAN2_f62e8f7a
        ComIPduSignalRef = LNonDrvnWhlRotlRstOcd_SecCAN2_f62e8f7a
        ComIPduSignalRef = LNonDrvnWhlRotlSeqNum_SecCAN2_f62e8f7a
        ComIPduSignalRef = RNonDrvnWhlRotlDistPC_SecCAN2_f62e8f7a
        ComIPduSignalRef = RNonDrvnWhlRotlDistTRC_SecCAN2_f62e8f7a
        ComIPduSignalRef = RNonDrvnWhlRotlDistT_SecCAN2_f62e8f7a
        ComIPduSignalRef = RNonDrvnWhlRotlDistV_SecCAN2_f62e8f7a
        ComIPduSignalRef = RNonDrvnWhlRotlRstOcd_SecCAN2_f62e8f7a
        ComIPduSignalRef = RNonDrvnWhlRotlSeqNum_SecCAN2_f62e8f7a
        ComPduIdRef = PT_P2P_SecCH_SCS_FrP01_PP_P2P_SecCH_SCS_FrP01_Tx_427ad0d9_2e7839d1
        ComTxIPdu: ComTxIPduUnusedAreasDefault=0, ComMinimumDelayTime=0
          ComTxModeTrue
            ComTxMode: ComTxModeMode=PERIODIC, ComTxModeTimePeriod=0.02, ComTxModeTimeOffset=0
          ComTxModeFalse
            ComTxMode: ComTxModeMode=PERIODIC, ComTxModeTimePeriod=0.02, ComTxModeTimeOffset=0
      21 x ComSignal, all with ComSignalEndianness=BIG_ENDIAN, ComSignalAccess=ACCESS_UNCLEAR:
        RrMidLObsRng_sech2_SecCAN2_27d72756: ComBitPosition=23, ComBitSize=4, ComSignalInitValue=0, ComSignalType=UINT8, ComHandleId=200, ComSystemTemplateSystemSignalRef=RrMidLObsRng_sech2_SecCAN2
        VSELongtAcc_SecCAN2_78a18899: ComBitPosition=1, ComBitSize=10, ComSignalInitValue=0, ComSignalType=SINT16, ComTransferProperty=PENDING, ComHandleId=182, ComSystemTemplateSystemSignalRef=VSELongtAcc_SecCAN2
        SysVolMdV_h2_SecCAN2_443f54b7: ComBitPosition=7, ComBitSize=1, ComSignalInitValue=0, ComSignalType=BOOLEAN, ComTransferProperty=PENDING, ComHandleId=164, ComSystemTemplateSystemSignalRef=SysVolMdV_h2_SecCAN2
        PDCSwReq_SecCAN2_0e098acc: ComBitPosition=61, ComBitSize=2, ComSignalInitValue=0, ComSignalType=UINT8, ComTransferProperty=PENDING, ComHandleId=114, ComSystemTemplateSystemSignalRef=PDCSwReq_SecCAN2
        APASlotBearng_sech2_SecCAN2_48fe6e71: ComBitPosition=47, ComBitSize=2, ComSignalInitValue=0, ComSignalType=UINT8, ComHandleId=22, ComSystemTemplateSystemSignalRef=APASlotBearng_sech2_SecCAN2
        EPBSwSts_SecCAN2_2190f0b2: ComBitPosition=7, ComBitSize=2, ComSignalInitValue=0, ComSignalType=UINT8, ComTransferProperty=PENDING, ComHandleId=55, ComSystemTemplateSystemSignalRef=EPBSwSts_SecCAN2
        FrtMidLObsDist_sech2_SecCAN2_8e9167f6: ComBitPosition=24, ComBitSize=9, ComSignalInitValue=0, ComSignalType=UINT16, ComHandleId=119, ComSystemTemplateSystemSignalRef=FrtMidLObsDist_sech2_SecCAN2
        APAAlvRC_sech2_SecCAN2_0adb690c: ComBitPosition=39, ComBitSize=8, ComSignalInitValue=0, ComSignalType=UINT8, ComHandleId=1, ComSystemTemplateSystemSignalRef=APAAlvRC_sech2_SecCAN2
        TimeDspFmt_SecCAN2_ee8bd5bd: ComBitPosition=46, ComBitSize=1, ComSignalInitValue=0, ComSignalType=BOOLEAN, ComTransferProperty=PENDING, ComHandleId=172, ComSystemTemplateSystemSignalRef=TimeDspFmt_SecCAN2
        WhlGndVelRNonDrvn_SecCAN2_6fda9cda: ComBitPosition=21, ComBitSize=14, ComSignalInitValue=0, ComSignalType=UINT16, ComTransferProperty=PENDING, ComHandleId=199, ComSystemTemplateSystemSignalRef=WhlGndVelRNonDrvn_SecCAN2
        EPTBrkPdlDscrtInptStsV_SecCAN2_7ebad171: ComBitPosition=16, ComBitSize=1, ComSignalInitValue=1, ComSignalType=BOOLEAN, ComTransferProperty=PENDING, ComHandleId=62, ComSystemTemplateSystemSignalRef=EPTBrkPdlDscrtInptStsV_SecCAN2
        VehSpdAvgNonDrvnV_SecCAN2_651f95c3: ComBitPosition=39, ComBitSize=1, ComSignalInitValue=0, ComSignalType=BOOLEAN, ComTransferProperty=PENDING, ComHandleId=190, ComSystemTemplateSystemSignalRef=VehSpdAvgNonDrvnV_SecCAN2
        WhlGndVelLNonDrvnV_SecCAN2_6fda9cda: ComBitPosition=6, ComBitSize=1, ComSignalInitValue=1, ComSignalType=BOOLEAN, ComTransferProperty=PENDING, ComHandleId=194, ComSystemTemplateSystemSignalRef=WhlGndVelLNonDrvnV_SecCAN2
        DistRCAvgDrvnRstOcd_SecCAN2_651f95c3: ComBitPosition=21, ComBitSize=1, ComSignalInitValue=0, ComSignalType=BOOLEAN, ComTransferProperty=PENDING, ComHandleId=41, ComSystemTemplateSystemSignalRef=DistRCAvgDrvnRstOcd_SecCAN2
        ECMAvlbly_h2_SecCAN2_88955429: ComBitPosition=7, ComBitSize=1, ComSignalInitValue=0, ComSignalType=BOOLEAN, ComTransferProperty=PENDING, ComHandleId=50, ComSystemTemplateSystemSignalRef=ECMAvlbly_h2_SecCAN2
        EPTBrkPdlDscrtInptSts_SecCAN2_7ebad171: ComBitPosition=31, ComBitSize=1, ComSignalInitValue=0, ComSignalType=BOOLEAN, ComTransferProperty=PENDING, ComHandleId=63, ComSystemTemplateSystemSignalRef=EPTBrkPdlDscrtInptSts_SecCAN2
        BPMMstrAvlbly_h2_SecCAN2_443f54b7: ComBitPosition=35, ComBitSize=1, ComSignalInitValue=0, ComSignalType=BOOLEAN, ComTransferProperty=PENDING, ComHandleId=34, ComSystemTemplateSystemSignalRef=BPMMstrAvlbly_h2_SecCAN2
        NRCDSts_h2_SecCAN2_11614789: ComBitPosition=25, ComBitSize=2, ComSignalInitValue=0, ComSignalType=UINT8, ComTransferProperty=PENDING, ComHandleId=106, ComSystemTemplateSystemSignalRef=NRCDSts_h2_SecCAN2
        APASCSAcclReqVal_sech2_SecCAN2_c6716992: ComBitPosition=23, ComBitSize=8, ComSignalInitValue=0, ComSignalType=UINT8, ComHandleId=19, ComSystemTemplateSystemSignalRef=APASCSAcclReqVal_sech2_SecCAN2
        RrMidLObsDist_sech2_SecCAN2_8e9167f6: ComBitPosition=14, ComBitSize=9, ComSignalInitValue=0, ComSignalType=UINT16, ComHandleId=199, ComSystemTemplateSystemSignalRef=RrMidLObsDist_sech2_SecCAN2
        LNonDrvnWhlRotlSeqNum_SecCAN2_f62e8f7a: ComBitPosition=5, ComBitSize=2, ComSignalInitValue=0, ComSignalType=UINT8, ComTransferProperty=PENDING, ComHandleId=100, ComSystemTemplateSystemSignalRef=LNonDrvnWhlRotlSeqNum_SecCAN2
      3 x ComIPdu, all with ComIPduDirection=SEND, ComIPduType=NORMAL, ComIPduSignalProcessing=DEFERRED, ComIPduCancellationSupport=false, ComIPduGroupRef=P2P_oCAN02_Tx_fcef2243:
        P2P_SecCH_FICM_FrP02_oCAN02_3abd61be: ComIPduHandleId=21, ComIPduSignalRef=RstrFctryDeftsReq_SecCAN2_9fc99604, ComPduIdRef=PT_P2P_SecCH_FICM_FrP02_PP_P2P_SecCH_FICM_FrP02_Tx_427ad0d9_2e7839d1
          ComTxIPdu: ComTxIPduUnusedAreasDefault=0, ComMinimumDelayTime=0
            ComTxModeTrue
              ComTxMode: ComTxModeMode=PERIODIC, ComTxModeTimePeriod=0.1, ComTxModeTimeOffset=0
            ComTxModeFalse
              ComTxMode: ComTxModeMode=PERIODIC, ComTxModeTimePeriod=0.1, ComTxModeTimeOffset=0
        P2P_SecCH_FICM_FrP08_oCAN02_3abd61be: ComIPduHandleId=22, ComIPduSignalRef=APASwReq_SecCAN2_0e098acc, ComIPduSignalRef=PDCSwReq_SecCAN2_0e098acc, ComPduIdRef=PT_P2P_SecCH_FICM_FrP08_PP_P2P_SecCH_FICM_FrP08_Tx_427ad0d9_2e7839d1
          ComTxIPdu: ComTxIPduUnusedAreasDefault=0, ComMinimumDelayTime=0
            ComTxModeTrue
              ComTxMode: ComTxModeMode=PERIODIC, ComTxModeTimePeriod=0.01, ComTxModeTimeOffset=0
            ComTxModeFalse
              ComTxMode: ComTxModeMode=PERIODIC, ComTxModeTimePeriod=0.01, ComTxModeTimeOffset=0
        P2P_SecCH_SCS_FrP11_oCAN02_3abd61be: ComIPduHandleId=41, ComIPduSignalRef=WhlGndVelLDrvnV_SecCAN2_e1559b39, ComIPduSignalRef=WhlGndVelLDrvn_SecCAN2_e1559b39, ComIPduSignalRef=WhlGndVelRDrvnV_SecCAN2_e1559b39, ComIPduSignalRef=WhlGndVelRDrvn_SecCAN2_e1559b39, ComPduIdRef=PT_P2P_SecCH_SCS_FrP11_PP_P2P_SecCH_SCS_FrP11_Tx_427ad0d9_2e7839d1
          ComTxIPdu: ComTxIPduUnusedAreasDefault=0, ComMinimumDelayTime=0
            ComTxModeTrue
              ComTxMode: ComTxModeMode=PERIODIC, ComTxModeTimePeriod=0.05, ComTxModeTimeOffset=0
            ComTxModeFalse
              ComTxMode: ComTxModeMode=PERIODIC, ComTxModeTimePeriod=0.05, ComTxModeTimeOffset=0
      LNonDrvnWhlRotlDistPC_SecCAN2_f62e8f7a (ComSignal):
        ComBitPosition = 1
        ComBitSize = 10
        ComSignalEndianness = BIG_ENDIAN
        ComSignalInitValue = 0
        ComSignalType = UINT16
        ComTransferProperty = PENDING
        ComSignalAccess = ACCESS_UNCLEAR
        ComHandleId = 95
        ComSystemTemplateSystemSignalRef = LNonDrvnWhlRotlDistPC_SecCAN2
      P2P_SecCH_HCU_FrP00_oCAN02_3abd61be (ComIPdu):
        ComIPduDirection = SEND
        ComIPduType = NORMAL
        ComIPduHandleId = 31
        ComIPduSignalProcessing = DEFERRED
        ComIPduCancellationSupport = false
        ComIPduGroupRef = P2P_oCAN02_Tx_fcef2243
        ComIPduSignalRef = EPTAccelActuPosV_SecCAN2_7ebad171
        ComIPduSignalRef = EPTAccelActuPos_SecCAN2_7ebad171
        ComIPduSignalRef = EPTBrkPdlDscrtInptStsV_SecCAN2_7ebad171
        ComIPduSignalRef = EPTBrkPdlDscrtInptSts_SecCAN2_7ebad171
        ComIPduSignalRef = EPTStCmdOn_h1_SecCAN2_7ebad171
        ComPduIdRef = PT_P2P_SecCH_HCU_FrP00_PP_P2P_SecCH_HCU_FrP00_Tx_427ad0d9_2e7839d1
        ComTxIPdu: ComTxIPduUnusedAreasDefault=0, ComMinimumDelayTime=0
          ComTxModeTrue
            ComTxMode: ComTxModeMode=PERIODIC, ComTxModeTimePeriod=0.01, ComTxModeTimeOffset=0
          ComTxModeFalse
            ComTxMode: ComTxModeMode=PERIODIC, ComTxModeTimePeriod=0.01, ComTxModeTimeOffset=0
      LNonDrvnWhlRotlDircn_SecCAN2_b40b8807 (ComSignal):
        ComBitPosition = 33
        ComBitSize = 2
        ComSignalEndianness = BIG_ENDIAN
        ComSignalInitValue = 3
        ComSignalType = UINT8
        ComTransferProperty = PENDING
        ComSignalAccess = ACCESS_UNCLEAR
        ComHandleId = 94
        ComSystemTemplateSystemSignalRef = LNonDrvnWhlRotlDircn_SecCAN2
      P2P_SecCH_EPB_FrP01_oCAN02_3abd61be (ComIPdu):
        ComIPduDirection = SEND
        ComIPduType = NORMAL
        ComIPduHandleId = 19
        ComIPduSignalProcessing = DEFERRED
        ComIPduCancellationSupport = false
        ComIPduGroupRef = P2P_oCAN02_Tx_fcef2243
        ComIPduSignalRef = EPBAppcnSts_SecCAN2_ed3af02c
        ComIPduSignalRef = EPBAvlblyStsPV_SecCAN2_ed3af02c
        ComIPduSignalRef = EPBAvlblySts_SecCAN2_ed3af02c
        ComPduIdRef = PT_P2P_SecCH_EPB_FrP01_PP_P2P_SecCH_EPB_FrP01_Tx_427ad0d9_2e7839d1
        ComTxIPdu: ComTxIPduUnusedAreasDefault=0, ComMinimumDelayTime=0
          ComTxModeTrue
            ComTxMode: ComTxModeMode=PERIODIC, ComTxModeTimePeriod=0.02, ComTxModeTimeOffset=0
          ComTxModeFalse
            ComTxMode: ComTxModeMode=PERIODIC, ComTxModeTimePeriod=0.02, ComTxModeTimeOffset=0
      6 x ComSignal, all with ComSignalEndianness=BIG_ENDIAN, ComSignalInitValue=0, ComSignalAccess=ACCESS_UNCLEAR:
        VehOdoV_h2_SecCAN2_5b704f9c: ComBitPosition=31, ComBitSize=1, ComSignalType=BOOLEAN, ComTransferProperty=PENDING, ComHandleId=186, ComSystemTemplateSystemSignalRef=VehOdoV_h2_SecCAN2
        APACrpSpdReqVal_sech2_SecCAN2_c6716992: ComBitPosition=29, ComBitSize=6, ComSignalType=UINT8, ComHandleId=5, ComSystemTemplateSystemSignalRef=APACrpSpdReqVal_sech2_SecCAN2
        VSELongtAccV_SecCAN2_78a18899: ComBitPosition=2, ComBitSize=1, ComSignalType=BOOLEAN, ComTransferProperty=PENDING, ComHandleId=181, ComSystemTemplateSystemSignalRef=VSELongtAccV_SecCAN2
        RDrvnWhlRotlDistV_SecCAN2_3a848fe4: ComBitPosition=34, ComBitSize=1, ComSignalType=BOOLEAN, ComTransferProperty=PENDING, ComHandleId=122, ComSystemTemplateSystemSignalRef=RDrvnWhlRotlDistV_SecCAN2
        EnRunA_SecCAN2_221bb172: ComBitPosition=7, ComBitSize=1, ComSignalType=BOOLEAN, ComTransferProperty=PENDING, ComHandleId=66, ComSystemTemplateSystemSignalRef=EnRunA_SecCAN2
        APAVehCrdnatPosX_sech2_SecCAN2_48fe6e71: ComBitPosition=45, ComBitSize=12, ComSignalType=UINT16, ComHandleId=31, ComSystemTemplateSystemSignalRef=APAVehCrdnatPosX_sech2_SecCAN2
      P2P_SecCH_IPK_FrP06_oCAN02_3abd61be (ComIPdu):
        ComIPduDirection = SEND
        ComIPduType = NORMAL
        ComIPduHandleId = 34
        ComIPduSignalProcessing = DEFERRED
        ComIPduCancellationSupport = false
        ComIPduGroupRef = P2P_oCAN02_Tx_fcef2243
        ComIPduSignalRef = CalendarDay_SecCAN2_ee8bd5bd
        ComIPduSignalRef = CalendarMonth_SecCAN2_ee8bd5bd
        ComIPduSignalRef = CalendarYear_SecCAN2_ee8bd5bd
        ComIPduSignalRef = HourOfDay_SecCAN2_ee8bd5bd
        ComIPduSignalRef = MinuteOfHour_SecCAN2_ee8bd5bd
        ComIPduSignalRef = SecsOfMinute_SecCAN2_ee8bd5bd
        ComIPduSignalRef = TimeDspFmt_SecCAN2_ee8bd5bd
        ComPduIdRef = PT_P2P_SecCH_IPK_FrP06_PP_P2P_SecCH_IPK_FrP06_Tx_427ad0d9_2e7839d1
        ComTxIPdu: ComTxIPduUnusedAreasDefault=0, ComMinimumDelayTime=0
          ComTxModeTrue
            ComTxMode: ComTxModeMode=PERIODIC, ComTxModeTimePeriod=0.2, ComTxModeTimeOffset=0
          ComTxModeFalse
            ComTxMode: ComTxModeMode=PERIODIC, ComTxModeTimePeriod=0.2, ComTxModeTimeOffset=0
      5 x ComSignal, all with ComSignalEndianness=BIG_ENDIAN, ComSignalInitValue=0, ComTransferProperty=PENDING, ComSignalAccess=ACCESS_UNCLEAR:
        FICMAvlbly_h2_SecCAN2_88955429: ComBitPosition=25, ComBitSize=1, ComSignalType=BOOLEAN, ComHandleId=67, ComSystemTemplateSystemSignalRef=FICMAvlbly_h2_SecCAN2
        OtsdAirTemCrVal_h2_SecCAN2_9fee406a: ComBitPosition=63, ComBitSize=8, ComSignalType=UINT8, ComHandleId=109, ComSystemTemplateSystemSignalRef=OtsdAirTemCrVal_h2_SecCAN2
        EPTAccelActuPos_SecCAN2_7ebad171: ComBitPosition=7, ComBitSize=8, ComSignalType=UINT8, ComHandleId=61, ComSystemTemplateSystemSignalRef=EPTAccelActuPos_SecCAN2
        LDrvnWhlRotlSeqNum_SecCAN2_3a848fe4: ComBitPosition=5, ComBitSize=2, ComSignalType=UINT8, ComHandleId=93, ComSystemTemplateSystemSignalRef=LDrvnWhlRotlSeqNum_SecCAN2
        RNonDrvnWhlRotlDistPC_SecCAN2_f62e8f7a: ComBitPosition=33, ComBitSize=10, ComSignalType=UINT16, ComHandleId=129, ComSystemTemplateSystemSignalRef=RNonDrvnWhlRotlDistPC_SecCAN2
      P2P_SecCH_HCU_ECM_FrP04_oCAN02_3abd61be (ComIPdu):
        ComIPduDirection = SEND
        ComIPduType = NORMAL
        ComIPduHandleId = 30
        ComIPduSignalProcessing = DEFERRED
        ComIPduCancellationSupport = false
        ComIPduGroupRef = P2P_oCAN02_Tx_fcef2243
        ComIPduSignalRef = TrShftLvrPosV_h1_SecCAN2_f7a3932f
        ComIPduSignalRef = TrShftLvrPos_h1_SecCAN2_f7a3932f
        ComPduIdRef = PT_P2P_SecCH_HCU_ECM_FrP04_PP_P2P_SecCH_HCU_ECM_FrP04_Tx_427ad0d9_2e7839d1
        ComTxIPdu: ComTxIPduUnusedAreasDefault=0, ComMinimumDelayTime=0
          ComTxModeTrue
            ComTxMode: ComTxModeMode=PERIODIC, ComTxModeTimePeriod=0.02, ComTxModeTimeOffset=0
          ComTxModeFalse
            ComTxMode: ComTxModeMode=PERIODIC, ComTxModeTimePeriod=0.02, ComTxModeTimeOffset=0
      5 x ComSignal, all with ComBitSize=1, ComSignalEndianness=BIG_ENDIAN, ComSignalType=BOOLEAN, ComSignalAccess=ACCESS_UNCLEAR:
        TMSpdV_h1_SecCAN2_a8511b71: ComBitPosition=23, ComSignalInitValue=1, ComTransferProperty=PENDING, ComHandleId=170, ComSystemTemplateSystemSignalRef=TMSpdV_h1_SecCAN2
        DistRCAvgDrvnSrc_SecCAN2_651f95c3: ComBitPosition=55, ComSignalInitValue=0, ComTransferProperty=PENDING, ComHandleId=42, ComSystemTemplateSystemSignalRef=DistRCAvgDrvnSrc_SecCAN2
        PwrMdMstrRunCrkA_h2_SecCAN2_443f54b7: ComBitPosition=3, ComSignalInitValue=0, ComTransferProperty=PENDING, ComHandleId=117, ComSystemTemplateSystemSignalRef=PwrMdMstrRunCrkA_h2_SecCAN2
        APASCSAcclReqSts_sech2_SecCAN2_c6716992: ComBitPosition=55, ComSignalInitValue=0, ComHandleId=17, ComSystemTemplateSystemSignalRef=APASCSAcclReqSts_sech2_SecCAN2
        LDrvnWhlRotlRstOcd_SecCAN2_3a848fe4: ComBitPosition=3, ComSignalInitValue=0, ComTransferProperty=PENDING, ComHandleId=92, ComSystemTemplateSystemSignalRef=LDrvnWhlRotlRstOcd_SecCAN2
      P2P_SecCH_EPS_FrP02_oCAN02_3abd61be (ComIPdu):
        ComIPduDirection = SEND
        ComIPduType = NORMAL
        ComIPduHandleId = 20
        ComIPduSignalProcessing = DEFERRED
        ComIPduCancellationSupport = false
        ComIPduGroupRef = P2P_oCAN02_Tx_fcef2243
        ComIPduSignalRef = EPSAPAAlvRC_SecCAN2_98082ad5
        ComIPduSignalRef = EPSAPAChksm_SecCAN2_98082ad5
        ComIPduSignalRef = EPSAPAInh_SecCAN2_98082ad5
        ComIPduSignalRef = EPSAPASts_SecCAN2_98082ad5
        ComPduIdRef = PT_P2P_SecCH_EPS_FrP02_PP_P2P_SecCH_EPS_FrP02_Tx_427ad0d9_2e7839d1
        ComTxIPdu: ComTxIPduUnusedAreasDefault=0, ComMinimumDelayTime=0
          ComTxModeTrue
            ComTxMode: ComTxModeMode=PERIODIC, ComTxModeTimePeriod=0.02, ComTxModeTimeOffset=0
          ComTxModeFalse
            ComTxMode: ComTxModeMode=PERIODIC, ComTxModeTimePeriod=0.02, ComTxModeTimeOffset=0
      7 x ComSignal, all with ComSignalEndianness=BIG_ENDIAN, ComSignalInitValue=0, ComTransferProperty=PENDING, ComSignalAccess=ACCESS_UNCLEAR:
        MinuteOfHour_SecCAN2_ee8bd5bd: ComBitPosition=37, ComBitSize=6, ComSignalType=UINT8, ComHandleId=102, ComSystemTemplateSystemSignalRef=MinuteOfHour_SecCAN2
        RDrvnWhlRotlDistTRC_SecCAN2_3a848fe4: ComBitPosition=39, ComBitSize=2, ComSignalType=UINT8, ComHandleId=120, ComSystemTemplateSystemSignalRef=RDrvnWhlRotlDistTRC_SecCAN2
        LNonDrvnWhlRotlDistTRC_SecCAN2_f62e8f7a: ComBitPosition=7, ComBitSize=2, ComSignalType=UINT8, ComHandleId=96, ComSystemTemplateSystemSignalRef=LNonDrvnWhlRotlDistTRC_SecCAN2
        SysBPMEnbd_SecCAN2_d527401e: ComBitPosition=6, ComBitSize=1, ComSignalType=BOOLEAN, ComHandleId=160, ComSystemTemplateSystemSignalRef=SysBPMEnbd_SecCAN2
        LDrvnWhlRotlDistPlsCtr_SecCAN2_3a848fe4: ComBitPosition=1, ComBitSize=10, ComSignalType=UINT16, ComHandleId=88, ComSystemTemplateSystemSignalRef=LDrvnWhlRotlDistPlsCtr_SecCAN2
        IPCAvlbly_h2_SecCAN2_88955429: ComBitPosition=30, ComBitSize=1, ComSignalType=BOOLEAN, ComHandleId=86, ComSystemTemplateSystemSignalRef=IPCAvlbly_h2_SecCAN2
        LDrvnWhlRotlDistTRC_SecCAN2_3a848fe4: ComBitPosition=7, ComBitSize=2, ComSignalType=UINT8, ComHandleId=89, ComSystemTemplateSystemSignalRef=LDrvnWhlRotlDistTRC_SecCAN2
      P2P_SecCH_SCS_FrP05_oCAN02_3abd61be (ComIPdu):
        ComIPduDirection = SEND
        ComIPduType = NORMAL
        ComIPduHandleId = 40
        ComIPduSignalProcessing = DEFERRED
        ComIPduCancellationSupport = false
        ComIPduGroupRef = P2P_oCAN02_Tx_fcef2243
        ComIPduSignalRef = ABSA_SecCAN2_72648180
        ComIPduSignalRef = TCSA_SecCAN2_72648180
        ComIPduSignalRef = VSESysA_SecCAN2_72648180
        ComIPduSignalRef = VehDynYawRateV_SecCAN2_72648180
        ComIPduSignalRef = VehDynYawRate_SecCAN2_72648180
        ComPduIdRef = PT_P2P_SecCH_SCS_FrP05_PP_P2P_SecCH_SCS_FrP05_Tx_427ad0d9_2e7839d1
        ComTxIPdu: ComTxIPduUnusedAreasDefault=0, ComMinimumDelayTime=0
          ComTxModeTrue
            ComTxMode: ComTxModeMode=PERIODIC, ComTxModeTimePeriod=0.01, ComTxModeTimeOffset=0
          ComTxModeFalse
            ComTxMode: ComTxModeMode=PERIODIC, ComTxModeTimePeriod=0.01, ComTxModeTimeOffset=0
      P2P_SecCH_SCS_FrP02_oCAN02_3abd61be (ComIPdu):
        ComIPduDirection = SEND
        ComIPduType = NORMAL
        ComIPduHandleId = 38
        ComIPduSignalProcessing = DEFERRED
        ComIPduCancellationSupport = false
        ComIPduGroupRef = P2P_oCAN02_Tx_fcef2243
        ComIPduSignalRef = VSELatAccV_SecCAN2_78a18899
        ComIPduSignalRef = VSELatAcc_SecCAN2_78a18899
        ComIPduSignalRef = VSELongtAccV_SecCAN2_78a18899
        ComIPduSignalRef = VSELongtAcc_SecCAN2_78a18899
        ComPduIdRef = PT_P2P_SecCH_SCS_FrP02_PP_P2P_SecCH_SCS_FrP02_Tx_427ad0d9_2e7839d1
        ComTxIPdu: ComTxIPduUnusedAreasDefault=0, ComMinimumDelayTime=0
          ComTxModeTrue
            ComTxMode: ComTxModeMode=PERIODIC, ComTxModeTimePeriod=0.02, ComTxModeTimeOffset=0
          ComTxModeFalse
            ComTxMode: ComTxModeMode=PERIODIC, ComTxModeTimePeriod=0.02, ComTxModeTimeOffset=0
      LDrvnWhlRotlDistV_SecCAN2_3a848fe4 (ComSignal):
        ComBitPosition = 2
        ComBitSize = 1
        ComSignalEndianness = BIG_ENDIAN
        ComSignalInitValue = 0
        ComSignalType = BOOLEAN
        ComTransferProperty = PENDING
        ComSignalAccess = ACCESS_UNCLEAR
        ComHandleId = 91
        ComSystemTemplateSystemSignalRef = LDrvnWhlRotlDistV_SecCAN2
      P2P_SecCH_BCM_FrP07_oCAN02_3abd61be (ComIPdu):
        ComIPduDirection = SEND
        ComIPduType = NORMAL
        ComIPduHandleId = 16
        ComIPduSignalProcessing = DEFERRED
        ComIPduCancellationSupport = false
        ComIPduGroupRef = P2P_oCAN02_Tx_fcef2243
        ComIPduSignalRef = SysBPMEnbd_SecCAN2_d527401e
        ComIPduSignalRef = SysBPM_SecCAN2_d527401e
        ComPduIdRef = PT_P2P_SecCH_BCM_FrP07_PP_P2P_SecCH_BCM_FrP07_Tx_427ad0d9_2e7839d1
        ComTxIPdu: ComTxIPduUnusedAreasDefault=0, ComMinimumDelayTime=0
          ComTxModeTrue
            ComTxMode: ComTxModeMode=PERIODIC, ComTxModeTimePeriod=0.02, ComTxModeTimeOffset=0
          ComTxModeFalse
            ComTxMode: ComTxModeMode=PERIODIC, ComTxModeTimePeriod=0.02, ComTxModeTimeOffset=0
      VehSpdAvgDrvn_SecCAN2_651f95c3 (ComSignal):
        ComBitPosition = 6
        ComBitSize = 15
        ComSignalEndianness = BIG_ENDIAN
        ComSignalInitValue = 0
        ComSignalType = UINT16
        ComTransferProperty = PENDING
        ComSignalAccess = ACCESS_UNCLEAR
        ComHandleId = 189
        ComSystemTemplateSystemSignalRef = VehSpdAvgDrvn_SecCAN2
      P2P_SecCH_BCM_FrP04_oCAN02_3abd61be (ComIPdu):
        ComIPduDirection = SEND
        ComIPduType = NORMAL
        ComIPduHandleId = 15
        ComIPduSignalProcessing = DEFERRED
        ComIPduCancellationSupport = false
        ComIPduGroupRef = P2P_oCAN02_Tx_fcef2243
        ComIPduSignalRef = BntOpenSts_SecCAN2_5ba847fd
        ComIPduSignalRef = DrvrDoorOpenSts_SecCAN2_5ba847fd
        ComIPduSignalRef = FrtPsngDoorOpenSts_SecCAN2_5ba847fd
        ComIPduSignalRef = LDircnIO_SecCAN2_5ba847fd
        ComIPduSignalRef = LdspcOpenSts_SecCAN2_5ba847fd
        ComIPduSignalRef = RDircnIO_SecCAN2_5ba847fd
        ComIPduSignalRef = RLDoorOpenSts_SecCAN2_5ba847fd
        ComIPduSignalRef = RRDoorOpenSts_SecCAN2_5ba847fd
        ComPduIdRef = PT_P2P_SecCH_BCM_FrP04_PP_P2P_SecCH_BCM_FrP04_Tx_427ad0d9_2e7839d1
        ComTxIPdu: ComTxIPduUnusedAreasDefault=0, ComMinimumDelayTime=0
          ComTxModeTrue
            ComTxMode: ComTxModeMode=PERIODIC, ComTxModeTimePeriod=0.01, ComTxModeTimeOffset=0
          ComTxModeFalse
            ComTxMode: ComTxModeMode=PERIODIC, ComTxModeTimePeriod=0.01, ComTxModeTimeOffset=0
      5 x ComSignal, all with ComSignalEndianness=BIG_ENDIAN, ComSignalInitValue=0, ComSignalAccess=ACCESS_UNCLEAR:
        FrtMidRObsDist_sech2_SecCAN2_8e9167f6: ComBitPosition=21, ComBitSize=9, ComSignalType=UINT16, ComHandleId=121, ComSystemTemplateSystemSignalRef=FrtMidRObsDist_sech2_SecCAN2
        SCSAPAAlvRC_SecCAN2_b40b8807: ComBitPosition=39, ComBitSize=4, ComSignalType=UINT8, ComTransferProperty=PENDING, ComHandleId=148, ComSystemTemplateSystemSignalRef=SCSAPAAlvRC_SecCAN2
        RDrvnWhlRotlSeqNum_SecCAN2_3a848fe4: ComBitPosition=37, ComBitSize=2, ComSignalType=UINT8, ComTransferProperty=PENDING, ComHandleId=124, ComSystemTemplateSystemSignalRef=RDrvnWhlRotlSeqNum_SecCAN2
        NRCDF_SecCAN2_d64f184b: ComBitPosition=21, ComBitSize=1, ComSignalType=BOOLEAN, ComTransferProperty=PENDING, ComHandleId=104, ComSystemTemplateSystemSignalRef=NRCDF_SecCAN2
        APAInfoDispReq_sech2_SecCAN2_c6716992: ComBitPosition=37, ComBitSize=6, ComSignalType=UINT8, ComHandleId=11, ComSystemTemplateSystemSignalRef=APAInfoDispReq_sech2_SecCAN2
      DIAG_DTCInfo_APA_oCAN02_3abd61be (ComIPdu):
        ComIPduDirection = RECEIVE
        ComIPduType = NORMAL
        ComIPduHandleId = 8
        ComIPduSignalProcessing = DEFERRED
        ComIPduCancellationSupport = false
        ComIPduGroupRef = P2P_oCAN02_Rx_fcef2243
        ComIPduSignalRef = DTCInfomationAPA_SecCAN2_3e47bb85
        ComPduIdRef = PT_DIAG_DTCInfo_APA_PP_DIAG_DTCInfo_APA_Rx_427ad0d9_2e7839d1
      LDrvnWhlRotlDistTmsp_SecCAN2_3a848fe4 (ComSignal):
        ComBitPosition = 23
        ComBitSize = 16
        ComSignalEndianness = BIG_ENDIAN
        ComSignalInitValue = 0
        ComSignalType = UINT16
        ComTransferProperty = PENDING
        ComSignalAccess = ACCESS_UNCLEAR
        ComHandleId = 90
        ComSystemTemplateSystemSignalRef = LDrvnWhlRotlDistTmsp_SecCAN2
      FRSideObsDist_sech2_SecCAN2_eb7d27c8 (ComSignal):
        ComBitPosition = 32
        ComBitSize = 9
        ComSignalEndianness = BIG_ENDIAN
        ComSignalInitValue = 0
        ComSignalType = UINT16
        ComSignalAccess = ACCESS_UNCLEAR
        ComHandleId = 115
        ComSystemTemplateSystemSignalRef = FRSideObsDist_sech2_SecCAN2
      P2P_SecCH_SCS_FrP00_oCAN02_3abd61be (ComIPdu):
        ComIPduDirection = SEND
        ComIPduType = NORMAL
        ComIPduHandleId = 36
        ComIPduSignalProcessing = DEFERRED
        ComIPduCancellationSupport = false
        ComIPduGroupRef = P2P_oCAN02_Tx_fcef2243
        ComIPduSignalRef = LDrvnWhlRotlDistPlsCtr_SecCAN2_3a848fe4
        ComIPduSignalRef = LDrvnWhlRotlDistTRC_SecCAN2_3a848fe4
        ComIPduSignalRef = LDrvnWhlRotlDistTmsp_SecCAN2_3a848fe4
        ComIPduSignalRef = LDrvnWhlRotlDistV_SecCAN2_3a848fe4
        ComIPduSignalRef = LDrvnWhlRotlRstOcd_SecCAN2_3a848fe4
        ComIPduSignalRef = LDrvnWhlRotlSeqNum_SecCAN2_3a848fe4
        ComIPduSignalRef = RDrvnWhlRotlDistPlsCtr_SecCAN2_3a848fe4
        ComIPduSignalRef = RDrvnWhlRotlDistTRC_SecCAN2_3a848fe4
        ComIPduSignalRef = RDrvnWhlRotlDistTmsp_SecCAN2_3a848fe4
        ComIPduSignalRef = RDrvnWhlRotlDistV_SecCAN2_3a848fe4
        ComIPduSignalRef = RDrvnWhlRotlRstOcd_SecCAN2_3a848fe4
        ComIPduSignalRef = RDrvnWhlRotlSeqNum_SecCAN2_3a848fe4
        ComPduIdRef = PT_P2P_SecCH_SCS_FrP00_PP_P2P_SecCH_SCS_FrP00_Tx_427ad0d9_2e7839d1
        ComTxIPdu: ComTxIPduUnusedAreasDefault=0, ComMinimumDelayTime=0
          ComTxModeTrue
            ComTxMode: ComTxModeMode=PERIODIC, ComTxModeTimePeriod=0.01, ComTxModeTimeOffset=0
          ComTxModeFalse
            ComTxMode: ComTxModeMode=PERIODIC, ComTxModeTimePeriod=0.01, ComTxModeTimeOffset=0
      9 x ComSignal, all with ComSignalEndianness=BIG_ENDIAN, ComSignalInitValue=0, ComSignalAccess=ACCESS_UNCLEAR:
        RLSideObsDist_sech2_SecCAN2_eb7d27c8: ComBitPosition=16, ComBitSize=9, ComSignalType=UINT16, ComHandleId=181, ComSystemTemplateSystemSignalRef=RLSideObsDist_sech2_SecCAN2
        APACtrlAbotdRsn_SecCAN2_11614789: ComBitPosition=47, ComBitSize=4, ComSignalType=UINT8, ComTransferProperty=PENDING, ComHandleId=6, ComSystemTemplateSystemSignalRef=APACtrlAbotdRsn_SecCAN2
        VehSpdAvgNonDrvn_SecCAN2_651f95c3: ComBitPosition=38, ComBitSize=15, ComSignalType=UINT16, ComTransferProperty=PENDING, ComHandleId=191, ComSystemTemplateSystemSignalRef=VehSpdAvgNonDrvn_SecCAN2
        SysPwrMd_h2_SecCAN2_443f54b7: ComBitPosition=1, ComBitSize=2, ComSignalType=UINT8, ComTransferProperty=PENDING, ComHandleId=163, ComSystemTemplateSystemSignalRef=SysPwrMd_h2_SecCAN2
        PDCSysSts_sech2_SecCAN2_27d72756: ComBitPosition=7, ComBitSize=4, ComSignalType=UINT8, ComHandleId=163, ComSystemTemplateSystemSignalRef=PDCSysSts_sech2_SecCAN2
        DistRCAvgDrvn_SecCAN2_651f95c3: ComBitPosition=20, ComBitSize=13, ComSignalType=UINT16, ComTransferProperty=PENDING, ComHandleId=44, ComSystemTemplateSystemSignalRef=DistRCAvgDrvn_SecCAN2
        VSELatAcc_SecCAN2_78a18899: ComBitPosition=19, ComBitSize=12, ComSignalType=SINT16, ComTransferProperty=PENDING, ComHandleId=180, ComSystemTemplateSystemSignalRef=VSELatAcc_SecCAN2
        RrPDCAudWrnng_sech2_SecCAN2_27d72756: ComBitPosition=3, ComBitSize=4, ComSignalType=UINT8, ComHandleId=204, ComSystemTemplateSystemSignalRef=RrPDCAudWrnng_sech2_SecCAN2
        RDircnIO_SecCAN2_5ba847fd: ComBitPosition=38, ComBitSize=1, ComSignalType=BOOLEAN, ComTransferProperty=PENDING, ComHandleId=118, ComSystemTemplateSystemSignalRef=RDircnIO_SecCAN2
      P2P_SecCH_SCS_FrP12_oCAN02_3abd61be (ComIPdu):
        ComIPduDirection = SEND
        ComIPduType = NORMAL
        ComIPduHandleId = 42
        ComIPduSignalProcessing = DEFERRED
        ComIPduCancellationSupport = false
        ComIPduGroupRef = P2P_oCAN02_Tx_fcef2243
        ComIPduSignalRef = WhlGndVelLNonDrvnV_SecCAN2_6fda9cda
        ComIPduSignalRef = WhlGndVelLNonDrvn_SecCAN2_6fda9cda
        ComIPduSignalRef = WhlGndVelRNonDrvnV_SecCAN2_6fda9cda
        ComIPduSignalRef = WhlGndVelRNonDrvn_SecCAN2_6fda9cda
        ComPduIdRef = PT_P2P_SecCH_SCS_FrP12_PP_P2P_SecCH_SCS_FrP12_Tx_427ad0d9_2e7839d1
        ComTxIPdu: ComTxIPduUnusedAreasDefault=0, ComMinimumDelayTime=0
          ComTxModeTrue
            ComTxMode: ComTxModeMode=PERIODIC, ComTxModeTimePeriod=0.05, ComTxModeTimeOffset=0
          ComTxModeFalse
            ComTxMode: ComTxModeMode=PERIODIC, ComTxModeTimePeriod=0.05, ComTxModeTimeOffset=0
      6 x ComSignal, all with ComSignalEndianness=BIG_ENDIAN, ComSignalInitValue=0, ComSignalAccess=ACCESS_UNCLEAR:
        EPTRdy_h1_SecCAN2_b210d1ef: ComBitPosition=38, ComBitSize=1, ComSignalType=BOOLEAN, ComTransferProperty=PENDING, ComHandleId=64, ComSystemTemplateSystemSignalRef=EPTRdy_h1_SecCAN2
        APAEPBOPReq_sech2_SecCAN2_c6716992: ComBitPosition=31, ComBitSize=2, ComSignalType=UINT8, ComHandleId=7, ComSystemTemplateSystemSignalRef=APAEPBOPReq_sech2_SecCAN2
        EPSAPAChksm_SecCAN2_98082ad5: ComBitPosition=31, ComBitSize=8, ComSignalType=UINT8, ComTransferProperty=PENDING, ComHandleId=57, ComSystemTemplateSystemSignalRef=EPSAPAChksm_SecCAN2
        DistRCAvgDrvnV_SecCAN2_651f95c3: ComBitPosition=22, ComBitSize=1, ComSignalType=BOOLEAN, ComTransferProperty=PENDING, ComHandleId=43, ComSystemTemplateSystemSignalRef=DistRCAvgDrvnV_SecCAN2
        DrvrSelAPAParkngMd_SecCAN2_19729e8f: ComBitPosition=0, ComBitSize=3, ComSignalType=UINT8, ComTransferProperty=PENDING, ComHandleId=48, ComSystemTemplateSystemSignalRef=DrvrSelAPAParkngMd_SecCAN2
        SCUNRCDAvlbl_SecCAN2_c246c452: ComBitPosition=3, ComBitSize=1, ComSignalType=BOOLEAN, ComTransferProperty=PENDING, ComHandleId=153, ComSystemTemplateSystemSignalRef=SCUNRCDAvlbl_SecCAN2
      P2P_SecCH_SCS_FrP03_oCAN02_3abd61be (ComIPdu):
        ComIPduDirection = SEND
        ComIPduType = NORMAL
        ComIPduHandleId = 39
        ComIPduSignalProcessing = DEFERRED
        ComIPduCancellationSupport = false
        ComIPduGroupRef = P2P_oCAN02_Tx_fcef2243
        ComIPduSignalRef = LNonDrvnWhlRotlDircn_SecCAN2_b40b8807
        ComIPduSignalRef = RNonDrvnWhlRotlDircn_SecCAN2_b40b8807
        ComIPduSignalRef = SCSAPAAcclA_SecCAN2_b40b8807
        ComIPduSignalRef = SCSAPAAlvRC_SecCAN2_b40b8807
        ComIPduSignalRef = SCSAPAAvlbl_SecCAN2_b40b8807
        ComIPduSignalRef = SCSNRCDAvlbl_SecCAN2_b40b8807
        ComPduIdRef = PT_P2P_SecCH_SCS_FrP03_PP_P2P_SecCH_SCS_FrP03_Tx_427ad0d9_2e7839d1
        ComTxIPdu: ComTxIPduUnusedAreasDefault=0, ComMinimumDelayTime=0
          ComTxModeTrue
            ComTxMode: ComTxModeMode=PERIODIC, ComTxModeTimePeriod=0.01, ComTxModeTimeOffset=0
          ComTxModeFalse
            ComTxMode: ComTxModeMode=PERIODIC, ComTxModeTimePeriod=0.01, ComTxModeTimeOffset=0
      P2P_SecCH_SCS_FrP15_oCAN02_3abd61be (ComIPdu):
        ComIPduDirection = SEND
        ComIPduType = NORMAL
        ComIPduHandleId = 43
        ComIPduSignalProcessing = DEFERRED
        ComIPduCancellationSupport = false
        ComIPduGroupRef = P2P_oCAN02_Tx_fcef2243
        ComIPduSignalRef = DistRCAvgDrvnRstOcd_SecCAN2_651f95c3
        ComIPduSignalRef = DistRCAvgDrvnSrc_SecCAN2_651f95c3
        ComIPduSignalRef = DistRCAvgDrvnV_SecCAN2_651f95c3
        ComIPduSignalRef = DistRCAvgDrvn_SecCAN2_651f95c3
        ComIPduSignalRef = VehSpdAvgDrvnV_SecCAN2_651f95c3
        ComIPduSignalRef = VehSpdAvgDrvn_SecCAN2_651f95c3
        ComIPduSignalRef = VehSpdAvgNonDrvnV_SecCAN2_651f95c3
        ComIPduSignalRef = VehSpdAvgNonDrvn_SecCAN2_651f95c3
        ComPduIdRef = PT_P2P_SecCH_SCS_FrP15_PP_P2P_SecCH_SCS_FrP15_Tx_427ad0d9_2e7839d1
        ComTxIPdu: ComTxIPduUnusedAreasDefault=0, ComMinimumDelayTime=0
          ComTxModeTrue
            ComTxMode: ComTxModeMode=PERIODIC, ComTxModeTimePeriod=0.1, ComTxModeTimeOffset=0
          ComTxModeFalse
            ComTxMode: ComTxModeMode=PERIODIC, ComTxModeTimePeriod=0.1, ComTxModeTimeOffset=0
      P2P_oCAN02_Rx_fcef2243 (ComIPduGroup): ComIPduGroupHandleId=4
      APASts_sech2_SecCAN2_c6716992 (ComSignal):
        ComBitPosition = 54
        ComBitSize = 3
        ComSignalEndianness = BIG_ENDIAN
        ComSignalInitValue = 0
        ComSignalType = UINT8
        ComSignalAccess = ACCESS_UNCLEAR
        ComHandleId = 24
        ComSystemTemplateSystemSignalRef = APASts_sech2_SecCAN2
      P2P_SecCH_BCM_FrP03_oCAN02_3abd61be (ComIPdu):
        ComIPduDirection = SEND
        ComIPduType = NORMAL
        ComIPduHandleId = 14
        ComIPduSignalProcessing = DEFERRED
        ComIPduCancellationSupport = false
        ComIPduGroupRef = P2P_oCAN02_Tx_fcef2243
        ComIPduSignalRef = TrlrHitchSwA_SecCAN2_516d4ee4
        ComPduIdRef = PT_P2P_SecCH_BCM_FrP03_PP_P2P_SecCH_BCM_FrP03_Tx_427ad0d9_2e7839d1
        ComTxIPdu: ComTxIPduUnusedAreasDefault=0, ComMinimumDelayTime=0
          ComTxModeTrue
            ComTxMode: ComTxModeMode=PERIODIC, ComTxModeTimePeriod=0.2, ComTxModeTimeOffset=0
          ComTxModeFalse
            ComTxMode: ComTxModeMode=PERIODIC, ComTxModeTimePeriod=0.2, ComTxModeTimeOffset=0
      LNonDrvnWhlRotlDistV_SecCAN2_f62e8f7a (ComSignal):
        ComBitPosition = 2
        ComBitSize = 1
        ComSignalEndianness = BIG_ENDIAN
        ComSignalInitValue = 0
        ComSignalType = BOOLEAN
        ComTransferProperty = PENDING
        ComSignalAccess = ACCESS_UNCLEAR
        ComHandleId = 98
        ComSystemTemplateSystemSignalRef = LNonDrvnWhlRotlDistV_SecCAN2
      P2P_SecCH_GW_FrP08_oCAN02_3abd61be (ComIPdu):
        ComIPduDirection = SEND
        ComIPduType = NORMAL
        ComIPduHandleId = 26
        ComIPduSignalProcessing = DEFERRED
        ComIPduCancellationSupport = false
        ComIPduGroupRef = P2P_oCAN02_Tx_fcef2243
        ComIPduSignalRef = VehOdoV_h2_SecCAN2_5b704f9c
        ComIPduSignalRef = VehOdo_h2_SecCAN2_5b704f9c
        ComPduIdRef = PT_P2P_SecCH_GW_FrP08_PP_P2P_SecCH_GW_FrP08_Tx_427ad0d9_2e7839d1
        ComTxIPdu: ComTxIPduUnusedAreasDefault=0, ComMinimumDelayTime=0
          ComTxModeTrue
            ComTxMode: ComTxModeMode=PERIODIC, ComTxModeTimePeriod=1, ComTxModeTimeOffset=0
          ComTxModeFalse
            ComTxMode: ComTxModeMode=PERIODIC, ComTxModeTimePeriod=1, ComTxModeTimeOffset=0
      4 x ComSignal, all with ComSignalEndianness=BIG_ENDIAN, ComSignalInitValue=0, ComSignalAccess=ACCESS_UNCLEAR:
        FrtObsDist_sech2_SecCAN2_27d72756: ComBitPosition=55, ComBitSize=8, ComSignalType=UINT8, ComHandleId=123, ComSystemTemplateSystemSignalRef=FrtObsDist_sech2_SecCAN2
        RrMidRObsRng_sech2_SecCAN2_27d72756: ComBitPosition=11, ComBitSize=4, ComSignalType=UINT8, ComHandleId=202, ComSystemTemplateSystemSignalRef=RrMidRObsRng_sech2_SecCAN2
        EPTStCmdOn_h1_SecCAN2_7ebad171: ComBitPosition=17, ComBitSize=1, ComSignalType=BOOLEAN, ComTransferProperty=PENDING, ComHandleId=65, ComSystemTemplateSystemSignalRef=EPTStCmdOn_h1_SecCAN2
        RDrvnWhlRotlRstOcd_SecCAN2_3a848fe4: ComBitPosition=35, ComBitSize=1, ComSignalType=BOOLEAN, ComTransferProperty=PENDING, ComHandleId=123, ComSystemTemplateSystemSignalRef=RDrvnWhlRotlRstOcd_SecCAN2
      P2P_SecCH_SDM_FrP00_oCAN02_3abd61be (ComIPdu):
        ComIPduDirection = SEND
        ComIPduType = NORMAL
        ComIPduHandleId = 45
        ComIPduSignalProcessing = DEFERRED
        ComIPduCancellationSupport = false
        ComIPduGroupRef = P2P_oCAN02_Tx_fcef2243
        ComIPduSignalRef = DrvrSbltAtcV_SecCAN2_0cace912
        ComIPduSignalRef = DrvrSbltAtc_SecCAN2_0cace912
        ComPduIdRef = PT_P2P_SecCH_SDM_FrP00_PP_P2P_SecCH_SDM_FrP00_Tx_427ad0d9_2e7839d1
        ComTxIPdu: ComTxIPduUnusedAreasDefault=0, ComMinimumDelayTime=0
          ComTxModeTrue
            ComTxMode: ComTxModeMode=PERIODIC, ComTxModeTimePeriod=0.02, ComTxModeTimeOffset=0
          ComTxModeFalse
            ComTxMode: ComTxModeMode=PERIODIC, ComTxModeTimePeriod=0.02, ComTxModeTimeOffset=0
      5 x ComSignal, all with ComSignalEndianness=BIG_ENDIAN, ComTransferProperty=PENDING, ComSignalAccess=ACCESS_UNCLEAR:
        WhlGndVelRDrvnV_SecCAN2_e1559b39: ComBitPosition=22, ComBitSize=1, ComSignalInitValue=1, ComSignalType=BOOLEAN, ComHandleId=196, ComSystemTemplateSystemSignalRef=WhlGndVelRDrvnV_SecCAN2
        WhlGndVelRNonDrvnV_SecCAN2_6fda9cda: ComBitPosition=22, ComBitSize=1, ComSignalInitValue=1, ComSignalType=BOOLEAN, ComHandleId=198, ComSystemTemplateSystemSignalRef=WhlGndVelRNonDrvnV_SecCAN2
        OtsdAirTemCrValV_h2_SecCAN2_9fee406a: ComBitPosition=48, ComBitSize=1, ComSignalInitValue=0, ComSignalType=BOOLEAN, ComHandleId=108, ComSystemTemplateSystemSignalRef=OtsdAirTemCrValV_h2_SecCAN2
        CalendarDay_SecCAN2_ee8bd5bd: ComBitPosition=20, ComBitSize=5, ComSignalInitValue=0, ComSignalType=UINT8, ComHandleId=36, ComSystemTemplateSystemSignalRef=CalendarDay_SecCAN2
        StrgWhlAngV_SecCAN2_92023e75: ComBitPosition=7, ComBitSize=1, ComSignalInitValue=0, ComSignalType=BOOLEAN, ComHandleId=158, ComSystemTemplateSystemSignalRef=StrgWhlAngV_SecCAN2
      APA_SecCH_FrP03_oCAN02_3abd61be (ComIPdu):
        ComIPduDirection = RECEIVE
        ComIPduType = NORMAL
        ComIPduHandleId = 3
        ComIPduSignalProcessing = DEFERRED
        ComIPduCancellationSupport = false
        ComIPduGroupRef = P2P_oCAN02_Rx_fcef2243
        ComIPduSignalRef = FLObsDist_sech2_SecCAN2_84546eef
        ComIPduSignalRef = FRObsDist_sech2_SecCAN2_84546eef
        ComIPduSignalRef = RLObsDist_sech2_SecCAN2_84546eef
        ComIPduSignalRef = RRObsDist_sech2_SecCAN2_84546eef
        ComPduIdRef = PT_APA_SecCH_FrP03_PP_APA_SecCH_FrP03_Rx_427ad0d9_2e7839d1
      RNonDrvnWhlRotlDistT_SecCAN2_f62e8f7a (ComSignal):
        ComBitPosition = 55
        ComBitSize = 16
        ComSignalEndianness = BIG_ENDIAN
        ComSignalInitValue = 0
        ComSignalType = UINT16
        ComTransferProperty = PENDING
        ComSignalAccess = ACCESS_UNCLEAR
        ComHandleId = 131
        ComSystemTemplateSystemSignalRef = RNonDrvnWhlRotlDistT_SecCAN2
      PDC_SecCH_FrP00_oCAN02_3abd61be (ComIPdu):
        ComIPduDirection = RECEIVE
        ComIPduType = NORMAL
        ComIPduHandleId = 51
        ComIPduSignalProcessing = DEFERRED
        ComIPduCancellationSupport = false
        ComIPduGroupRef = P2P_oCAN02_Rx_fcef2243
        ComIPduSignalRef = FLObsRng_sech2_SecCAN2_27d72756
        ComIPduSignalRef = FRObsRng_sech2_SecCAN2_27d72756
        ComIPduSignalRef = FrtMidLObsRng_sech2_SecCAN2_27d72756
        ComIPduSignalRef = FrtMidRObsRng_sech2_SecCAN2_27d72756
        ComIPduSignalRef = FrtObsDist_sech2_SecCAN2_27d72756
        ComIPduSignalRef = FrtPDCAudWrnng_sech2_SecCAN2_27d72756
        ComIPduSignalRef = PDCCofignSts_sech2_SecCAN2_27d72756
        ComIPduSignalRef = PDCSysSts_sech2_SecCAN2_27d72756
        ComIPduSignalRef = RLObsRng_sech2_SecCAN2_27d72756
        ComIPduSignalRef = RRObsRng_sech2_SecCAN2_27d72756
        ComIPduSignalRef = RrMidLObsRng_sech2_SecCAN2_27d72756
        ComIPduSignalRef = RrMidRObsRng_sech2_SecCAN2_27d72756
        ComIPduSignalRef = RrObsDist_sech2_SecCAN2_27d72756
        ComIPduSignalRef = RrPDCAudWrnng_sech2_SecCAN2_27d72756
        ComPduIdRef = PT_PDC_SecCH_FrP00_PP_PDC_SecCH_FrP00_Rx_427ad0d9_2e7839d1
      3 x ComSignal, all with ComSignalEndianness=BIG_ENDIAN, ComSignalInitValue=0, ComSignalAccess=ACCESS_UNCLEAR:
        FRObsRng_sech2_SecCAN2_27d72756: ComBitPosition=35, ComBitSize=4, ComSignalType=UINT8, ComHandleId=114, ComSystemTemplateSystemSignalRef=FRObsRng_sech2_SecCAN2
        EPBSwStsV_SecCAN2_2190f0b2: ComBitPosition=5, ComBitSize=1, ComSignalType=BOOLEAN, ComTransferProperty=PENDING, ComHandleId=54, ComSystemTemplateSystemSignalRef=EPBSwStsV_SecCAN2
        APAF_sech2_SecCAN2_0adb690c: ComBitPosition=5, ComBitSize=1, ComSignalType=BOOLEAN, ComHandleId=10, ComSystemTemplateSystemSignalRef=APAF_sech2_SecCAN2
      APA_SecCH_FrP00_oCAN02_3abd61be (ComIPdu):
        ComIPduDirection = RECEIVE
        ComIPduType = NORMAL
        ComIPduHandleId = 0
        ComIPduSignalProcessing = DEFERRED
        ComIPduCancellationSupport = false
        ComIPduGroupRef = P2P_oCAN02_Rx_fcef2243
        ComIPduSignalRef = APAAlvRC_sech2_SecCAN2_0adb690c
        ComIPduSignalRef = APAChksm_sech2_SecCAN2_0adb690c
        ComIPduSignalRef = APACmdEPSSts_sech2_SecCAN2_0adb690c
        ComIPduSignalRef = APAF_sech2_SecCAN2_0adb690c
        ComIPduSignalRef = APAToqReqSts_sech2_SecCAN2_0adb690c
        ComIPduSignalRef = APAToqReqVal_sech2_SecCAN2_0adb690c
        ComIPduSignalRef = APATrgtEPSStrgWhlAng_sech2_SecCAN2_0adb690c
        ComPduIdRef = PT_APA_SecCH_FrP00_PP_APA_SecCH_FrP00_Rx_427ad0d9_2e7839d1
      PwrMdMstrAccryA_h2_SecCAN2_443f54b7 (ComSignal):
        ComBitPosition = 2
        ComBitSize = 1
        ComSignalEndianness = BIG_ENDIAN
        ComSignalInitValue = 0
        ComSignalType = BOOLEAN
        ComTransferProperty = PENDING
        ComSignalAccess = ACCESS_UNCLEAR
        ComHandleId = 116
        ComSystemTemplateSystemSignalRef = PwrMdMstrAccryA_h2_SecCAN2
      P2P_oCAN02_Tx_fcef2243 (ComIPduGroup): ComIPduGroupHandleId=5
      VehOdo_h2_SecCAN2_5b704f9c (ComSignal):
        ComBitPosition = 7
        ComBitSize = 24
        ComSignalEndianness = BIG_ENDIAN
        ComSignalInitValue = 0
        ComSignalType = UINT32
        ComTransferProperty = PENDING
        ComSignalAccess = ACCESS_UNCLEAR
        ComHandleId = 187
        ComSystemTemplateSystemSignalRef = VehOdo_h2_SecCAN2
      P2P_SecCH_Tester_GW_FrP14_oCAN02_3abd61be (ComIPdu):
        ComIPduDirection = SEND
        ComIPduType = NORMAL
        ComIPduHandleId = 47
        ComIPduSignalProcessing = DEFERRED
        ComIPduCancellationSupport = false
        ComIPduGroupRef = P2P_oCAN02_Tx_fcef2243
        ComIPduSignalRef = NRCDAlvRC_SecCAN2_d64f184b
        ComIPduSignalRef = NRCDF_SecCAN2_d64f184b
        ComPduIdRef = PT_P2P_SecCH_Tester_GW_FrP14_PP_P2P_SecCH_Tester_GW_FrP14_Tx_427ad0d9_2e7839d1
        ComTxIPdu: ComTxIPduUnusedAreasDefault=0, ComMinimumDelayTime=0
          ComTxModeTrue
            ComTxMode: ComTxModeMode=PERIODIC, ComTxModeTimePeriod=0.02, ComTxModeTimeOffset=0
          ComTxModeFalse
            ComTxMode: ComTxModeMode=PERIODIC, ComTxModeTimePeriod=0.02, ComTxModeTimeOffset=0
      21 x ComSignal, all with ComSignalEndianness=BIG_ENDIAN, ComSignalAccess=ACCESS_UNCLEAR:
        APACrpSpdReqSts_sech2_SecCAN2_c6716992: ComBitPosition=39, ComBitSize=1, ComSignalInitValue=0, ComSignalType=BOOLEAN, ComHandleId=4, ComSystemTemplateSystemSignalRef=APACrpSpdReqSts_sech2_SecCAN2
        SDMAvlbly_h2_SecCAN2_88955429: ComBitPosition=5, ComBitSize=1, ComSignalInitValue=0, ComSignalType=BOOLEAN, ComTransferProperty=PENDING, ComHandleId=154, ComSystemTemplateSystemSignalRef=SDMAvlbly_h2_SecCAN2
        APAReq_sech2_SecCAN2_c6716992: ComBitPosition=7, ComBitSize=3, ComSignalInitValue=0, ComSignalType=UINT8, ComHandleId=16, ComSystemTemplateSystemSignalRef=APAReq_sech2_SecCAN2
        RRObsRng_sech2_SecCAN2_27d72756: ComBitPosition=27, ComBitSize=4, ComSignalInitValue=0, ComSignalType=UINT8, ComHandleId=194, ComSystemTemplateSystemSignalRef=RRObsRng_sech2_SecCAN2
        FrtMidLObsRng_sech2_SecCAN2_27d72756: ComBitPosition=31, ComBitSize=4, ComSignalInitValue=0, ComSignalType=UINT8, ComHandleId=120, ComSystemTemplateSystemSignalRef=FrtMidLObsRng_sech2_SecCAN2
        APAParkngSched_sech2_SecCAN2_48fe6e71: ComBitPosition=22, ComBitSize=7, ComSignalInitValue=0, ComSignalType=UINT8, ComHandleId=15, ComSystemTemplateSystemSignalRef=APAParkngSched_sech2_SecCAN2
        VehDynYawRateV_SecCAN2_72648180: ComBitPosition=36, ComBitSize=1, ComSignalInitValue=0, ComSignalType=BOOLEAN, ComTransferProperty=PENDING, ComHandleId=184, ComSystemTemplateSystemSignalRef=VehDynYawRateV_SecCAN2
        EPBAppcnSts_SecCAN2_ed3af02c: ComBitPosition=15, ComBitSize=2, ComSignalInitValue=0, ComSignalType=UINT8, ComTransferProperty=PENDING, ComHandleId=51, ComSystemTemplateSystemSignalRef=EPBAppcnSts_SecCAN2
        OtsdAirTemCrValMsk_h2_SecCAN2_9fee406a: ComBitPosition=51, ComBitSize=1, ComSignalInitValue=0, ComSignalType=BOOLEAN, ComTransferProperty=PENDING, ComHandleId=107, ComSystemTemplateSystemSignalRef=OtsdAirTemCrValMsk_h2_SecCAN2
        VSELatAccV_SecCAN2_78a18899: ComBitPosition=3, ComBitSize=1, ComSignalInitValue=0, ComSignalType=BOOLEAN, ComTransferProperty=PENDING, ComHandleId=179, ComSystemTemplateSystemSignalRef=VSELatAccV_SecCAN2
        APASCSAcclReqValPV_sech2_SecCAN2_c6716992: ComBitPosition=1, ComBitSize=10, ComSignalInitValue=0, ComSignalType=UINT16, ComHandleId=18, ComSystemTemplateSystemSignalRef=APASCSAcclReqValPV_sech2_SecCAN2
        SCSAPAAvlbl_SecCAN2_b40b8807: ComBitPosition=47, ComBitSize=1, ComSignalInitValue=0, ComSignalType=BOOLEAN, ComTransferProperty=PENDING, ComHandleId=149, ComSystemTemplateSystemSignalRef=SCSAPAAvlbl_SecCAN2
        RNonDrvnWhlRotlDistTRC_SecCAN2_f62e8f7a: ComBitPosition=39, ComBitSize=2, ComSignalInitValue=0, ComSignalType=UINT8, ComTransferProperty=PENDING, ComHandleId=130, ComSystemTemplateSystemSignalRef=RNonDrvnWhlRotlDistTRC_SecCAN2
        APAToqReqVal_sech2_SecCAN2_0adb690c: ComBitPosition=3, ComBitSize=12, ComSignalInitValue=0, ComSignalType=UINT16, ComHandleId=28, ComSystemTemplateSystemSignalRef=APAToqReqVal_sech2_SecCAN2
        APATrgtEPSStrgWhlAng_sech2_SecCAN2_0adb690c: ComBitPosition=23, ComBitSize=16, ComSignalInitValue=0, ComSignalType=UINT16, ComHandleId=29, ComSystemTemplateSystemSignalRef=APATrgtEPSStrgWhlAng_sech2_SecCAN2
        TMSpd_h1_SecCAN2_a8511b71: ComBitPosition=7, ComBitSize=16, ComSignalInitValue=32768, ComSignalType=UINT16, ComTransferProperty=PENDING, ComHandleId=171, ComSystemTemplateSystemSignalRef=TMSpd_h1_SecCAN2
        LdspcOpenSts_SecCAN2_5ba847fd: ComBitPosition=48, ComBitSize=2, ComSignalInitValue=0, ComSignalType=UINT8, ComTransferProperty=PENDING, ComHandleId=101, ComSystemTemplateSystemSignalRef=LdspcOpenSts_SecCAN2
        RDrvnWhlRotlDistPlsCtr_SecCAN2_3a848fe4: ComBitPosition=33, ComBitSize=10, ComSignalInitValue=0, ComSignalType=UINT16, ComTransferProperty=PENDING, ComHandleId=119, ComSystemTemplateSystemSignalRef=RDrvnWhlRotlDistPlsCtr_SecCAN2
        EPSAPAAlvRC_SecCAN2_98082ad5: ComBitPosition=23, ComBitSize=8, ComSignalInitValue=0, ComSignalType=UINT8, ComTransferProperty=PENDING, ComHandleId=56, ComSystemTemplateSystemSignalRef=EPSAPAAlvRC_SecCAN2
        DrvrDoorOpenSts_SecCAN2_5ba847fd: ComBitPosition=47, ComBitSize=2, ComSignalInitValue=0, ComSignalType=UINT8, ComTransferProperty=PENDING, ComHandleId=45, ComSystemTemplateSystemSignalRef=DrvrDoorOpenSts_SecCAN2
        RrMidRObsDist_sech2_SecCAN2_8e9167f6: ComBitPosition=7, ComBitSize=9, ComSignalInitValue=0, ComSignalType=UINT16, ComHandleId=201, ComSystemTemplateSystemSignalRef=RrMidRObsDist_sech2_SecCAN2
      P2P_SecCH_GW_FrP01_oCAN02_3abd61be (ComIPdu):
        ComIPduDirection = SEND
        ComIPduType = NORMAL
        ComIPduHandleId = 25
        ComIPduSignalProcessing = DEFERRED
        ComIPduCancellationSupport = false
        ComIPduGroupRef = P2P_oCAN02_Tx_fcef2243
        ComIPduSignalRef = BPMMstrAvlbly_h2_SecCAN2_443f54b7
        ComIPduSignalRef = PwrMdMstrAccryA_h2_SecCAN2_443f54b7
        ComIPduSignalRef = PwrMdMstrRunCrkA_h2_SecCAN2_443f54b7
        ComIPduSignalRef = SysOpnlMd_h2_SecCAN2_443f54b7
        ComIPduSignalRef = SysPwrMd_h2_SecCAN2_443f54b7
        ComIPduSignalRef = SysVolMdV_h2_SecCAN2_443f54b7
        ComIPduSignalRef = SysVolMd_h2_SecCAN2_443f54b7
        ComIPduSignalRef = SysVolV_h2_SecCAN2_443f54b7
        ComIPduSignalRef = SysVol_h2_SecCAN2_443f54b7
        ComPduIdRef = PT_P2P_SecCH_GW_FrP01_PP_P2P_SecCH_GW_FrP01_Tx_427ad0d9_2e7839d1
        ComTxIPdu: ComTxIPduUnusedAreasDefault=0, ComMinimumDelayTime=0
          ComTxModeTrue
            ComTxMode: ComTxModeMode=PERIODIC, ComTxModeTimePeriod=0.02, ComTxModeTimeOffset=0
          ComTxModeFalse
            ComTxMode: ComTxModeMode=PERIODIC, ComTxModeTimePeriod=0.02, ComTxModeTimeOffset=0
      3 x ComSignal, all with ComSignalEndianness=BIG_ENDIAN, ComSignalInitValue=0, ComSignalAccess=ACCESS_UNCLEAR:
        LNonDrvnWhlRotlRstOcd_SecCAN2_f62e8f7a: ComBitPosition=3, ComBitSize=1, ComSignalType=BOOLEAN, ComTransferProperty=PENDING, ComHandleId=99, ComSystemTemplateSystemSignalRef=LNonDrvnWhlRotlRstOcd_SecCAN2
        SCUAvlbly_h2_SecCAN2_88955429: ComBitPosition=3, ComBitSize=1, ComSignalType=BOOLEAN, ComTransferProperty=PENDING, ComHandleId=151, ComSystemTemplateSystemSignalRef=SCUAvlbly_h2_SecCAN2
        APASlotLngth_sech2_SecCAN2_48fe6e71: ComBitPosition=2, ComBitSize=11, ComSignalType=UINT16, ComHandleId=23, ComSystemTemplateSystemSignalRef=APASlotLngth_sech2_SecCAN2
      P2P_SecCH_TC_FrP07_oCAN02_3abd61be (ComIPdu):
        ComIPduDirection = SEND
        ComIPduType = NORMAL
        ComIPduHandleId = 46
        ComIPduSignalProcessing = DEFERRED
        ComIPduCancellationSupport = false
        ComIPduGroupRef = P2P_oCAN02_Tx_fcef2243
        ComIPduSignalRef = TMSpdV_h1_SecCAN2_a8511b71
        ComIPduSignalRef = TMSpd_h1_SecCAN2_a8511b71
        ComPduIdRef = PT_P2P_SecCH_TC_FrP07_PP_P2P_SecCH_TC_FrP07_Tx_427ad0d9_2e7839d1
        ComTxIPdu: ComTxIPduUnusedAreasDefault=0, ComMinimumDelayTime=0
          ComTxModeTrue
            ComTxMode: ComTxModeMode=PERIODIC, ComTxModeTimePeriod=0.01, ComTxModeTimeOffset=0
          ComTxModeFalse
            ComTxMode: ComTxModeMode=PERIODIC, ComTxModeTimePeriod=0.01, ComTxModeTimeOffset=0
      19 x ComSignal, all with ComSignalAccess=ACCESS_UNCLEAR:
        DrvrSelAPASlotBearng_SecCAN2_19729e8f: ComBitPosition=6, ComBitSize=2, ComSignalEndianness=BIG_ENDIAN, ComSignalInitValue=0, ComSignalType=UINT8, ComTransferProperty=PENDING, ComHandleId=49, ComSystemTemplateSystemSignalRef=DrvrSelAPASlotBearng_SecCAN2
        RLDoorOpenSts_SecCAN2_5ba847fd: ComBitPosition=50, ComBitSize=2, ComSignalEndianness=BIG_ENDIAN, ComSignalInitValue=0, ComSignalType=UINT8, ComTransferProperty=PENDING, ComHandleId=125, ComSystemTemplateSystemSignalRef=RLDoorOpenSts_SecCAN2
        FrtMidRObsRng_sech2_SecCAN2_27d72756: ComBitPosition=19, ComBitSize=4, ComSignalEndianness=BIG_ENDIAN, ComSignalInitValue=0, ComSignalType=UINT8, ComHandleId=122, ComSystemTemplateSystemSignalRef=FrtMidRObsRng_sech2_SecCAN2
        WhlGndVelRDrvn_SecCAN2_e1559b39: ComBitPosition=21, ComBitSize=14, ComSignalEndianness=BIG_ENDIAN, ComSignalInitValue=0, ComSignalType=UINT16, ComTransferProperty=PENDING, ComHandleId=197, ComSystemTemplateSystemSignalRef=WhlGndVelRDrvn_SecCAN2
        WhlGndVelLDrvn_SecCAN2_e1559b39: ComBitPosition=5, ComBitSize=14, ComSignalEndianness=BIG_ENDIAN, ComSignalInitValue=0, ComSignalType=UINT16, ComTransferProperty=PENDING, ComHandleId=193, ComSystemTemplateSystemSignalRef=WhlGndVelLDrvn_SecCAN2
        DTCInfomationAPA_SecCAN2_3e47bb85: ComBitPosition=0, ComSignalEndianness=opaque, ComSignalInitValue=0 0 0 0 0 0 0, ComSignalLength=7, ComSignalType=UINT8_N, ComHandleId=62, ComSystemTemplateSystemSignalRef=DTCInfomationAPA_SecCAN2
        EPSAPAInh_SecCAN2_98082ad5: ComBitPosition=15, ComBitSize=8, ComSignalEndianness=BIG_ENDIAN, ComSignalInitValue=0, ComSignalType=UINT8, ComTransferProperty=PENDING, ComHandleId=58, ComSystemTemplateSystemSignalRef=EPSAPAInh_SecCAN2
        SCSAPAAcclA_SecCAN2_b40b8807: ComBitPosition=46, ComBitSize=1, ComSignalEndianness=BIG_ENDIAN, ComSignalInitValue=0, ComSignalType=BOOLEAN, ComTransferProperty=PENDING, ComHandleId=147, ComSystemTemplateSystemSignalRef=SCSAPAAcclA_SecCAN2
        APAVehCrdnatAzmth_sech2_SecCAN2_48fe6e71: ComBitPosition=24, ComBitSize=9, ComSignalEndianness=BIG_ENDIAN, ComSignalInitValue=0, ComSignalType=UINT16, ComHandleId=30, ComSystemTemplateSystemSignalRef=APAVehCrdnatAzmth_sech2_SecCAN2
        SysVol_h2_SecCAN2_443f54b7: ComBitPosition=47, ComBitSize=8, ComSignalEndianness=BIG_ENDIAN, ComSignalInitValue=0, ComSignalType=UINT8, ComTransferProperty=PENDING, ComHandleId=167, ComSystemTemplateSystemSignalRef=SysVol_h2_SecCAN2
        SecsOfMinute_SecCAN2_ee8bd5bd: ComBitPosition=45, ComBitSize=6, ComSignalEndianness=BIG_ENDIAN, ComSignalInitValue=0, ComSignalType=UINT8, ComTransferProperty=PENDING, ComHandleId=155, ComSystemTemplateSystemSignalRef=SecsOfMinute_SecCAN2
        EPBAvlblySts_SecCAN2_ed3af02c: ComBitPosition=5, ComBitSize=3, ComSignalEndianness=BIG_ENDIAN, ComSignalInitValue=0, ComSignalType=UINT8, ComTransferProperty=PENDING, ComHandleId=53, ComSystemTemplateSystemSignalRef=EPBAvlblySts_SecCAN2
        SCSNRCDAvlbl_SecCAN2_b40b8807: ComBitPosition=45, ComBitSize=1, ComSignalEndianness=BIG_ENDIAN, ComSignalInitValue=0, ComSignalType=BOOLEAN, ComTransferProperty=PENDING, ComHandleId=150, ComSystemTemplateSystemSignalRef=SCSNRCDAvlbl_SecCAN2
        RDrvnWhlRotlDistTmsp_SecCAN2_3a848fe4: ComBitPosition=55, ComBitSize=16, ComSignalEndianness=BIG_ENDIAN, ComSignalInitValue=0, ComSignalType=UINT16, ComTransferProperty=PENDING, ComHandleId=121, ComSystemTemplateSystemSignalRef=RDrvnWhlRotlDistTmsp_SecCAN2
        LDircnIO_SecCAN2_5ba847fd: ComBitPosition=37, ComBitSize=1, ComSignalEndianness=BIG_ENDIAN, ComSignalInitValue=0, ComSignalType=BOOLEAN, ComTransferProperty=PENDING, ComHandleId=87, ComSystemTemplateSystemSignalRef=LDircnIO_SecCAN2
        APAEPBOpReqValPV_sech2_SecCAN2_c6716992: ComBitPosition=63, ComBitSize=8, ComSignalEndianness=BIG_ENDIAN, ComSignalInitValue=0, ComSignalType=UINT8, ComHandleId=8, ComSystemTemplateSystemSignalRef=APAEPBOpReqValPV_sech2_SecCAN2
        VCUNRCDAvlbl_SecCAN2_e74ec2d1: ComBitPosition=52, ComBitSize=1, ComSignalEndianness=BIG_ENDIAN, ComSignalInitValue=0, ComSignalType=BOOLEAN, ComTransferProperty=PENDING, ComHandleId=178, ComSystemTemplateSystemSignalRef=VCUNRCDAvlbl_SecCAN2
        APAShifterPosReqd_sech2_SecCAN2_c6716992: ComBitPosition=43, ComBitSize=4, ComSignalEndianness=BIG_ENDIAN, ComSignalInitValue=0, ComSignalType=UINT8, ComHandleId=21, ComSystemTemplateSystemSignalRef=APAShifterPosReqd_sech2_SecCAN2
        SysVolMd_h2_SecCAN2_443f54b7: ComBitPosition=58, ComBitSize=2, ComSignalEndianness=BIG_ENDIAN, ComSignalInitValue=0, ComSignalType=UINT8, ComTransferProperty=PENDING, ComHandleId=165, ComSystemTemplateSystemSignalRef=SysVolMd_h2_SecCAN2
      APA_SecCH_FrP01_oCAN02_3abd61be (ComIPdu):
        ComIPduDirection = RECEIVE
        ComIPduType = NORMAL
        ComIPduHandleId = 1
        ComIPduSignalProcessing = DEFERRED
        ComIPduCancellationSupport = false
        ComIPduGroupRef = P2P_oCAN02_Rx_fcef2243
        ComIPduSignalRef = APACrpSpdReqSts_sech2_SecCAN2_c6716992
        ComIPduSignalRef = APACrpSpdReqVal_sech2_SecCAN2_c6716992
        ComIPduSignalRef = APAEPBOPReq_sech2_SecCAN2_c6716992
        ComIPduSignalRef = APAEPBOpReqValPV_sech2_SecCAN2_c6716992
        ComIPduSignalRef = APAEPBReqAlvRC_sech2_SecCAN2_c6716992
        ComIPduSignalRef = APAInfoDispReq_sech2_SecCAN2_c6716992
        ComIPduSignalRef = APAMd_sech2_SecCAN2_c6716992
        ComIPduSignalRef = APANRCDAvlbl_sech2_SecCAN2_c6716992
        ComIPduSignalRef = APAReq_sech2_SecCAN2_c6716992
        ComIPduSignalRef = APASCSAcclReqSts_sech2_SecCAN2_c6716992
        ComIPduSignalRef = APASCSAcclReqValPV_sech2_SecCAN2_c6716992
        ComIPduSignalRef = APASCSAcclReqVal_sech2_SecCAN2_c6716992
        ComIPduSignalRef = APASCSAlvRC_sech2_SecCAN2_c6716992
        ComIPduSignalRef = APAShifterPosReqd_sech2_SecCAN2_c6716992
        ComIPduSignalRef = APASts_sech2_SecCAN2_c6716992
        ComPduIdRef = PT_APA_SecCH_FrP01_PP_APA_SecCH_FrP01_Rx_427ad0d9_2e7839d1
      3 x ComSignal, all with ComSignalEndianness=BIG_ENDIAN, ComSignalInitValue=0, ComSignalAccess=ACCESS_UNCLEAR:
        FLSideObsDist_sech2_SecCAN2_eb7d27c8: ComBitPosition=48, ComBitSize=9, ComSignalType=UINT16, ComHandleId=109, ComSystemTemplateSystemSignalRef=FLSideObsDist_sech2_SecCAN2
        RRDoorOpenSts_SecCAN2_5ba847fd: ComBitPosition=41, ComBitSize=2, ComSignalType=UINT8, ComTransferProperty=PENDING, ComHandleId=135, ComSystemTemplateSystemSignalRef=RRDoorOpenSts_SecCAN2
        RNonDrvnWhlRotlDistV_SecCAN2_f62e8f7a: ComBitPosition=34, ComBitSize=1, ComSignalType=BOOLEAN, ComTransferProperty=PENDING, ComHandleId=132, ComSystemTemplateSystemSignalRef=RNonDrvnWhlRotlDistV_SecCAN2
      P2P_SecCH_GW_FrP10_oCAN02_3abd61be (ComIPdu):
        ComIPduDirection = SEND
        ComIPduType = NORMAL
        ComIPduHandleId = 27
        ComIPduSignalProcessing = DEFERRED
        ComIPduCancellationSupport = false
        ComIPduGroupRef = P2P_oCAN02_Tx_fcef2243
        ComIPduSignalRef = OtsdAirTemCrValMsk_h2_SecCAN2_9fee406a
        ComIPduSignalRef = OtsdAirTemCrValV_h2_SecCAN2_9fee406a
        ComIPduSignalRef = OtsdAirTemCrVal_h2_SecCAN2_9fee406a
        ComPduIdRef = PT_P2P_SecCH_GW_FrP10_PP_P2P_SecCH_GW_FrP10_Tx_427ad0d9_2e7839d1
        ComTxIPdu: ComTxIPduUnusedAreasDefault=0, ComMinimumDelayTime=0
          ComTxModeTrue
            ComTxMode: ComTxModeMode=PERIODIC, ComTxModeTimePeriod=0.25, ComTxModeTimeOffset=0
          ComTxModeFalse
            ComTxMode: ComTxModeMode=PERIODIC, ComTxModeTimePeriod=0.25, ComTxModeTimeOffset=0
      P2P_SecCH_GW_FrP13_oCAN02_3abd61be (ComIPdu):
        ComIPduDirection = SEND
        ComIPduType = NORMAL
        ComIPduHandleId = 28
        ComIPduSignalProcessing = DEFERRED
        ComIPduCancellationSupport = false
        ComIPduGroupRef = P2P_oCAN02_Tx_fcef2243
        ComIPduSignalRef = APACtrlAbotdRsn_SecCAN2_11614789
        ComIPduSignalRef = NRCDSts_h2_SecCAN2_11614789
        ComPduIdRef = PT_P2P_SecCH_GW_FrP13_PP_P2P_SecCH_GW_FrP13_Tx_427ad0d9_2e7839d1
        ComTxIPdu: ComTxIPduUnusedAreasDefault=0, ComMinimumDelayTime=0
          ComTxModeTrue
            ComTxMode: ComTxModeMode=PERIODIC, ComTxModeTimePeriod=0.05, ComTxModeTimeOffset=0
          ComTxModeFalse
            ComTxMode: ComTxModeMode=PERIODIC, ComTxModeTimePeriod=0.05, ComTxModeTimeOffset=0
      11 x ComSignal, all with ComSignalAccess=ACCESS_UNCLEAR:
        APAMd_sech2_SecCAN2_c6716992: ComBitPosition=4, ComBitSize=3, ComSignalEndianness=BIG_ENDIAN, ComSignalInitValue=0, ComSignalType=UINT8, ComHandleId=12, ComSystemTemplateSystemSignalRef=APAMd_sech2_SecCAN2
        LNonDrvnWhlRotlDistT_SecCAN2_f62e8f7a: ComBitPosition=23, ComBitSize=16, ComSignalEndianness=BIG_ENDIAN, ComSignalInitValue=0, ComSignalType=UINT16, ComTransferProperty=PENDING, ComHandleId=97, ComSystemTemplateSystemSignalRef=LNonDrvnWhlRotlDistT_SecCAN2
        BCMAvlbly_h2_SecCAN2_88955429: ComBitPosition=31, ComBitSize=1, ComSignalEndianness=BIG_ENDIAN, ComSignalInitValue=0, ComSignalType=BOOLEAN, ComTransferProperty=PENDING, ComHandleId=33, ComSystemTemplateSystemSignalRef=BCMAvlbly_h2_SecCAN2
        TrShftLvrPosV_h1_SecCAN2_f7a3932f: ComBitPosition=28, ComBitSize=1, ComSignalEndianness=BIG_ENDIAN, ComSignalInitValue=0, ComSignalType=BOOLEAN, ComTransferProperty=PENDING, ComHandleId=173, ComSystemTemplateSystemSignalRef=TrShftLvrPosV_h1_SecCAN2
        SysVolV_h2_SecCAN2_443f54b7: ComBitPosition=32, ComBitSize=1, ComSignalEndianness=BIG_ENDIAN, ComSignalInitValue=0, ComSignalType=BOOLEAN, ComTransferProperty=PENDING, ComHandleId=166, ComSystemTemplateSystemSignalRef=SysVolV_h2_SecCAN2
        APAEPBReqAlvRC_sech2_SecCAN2_c6716992: ComBitPosition=51, ComBitSize=4, ComSignalEndianness=BIG_ENDIAN, ComSignalInitValue=0, ComSignalType=UINT8, ComHandleId=9, ComSystemTemplateSystemSignalRef=APAEPBReqAlvRC_sech2_SecCAN2
        VehDynYawRate_SecCAN2_72648180: ComBitPosition=35, ComBitSize=12, ComSignalEndianness=BIG_ENDIAN, ComSignalInitValue=0, ComSignalType=SINT16, ComTransferProperty=PENDING, ComHandleId=185, ComSystemTemplateSystemSignalRef=VehDynYawRate_SecCAN2
        NRCDMstrChlg_h2_SecCAN2_63a2ef2a: ComBitPosition=0, ComSignalEndianness=opaque, ComSignalInitValue=0 0 0 0 0 0 0 0, ComSignalLength=8, ComSignalType=UINT8_N, ComTransferProperty=PENDING, ComHandleId=105, ComSystemTemplateSystemSignalRef=NRCDMstrChlg_h2_SecCAN2
        CalendarYear_SecCAN2_ee8bd5bd: ComBitPosition=7, ComBitSize=8, ComSignalEndianness=BIG_ENDIAN, ComSignalInitValue=0, ComSignalType=UINT8, ComTransferProperty=PENDING, ComHandleId=38, ComSystemTemplateSystemSignalRef=CalendarYear_SecCAN2
        NRCDAlvRC_SecCAN2_d64f184b: ComBitPosition=55, ComBitSize=8, ComSignalEndianness=BIG_ENDIAN, ComSignalInitValue=0, ComSignalType=UINT8, ComTransferProperty=PENDING, ComHandleId=103, ComSystemTemplateSystemSignalRef=NRCDAlvRC_SecCAN2
        WhlGndVelLNonDrvn_SecCAN2_6fda9cda: ComBitPosition=5, ComBitSize=14, ComSignalEndianness=BIG_ENDIAN, ComSignalInitValue=0, ComSignalType=UINT16, ComTransferProperty=PENDING, ComHandleId=195, ComSystemTemplateSystemSignalRef=WhlGndVelLNonDrvn_SecCAN2
      APA_SecCH_FrP04_oCAN02_3abd61be (ComIPdu):
        ComIPduDirection = RECEIVE
        ComIPduType = NORMAL
        ComIPduHandleId = 4
        ComIPduSignalProcessing = DEFERRED
        ComIPduCancellationSupport = false
        ComIPduGroupRef = P2P_oCAN02_Rx_fcef2243
        ComIPduSignalRef = FrtMidLObsDist_sech2_SecCAN2_8e9167f6
        ComIPduSignalRef = FrtMidRObsDist_sech2_SecCAN2_8e9167f6
        ComIPduSignalRef = RrMidLObsDist_sech2_SecCAN2_8e9167f6
        ComIPduSignalRef = RrMidRObsDist_sech2_SecCAN2_8e9167f6
        ComPduIdRef = PT_APA_SecCH_FrP04_PP_APA_SecCH_FrP04_Rx_427ad0d9_2e7839d1
      5 x ComSignal, all with ComSignalEndianness=BIG_ENDIAN, ComSignalInitValue=0, ComSignalAccess=ACCESS_UNCLEAR:
        RNonDrvnWhlRotlRstOcd_SecCAN2_f62e8f7a: ComBitPosition=35, ComBitSize=1, ComSignalType=BOOLEAN, ComTransferProperty=PENDING, ComHandleId=133, ComSystemTemplateSystemSignalRef=RNonDrvnWhlRotlRstOcd_SecCAN2
        DrvrSbltAtcV_SecCAN2_0cace912: ComBitPosition=13, ComBitSize=1, ComSignalType=BOOLEAN, ComTransferProperty=PENDING, ComHandleId=46, ComSystemTemplateSystemSignalRef=DrvrSbltAtcV_SecCAN2
        TrlrHitchSwA_SecCAN2_516d4ee4: ComBitPosition=15, ComBitSize=1, ComSignalType=BOOLEAN, ComTransferProperty=PENDING, ComHandleId=175, ComSystemTemplateSystemSignalRef=TrlrHitchSwA_SecCAN2
        BntOpenSts_SecCAN2_5ba847fd: ComBitPosition=45, ComBitSize=2, ComSignalType=UINT8, ComTransferProperty=PENDING, ComHandleId=35, ComSystemTemplateSystemSignalRef=BntOpenSts_SecCAN2
        APAToqReqSts_sech2_SecCAN2_0adb690c: ComBitPosition=4, ComBitSize=1, ComSignalType=BOOLEAN, ComHandleId=27, ComSystemTemplateSystemSignalRef=APAToqReqSts_sech2_SecCAN2
      P2P_SecCH_FICM_FrP18_oCAN02_3abd61be (ComIPdu):
        ComIPduDirection = SEND
        ComIPduType = NORMAL
        ComIPduHandleId = 23
        ComIPduSignalProcessing = DEFERRED
        ComIPduCancellationSupport = false
        ComIPduGroupRef = P2P_oCAN02_Tx_fcef2243
        ComIPduSignalRef = DrvrSelAPAParkngMd_SecCAN2_19729e8f
        ComIPduSignalRef = DrvrSelAPASlotBearng_SecCAN2_19729e8f
        ComPduIdRef = PT_P2P_SecCH_FICM_FrP18_PP_P2P_SecCH_FICM_FrP18_Tx_427ad0d9_2e7839d1
        ComTxIPdu: ComTxIPduUnusedAreasDefault=0, ComMinimumDelayTime=0
          ComTxModeTrue
            ComTxMode: ComTxModeMode=PERIODIC, ComTxModeTimePeriod=0.1, ComTxModeTimeOffset=0
          ComTxModeFalse
            ComTxMode: ComTxModeMode=PERIODIC, ComTxModeTimePeriod=0.1, ComTxModeTimeOffset=0
      EPBAvlblyStsPV_SecCAN2_ed3af02c (ComSignal):
        ComBitPosition = 2
        ComBitSize = 3
        ComSignalEndianness = BIG_ENDIAN
        ComSignalInitValue = 0
        ComSignalType = UINT8
        ComTransferProperty = PENDING
        ComSignalAccess = ACCESS_UNCLEAR
        ComHandleId = 52
        ComSystemTemplateSystemSignalRef = EPBAvlblyStsPV_SecCAN2
      P2P_oLIN00_Rx_fcef2243 (ComIPduGroup): ComIPduGroupHandleId=6
      P2P_oLIN00_Tx_fcef2243 (ComIPduGroup): ComIPduGroupHandleId=7
      3 x ComSignal, all with ComSignalEndianness=LITTLE_ENDIAN, ComSignalInitValue=0, ComSignalAccess=ACCESS_UNCLEAR:
        Width_LRU1_18ef6e8d: ComBitPosition=24, ComBitSize=8, ComSignalType=UINT8, ComHandleId=290, ComSystemTemplateSystemSignalRef=Width_LRU1
        TOF_LRU1_18ef6e8d: ComBitPosition=0, ComBitSize=16, ComSignalType=UINT16, ComHandleId=244, ComSystemTemplateSystemSignalRef=TOF_LRU1
        Status_LRU1_18ef6e8d: ComBitPosition=48, ComBitSize=8, ComSignalType=UINT8, ComHandleId=224, ComSystemTemplateSystemSignalRef=Status_LRU1
      Read_SRU3_oLIN00_3abd61be (ComIPdu):
        ComIPduDirection = RECEIVE
        ComIPduType = NORMAL
        ComIPduHandleId = 55
        ComIPduSignalProcessing = DEFERRED
        ComIPduCancellationSupport = false
        ComIPduCallout = ComIPduCallout_Read_SRU3_oLIN00_3abd61be
        ComIPduGroupRef = P2P_oLIN00_Rx_fcef2243
        ComIPduSignalRef = Status_SRU3_67c459fd
        ComIPduSignalRef = TOF_SRU3_67c459fd
        ComPduIdRef = PT_Read_SRU3_PP_Read_SRU3_Rx_45618847_8792e7c3
      4 x ComSignal, all with ComSignalEndianness=LITTLE_ENDIAN, ComSignalInitValue=0, ComSignalAccess=ACCESS_UNCLEAR:
        Sig_Init_SRU3_829252cc: ComBitPosition=0, ComBitSize=16, ComSignalType=UINT16, ComHandleId=156, ComTransferProperty=PENDING, ComSystemTemplateSystemSignalRef=Sig_Init_SRU3
        Sin_Init_LRU1_fdb965bc: ComBitPosition=0, ComBitSize=8, ComSignalType=UINT8, ComHandleId=157, ComTransferProperty=PENDING, ComSystemTemplateSystemSignalRef=Sin_Init_LRU1
        Peak_LRU1_18ef6e8d: ComBitPosition=16, ComBitSize=8, ComSignalType=UINT8, ComHandleId=167, ComSystemTemplateSystemSignalRef=Peak_LRU1
        Status_SRU3_67c459fd: ComBitPosition=16, ComBitSize=8, ComSignalType=UINT8, ComHandleId=225, ComSystemTemplateSystemSignalRef=Status_SRU3
      Read_LRU1_oLIN00_3abd61be (ComIPdu):
        ComIPduDirection = RECEIVE
        ComIPduType = NORMAL
        ComIPduHandleId = 54
        ComIPduSignalProcessing = DEFERRED
        ComIPduCancellationSupport = false
        ComIPduCallout = ComIPduCallout_Read_LRU1_oLIN00_3abd61be
        ComIPduGroupRef = P2P_oLIN00_Rx_fcef2243
        ComIPduSignalRef = Peak_LRU1_18ef6e8d
        ComIPduSignalRef = Status_LRU1_18ef6e8d
        ComIPduSignalRef = TOF_LRU1_18ef6e8d
        ComIPduSignalRef = Width_LRU1_18ef6e8d
        ComPduIdRef = PT_Read_LRU1_PP_Read_LRU1_Rx_45618847_8792e7c3
      Init_LRU1_oLIN00_3abd61be (ComIPdu):
        ComIPduDirection = SEND
        ComIPduType = NORMAL
        ComIPduHandleId = 1
        ComIPduSignalProcessing = DEFERRED
        ComIPduCancellationSupport = false
        ComIPduTriggerTransmitCallout = ComIPduTriggerTransmitCallout_Init_LRU1_oLIN00_3abd61be
        ComIPduGroupRef = P2P_oLIN00_Tx_fcef2243
        ComIPduSignalRef = Sin_Init_LRU1_fdb965bc
        ComPduIdRef = PT_Init_LRU1_PP_Init_LRU1_Tx_45618847_8792e7c3
        ComTxIPdu: ComTxIPduUnusedAreasDefault=255, ComMinimumDelayTime=0
          ComTxModeTrue
            ComTxMode: ComTxModeMode=NONE
          ComTxModeFalse
            ComTxMode: ComTxModeMode=NONE
      TOF_SRU3_67c459fd (ComSignal):
        ComBitPosition = 0
        ComBitSize = 16
        ComSignalEndianness = LITTLE_ENDIAN
        ComSignalInitValue = 0
        ComSignalType = UINT16
        ComSignalAccess = ACCESS_UNCLEAR
        ComHandleId = 245
        ComSystemTemplateSystemSignalRef = TOF_SRU3
      4 x ComIPdu, all with ComIPduType=NORMAL, ComIPduSignalProcessing=DEFERRED, ComIPduCancellationSupport=false:
        Init_SRU3_oLIN00_3abd61be: ComIPduDirection=SEND, ComIPduHandleId=2, ComIPduTriggerTransmitCallout=ComIPduTriggerTransmitCallout_Init_SRU3_oLIN00_3abd61be, ComIPduGroupRef=P2P_oLIN00_Tx_fcef2243, ComIPduSignalRef=Sig_Init_SRU3_829252cc, ComPduIdRef=PT_Init_SRU3_PP_Init_SRU3_Tx_45618847_8792e7c3
          ComTxIPdu: ComTxIPduUnusedAreasDefault=255, ComMinimumDelayTime=0
            ComTxModeTrue
              ComTxMode: ComTxModeMode=NONE
            ComTxModeFalse
              ComTxMode: ComTxModeMode=NONE
        ComIPdu_Aceinna_Accel: ComIPduDirection=RECEIVE, ComIPduHandleId=6, ComIPduCallout=MessageRX_Aceinna_Accel_0x08F02D80, ComIPduGroupRef=P2P_oCAN01_Rx_fcef2243, ComPduIdRef=Pdu_Aceinna_Accel, ComIPduSignalRef=ComSignal_Aceinna_AccX, ComIPduSignalRef=ComSignal_Aceinna_AccY, ComIPduSignalRef=ComSignal_Aceinna_AccZ
        ComIPdu_Aceinna_AngleRate: ComIPduDirection=RECEIVE, ComIPduHandleId=7, ComIPduCallout=MessageRx_Aceinna_AngleRate_0x0CF02A80, ComIPduGroupRef=P2P_oCAN01_Rx_fcef2243, ComPduIdRef=Pdu_Aceinna_AngleRate, ComIPduSignalRef=ComSignal_Aceinna_GryoX, ComIPduSignalRef=ComSignal_Aceinna_GryoZ, ComIPduSignalRef=ComSignal_Aceinna_GyroY
        ComIPdu_Aceinna_Angles: ComIPduDirection=RECEIVE, ComIPduHandleId=5, ComIPduCallout=MessageRx_Aceinna_Angles_0x0CF02980, ComIPduGroupRef=P2P_oCAN01_Rx_fcef2243, ComPduIdRef=Pdu_Aceinna_Angles, ComIPduSignalRef=ComSignal_Aceinna_Pitch, ComIPduSignalRef=ComSignal_Aceinna_Roll
      8 x ComSignal, all with ComSignalEndianness=BIG_ENDIAN, ComSignalInitValue=0, ComSignalAccess=ACCESS_UNCLEAR:
        ComSignal_Aceinna_AccX: ComBitPosition=0, ComSignalType=UINT16, ComHandleId=54, ComBitSize=16
        ComSignal_Aceinna_AccY: ComBitPosition=16, ComSignalType=UINT16, ComHandleId=55, ComBitSize=16
        ComSignal_Aceinna_AccZ: ComBitPosition=32, ComSignalType=UINT16, ComHandleId=56, ComBitSize=16
        ComSignal_Aceinna_GryoX: ComBitPosition=0, ComSignalType=UINT16, ComHandleId=57, ComBitSize=16
        ComSignal_Aceinna_GyroY: ComBitPosition=16, ComSignalType=UINT16, ComHandleId=59, ComBitSize=16
        ComSignal_Aceinna_GryoZ: ComBitPosition=32, ComSignalType=UINT16, ComHandleId=58, ComBitSize=16
        ComSignal_Aceinna_Pitch: ComBitPosition=0, ComSignalType=UINT32, ComHandleId=60, ComBitSize=24
        ComSignal_Aceinna_Roll: ComBitPosition=24, ComSignalType=UINT32, ComHandleId=61, ComBitSize=24
    ComGeneral:
      ComConfigurationUseDet = false
      ComEnableSignalGroupArrayApi = false
      ComRetryFailedTransmitRequests = false
      ComSupportedIPduGroups = 8
      ComVersionInfoApi = false
      ComAdvancedIPduCallouts = true
      ComOptimizedIPduGroupHandling = true
      ComMetaDataSupport = false
      ComReceiveSignalMacroAPI = false
      ComDeferredEventCacheSupport = false
      ComMainfunctionTimingDomainSupport = false
      ComDescriptionRoutingCodeGeneration = false
      ComSafeBswChecks = false
    ComGeneration:
      ComOutOfBoundsWriteProtectionStrategy = NONE
      ComOutOfBoundsWriteSanitizer = false
      ComOutOfBoundsReadSanitizer = false
      ComReduceConstantData2Define = false
      ComBoolDataInArrayOfStructStrategy = BOOLEAN
      ComDeduplicateIndirectedData = true
      ComDataDeduplicationStrategy = WITH_CAST
      ComReduceBoolDataByNegationThreshold = 2
      ComReduceBoolDataByNumericalComparisonThreshold = 2
      ComReduceBoolDataByNumericalRelationThreshold = 2
      ComReduceBoolDataByNumericalOperandStrategy = WITH_ANY_VALUE
      ComReduceNumericalDataByOffsetThreshold = 2
      ComReduceNumericalDataByArraySubtractionThreshold = 2
      ComReduceDataByStreaming = false
      ComShortSymbols = false
      ComInterfacesForDeactivatedData = false
      ComReferringKeysInComments = false
    ComOptimization:
      ComTxCyclicProcessingISRLockThreshold = 1
      ComTxDeadlineMonitoringISRLockThreshold = 1
      ComTxProcessingISRLockThreshold = 1
      ComRxDeadlineMonitoringISRLockThreshold = 1
      ComRxDeferredProcessingISRLockThreshold = 1
      ComGatewayProcessingISRLockThreshold = 1
      ComGatewayDescriptionProcessingISRLockThreshold = 1
      ComIPduGroupISRLockThreshold = 1
