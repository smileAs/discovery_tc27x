AUTOSAR XML (schema 4-2-1)
package /ActiveEcuC
  module config Os: implementation-config-variant=VARIANT-PRE-COMPILE, module-description=Os_Impl
    OsOS:
      OsStackMonitoring = true
      OsStatus = EXTENDED
      OsUseGetServiceId = true
      OsUseParameterAccess = true
      OsUseResScheduler = false
      OsForcibleTermination = true
      OsGenerateCalloutStubs = true
      OsGenerateMemMap = COMPLETE
      OsGenerateMemMapForThreads = false
      OsServiceProtection = false
      OsStackUsageMeasurement = false
      OsUseXSignalAsyncApiCalls = false
      OsScalabilityClass = SC1
      OsNumberOfCores = 3
      OsMasterCore = OsCore_Core0
      OsSystemTimer = SystemTimer_Core0
      OsHardwareInitCore = OsCore_Core0
      OsHooks: OsErrorHook=true, OsPostTaskHook=false, OsPreTaskHook=false, OsShutdownHook=true, OsStartupHook=true, OsPanicHook=true, OsProtectionHook=false
    OSDEFAULTAPPMODE (OsAppMode)
    OS_APPMODE_ANY (OsAppMode)
    OsPublishedInformation: OsKernelVersion=7, OsPlatformName=TriCoreAurix
      TC27x (OsDerivativeInformation):
        OsMpuAlignment = 8
        OsStackAlignment = 8
        OsExceptionVectorTableAlignment = 32
        OsInterruptVectorTableAlignment = 32
        OsHardwareManuals = User Manual: tc27xD_um_v2.2_UserManual_rev2v2_2014-12.pdf V2.2 Errata Sheet: TC27x_BC_Errata_Sheet_rev1v5_2015_09_16.pdf V1.5 Safety Manual: AURIX Safety Manual_3.pdf V1.3 2015-09
        3 x OsPhysicalCore, all with OsPhysicalCoreExceptionSources=8, OsPhysicalCorePrivelegedHwAccess=true:
          Core0: OsPhysicalCoreId=0, OsPhysicalCoreDefaultEntrySymbol=_start_tc0, OsPhysicalCoreType=TC1.6.1E, OsPhysicalCoreMasterStartAllowed=true, OsPhysicalCoreIsAutostart=true
            OsPhysicalCore0DataMpu (OsPhysicalCoreMpu): OsPhysicalCoreMpuId=0, OsPhysicalCoreMpuMaxRegions=15, OsPhysicalCoreMpuType=DATA
            OsPhysicalCore0CodeMpu (OsPhysicalCoreMpu): OsPhysicalCoreMpuId=1, OsPhysicalCoreMpuMaxRegions=8, OsPhysicalCoreMpuType=CODE
          Core1: OsPhysicalCoreId=1, OsPhysicalCoreDefaultEntrySymbol=_start_tc1, OsPhysicalCoreType=TC1.6.1P, OsPhysicalCoreMasterStartAllowed=false, OsPhysicalCoreIsAutostart=false
            OsPhysicalCore1DataMpu (OsPhysicalCoreMpu): OsPhysicalCoreMpuId=0, OsPhysicalCoreMpuMaxRegions=15, OsPhysicalCoreMpuType=DATA
            OsPhysicalCore1CodeMpu (OsPhysicalCoreMpu): OsPhysicalCoreMpuId=1, OsPhysicalCoreMpuMaxRegions=8, OsPhysicalCoreMpuType=CODE
          Core2: OsPhysicalCoreId=2, OsPhysicalCoreDefaultEntrySymbol=_start_tc2, OsPhysicalCoreType=TC1.6.1P, OsPhysicalCoreMasterStartAllowed=false, OsPhysicalCoreIsAutostart=false
            OsPhysicalCore2DataMpu (OsPhysicalCoreMpu): OsPhysicalCoreMpuId=0, OsPhysicalCoreMpuMaxRegions=15, OsPhysicalCoreMpuType=DATA
            OsPhysicalCore2CodeMpu (OsPhysicalCoreMpu): OsPhysicalCoreMpuId=1, OsPhysicalCoreMpuMaxRegions=8, OsPhysicalCoreMpuType=CODE
        3 x OsHardwareTimer, all with OsHardwareTimerSize=32, OsHardwareTimerUnit=STM, OsHardwareTimerHighResPossible=true, OsHardwareTimerType=STM:
          STM0: OsHardwareTimerBaseAddress=4026531840, OsHardwareTimerId=0
            STM0_Ch0 (OsHardwareTimerChannel): OsHardwareTimerChannelIntSource=1168, OsHardwareTimerChannelOffset=0, OsHardwareTimerChannelId=0
            STM0_Ch1 (OsHardwareTimerChannel): OsHardwareTimerChannelIntSource=1172, OsHardwareTimerChannelOffset=1, OsHardwareTimerChannelId=1
          STM1: OsHardwareTimerBaseAddress=4026532096, OsHardwareTimerId=1
            STM1_Ch0 (OsHardwareTimerChannel): OsHardwareTimerChannelIntSource=1176, OsHardwareTimerChannelOffset=0, OsHardwareTimerChannelId=0
            STM1_Ch1 (OsHardwareTimerChannel): OsHardwareTimerChannelIntSource=1180, OsHardwareTimerChannelOffset=1, OsHardwareTimerChannelId=1
          STM2: OsHardwareTimerBaseAddress=4026532352, OsHardwareTimerId=2
            STM2_Ch0 (OsHardwareTimerChannel): OsHardwareTimerChannelIntSource=1184, OsHardwareTimerChannelOffset=0, OsHardwareTimerChannelId=0
            STM2_Ch1 (OsHardwareTimerChannel): OsHardwareTimerChannelIntSource=1188, OsHardwareTimerChannelOffset=1, OsHardwareTimerChannelId=1
        AURIXTC2XX_IR (OsSystemIntCtrl): OsSystemIntCtrlMaxPrios=255, OsSystemIntCtrlPrioOrder=ASC, OsSystemIntCtrlMaxSources=8192, OsSystemIntCtrlBaseAddress=4026757120
        GPT (OsHardwareTimer):
          OsHardwareTimerSize = 16
          OsHardwareTimerUnit = PIT
          OsHardwareTimerBaseAddress = 4026543616
          OsHardwareTimerHighResPossible = false
          OsHardwareTimerId = 0
          OsHardwareTimerType = PIT
          GPT_Ch0 (OsHardwareTimerChannel): OsHardwareTimerChannelIntSource=1128, OsHardwareTimerChannelOffset=0, OsHardwareTimerChannelId=0
          GPT_Ch1 (OsHardwareTimerChannel): OsHardwareTimerChannelIntSource=1140, OsHardwareTimerChannelOffset=1, OsHardwareTimerChannelId=1
        OsMemoryRegionSpecifics
          12 x OsMemoryRegionAccess:
            PS0_R: OsMemoryRegionAccessRights=R, OsMemoryRegionAccessType=PROTECTION_SET0
            PS0_W: OsMemoryRegionAccessRights=W, OsMemoryRegionAccessType=PROTECTION_SET0
            PS0_X: OsMemoryRegionAccessRights=X, OsMemoryRegionAccessType=PROTECTION_SET0
            PS1_R: OsMemoryRegionAccessRights=R, OsMemoryRegionAccessType=PROTECTION_SET1
            PS1_W: OsMemoryRegionAccessRights=W, OsMemoryRegionAccessType=PROTECTION_SET1
            PS1_X: OsMemoryRegionAccessRights=X, OsMemoryRegionAccessType=PROTECTION_SET1
            PS2_R: OsMemoryRegionAccessRights=R, OsMemoryRegionAccessType=PROTECTION_SET2
            PS2_W: OsMemoryRegionAccessRights=W, OsMemoryRegionAccessType=PROTECTION_SET2
            PS2_X: OsMemoryRegionAccessRights=X, OsMemoryRegionAccessType=PROTECTION_SET2
            PS3_R: OsMemoryRegionAccessRights=R, OsMemoryRegionAccessType=PROTECTION_SET3
            PS3_W: OsMemoryRegionAccessRights=W, OsMemoryRegionAccessType=PROTECTION_SET3
            PS3_X: OsMemoryRegionAccessRights=X, OsMemoryRegionAccessType=PROTECTION_SET3
        OsMemoryRegionDefault_AppT (OsMemoryRegionDefaults): OsMemoryRegionDefType=APPLICATION_TRUSTED, OsMemoryRegionDefIdentifier=0, OsMemoryRegionDefAccessRights=PS0_W
        OsMemoryRegionDefault_AppNT (OsMemoryRegionDefaults): OsMemoryRegionDefType=APPLICATION_NONTRUSTED, OsMemoryRegionDefIdentifier=1, OsMemoryRegionDefAccessRights=PS1_W
    OsCore_Core0 (OsCore):
      OsCoreIsAutosar = true
      OsCoreIsAutostart = true
      OsCoreEntrySymbol = _start_tc0
      OsCorePhysicalCoreRef = Core0
      OsCoreIdleTask = IdleTask_OsCore_Core0
      OsCoreSystemApplication = SystemApplication_OsCore_Core0
      OsCoreEcucCoreRef = EcucCore0
      OsCoreStacks:
        OsCoreKernelStackSize = 2048
        OsCoreStartupStackSize = 256
        OsCoreShutdownStackSize = 256
        OsCoreErrorStackSize = 256
        OsCoreProtectionStackSize = 256
        OsCoreInitStackSize = 1024
      XSignalChl_OsCore_Core1 (OsCoreXSignalChannel): OsCoreXSignalChannelSize=1, OsCoreXSignalChannelReceiverIsr=XSignalIsr_OsCore_Core1
      XSignalChl_OsCore_Core2 (OsCoreXSignalChannel): OsCoreXSignalChannelSize=1, OsCoreXSignalChannelReceiverIsr=XSignalIsr_OsCore_Core2
    SystemApplication_OsCore_Core0 (OsApplication):
      OsTrusted = true
      OsTrustedApplicationDelayTimingViolationCall = false
      OsTrustedApplicationWithProtection = false
      OsApplicationIsPrivileged = true
      OsAppUseTrustedFunctionStubs = false
      OsAppMemoryProtectionIdentifier = 0
      OsApplicationCoreRef = EcucCore0
      OsAppIsrRef = XSignalIsr_OsCore_Core0
      OsAppTaskRef = IdleTask_OsCore_Core0
      OsAppIsrRef = CounterIsr_SystemTimerCore0
      OsAppIsrRef = Uart0_Tx_Isr
      OsAppIsrRef = Uart0_Err_Isr
      OsAppIsrRef = Uart0_Rx_Isr
      OsAppIsrRef = CanIsr_{0..2}
      OsApplicationHooks: OsAppErrorHook=false, OsAppShutdownHook=false, OsAppStartupHook=false
    Untrusted_BSW_Core0 (OsApplication):
      OsTrusted = true
      OsTrustedApplicationDelayTimingViolationCall = false
      OsTrustedApplicationWithProtection = false
      OsApplicationIsPrivileged = true
      OsAppUseTrustedFunctionStubs = false
      OsAppMemoryProtectionIdentifier = 0
      OsApplicationCoreRef = EcucCore0
      OsAppCounterRef = SystemTimer_Core0
      OsAppTaskRef = Default_BSW_Async_Task_Core0
      OsAppAlarmRef = Rte_Al_TE2_Default_BSW_Async_Task_Core0_10ms
      OsAppEcucPartitionRef = EcucPartition_Core0_QM
      OsAppAlarmRef = Rte_Al_TE2_Default_BSW_Async_Task_Core0_0_10ms
      OsAppTaskRef = Default_Init_Task_Core0
      OsAppAlarmRef = Rte_Al_TE2_Default_BSW_Async_Task_Core0_0_20ms
      OsAppAlarmRef = Rte_Al_TE_disc_ecu_Core0_Task_10ms
      OsAppAlarmRef = Rte_Al_TE_disc_ecu_Core0_Task_100ms
      OsAppAlarmRef = Rte_Al_TE_disc_ecu_Core0_Task_20ms
      OsAppAlarmRef = Rte_Al_TE_disc_ecu_Core0_Task_50ms
      OsAppIsrRef = Lin_Channel_1_EX_Extended_Error_Interrupt
      OsAppIsrRef = Lin_Channel_1_RX_Receive_Interrupt
      OsAppIsrRef = Lin_Channel_1_TX_Transmit_Interrupt
      OsAppAlarmRef = Rte_Al_TE_LinIf_LinIf_MainFunction
      OsAppTaskRef = Core0_OsTask_1ms
      OsAppAlarmRef = Rte_Al_TE_Cycle_Task_1ms_Core0_Task_1ms
      OsApplicationHooks: OsAppErrorHook=false, OsAppShutdownHook=false, OsAppStartupHook=false
    OsResource:
      OsResourceProperty = STANDARD
      OsResourceAccessingApplication = SystemApplication_OsCore_Core{0..2}
      OsResourceAccessingApplication = Untrusted_BSW_Core{0..2}
    OsCore_Core1 (OsCore):
      OsCoreIsAutosar = true
      OsCoreIsAutostart = false
      OsCoreEntrySymbol = _start_tc1
      OsCorePhysicalCoreRef = Core1
      OsCoreEcucCoreRef = EcucCore1
      OsCoreIdleTask = IdleTask_OsCore_Core1
      OsCoreSystemApplication = SystemApplication_OsCore_Core1
      OsCoreStacks:
        OsCoreKernelStackSize = 256
        OsCoreStartupStackSize = 256
        OsCoreShutdownStackSize = 256
        OsCoreErrorStackSize = 256
        OsCoreProtectionStackSize = 256
        OsCoreInitStackSize = 1024
      XSignalChl_OsCore_Core0 (OsCoreXSignalChannel): OsCoreXSignalChannelSize=1, OsCoreXSignalChannelReceiverIsr=XSignalIsr_OsCore_Core0
      XSignalChl_OsCore_Core2 (OsCoreXSignalChannel): OsCoreXSignalChannelSize=1, OsCoreXSignalChannelReceiverIsr=XSignalIsr_OsCore_Core2
    OsCore_Core2 (OsCore):
      OsCoreIsAutostart = false
      OsCoreEntrySymbol = _start_tc2
      OsCoreIsAutosar = true
      OsCorePhysicalCoreRef = Core2
      OsCoreEcucCoreRef = EcucCore2
      OsCoreIdleTask = IdleTask_OsCore_Core2
      OsCoreSystemApplication = SystemApplication_OsCore_Core2
      OsCoreStacks:
        OsCoreKernelStackSize = 256
        OsCoreStartupStackSize = 256
        OsCoreShutdownStackSize = 256
        OsCoreErrorStackSize = 256
        OsCoreProtectionStackSize = 256
        OsCoreInitStackSize = 1024
      XSignalChl_OsCore_Core0 (OsCoreXSignalChannel): OsCoreXSignalChannelSize=1, OsCoreXSignalChannelReceiverIsr=XSignalIsr_OsCore_Core0
      XSignalChl_OsCore_Core1 (OsCoreXSignalChannel): OsCoreXSignalChannelSize=1, OsCoreXSignalChannelReceiverIsr=XSignalIsr_OsCore_Core1
    OsIoc: OsIocIncludeHeader=Rte.h
      OsIocCommunication: OsIocBufferLength=10
        OsIocDataProperties: OsIocDataType=uint32, OsIocDataTypeIsAtomic=false
        OsIocReceiverProperties: OsIocReceivingOsApplicationRef=SystemApplication_OsCore_Core1
        OsIocSenderProperties: OsIocSendingOsApplicationRef=SystemApplication_OsCore_Core0
    4 x OsApplication, all with OsTrusted=true, OsTrustedApplicationDelayTimingViolationCall=false, OsTrustedApplicationWithProtection=false, OsApplicationIsPrivileged=true, OsAppUseTrustedFunctionStubs=false, OsAppMemoryProtectionIdentifier=0:
      SystemApplication_OsCore_Core1: OsApplicationCoreRef=EcucCore1, OsAppTaskRef=IdleTask_OsCore_Core1, OsAppIsrRef=XSignalIsr_OsCore_Core1, OsAppIsrRef=CounterIsr_SystemTimerCore1
        OsApplicationHooks: OsAppErrorHook=false, OsAppShutdownHook=false, OsAppStartupHook=false
      SystemApplication_OsCore_Core2: OsApplicationCoreRef=EcucCore2, OsAppIsrRef=XSignalIsr_OsCore_Core2, OsAppIsrRef=CounterIsr_SystemTimerCore2, OsAppTaskRef=IdleTask_OsCore_Core2
        OsApplicationHooks: OsAppErrorHook=false, OsAppShutdownHook=false, OsAppStartupHook=false
      Untrusted_BSW_Core1: OsApplicationCoreRef=EcucCore1, OsAppCounterRef=SystemTimer_Core1, OsAppTaskRef=Default_BSW_Async_Task_Core1, OsAppTaskRef=Default_Init_Task_Core1, OsAppAlarmRef=Rte_Al_TE2_EcuM_EcuM_MainFunction, OsAppIsrRef=KEY_EVENT_Isr
        OsApplicationHooks: OsAppErrorHook=false, OsAppShutdownHook=false, OsAppStartupHook=false
      Untrusted_BSW_Core2: OsApplicationCoreRef=EcucCore2, OsAppCounterRef=SystemTimer_Core2, OsAppTaskRef=Default_BSW_Async_Task_Core2, OsAppAlarmRef=Rte_Al_TE3_EcuM_EcuM_MainFunction, OsAppTaskRef=Default_Init_Task_Core2
        OsApplicationHooks: OsAppErrorHook=false, OsAppShutdownHook=false, OsAppStartupHook=false
    3 x OsIsr, all with OsIsrCategory=CATEGORY_2, OsIsrInterruptType=EXTERNAL, OsIsrInterruptPriority=0, OsIsrStackSize=2048, OsIsrEnableNesting=false, OsIsrSpecialFunctionName=Os_XSigRecvIsrHandler:
      XSignalIsr_OsCore_Core0: OsIsrInterruptSource=4096
        OsIsrXSignalReceiver: OsIsrXSignalReceiverProvidedApis=ShutdownAllCores
      XSignalIsr_OsCore_Core2: OsIsrInterruptSource=4160
        OsIsrXSignalReceiver: OsIsrXSignalReceiverProvidedApis=ShutdownAllCores
      XSignalIsr_OsCore_Core1: OsIsrInterruptSource=4128
        OsIsrXSignalReceiver: OsIsrXSignalReceiverProvidedApis=ShutdownAllCores
    3 x OsCounter, all with OsCounterMaxAllowedValue=1073741823, OsCounterMinCycle=1, OsCounterTicksPerBase=1, OsCounterType=HARDWARE, OsCounterAccessingApplication=SystemApplication_OsCore_Core0, OsCounterAccessingApplication=SystemApplication_OsCore_Core1, OsCounterAccessingApplication=SystemApplication_OsCore_Core2, OsCounterAccessingApplication=Untrusted_BSW_Core0, OsCounterAccessingApplication=Untrusted_BSW_Core1, OsCounterAccessingApplication=Untrusted_BSW_Core2:
      SystemTimer_Core0: OsSecondsPerTick=1.25E-8
        OsDriver: OsDriverHighResolution=true, OsDriverHardwareTimerChannelRef=STM0_Ch0, OsDriverIsrRef=CounterIsr_SystemTimerCore0
      SystemTimer_Core1: OsSecondsPerTick=2.5E-8
        OsDriver: OsDriverHighResolution=true, OsDriverHardwareTimerChannelRef=STM1_Ch0, OsDriverIsrRef=CounterIsr_SystemTimerCore1
      SystemTimer_Core2: OsSecondsPerTick=2.5E-8
        OsDriver: OsDriverHighResolution=true, OsDriverHardwareTimerChannelRef=STM2_Ch0, OsDriverIsrRef=CounterIsr_SystemTimerCore2
    3 x OsIsr, all with OsIsrCategory=CATEGORY_2, OsIsrInterruptType=EXTERNAL, OsIsrStackSize=512, OsIsrEnableNesting=false, OsIsrSpecialFunctionName=Os_TimerHrtIsr:
      CounterIsr_SystemTimerCore0: OsIsrInterruptSource=1168, OsIsrInterruptPriority=5
      CounterIsr_SystemTimerCore1: OsIsrInterruptSource=1176, OsIsrInterruptPriority=17
      CounterIsr_SystemTimerCore2: OsIsrInterruptSource=1184, OsIsrInterruptPriority=18
    3 x OsTask, all with OsTaskActivation=1, OsTaskSchedule=NON, OsTaskStackSharing=false, OsTaskType=AUTO, OsTaskAccessingApplication=SystemApplication_OsCore_Core0, OsTaskAccessingApplication=SystemApplication_OsCore_Core1, OsTaskAccessingApplication=SystemApplication_OsCore_Core2:
      Default_BSW_Async_Task_Core0: OsTaskPriority=30, OsTaskStackSize=16384, OsTaskAccessingApplication=Untrusted_BSW_Core1, OsTaskAccessingApplication=Untrusted_BSW_Core2, OsTaskResourceRef=OsResource, OsTaskEventRef=Rte_Ev_Cyclic2_Default_BSW_Async_Task_Core0_10ms, OsTaskEventRef=Rte_Ev_Cyclic2_Default_BSW_Async_Task_Core0_0_10ms, OsTaskEventRef=Rte_Ev_Cyclic2_Default_BSW_Async_Task_Core0_0_20ms, OsTaskEventRef=Rte_Ev_Run_disc_ecu_Core0_Task_10ms, OsTaskEventRef=Rte_Ev_Run_disc_ecu_Core0_Task_100ms, OsTaskEventRef=Rte_Ev_Run_disc_ecu_Core0_Task_20ms, OsTaskEventRef=Rte_Ev_Run_disc_ecu_Core0_Task_50ms, OsTaskEventRef=Rte_Ev_Run_LinIf_LinIf_MainFunction
      Default_BSW_Async_Task_Core1: OsTaskPriority=25, OsTaskStackSize=1024, OsTaskAccessingApplication=Untrusted_BSW_Core0, OsTaskAccessingApplication=Untrusted_BSW_Core2
      Default_BSW_Async_Task_Core2: OsTaskPriority=20, OsTaskStackSize=1024, OsTaskAccessingApplication=Untrusted_BSW_Core0, OsTaskAccessingApplication=Untrusted_BSW_Core1
    Rte_Al_TE2_Default_BSW_Async_Task_Core0_10ms (OsAlarm):
      OsAlarmCounterRef = SystemTimer_Core0
      OsAlarmAccessingApplication = SystemApplication_OsCore_Core{0..2}
      OsAlarmAccessingApplication = Untrusted_BSW_Core1
      OsAlarmAccessingApplication = Untrusted_BSW_Core2
      OsAlarmAction
        OsAlarmSetEvent: OsAlarmSetEventRef=Rte_Ev_Cyclic2_Default_BSW_Async_Task_Core0_10ms, OsAlarmSetEventTaskRef=Default_BSW_Async_Task_Core0
    Rte_Ev_Cyclic2_Default_BSW_Async_Task_Core0_10ms (OsEvent)
    Rte_Al_TE2_Default_BSW_Async_Task_Core0_0_10ms (OsAlarm):
      OsAlarmCounterRef = SystemTimer_Core0
      OsAlarmAccessingApplication = Untrusted_BSW_Core1
      OsAlarmAccessingApplication = Untrusted_BSW_Core2
      OsAlarmAccessingApplication = SystemApplication_OsCore_Core{0..2}
      OsAlarmAction
        OsAlarmSetEvent: OsAlarmSetEventRef=Rte_Ev_Cyclic2_Default_BSW_Async_Task_Core0_0_10ms, OsAlarmSetEventTaskRef=Default_BSW_Async_Task_Core0
    Rte_Al_TE3_EcuM_EcuM_MainFunction (OsAlarm):
      OsAlarmCounterRef = SystemTimer_Core2
      OsAlarmAccessingApplication = Untrusted_BSW_Core0
      OsAlarmAccessingApplication = Untrusted_BSW_Core1
      OsAlarmAccessingApplication = SystemApplication_OsCore_Core{0..2}
      OsAlarmAction
        OsAlarmActivateTask: OsAlarmActivateTaskRef=Default_BSW_Async_Task_Core2
    Rte_Ev_Cyclic2_Default_BSW_Async_Task_Core0_0_10ms (OsEvent)
    3 x OsTask, all with OsTaskActivation=1, OsTaskSchedule=NON, OsTaskStackSharing=false, OsTaskStackSize=1024, OsTaskType=BASIC, OsTaskAccessingApplication=SystemApplication_OsCore_Core0, OsTaskAccessingApplication=SystemApplication_OsCore_Core1, OsTaskAccessingApplication=SystemApplication_OsCore_Core2:
      Default_Init_Task_Core0: OsTaskPriority=0
        OsTaskAutostart: OsTaskAppModeRef=OS_APPMODE_ANY
      Default_Init_Task_Core1: OsTaskPriority=1
        OsTaskAutostart: OsTaskAppModeRef=OS_APPMODE_ANY
      Default_Init_Task_Core2: OsTaskPriority=2
        OsTaskAutostart: OsTaskAppModeRef=OS_APPMODE_ANY
    OsBarrier: OsBarrierTaskRef=Default_BSW_Async_Task_Core0, OsBarrierTaskRef=Default_BSW_Async_Task_Core1, OsBarrierTaskRef=Default_BSW_Async_Task_Core2
    3 x OsTask, all with OsTaskActivation=1, OsTaskPriority=-1, OsTaskSchedule=FULL, OsTaskStackSharing=false, OsTaskStackSize=2048, OsTaskType=AUTO, OsTaskAccessingApplication=SystemApplication_OsCore_Core0, OsTaskAccessingApplication=SystemApplication_OsCore_Core1, OsTaskAccessingApplication=SystemApplication_OsCore_Core2:
      IdleTask_OsCore_Core0
        OsTaskAutostart: OsTaskAppModeRef=OS_APPMODE_ANY
      IdleTask_OsCore_Core1
        OsTaskAutostart: OsTaskAppModeRef=OS_APPMODE_ANY
      IdleTask_OsCore_Core2
        OsTaskAutostart: OsTaskAppModeRef=OS_APPMODE_ANY
    4 x OsIsr, all with OsIsrCategory=CATEGORY_2, OsIsrInterruptType=EXTERNAL, OsIsrStackSize=1024, OsIsrEnableNesting=false:
      Uart0_Tx_Isr: OsIsrInterruptSource=128, OsIsrInterruptPriority=30, OsIsrSpecialFunctionName=Uart_IsrTransmit0
      Uart0_Rx_Isr: OsIsrInterruptSource=132, OsIsrInterruptPriority=31, OsIsrSpecialFunctionName=Uart_IsrReceive0
      Uart0_Err_Isr: OsIsrInterruptSource=136, OsIsrInterruptPriority=32, OsIsrSpecialFunctionName=Uart_IsrError0
      CanIsr_0: OsIsrInterruptSource=2304, OsIsrInterruptPriority=10  # Os Interrupt Service Routine PLAIN_TEXT Can transmit, receive and busoff events of controller CanController. This OsIsr container has been created automatically based on the driver configuration.
    Rte_Al_TE2_Default_BSW_Async_Task_Core0_0_20ms (OsAlarm):
      OsAlarmCounterRef = SystemTimer_Core0
      OsAlarmAccessingApplication = Untrusted_BSW_Core1
      OsAlarmAccessingApplication = Untrusted_BSW_Core2
      OsAlarmAccessingApplication = SystemApplication_OsCore_Core{0..2}
      OsAlarmAction
        OsAlarmSetEvent: OsAlarmSetEventRef=Rte_Ev_Cyclic2_Default_BSW_Async_Task_Core0_0_20ms, OsAlarmSetEventTaskRef=Default_BSW_Async_Task_Core0
    Rte_Ev_Cyclic2_Default_BSW_Async_Task_Core0_0_20ms (OsEvent)
    Rte_Al_TE_disc_ecu_Core0_Task_10ms (OsAlarm):
      OsAlarmCounterRef = SystemTimer_Core0
      OsAlarmAccessingApplication = Untrusted_BSW_Core1
      OsAlarmAccessingApplication = Untrusted_BSW_Core2
      OsAlarmAccessingApplication = SystemApplication_OsCore_Core{0..2}
      OsAlarmAction
        OsAlarmSetEvent: OsAlarmSetEventRef=Rte_Ev_Run_disc_ecu_Core0_Task_10ms, OsAlarmSetEventTaskRef=Default_BSW_Async_Task_Core0
    Rte_Ev_Run_disc_ecu_Core0_Task_10ms (OsEvent)
    3 x OsAlarm, all with OsAlarmCounterRef=SystemTimer_Core0, OsAlarmAccessingApplication=Untrusted_BSW_Core1, OsAlarmAccessingApplication=Untrusted_BSW_Core2, OsAlarmAccessingApplication=SystemApplication_OsCore_Core0, OsAlarmAccessingApplication=SystemApplication_OsCore_Core1, OsAlarmAccessingApplication=SystemApplication_OsCore_Core2:
      Rte_Al_TE_disc_ecu_Core0_Task_100ms
        OsAlarmAction
          OsAlarmSetEvent: OsAlarmSetEventRef=Rte_Ev_Run_disc_ecu_Core0_Task_100ms, OsAlarmSetEventTaskRef=Default_BSW_Async_Task_Core0
      Rte_Al_TE_disc_ecu_Core0_Task_20ms
        OsAlarmAction
          OsAlarmSetEvent: OsAlarmSetEventRef=Rte_Ev_Run_disc_ecu_Core0_Task_20ms, OsAlarmSetEventTaskRef=Default_BSW_Async_Task_Core0
      Rte_Al_TE_disc_ecu_Core0_Task_50ms
        OsAlarmAction
          OsAlarmSetEvent: OsAlarmSetEventRef=Rte_Ev_Run_disc_ecu_Core0_Task_50ms, OsAlarmSetEventTaskRef=Default_BSW_Async_Task_Core0
    3 x OsEvent:
      Rte_Ev_Run_disc_ecu_Core0_Task_100ms
      Rte_Ev_Run_disc_ecu_Core0_Task_20ms
      Rte_Ev_Run_disc_ecu_Core0_Task_50ms
    CanIsr_1 (OsIsr):  # Os Interrupt Service Routine PLAIN_TEXT Can transmit, receive and busoff events of controller CT_CAN01_388e5969. This OsIsr container has been created automatically based on the driver configuration.
      OsIsrCategory = CATEGORY_2
      OsIsrInterruptType = EXTERNAL
      OsIsrInterruptSource = 2308
      OsIsrInterruptPriority = 11
      OsIsrStackSize = 1024
      OsIsrEnableNesting = false
    Rte_Al_TE2_EcuM_EcuM_MainFunction (OsAlarm):
      OsAlarmCounterRef = SystemTimer_Core1
      OsAlarmAccessingApplication = Untrusted_BSW_Core0
      OsAlarmAccessingApplication = Untrusted_BSW_Core2
      OsAlarmAccessingApplication = SystemApplication_OsCore_Core{0..2}
      OsAlarmAction
        OsAlarmActivateTask: OsAlarmActivateTaskRef=Default_BSW_Async_Task_Core1
    CanIsr_2 (OsIsr):  # Os Interrupt Service Routine PLAIN_TEXT Can transmit, receive and busoff events of controller CT_CAN02_388e5969. This OsIsr container has been created automatically based on the driver configuration.
      OsIsrCategory = CATEGORY_2
      OsIsrInterruptType = EXTERNAL
      OsIsrInterruptSource = 2312
      OsIsrInterruptPriority = 12
      OsIsrStackSize = 1024
      OsIsrEnableNesting = false
    Rte_Al_TE_LinIf_LinIf_MainFunction (OsAlarm):
      OsAlarmCounterRef = SystemTimer_Core0
      OsAlarmAccessingApplication = Untrusted_BSW_Core1
      OsAlarmAccessingApplication = Untrusted_BSW_Core2
      OsAlarmAccessingApplication = SystemApplication_OsCore_Core{0..2}
      OsAlarmAction
        OsAlarmSetEvent: OsAlarmSetEventRef=Rte_Ev_Run_LinIf_LinIf_MainFunction, OsAlarmSetEventTaskRef=Default_BSW_Async_Task_Core0
    Rte_Ev_Run_LinIf_LinIf_MainFunction (OsEvent)
    4 x OsIsr, all with OsIsrCategory=CATEGORY_2, OsIsrInterruptType=EXTERNAL, OsIsrStackSize=1024, OsIsrEnableNesting=false:
      Lin_Channel_1_EX_Extended_Error_Interrupt: OsIsrInterruptSource=148, OsIsrInterruptPriority=22, OsIsrSpecialFunctionName=LinIsr_1  # Os Interrupt Service Routine PLAIN_TEXT LIN interrupt EX - Extended Error Interrupt for Channel 1. This OsInterrupt container has been created automatically based on the driver configuration.
      Lin_Channel_1_RX_Receive_Interrupt: OsIsrInterruptSource=144, OsIsrInterruptPriority=23, OsIsrSpecialFunctionName=LinIsr_1  # Os Interrupt Service Routine PLAIN_TEXT LIN interrupt RX - Receive Interrupt for Channel 1. This OsInterrupt container has been created automatically based on the driver configuration.
      Lin_Channel_1_TX_Transmit_Interrupt: OsIsrInterruptSource=140, OsIsrInterruptPriority=24, OsIsrSpecialFunctionName=LinIsr_1  # Os Interrupt Service Routine PLAIN_TEXT LIN interrupt TX - Transmit Interrupt for Channel 1. This OsInterrupt container has been created automatically based on the driver configuration.
      KEY_EVENT_Isr: OsIsrInterruptSource=3284, OsIsrInterruptPriority=33, OsIsrSpecialFunctionName=KEY_EVENT
    Core0_OsTask_1ms (OsTask):
      OsTaskActivation = 1
      OsTaskPriority = 50
      OsTaskSchedule = NON
      OsTaskStackSharing = false
      OsTaskStackSize = 1024
      OsTaskType = AUTO
      OsTaskAccessingApplication = SystemApplication_OsCore_Core{0..2}
      OsTaskAccessingApplication = Untrusted_BSW_Core1
      OsTaskAccessingApplication = Untrusted_BSW_Core2
    Rte_Al_TE_Cycle_Task_1ms_Core0_Task_1ms (OsAlarm):
      OsAlarmCounterRef = SystemTimer_Core0
      OsAlarmAccessingApplication = Untrusted_BSW_Core1
      OsAlarmAccessingApplication = Untrusted_BSW_Core2
      OsAlarmAccessingApplication = SystemApplication_OsCore_Core{0..2}
      OsAlarmAction
        OsAlarmActivateTask: OsAlarmActivateTaskRef=Core0_OsTask_1ms
