AUTOSAR XML (schema 4-2-1)
package /ActiveEcuC
  module config Icu: implementation-config-variant=VARIANT-POST-BUILD-LOADABLE, module-description=Icu_Impl
    IcuConfigSet: IcuMaxChannel=2
      IcuChannel:
        IcuChannelId = 0
        IcuDefaultStartEdge = ICU_RISING_EDGE
        IcuMeasurementMode = ICU_MODE_SIGNAL_EDGE_DETECT
        IcuWakeupCapability = false
        IcuSignalType = ICU_QM_SIGNAL
        IcuAssignedHwUnit = Cc61
        IcuSignalEdgeDetection: IcuSignalNotification=NULL
        IcuSignalMeasurement: IcuDutycycleBufferMarker=0, IcuSignalMeasurementProperty=ICU_LOW_TIME
        IcuTimestampMeasurement: IcuTimestampBufferMarker=0
        IcuWakeup
      IcuChannel_001 (IcuChannel):
        IcuChannelId = 1
        IcuDefaultStartEdge = ICU_FALLING_EDGE
        IcuMeasurementMode = ICU_MODE_SIGNAL_EDGE_DETECT
        IcuWakeupCapability = false
        IcuSignalType = ICU_ASIL_SIGNAL
        IcuAssignedHwUnit = ERU5
    IcuGeneral:
      IcuDevErrorDetect = false
      IcuDebugSupport = false
      IcuIndex = 0
      IcuReportWakeupSource = false
      IcuPBFixedAddress = false
      IcuResetSfrAtInit = false
      IcuUserModeRuntimeApiEnable = false
      IcuUserModeInitApiEnable = false
      IcuUserModeDeInitApiEnable = false
      IcuRunningInUser0Mode = false
    IcuOptionalApis:
      IcuDeInitApi = false
      IcuDisableWakeupApi = false
      IcuEdgeCountApi = false
      IcuEdgeDetectApi = true
      IcuEnableWakeupApi = false
      IcuGetDutyCycleValuesApi = false
      IcuGetInputStateApi = false
      IcuGetTimeElapsedApi = false
      IcuGetVersionInfoApi = false
      IcuSetModeApi = false
      IcuSignalMeasurementApi = false
      IcuTimestampApi = false
      IcuWakeupFunctionalityApi = false
    IcuSafety: IcuSafetyEnable=false, IcuInitCheckApi=false, IcuGetModeApi=false
    CommonPublishedInformation:
      ArMajorVersion = 4
      ArMinorVersion = 2
      ArPatchVersion = 0
      SwMajorVersion = 3
      SwMinorVersion = 11
      SwPatchVersion = 0
      ModuleId = 122
      VendorId = 17
      Release = _TRICORE_TC277
      VendorApiInfix = GtmCcu6
