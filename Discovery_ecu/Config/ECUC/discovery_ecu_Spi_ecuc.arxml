AUTOSAR XML (schema 4-2-1)
package /ActiveEcuC
  module config Spi: implementation-config-variant=VARIANT-POST-BUILD-LOADABLE, module-description=Spi_Impl
    SpiGeneral:
      SpiDevErrorDetect = false
      SpiVersionInfoApi = false
      SpiChannelBuffersAllowed = 1
      SpiHwStatusApi = false
      SpiCancelApi = false
      SpiMaxJobTriggerQueueLength = 2
      SpiPBFixedAddress = false
      SpiDebugSupport = false
      SpiAsyncParallelTransmit = false
      SpiBaudrateConfigAtRuntime = false
      SpiResetSfrAtInit = false
      SpiSyncTransmitTimeoutDuration = 1048575
      SpiRunningInUser0Mode = false
      SpiUserModeInitApiEnable = false
      SpiUserModeDeInitApiEnable = false
      SpiUserModeRuntimeApiEnable = false
      SpiLevelDelivered = 2
    SpiSafety: SpiSafetyEnable=false
    SpiDriver: SpiMaxChannel=4, SpiMaxJob=4, SpiMaxSequence=4, SpiSystemClock=McuClockReferencePoint
      SpiChannel_0 (SpiChannel): SpiChannelType=EB, SpiDataWidth=16, SpiDefaultData=0, SpiTransferStart=MSB, SpiChannelId=0, SpiEbMaxLength=64
      SpiPMIC (SpiExternalDevice):
        SpiCsPolarity = LOW
        SpiDataShiftEdge = TRAILING
        SpiShiftClockIdleLevel = LOW
        SpiAutoCalcBaudParams = true
        SpiAutoCalcDelayParams = false
        SpiEnableCs = true
        SpiCsSelection = CS_VIA_PERIPHERAL_ENGINE
        SpiParitySupport = Unused
        SpiBaudrate = 5000000
        SpiHwUnit: SpiAssignedHwModule=QSPI2, SpiAssignedHwChannel=Channel11
        SpiCsGpio: SpiCsGpioPinSelection=15, SpiCsGpioPortSelection=33
      SpiJobPMIC (SpiJob): SpiJobPriority=2, SpiChannelBasedCS=Enabled, SpiJobId=0, SpiHwUnitSynchronous=Synchronous, SpiDeviceAssignment=SpiPMIC
        SpiChannelList: SpiChannelIndex=0, SpiChannelAssignment=SpiChannel_0
      SpiSequencePMIC (SpiSequence): SpiSequenceId=0, SpiJobAssignment=SpiJobPMIC
      3 x SpiChannel, all with SpiChannelType=EB, SpiDataWidth=8, SpiDefaultData=0, SpiTransferStart=MSB, SpiEbMaxLength=64:
        SpiChannel_{1..3}: SpiChannelId={1..3}
      3 x SpiExternalDevice, all with SpiCsPolarity=LOW, SpiDataShiftEdge=LEADING, SpiShiftClockIdleLevel=LOW, SpiAutoCalcBaudParams=true, SpiAutoCalcDelayParams=false, SpiEnableCs=true, SpiCsSelection=CS_VIA_PERIPHERAL_ENGINE, SpiParitySupport=Unused:
        SpiRTK: SpiBaudrate=2000000
          SpiHwUnit: SpiAssignedHwModule=QSPI0, SpiAssignedHwChannel=Channel10
          SpiCsGpio: SpiCsGpioPinSelection=11, SpiCsGpioPortSelection=22
        SpiSD: SpiBaudrate=100000
          SpiHwUnit: SpiAssignedHwModule=QSPI1, SpiAssignedHwChannel=Channel10
          SpiCsGpio: SpiCsGpioPinSelection=0, SpiCsGpioPortSelection=10
        SpiSOC: SpiBaudrate=100000
          SpiHwUnit: SpiAssignedHwModule=QSPI3, SpiAssignedHwChannel=Channel12
          SpiCsGpio: SpiCsGpioPinSelection=2, SpiCsGpioPortSelection=22
      3 x SpiJob, all with SpiChannelBasedCS=Enabled:
        SpiJobRTK: SpiJobPriority=0, SpiJobId=1, SpiHwUnitSynchronous=Synchronous, SpiDeviceAssignment=SpiRTK
          SpiChannelList: SpiChannelIndex=0, SpiChannelAssignment=SpiChannel_1
        SpiJobSOC: SpiJobPriority=1, SpiJobId=2, SpiHwUnitSynchronous=Synchronous, SpiDeviceAssignment=SpiSOC
          SpiChannelList: SpiChannelIndex=0, SpiChannelAssignment=SpiChannel_2
        SpiJobSD: SpiJobPriority=3, SpiJobId=3, SpiHwUnitSynchronous=Asynchronous, SpiDeviceAssignment=SpiSD
          SpiChannelList: SpiChannelIndex=0, SpiChannelAssignment=SpiChannel_3
      3 x SpiSequence:
        SpiSequenceRTK: SpiSequenceId=1, SpiJobAssignment=SpiJobRTK
        SpiSequenceSD: SpiSequenceId=3, SpiJobAssignment=SpiJobSD
        SpiSequenceSOC: SpiSequenceId=2, SpiJobAssignment=SpiJobSOC
    SpiHwConfiguration
      SpiHwConfigurationQspi0
        SpiClockConfiguration: SpiSleepEnable=false
        SpiHwPinConfiguration: SpiHWPinMISO=MRST0B_PORT22_PIN9, SPISlaveHwPinMOSI=MTSR0B_PORT22_PIN10, SPISlaveHwPinSCLK=SCLK0C_PORT22_PIN7
        SpiHwDmaConfiguration: SpiHwDmaChannelReceptionRef=DmaChannel_1, SpiHwDmaChannelTransmissionRef=DmaChannel_0
      SpiHwConfigurationQspi1
        SpiClockConfiguration: SpiSleepEnable=false
        SpiHwPinConfiguration: SpiHWPinMISO=MRST1A_PORT10_PIN1, SPISlaveHwPinMOSI=MTSR1A_PORT10_PIN3, SPISlaveHwPinSCLK=SCLK1A_PORT10_PIN2
        SpiHwDmaConfiguration: SpiHwDmaChannelReceptionRef=DmaChannel_3, SpiHwDmaChannelTransmissionRef=DmaChannel_2
      SpiHwConfigurationQspi2
        SpiClockConfiguration: SpiSleepEnable=false
        SpiHwPinConfiguration: SpiHWPinMISO=MRST2D_PORT34_PIN4, SPISlaveHwPinMOSI=MTSR2D_PORT34_PIN5, SPISlaveHwPinSCLK=SCLK2D_PORT33_PIN14
        SpiHwDmaConfiguration: SpiHwDmaChannelReceptionRef=DmaChannel_5, SpiHwDmaChannelTransmissionRef=DmaChannel_4
      SpiHwConfigurationQspi3
        SpiClockConfiguration: SpiSleepEnable=false
        SpiHwPinConfiguration: SpiHWPinMISO=MRST3E_PORT22_PIN1, SPISlaveHwPinMOSI=MTSR3E_PORT22_PIN0, SPISlaveHwPinSCLK=SCLK3E_PORT22_PIN3
        SpiHwDmaConfiguration: SpiHwDmaChannelReceptionRef=DmaChannel_7, SpiHwDmaChannelTransmissionRef=DmaChannel_6
    SpiPublishedInformation: SpiMaxHwUnit=4
    CommonPublishedInformation: ArMajorVersion=3, ArMinorVersion=2, ArPatchVersion=0, SwMajorVersion=4, SwMinorVersion=8, SwPatchVersion=0, ModuleId=83, VendorId=17, Release=_TRICORE_TC277
