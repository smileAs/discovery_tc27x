AUTOSAR XML (schema 4-2-1)
package /ActiveEcuC
  module config Lin: implementation-config-variant=VARIANT-PRE-COMPILE, module-description=Lin_Impl
    LinPlatformConfig: LinRegisterAddresses=0xF0000600UL 0xF0000700UL 0xF0000800UL 0xF0000900UL, LinClockRegister=F_CLC=0x01 F_OSC=0x02 F_ERAY=0x04 F_MAX=0x08
    LinGeneral:
      LinDevErrorDetect = false
      LinIndex = 0
      LinTimeoutDuration = 100
      LinVersionInfoApi = false
      LinTypeOfInterruptFunction = CATEGORY2
      LinRuntimeMeasurementSupport = false
    LinGlobalConfig
      LIN00_f26020e5 (LinChannel):  # CN_LIN00
        LinChannelBaudRate = 19200
        LinChannelId = 0
        LinChannelWakeupSupport = true
        LinUart = 1
        LinAlternateInputSelect = INPUT_5
        LinClockSource = F_OSC
        LinClockFrequency = 20000000
        LinChannelEcuMWakeupSource = LIN00_f26020e5
        LinClockRef = McuClockReferencePoint
