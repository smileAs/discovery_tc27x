AUTOSAR XML (schema 4-2-1)
package /ActiveEcuC
  module config Irq: implementation-config-variant=VARIANT-PRE-COMPILE, module-description=Irq_Impl
    IrqGeneral: IrqOsekEnable=false
    IrqQspiConfig
      IrqQspiCatConfig
        IrqQspiTxCatConfig: IrqQspi0TxCat=CAT1, IrqQspi1TxCat=CAT1, IrqQspi2TxCat=CAT1, IrqQspi3TxCat=CAT1
        IrqQspiRxCatConfig: IrqQspi0RxCat=CAT1, IrqQspi1RxCat=CAT1, IrqQspi2RxCat=CAT1, IrqQspi3RxCat=CAT1
        IrqQspiErrCatConfig: IrqQspi0ErrCat=CAT1, IrqQspi1ErrCat=CAT1, IrqQspi2ErrCat=CAT1, IrqQspi3ErrCat=CAT1
        IrqQspiPTCatConfig: IrqQspi0PTCat=CAT1, IrqQspi1PTCat=CAT1, IrqQspi2PTCat=CAT1, IrqQspi3PTCat=CAT1
        IrqQspiHCCatConfig: IrqQspi0HCCat=CAT1, IrqQspi1HCCat=CAT1, IrqQspi2HCCat=CAT1, IrqQspi3HCCat=CAT1
        IrqQspiUDCatConfig: IrqQspi0UDCat=CAT1, IrqQspi1UDCat=CAT1, IrqQspi2UDCat=CAT1, IrqQspi3UDCat=CAT1
      IrqQspiPrioConfig
        IrqQspiTxPrioConfig: IrqQspi0TxPrio=0, IrqQspi1TxPrio=0, IrqQspi2TxPrio=0, IrqQspi3TxPrio=0
        IrqQspiRxPrioConfig: IrqQspi0RxPrio=0, IrqQspi1RxPrio=0, IrqQspi2RxPrio=0, IrqQspi3RxPrio=0
        IrqQspiErrPrioConfig: IrqQspi0ErrPrio=0, IrqQspi1ErrPrio=0, IrqQspi2ErrPrio=0, IrqQspi3ErrPrio=0
        IrqQspiPTPrioConfig: IrqQspi0PTPrio=0, IrqQspi1PTPrio=0, IrqQspi2PTPrio=0, IrqQspi3PTPrio=0
        IrqQspiHCPrioConfig: IrqQspi0HCPrio=0, IrqQspi1HCPrio=0, IrqQspi2HCPrio=0, IrqQspi3HCPrio=0
        IrqQspiUDPrioConfig: IrqQspi0UDPrio=0, IrqQspi1UDPrio=0, IrqQspi2UDPrio=0, IrqQspi3UDPrio=0
      IrqQspiTosConfig
        IrqQspiTxTosConfig: IrqQspi0TxTos=CPU0, IrqQspi1TxTos=CPU0, IrqQspi2TxTos=CPU0, IrqQspi3TxTos=CPU0
        IrqQspiRxTosConfig: IrqQspi0RxTos=CPU0, IrqQspi1RxTos=CPU0, IrqQspi2RxTos=CPU1, IrqQspi3RxTos=CPU0
        IrqQspiErrTosConfig: IrqQspi0ErrTos=CPU0, IrqQspi1ErrTos=CPU0, IrqQspi2ErrTos=CPU0, IrqQspi3ErrTos=CPU0
        IrqQspiPTTosConfig: IrqQspi0PTTos=CPU0, IrqQspi1PTTos=CPU0, IrqQspi2PTTos=CPU0, IrqQspi3PTTos=CPU0
        IrqQspiHCTosConfig: IrqQspi0HCTos=CPU0, IrqQspi1HCTos=CPU0, IrqQspi2HCTos=CPU0, IrqQspi3HCTos=CPU0
        IrqQspiUDTosConfig: IrqQspi0UDTos=CPU0, IrqQspi1UDTos=CPU0, IrqQspi2UDTos=CPU0, IrqQspi3UDTos=CPU0
    IrqGptConfig
      IrqGpt120Config
        IrqGpt120CatConfig: IrqGpt120CARPELCat=CAT1, IrqGpt120T2Cat=CAT1, IrqGpt120T3Cat=CAT1, IrqGpt120T4Cat=CAT1, IrqGpt120T5Cat=CAT1, IrqGpt120T6Cat=CAT1
        IrqGpt120PrioConfig: IrqGpt120CARPELPrio=0, IrqGpt120T2Prio=0, IrqGpt120T3Prio=0, IrqGpt120T4Prio=0, IrqGpt120T5Prio=0, IrqGpt120T6Prio=0
        IrqGpt120TosConfig: IrqGpt120CARPELTos=CPU0, IrqGpt120T2Tos=CPU0, IrqGpt120T3Tos=CPU0, IrqGpt120T4Tos=CPU0, IrqGpt120T5Tos=CPU0, IrqGpt120T6Tos=CPU0
    IrqGtmConfig
    CommonPublishedInformation:
      ArMajorVersion = 0
      ArMinorVersion = 0
      ArPatchVersion = 0
      SwMajorVersion = 5
      SwMinorVersion = 1
      SwPatchVersion = 0
      ModuleId = 255
      VendorId = 17
      Release = _TRICORE_TC277
    IrqAdcConfig
    IrqAscLinConfig
      IrqAscLinCatConfig
        IrqAscLinTxCatConfig: IrqAscLin0TxCat=CAT1
        IrqAscLinRxCatConfig
        IrqAscLinErrCatConfig
      IrqAscLinPrioConfig
        IrqAscLinTxPrioConfig
        IrqAscLinRxPrioConfig
        IrqAscLinErrPrioConfig
      IrqAscLinTosConfig
        IrqAscLinTxTosConfig
        IrqAscLinRxTosConfig
        IrqAscLinErrTosConfig
    IrqCCU6Config
    IrqCanConfig
      IrqCanCatConfig
      IrqCanPrioConfig
      IrqCanTosConfig
    IrqDSAdcConfig
      IrqDSAdcCatConfig
      IrqDSAdcPrioConfig
      IrqDSAdcTosConfig
    IrqDmaConfig
      IrqDmaCatConfig
      IrqDmaPrioConfig
      IrqDmaTosConfig
    IrqETHConfig
      IrqETHCatConfig: IrqETHSRCat=CAT1
      IrqETHPrioConfig: IrqETHSRPrio=0
      IrqETHTosConfig: IrqETHSRTos=CPU0
    IrqFlexRayConfig
    IrqGPSRGroupConfig
    IrqHSMConfig
      IrqHSMCatConfig: IrqHSMSR0Cat=CAT1, IrqHSMSR1Cat=CAT1
      IrqHSMPrioConfig: IrqHSMSR0Prio=0, IrqHSMSR1Prio=0
      IrqHSMTosConfig: IrqHSMSR0Tos=CPU0, IrqHSMSR1Tos=CPU0
    IrqHsslConfig
      IrqHsslCatConfig
        IrqHsslCokCatConfig: IrqHssl0CokCat=CAT1, IrqHssl1CokCat=CAT1, IrqHssl2CokCat=CAT1, IrqHssl3CokCat=CAT1, IrqHssl4CokCat=CAT1
        IrqHsslTrgCatConfig: IrqHssl0TrgCat=CAT1, IrqHssl1TrgCat=CAT1, IrqHssl2TrgCat=CAT1, IrqHssl3TrgCat=CAT1, IrqHssl4TrgCat=CAT1
        IrqHsslRdiCatConfig: IrqHssl0RdiCat=CAT1, IrqHssl1RdiCat=CAT1, IrqHssl2RdiCat=CAT1, IrqHssl3RdiCat=CAT1, IrqHssl4RdiCat=CAT1
        IrqHsslErrCatConfig: IrqHssl0ErrCat=CAT1, IrqHssl1ErrCat=CAT1, IrqHssl2ErrCat=CAT1, IrqHssl3ErrCat=CAT1, IrqHssl4ErrCat=CAT1
        IrqHsslExiCatConfig: IrqHsslExiCat=CAT1
      IrqHsslPrioConfig
        IrqHsslCokPrioConfig: IrqHssl0CokPrio=0, IrqHssl1CokPrio=0, IrqHssl2CokPrio=0, IrqHssl3CokPrio=0, IrqHssl4CokPrio=0
        IrqHsslTrgPrioConfig: IrqHssl0TrgPrio=0, IrqHssl1TrgPrio=0, IrqHssl2TrgPrio=0, IrqHssl3TrgPrio=0, IrqHssl4TrgPrio=0
        IrqHsslRdiPrioConfig: IrqHssl0RdiPrio=0, IrqHssl1RdiPrio=0, IrqHssl2RdiPrio=0, IrqHssl3RdiPrio=0, IrqHssl4RdiPrio=0
        IrqHsslErrPrioConfig: IrqHssl0ErrPrio=0, IrqHssl1ErrPrio=0, IrqHssl2ErrPrio=0, IrqHssl3ErrPrio=0, IrqHssl4ErrPrio=0
        IrqHsslExiPrioConfig: IrqHsslExiPrio=0
      IrqHsslTosConfig
        IrqHsslCokTosConfig: IrqHssl0CokTos=CPU0, IrqHssl1CokTos=CPU0, IrqHssl2CokTos=CPU0, IrqHssl3CokTos=CPU0, IrqHssl4CokTos=CPU0
        IrqHsslTrgTosConfig: IrqHssl0TrgTos=CPU0, IrqHssl1TrgTos=CPU0, IrqHssl2TrgTos=CPU0, IrqHssl3TrgTos=CPU0, IrqHssl4TrgTos=CPU0
        IrqHsslRdiTosConfig: IrqHssl0RdiTos=CPU0, IrqHssl1RdiTos=CPU0, IrqHssl2RdiTos=CPU0, IrqHssl3RdiTos=CPU0, IrqHssl4RdiTos=CPU0
        IrqHsslErrTosConfig: IrqHssl0ErrTos=CPU0, IrqHssl1ErrTos=CPU0, IrqHssl2ErrTos=CPU0, IrqHssl3ErrTos=CPU0, IrqHssl4ErrTos=CPU0
        IrqHsslExiTosConfig: IrqHsslExiTos=CPU0
    IrqI2CConfig
    IrqMscConfig
    IrqPMU0Config
      IrqPMU0CatConfig
      IrqPMU0PrioConfig
      IrqPMU0TosConfig
    IrqScuConfig
      IrqScuCatConfig
      IrqScuPrioConfig
      IrqScuTosConfig
    IrqSentConfig
      IrqSentCatConfig
      IrqSentPrioConfig
      IrqSentTosConfig
    IrqStmConfig
