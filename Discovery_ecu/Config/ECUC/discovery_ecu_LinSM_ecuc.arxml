AUTOSAR XML (schema 4-2-1)
package /ActiveEcuC
  module config LinSM: implementation-config-variant=VARIANT-PRE-COMPILE, module-description=LinSM_Impl
    LinSMConfigSet
      LIN00_f26020e5 (LinSMChannel): LinSMConfirmationTimeout=1, LinSMSleepSupport=false, LinSMTransceiverHandling=false, LinSMComMNetworkHandleRef=LIN00_f26020e5  # CHNL
        Normal_45618847 (LinSMSchedule): LinSMScheduleIndex=1, LinSMScheduleIndexRef=Normal_45618847
        NULLSchedule (LinSMSchedule): LinSMScheduleIndex=0, LinSMScheduleIndexRef=NULLSchedule
    LinSMGeneral: LinSMDevErrorDetect=false, LinSMMainProcessingPeriod=0.01, LinSMVersionInfoApi=false
      LinSMGeneration: LinSMOutOfBoundsWriteSanitizer=false, LinSMOutOfBoundsReadSanitizer=false, LinSMShortSymbols=false
