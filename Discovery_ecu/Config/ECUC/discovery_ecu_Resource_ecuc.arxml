AUTOSAR XML (schema 4-2-1)
package /ActiveEcuC
  module config Resource: implementation-config-variant=VARIANT-PRE-COMPILE
    ResourceGeneral: ResourceSubDerivative=TC277TP_64F200S
