AUTOSAR XML (schema 4-2-1)
package /ActiveEcuC
  module config EcuC: implementation-config-variant=VARIANT-PRE-COMPILE, module-description=EcuC_Impl
    EcucGeneral:
      CPUType = CPU32Bit
      SizeOfInt = Size32Bit
      ByteOrder = LITTLE_ENDIAN
      BitOrder = LSB_to_MSB
      AtomicBitAccessInBitfield = true
      AtomicVariableAccess = Atomic32BitAccess
      SizeOfEnum = Size8Bit
      SizeOfROMPointer = Size32Bit
      SizeOfRAMPointer = Size32Bit
      BitFieldDataType = INT
      StructAlignment = Auto
      ArrayAlignment = Auto
      StructInArrayAlignment = Auto
      DummyFunction = false
      EcuCSafeBswChecks = false
      DummyStatement = true
      DummyStatementKind = None
      ConditionalGenerating = true
      EcucBswImplementationCodeType = EcuCSourceCode
      EcuCUseStdReturnTypeForRte = false
      PostbuildLoadable: AlignmentFillPattern=90, PBROMStartAddress=0, PBRAMStartAddress=0, PBROMEndAddress=0, PBRAMEndAddress=0
      BswInitialization
        39 x InitFunction:
          Mcu_Init: Header=Mcu.h, InitPhase=INIT_ONE_EARLY, ConfigType=Mcu_ConfigType, ConfigPtrName=Mcu_ConfigRoot, ConfigPtrClass=const, ModuleRef=Mcu
          BswM_Init: Header=BswM.h, InitPhase=NO_INIT, ConfigType=BswM_ConfigType, ConfigPtrName=BswM_Config_Ptr, ConfigPtrClass=BSWM_INIT_DATA, ModuleRef=BswM
          BswM_InitMemory: Header=BswM.h, InitPhase=INIT_MEMORY, ModuleRef=BswM
          EcuM_Init: Header=EcuM.h, InitPhase=NO_INIT, ConfigType=EcuM_PbConfigType, ConfigPtrName=EcuM_Config_Ptr, ConfigPtrClass=ECUM_INIT_DATA, ModuleRef=EcuM
          Rte_InitMemory: Header=Rte_Main.h, InitPhase=INIT_MEMORY, ModuleRef=Rte
          SchM_Init: Header=Rte_Main.h, InitPhase=NO_INIT, ModuleRef=Rte
          Dio_Init: Header=Dio.h, InitPhase=INIT_ONE, ConfigType=Dio_ConfigType, ConfigPtrName=Dio_ConfigRoot, ConfigPtrClass=const, ModuleRef=Dio
          Irq_Init: Header=Irq.h, InitPhase=INIT_ONE_LATE, ConfigType=Irq_ConfigType, ConfigPtrName=&NULL_PTR, ConfigPtrClass=const, ModuleRef=Irq
          Gpt_Init: Header=Gpt.h, InitPhase=INIT_ONE, ConfigType=Gpt_ConfigType, ConfigPtrName=Gpt_ConfigRoot, ConfigPtrClass=const, ModuleRef=Gpt
          Port_Init: Header=Port.h, InitPhase=INIT_ONE_EARLY, ConfigType=Port_ConfigType, ConfigPtrName=Port_ConfigRoot, ConfigPtrClass=const, ModuleRef=Port
          Spi_Init: Header=Spi.h, InitPhase=INIT_ONE, ConfigType=Spi_ConfigType, ConfigPtrName=Spi_ConfigRoot, ConfigPtrClass=const, ModuleRef=Spi
          Pwm_17_Gtm_Init: Header=Pwm_17_Gtm.h, InitPhase=INIT_ONE, ConfigType=Pwm_17_Gtm_ConfigType, ConfigPtrName=Pwm_ConfigRoot, ConfigPtrClass=const, ModuleRef=Pwm
          Icu_17_GtmCcu6_Init: Header=Icu_17_GtmCcu6.h, InitPhase=INIT_ONE_LATE, ConfigType=Icu_17_GtmCcu6_ConfigType, ConfigPtrName=Icu_ConfigRoot, ConfigPtrClass=const, ModuleRef=Icu
          CanIf_InitMemory: Header=CanIf.h, InitPhase=INIT_MEMORY, ModuleRef=CanIf
          CanIf_Init: Header=CanIf.h, InitPhase=INIT_TWO_IF, ConfigType=CanIf_ConfigType, ConfigPtrName=CanIf_Config_Ptr, ConfigPtrClass=CANIF_INIT_DATA, ModuleRef=CanIf
          Uart_Init: Header=Uart.h, InitPhase=INIT_ONE, ConfigType=Uart_ConfigType, ConfigPtrName=Uart_ConfigRoot, ConfigPtrClass=const, ModuleRef=Uart
          I2c_Init: Header=I2c.h, InitPhase=INIT_ONE, ConfigType=I2c_ConfigType, ConfigPtrName=I2c_ConfigRoot, ConfigPtrClass=const, ModuleRef=I2c
          Can_Init: Header=Can.h, InitPhase=INIT_TWO_DRV, ConfigType=Can_ConfigType, ConfigPtrName=Can_Config_Ptr, ConfigPtrClass=CAN_INIT_DATA, ModuleRef=Can
          Can_InitMemory: Header=Can.h, InitPhase=INIT_MEMORY, ModuleRef=Can
          Com_Init: Header=Com.h, InitPhase=INIT_TWO_COM, ConfigType=Com_ConfigType, ConfigPtrName=Com_Config_Ptr, ConfigPtrClass=COM_INIT_DATA, ModuleRef=Com
          Com_InitMemory: Header=Com.h, InitPhase=INIT_MEMORY, ModuleRef=Com
          PduR_Init: Header=PduR.h, InitPhase=INIT_TWO_COM, ConfigType=PduR_PBConfigType, ConfigPtrName=PduR_Config_Ptr, ConfigPtrClass=PDUR_INIT_DATA, ModuleRef=PduR
          PduR_InitMemory: Header=PduR.h, InitPhase=INIT_MEMORY, ModuleRef=PduR
          CanTrcv_30_Tja1043_Init: Header=CanTrcv_30_Tja1043.h, InitPhase=INIT_TWO_TRCV, ConfigType=CanTrcv_30_Tja1043_ConfigType, ConfigPtrName=CanTrcv_30_Tja1043_Config_Ptr, ConfigPtrClass=CANTRCV_30_TJA1043_INIT_DATA, ModuleRef=CanTrcv
          CanTrcv_30_Tja1043_InitMemory: Header=CanTrcv_30_Tja1043.h, InitPhase=INIT_MEMORY, ModuleRef=CanTrcv
          CanSM_InitMemory: Header=CanSM_EcuM.h, InitPhase=INIT_MEMORY, ModuleRef=CanSM
          CanSM_Init: Header=CanSM_EcuM.h, InitPhase=INIT_TWO_SM, ConfigType=CanSM_ConfigType, ConfigPtrName=CanSM_Config_Ptr, ConfigPtrClass=CANSM_INIT_DATA, ModuleRef=CanSM
          ComM_InitMemory: Header=ComM.h, InitPhase=INIT_MEMORY, ModuleRef=ComM
          ComM_Init: Header=ComM.h, InitPhase=INIT_TWO_POST_NVMREADALL, ModuleRef=ComM
          CanTp_Init: Header=CanTp.h, InitPhase=INIT_TWO_TP, ConfigType=CanTp_ConfigType, ConfigPtrName=CanTp_Config_Ptr, ConfigPtrClass=CANTP_INIT_DATA, ModuleRef=CanTp
          CanTp_InitMemory: Header=CanTp.h, InitPhase=INIT_MEMORY, ModuleRef=CanTp
          Dcm_InitMemory: Header=Dcm.h, InitPhase=INIT_MEMORY, ModuleRef=Dcm
          Dcm_Init: Header=Dcm.h, InitPhase=INIT_TWO_POST_NVMREADALL, ConfigType=Dcm_ConfigType, ConfigPtrName=NULL_PTR, ConfigPtrClass=DCM_CONST, ModuleRef=Dcm
          Lin_Init: Header=Lin.h, InitPhase=INIT_TWO_DRV, ConfigType=Lin_ConfigType, ConfigPtrName=Lin_Config_Ptr, ConfigPtrClass=LIN_INIT_DATA, ModuleRef=Lin
          Lin_InitMemory: Header=Lin.h, InitPhase=INIT_MEMORY, ModuleRef=Lin
          LinSM_Init: Header=LinSM.h, InitPhase=INIT_TWO_SM, ConfigType=LinSM_ConfigType, ConfigPtrName=LinSM_Config_Ptr, ConfigPtrClass=LINSM_INIT_DATA, ModuleRef=LinSM
          LinSM_InitMemory: Header=LinSM.h, InitPhase=INIT_MEMORY, ModuleRef=LinSM
          LinIf_InitMemory: Header=LinIf.h, InitPhase=INIT_MEMORY, ModuleRef=LinIf
          LinIf_Init: Header=LinIf.h, InitPhase=INIT_TWO_IF, ConfigType=LinIf_ConfigType, ConfigPtrName=LinIf_Config_Ptr, ConfigPtrClass=LINIF_INIT_DATA, ModuleRef=LinIf
    EcucHardware
      3 x EcucCoreDefinition:
        EcucCore{0..2}: EcucCoreId={0..2}
    EcucPartitionCollection
      EcucPartition_Core0_QM (EcucPartition): EcucPartitionBswModuleExecution=false, PartitionCanBeRestarted=false, ASIL=QM, EcucPartitionSoftwareComponentInstanceRef=Os_OsCore_Core0_swc
    EcucPduCollection: PduIdTypeEnum=UINT8, PduLengthTypeEnum=UINT16
      127 x Pdu, all with J1939Requestable=false:
        PT_SCS_HSC2_FrP05_PP_SCS_HSC2_FrP05_Rx_0fb271d2_c07658fd: PduLength=8, SysTPduToFrameMappingRef=SCS_HSC2_FrP05  # SCS_HSC2_FrP05_oCAN00
        PT_DIAG_PhysReq_P2P_PP_DIAG_PhysReq_P2P_Rx_0fb271d2_c07658fd: PduLength=8, SysTPduToFrameMappingRef=DIAG_PhysReq_P2P  # DIAG_PhysReq_P2P_oCAN00
        PT_GW_HSC2_HCU_FrP01_PP_GW_HSC2_HCU_FrP01_Rx_0fb271d2_c07658fd: PduLength=8, SysTPduToFrameMappingRef=GW_HSC2_HCU_FrP01  # GW_HSC2_HCU_FrP01_oCAN00
        PT_P2P_HSC2_FrP03_PP_P2P_HSC2_FrP03_Tx_0fb271d2_c07658fd: PduLength=8, SysTPduToFrameMappingRef=P2P_HSC2_FrP03  # P2P_HSC2_FrP03_oCAN00
        PT_SCS_HSC2_FrP00_PP_SCS_HSC2_FrP00_Rx_0fb271d2_c07658fd: PduLength=8, SysTPduToFrameMappingRef=SCS_HSC2_FrP00  # SCS_HSC2_FrP00_oCAN00
        PT_P2P_HSC2_FrP01_PP_P2P_HSC2_FrP01_Tx_0fb271d2_c07658fd: PduLength=8, SysTPduToFrameMappingRef=P2P_HSC2_FrP01  # P2P_HSC2_FrP01_oCAN00
        PT_GW_HSC2_BCM_FrP07_PP_GW_HSC2_BCM_FrP07_Rx_0fb271d2_c07658fd: PduLength=2, SysTPduToFrameMappingRef=GW_HSC2_BCM_FrP07  # GW_HSC2_BCM_FrP07_oCAN00
        PT_DIAG_DTCInfo_P2P_PP_DIAG_DTCInfo_P2P_Tx_0fb271d2_c07658fd: PduLength=7, SysTPduToFrameMappingRef=DIAG_DTCInfo_P2P  # DIAG_DTCInfo_P2P_oCAN00
        PT_SCS_HSC2_FrP11_PP_SCS_HSC2_FrP11_Rx_0fb271d2_c07658fd: PduLength=8, SysTPduToFrameMappingRef=SCS_HSC2_FrP11  # SCS_HSC2_FrP11_oCAN00
        PT_EHBS_HSC2_FrP00_PP_EHBS_HSC2_FrP00_Rx_0fb271d2_c07658fd: PduLength=8, SysTPduToFrameMappingRef=EHBS_HSC2_FrP00  # EHBS_HSC2_FrP00_oCAN00
        PT_GW_HSC2_HCU_FrP13_PP_GW_HSC2_HCU_FrP13_Rx_0fb271d2_c07658fd: PduLength=8, SysTPduToFrameMappingRef=GW_HSC2_HCU_FrP13  # GW_HSC2_HCU_FrP13_oCAN00
        PT_SCS_HSC2_FrP15_PP_SCS_HSC2_FrP15_Rx_0fb271d2_c07658fd: PduLength=8, SysTPduToFrameMappingRef=SCS_HSC2_FrP15  # SCS_HSC2_FrP15_oCAN00
        PT_SAS_HSC2_FrP00_PP_SAS_HSC2_FrP00_Rx_0fb271d2_c07658fd: PduLength=8, SysTPduToFrameMappingRef=SAS_HSC2_FrP00  # SAS_HSC2_FrP00_oCAN00
        PT_SCS_HSC2_FrP02_PP_SCS_HSC2_FrP02_Rx_0fb271d2_c07658fd: PduLength=4, SysTPduToFrameMappingRef=SCS_HSC2_FrP02  # SCS_HSC2_FrP02_oCAN00
        PT_Tester_HSC2_GW_FrP14_PP_Tester_HSC2_GW_FrP14_Rx_0fb271d2_c07658fd: PduLength=6, SysTPduToFrameMappingRef=Tester_HSC2_GW_FrP14  # Tester_HSC2_GW_FrP14_oCAN00
        PT_GW_HSC2_FrP13_PP_GW_HSC2_FrP13_Rx_0fb271d2_c07658fd: PduLength=8, SysTPduToFrameMappingRef=GW_HSC2_FrP13  # GW_HSC2_FrP13_oCAN00
        PT_GW_HSC2_FrP01_PP_GW_HSC2_FrP01_Rx_0fb271d2_c07658fd: PduLength=8, SysTPduToFrameMappingRef=GW_HSC2_FrP01  # GW_HSC2_FrP01_oCAN00
        PT_DIAG_FuncReq_HSC2_PP_DIAG_FuncReq_HSC2_Rx_0fb271d2_c07658fd: PduLength=7, SysTPduToFrameMappingRef=DIAG_FuncReq_HSC2  # DIAG_FuncReq_HSC2_oCAN00
        PT_GW_HSC2_BCM_FrP04_PP_GW_HSC2_BCM_FrP04_Rx_0fb271d2_c07658fd: PduLength=8, SysTPduToFrameMappingRef=GW_HSC2_BCM_FrP04  # GW_HSC2_BCM_FrP04_oCAN00
        PT_P2P_HSC2_FrP04_PP_P2P_HSC2_FrP04_Tx_0fb271d2_c07658fd: PduLength=8, SysTPduToFrameMappingRef=P2P_HSC2_FrP04  # P2P_HSC2_FrP04_oCAN00
        PT_P2P_DIAG_DTCInfo_APA_PP_P2P_DIAG_DTCInfo_APA_Tx_0fb271d2_c07658fd: PduLength=7, SysTPduToFrameMappingRef=P2P_DIAG_DTCInfo_APA  # P2P_DIAG_DTCInfo_APA_oCAN00
        PT_GW_HSC2_ECM_FrP04_PP_GW_HSC2_ECM_FrP04_Rx_0fb271d2_c07658fd: PduLength=8, SysTPduToFrameMappingRef=GW_HSC2_ECM_FrP04  # GW_HSC2_ECM_FrP04_oCAN00
        PT_GW_HSC2_HCU_FrP00_PP_GW_HSC2_HCU_FrP00_Rx_0fb271d2_c07658fd: PduLength=8, SysTPduToFrameMappingRef=GW_HSC2_HCU_FrP00  # GW_HSC2_HCU_FrP00_oCAN00
        PT_P2P_HSC2_FrS01_PP_P2P_HSC2_FrS01_Tx_0fb271d2_c07658fd: PduLength=8, SysTPduToFrameMappingRef=P2P_HSC2_FrS01  # P2P_HSC2_FrS01_oCAN00
        PT_EPB_HSC2_FrP01_PP_EPB_HSC2_FrP01_Rx_0fb271d2_c07658fd: PduLength=2, SysTPduToFrameMappingRef=EPB_HSC2_FrP01  # EPB_HSC2_FrP01_oCAN00
        PT_GW_HSC2_FrP10_PP_GW_HSC2_FrP10_Rx_0fb271d2_c07658fd: PduLength=8, SysTPduToFrameMappingRef=GW_HSC2_FrP10  # GW_HSC2_FrP10_oCAN00
        PT_SCS_HSC2_FrP12_PP_SCS_HSC2_FrP12_Rx_0fb271d2_c07658fd: PduLength=8, SysTPduToFrameMappingRef=SCS_HSC2_FrP12  # SCS_HSC2_FrP12_oCAN00
        PT_GW_HSC2_SCU_FrP00_PP_GW_HSC2_SCU_FrP00_Rx_0fb271d2_c07658fd: PduLength=8, SysTPduToFrameMappingRef=GW_HSC2_SCU_FrP00  # GW_HSC2_SCU_FrP00_oCAN00
        PT_GW_HSC2_FICM_FrP08_PP_GW_HSC2_FICM_FrP08_Rx_0fb271d2_c07658fd: PduLength=8, SysTPduToFrameMappingRef=GW_HSC2_FICM_FrP08  # GW_HSC2_FICM_FrP08_oCAN00
        PT_GW_HSC2_IPK_FrP06_PP_GW_HSC2_IPK_FrP06_Rx_0fb271d2_c07658fd: PduLength=8, SysTPduToFrameMappingRef=GW_HSC2_IPK_FrP06  # GW_HSC2_IPK_FrP06_oCAN00
        PT_P2P_HSC2_FrP02_PP_P2P_HSC2_FrP02_Tx_0fb271d2_c07658fd: PduLength=8, SysTPduToFrameMappingRef=P2P_HSC2_FrP02  # P2P_HSC2_FrP02_oCAN00
        PT_GW_HSC2_BCM_FrP06_PP_GW_HSC2_BCM_FrP06_Rx_0fb271d2_c07658fd: PduLength=8, SysTPduToFrameMappingRef=GW_HSC2_BCM_FrP06  # GW_HSC2_BCM_FrP06_oCAN00
        PT_GW_HSC2_SDM_FrP00_PP_GW_HSC2_SDM_FrP00_Rx_0fb271d2_c07658fd: PduLength=8, SysTPduToFrameMappingRef=GW_HSC2_SDM_FrP00  # GW_HSC2_SDM_FrP00_oCAN00
        PT_GW_HSC2_FrP08_PP_GW_HSC2_FrP08_Rx_0fb271d2_c07658fd: PduLength=8, SysTPduToFrameMappingRef=GW_HSC2_FrP08  # GW_HSC2_FrP08_oCAN00
        PT_GW_HSC2_BCM_FrS16_PP_GW_HSC2_BCM_FrS16_Rx_0fb271d2_c07658fd: PduLength=8, SysTPduToFrameMappingRef=GW_HSC2_BCM_FrS16  # GW_HSC2_BCM_FrS16_oCAN00
        PT_P2P_HSC2_FrP00_PP_P2P_HSC2_FrP00_Tx_0fb271d2_c07658fd: PduLength=6, SysTPduToFrameMappingRef=P2P_HSC2_FrP00  # P2P_HSC2_FrP00_oCAN00
        PT_GW_HSC2_FrP00_PP_GW_HSC2_FrP00_Rx_0fb271d2_c07658fd: PduLength=6, SysTPduToFrameMappingRef=GW_HSC2_FrP00  # GW_HSC2_FrP00_oCAN00
        PT_EPS_HSC2_FrP02_PP_EPS_HSC2_FrP02_Rx_0fb271d2_c07658fd: PduLength=4, SysTPduToFrameMappingRef=EPS_HSC2_FrP02  # EPS_HSC2_FrP02_oCAN00
        PT_GW_HSC2_FrS00_PP_GW_HSC2_FrS00_Rx_0fb271d2_c07658fd: PduLength=8, SysTPduToFrameMappingRef=GW_HSC2_FrS00  # GW_HSC2_FrS00_oCAN00
        PT_EPB_HSC2_FrP00_PP_EPB_HSC2_FrP00_Rx_0fb271d2_c07658fd: PduLength=8, SysTPduToFrameMappingRef=EPB_HSC2_FrP00  # EPB_HSC2_FrP00_oCAN00
        PT_GW_HSC2_FICM_FrP02_PP_GW_HSC2_FICM_FrP02_Rx_0fb271d2_c07658fd: PduLength=8, SysTPduToFrameMappingRef=GW_HSC2_FICM_FrP02  # GW_HSC2_FICM_FrP02_oCAN00
        PT_SCS_HSC2_FrP01_PP_SCS_HSC2_FrP01_Rx_0fb271d2_c07658fd: PduLength=8, SysTPduToFrameMappingRef=SCS_HSC2_FrP01  # SCS_HSC2_FrP01_oCAN00
        PT_SCS_HSC2_FrP03_PP_SCS_HSC2_FrP03_Rx_0fb271d2_c07658fd: PduLength=8, SysTPduToFrameMappingRef=SCS_HSC2_FrP03  # SCS_HSC2_FrP03_oCAN00
        PT_Tester_HSC2_ECM_FrP00_PP_Tester_HSC2_ECM_FrP00_Rx_0fb271d2_c07658fd: PduLength=8, SysTPduToFrameMappingRef=Tester_HSC2_ECM_FrP00  # Tester_HSC2_ECM_FrP00_oCAN00
        PT_DIAG_PhysResp_P2P_PP_DIAG_PhysResp_P2P_Tx_0fb271d2_c07658fd: PduLength=8, SysTPduToFrameMappingRef=DIAG_PhysResp_P2P  # DIAG_PhysResp_P2P_oCAN00
        diag_request_tp_rx_physical_address: PduLength=8, SysTPduToFrameMappingRef=DIAG_PhysReq_P2P
        diag_response_tp_tx: PduLength=8, SysTPduToFrameMappingRef=DIAG_PhysResp_P2P
        diag_request_tp_rx_functional_address: PduLength=8, SysTPduToFrameMappingRef=DIAG_FuncReq_HSC2
        diag_PUDR_Physical_request: PduLength=8, SysTPduToFrameMappingRef=DIAG_PhysReq_P2P
        diag_PUDR_Functional_request: PduLength=8, SysTPduToFrameMappingRef=DIAG_FuncReq_HSC2
        diag_PDUR_response: PduLength=8
        PT_FICM_HSC4_FrP13_PP_FICM_HSC4_FrP13_Rx_c4eea277_b771686b: PduLength=8, SysTPduToFrameMappingRef=FICM_HSC4_FrP13  # FICM_HSC4_FrP13_oCAN01
        PT_GW_HSC4_BMS_FrP07_PP_GW_HSC4_BMS_FrP07_Rx_c4eea277_b771686b: PduLength=8, SysTPduToFrameMappingRef=GW_HSC4_BMS_FrP07  # GW_HSC4_BMS_FrP07_oCAN01
        PT_GW_HSC4_TBOX_FrP05_PP_GW_HSC4_TBOX_FrP05_Rx_c4eea277_b771686b: PduLength=8, SysTPduToFrameMappingRef=GW_HSC4_TBOX_FrP05  # GW_HSC4_TBOX_FrP05_oCAN01
        PT_FICM_HSC4_FrP33_PP_FICM_HSC4_FrP33_Rx_c4eea277_b771686b: PduLength=8, SysTPduToFrameMappingRef=FICM_HSC4_FrP33  # FICM_HSC4_FrP33_oCAN01
        PT_FICM_HSC4_FrP32_PP_FICM_HSC4_FrP32_Rx_c4eea277_b771686b: PduLength=8, SysTPduToFrameMappingRef=FICM_HSC4_FrP32  # FICM_HSC4_FrP32_oCAN01
        PT_FICM_HSC4_FrP08_PP_FICM_HSC4_FrP08_Rx_c4eea277_b771686b: PduLength=8, SysTPduToFrameMappingRef=FICM_HSC4_FrP08  # FICM_HSC4_FrP08_oCAN01
        PT_TPMS_HSC3_FrP02_PP_TPMS_HSC3_FrP02_Rx_c4eea277_b771686b: PduLength=8, SysTPduToFrameMappingRef=TPMS_HSC3_FrP02  # TPMS_HSC3_FrP02_oCAN01
        PT_GW_HSC4_TBOX_FrP01_PP_GW_HSC4_TBOX_FrP01_Rx_c4eea277_b771686b: PduLength=8, SysTPduToFrameMappingRef=GW_HSC4_TBOX_FrP01  # GW_HSC4_TBOX_FrP01_oCAN01
        PT_GW_HSC4_BCM_FrS10_PP_GW_HSC4_BCM_FrS10_Rx_c4eea277_b771686b: PduLength=8, SysTPduToFrameMappingRef=GW_HSC4_BCM_FrS10  # GW_HSC4_BCM_FrS10_oCAN01
        PT_P2P_HSC4_FrP03_PP_P2P_HSC4_FrP03_Tx_c4eea277_b771686b: PduLength=8, SysTPduToFrameMappingRef=P2P_HSC4_FrP03  # P2P_HSC4_FrP03_oCAN01
        PT_P2P_HSC4_FrS01_PP_P2P_HSC4_FrS01_Tx_c4eea277_b771686b: PduLength=8, SysTPduToFrameMappingRef=P2P_HSC4_FrS01  # P2P_HSC4_FrS01_oCAN01
        PT_GW_HSC4_TBOX_FrS10_PP_GW_HSC4_TBOX_FrS10_Rx_c4eea277_b771686b: PduLength=8, SysTPduToFrameMappingRef=GW_HSC4_TBOX_FrS10  # GW_HSC4_TBOX_FrS10_oCAN01
        PT_GW_HSC4_TC_FrP01_PP_GW_HSC4_TC_FrP01_Rx_c4eea277_b771686b: PduLength=8, SysTPduToFrameMappingRef=GW_HSC4_TC_FrP01  # GW_HSC4_TC_FrP01_oCAN01
        PT_P2P_IECU_HSC4_FrP02_PP_P2P_IECU_HSC4_FrP02_Tx_c4eea277_b771686b: PduLength=8, SysTPduToFrameMappingRef=P2P_IECU_HSC4_FrP02  # P2P_IECU_HSC4_FrP02_oCAN01
        PT_IPK_HSC4_FrP06_PP_IPK_HSC4_FrP06_Rx_c4eea277_b771686b: PduLength=8, SysTPduToFrameMappingRef=IPK_HSC4_FrP06  # IPK_HSC4_FrP06_oCAN01
        PT_GW_HSC4_BCM_FrS09_PP_GW_HSC4_BCM_FrS09_Rx_c4eea277_b771686b: PduLength=8, SysTPduToFrameMappingRef=GW_HSC4_BCM_FrS09  # GW_HSC4_BCM_FrS09_oCAN01
        PT_RDA_HSC4_P02_PP_RDA_HSC4_P02_Rx_c4eea277_b771686b: PduLength=8, SysTPduToFrameMappingRef=RDA_HSC4_P02  # RDA_HSC4_P02_oCAN01
        PT_TPMS_HSC3_FrP01_PP_TPMS_HSC3_FrP01_Rx_c4eea277_b771686b: PduLength=8, SysTPduToFrameMappingRef=TPMS_HSC3_FrP01  # TPMS_HSC3_FrP01_oCAN01
        PT_GW_HSC4_BCM_FrP04_PP_GW_HSC4_BCM_FrP04_Rx_c4eea277_b771686b: PduLength=8, SysTPduToFrameMappingRef=GW_HSC4_BCM_FrP04  # GW_HSC4_BCM_FrP04_oCAN01
        PT_P2P_IECU_HSC4_FrP01_PP_P2P_IECU_HSC4_FrP01_Tx_c4eea277_b771686b: PduLength=8, SysTPduToFrameMappingRef=P2P_IECU_HSC4_FrP01  # P2P_IECU_HSC4_FrP01_oCAN01
        PT_FICM_HSC4_FrP18_PP_FICM_HSC4_FrP18_Rx_c4eea277_b771686b: PduLength=8, SysTPduToFrameMappingRef=FICM_HSC4_FrP18  # FICM_HSC4_FrP18_oCAN01
        PT_GW_HSC4_PEPS_FrP01_PP_GW_HSC4_PEPS_FrP01_Rx_c4eea277_b771686b: PduLength=8, SysTPduToFrameMappingRef=GW_HSC4_PEPS_FrP01  # GW_HSC4_PEPS_FrP01_oCAN01
        PT_GW_HSC4_PEPS_FrP02_PP_GW_HSC4_PEPS_FrP02_Rx_c4eea277_b771686b: PduLength=8, SysTPduToFrameMappingRef=GW_HSC4_PEPS_FrP02  # GW_HSC4_PEPS_FrP02_oCAN01
        PT_FICM_HSC4_FrP02_PP_FICM_HSC4_FrP02_Rx_c4eea277_b771686b: PduLength=8, SysTPduToFrameMappingRef=FICM_HSC4_FrP02  # FICM_HSC4_FrP02_oCAN01
        PT_P2P_SecCH_GW_FrP10_PP_P2P_SecCH_GW_FrP10_Tx_427ad0d9_2e7839d1: PduLength=8, SysTPduToFrameMappingRef=P2P_SecCH_GW_FrP10  # P2P_SecCH_GW_FrP10_oCAN02
        PT_P2P_SecCH_BCM_FrP07_PP_P2P_SecCH_BCM_FrP07_Tx_427ad0d9_2e7839d1: PduLength=2, SysTPduToFrameMappingRef=P2P_SecCH_BCM_FrP07  # P2P_SecCH_BCM_FrP07_oCAN02
        PT_APA_SecCH_FrP01_PP_APA_SecCH_FrP01_Rx_427ad0d9_2e7839d1: PduLength=8, SysTPduToFrameMappingRef=APA_SecCH_FrP01  # APA_SecCH_FrP01_oCAN02
        PT_P2P_SecCH_SCU_FrP00_PP_P2P_SecCH_SCU_FrP00_Tx_427ad0d9_2e7839d1: PduLength=8, SysTPduToFrameMappingRef=P2P_SecCH_SCU_FrP00  # P2P_SecCH_SCU_FrP00_oCAN02
        PT_P2P_SecCH_TC_FrP07_PP_P2P_SecCH_TC_FrP07_Tx_427ad0d9_2e7839d1: PduLength=8, SysTPduToFrameMappingRef=P2P_SecCH_TC_FrP07  # P2P_SecCH_TC_FrP07_oCAN02
        PT_P2P_SecCH_FICM_FrP08_PP_P2P_SecCH_FICM_FrP08_Tx_427ad0d9_2e7839d1: PduLength=8, SysTPduToFrameMappingRef=P2P_SecCH_FICM_FrP08  # P2P_SecCH_FICM_FrP08_oCAN02
        PT_APA_SecCH_FrP03_PP_APA_SecCH_FrP03_Rx_427ad0d9_2e7839d1: PduLength=8, SysTPduToFrameMappingRef=APA_SecCH_FrP03  # APA_SecCH_FrP03_oCAN02
        PT_P2P_SecCH_GW_FrP00_PP_P2P_SecCH_GW_FrP00_Tx_427ad0d9_2e7839d1: PduLength=6, SysTPduToFrameMappingRef=P2P_SecCH_GW_FrP00  # P2P_SecCH_GW_FrP00_oCAN02
        PT_P2P_SecCH_SAS_FrP00_PP_P2P_SecCH_SAS_FrP00_Tx_427ad0d9_2e7839d1: PduLength=8, SysTPduToFrameMappingRef=P2P_SecCH_SAS_FrP00  # P2P_SecCH_SAS_FrP00_oCAN02
        PT_P2P_SecCH_BCM_FrP03_PP_P2P_SecCH_BCM_FrP03_Tx_427ad0d9_2e7839d1: PduLength=8, SysTPduToFrameMappingRef=P2P_SecCH_BCM_FrP03  # P2P_SecCH_BCM_FrP03_oCAN02
        PT_P2P_SecCH_EPS_FrP02_PP_P2P_SecCH_EPS_FrP02_Tx_427ad0d9_2e7839d1: PduLength=4, SysTPduToFrameMappingRef=P2P_SecCH_EPS_FrP02  # P2P_SecCH_EPS_FrP02_oCAN02
        PT_P2P_SecCH_SCS_FrP11_PP_P2P_SecCH_SCS_FrP11_Tx_427ad0d9_2e7839d1: PduLength=8, SysTPduToFrameMappingRef=P2P_SecCH_SCS_FrP11  # P2P_SecCH_SCS_FrP11_oCAN02
        PT_P2P_SecCH_EPB_FrP00_PP_P2P_SecCH_EPB_FrP00_Tx_427ad0d9_2e7839d1: PduLength=8, SysTPduToFrameMappingRef=P2P_SecCH_EPB_FrP00  # P2P_SecCH_EPB_FrP00_oCAN02
        PT_APA_SecCH_FrP00_PP_APA_SecCH_FrP00_Rx_427ad0d9_2e7839d1: PduLength=6, SysTPduToFrameMappingRef=APA_SecCH_FrP00  # APA_SecCH_FrP00_oCAN02
        PT_P2P_SecCH_GW_FrP13_PP_P2P_SecCH_GW_FrP13_Tx_427ad0d9_2e7839d1: PduLength=8, SysTPduToFrameMappingRef=P2P_SecCH_GW_FrP13  # P2P_SecCH_GW_FrP13_oCAN02
        PT_P2P_SecCH_GW_FrS00_PP_P2P_SecCH_GW_FrS00_Tx_427ad0d9_2e7839d1: PduLength=8, SysTPduToFrameMappingRef=P2P_SecCH_GW_FrS00  # P2P_SecCH_GW_FrS00_oCAN02
        PT_PDC_SecCH_FrP00_PP_PDC_SecCH_FrP00_Rx_427ad0d9_2e7839d1: PduLength=8, SysTPduToFrameMappingRef=PDC_SecCH_FrP00  # PDC_SecCH_FrP00_oCAN02
        PT_P2P_SecCH_HCU_ECM_FrP04_PP_P2P_SecCH_HCU_ECM_FrP04_Tx_427ad0d9_2e7839d1: PduLength=8, SysTPduToFrameMappingRef=P2P_SecCH_HCU_ECM_FrP04  # P2P_SecCH_HCU_ECM_FrP04_oCAN02
        PT_P2P_SecCH_FICM_FrP02_PP_P2P_SecCH_FICM_FrP02_Tx_427ad0d9_2e7839d1: PduLength=8, SysTPduToFrameMappingRef=P2P_SecCH_FICM_FrP02  # P2P_SecCH_FICM_FrP02_oCAN02
        PT_P2P_SecCH_BCM_FrP04_PP_P2P_SecCH_BCM_FrP04_Tx_427ad0d9_2e7839d1: PduLength=8, SysTPduToFrameMappingRef=P2P_SecCH_BCM_FrP04  # P2P_SecCH_BCM_FrP04_oCAN02
        PT_P2P_SecCH_ECM_FrP00_PP_P2P_SecCH_ECM_FrP00_Tx_427ad0d9_2e7839d1: PduLength=8, SysTPduToFrameMappingRef=P2P_SecCH_ECM_FrP00  # P2P_SecCH_ECM_FrP00_oCAN02
        PT_APA_SecCH_FrP04_PP_APA_SecCH_FrP04_Rx_427ad0d9_2e7839d1: PduLength=8, SysTPduToFrameMappingRef=APA_SecCH_FrP04  # APA_SecCH_FrP04_oCAN02
        PT_P2P_SecCH_HCU_FrP00_PP_P2P_SecCH_HCU_FrP00_Tx_427ad0d9_2e7839d1: PduLength=8, SysTPduToFrameMappingRef=P2P_SecCH_HCU_FrP00  # P2P_SecCH_HCU_FrP00_oCAN02
        PT_P2P_SecCH_SCS_FrP05_PP_P2P_SecCH_SCS_FrP05_Tx_427ad0d9_2e7839d1: PduLength=8, SysTPduToFrameMappingRef=P2P_SecCH_SCS_FrP05  # P2P_SecCH_SCS_FrP05_oCAN02
        PT_P2P_SecCH_SCS_FrP03_PP_P2P_SecCH_SCS_FrP03_Tx_427ad0d9_2e7839d1: PduLength=8, SysTPduToFrameMappingRef=P2P_SecCH_SCS_FrP03  # P2P_SecCH_SCS_FrP03_oCAN02
        PT_P2P_SecCH_SCS_FrP02_PP_P2P_SecCH_SCS_FrP02_Tx_427ad0d9_2e7839d1: PduLength=4, SysTPduToFrameMappingRef=P2P_SecCH_SCS_FrP02  # P2P_SecCH_SCS_FrP02_oCAN02
        PT_P2P_SecCH_SCS_FrP01_PP_P2P_SecCH_SCS_FrP01_Tx_427ad0d9_2e7839d1: PduLength=8, SysTPduToFrameMappingRef=P2P_SecCH_SCS_FrP01  # P2P_SecCH_SCS_FrP01_oCAN02
        PT_P2P_SecCH_GW_FrP01_PP_P2P_SecCH_GW_FrP01_Tx_427ad0d9_2e7839d1: PduLength=8, SysTPduToFrameMappingRef=P2P_SecCH_GW_FrP01  # P2P_SecCH_GW_FrP01_oCAN02
        PT_P2P_SecCH_SCS_FrP00_PP_P2P_SecCH_SCS_FrP00_Tx_427ad0d9_2e7839d1: PduLength=8, SysTPduToFrameMappingRef=P2P_SecCH_SCS_FrP00  # P2P_SecCH_SCS_FrP00_oCAN02
        PT_PDC_SecCH_FrP01_PP_PDC_SecCH_FrP01_Rx_427ad0d9_2e7839d1: PduLength=8, SysTPduToFrameMappingRef=PDC_SecCH_FrP01  # PDC_SecCH_FrP01_oCAN02
        PT_P2P_SecCH_GW_FrP08_PP_P2P_SecCH_GW_FrP08_Tx_427ad0d9_2e7839d1: PduLength=8, SysTPduToFrameMappingRef=P2P_SecCH_GW_FrP08  # P2P_SecCH_GW_FrP08_oCAN02
        PT_P2P_SecCH_HCU_FrP01_PP_P2P_SecCH_HCU_FrP01_Tx_427ad0d9_2e7839d1: PduLength=8, SysTPduToFrameMappingRef=P2P_SecCH_HCU_FrP01  # P2P_SecCH_HCU_FrP01_oCAN02
        PT_P2P_SecCH_IPK_FrP06_PP_P2P_SecCH_IPK_FrP06_Tx_427ad0d9_2e7839d1: PduLength=8, SysTPduToFrameMappingRef=P2P_SecCH_IPK_FrP06  # P2P_SecCH_IPK_FrP06_oCAN02
        PT_P2P_SecCH_SCS_FrP15_PP_P2P_SecCH_SCS_FrP15_Tx_427ad0d9_2e7839d1: PduLength=8, SysTPduToFrameMappingRef=P2P_SecCH_SCS_FrP15  # P2P_SecCH_SCS_FrP15_oCAN02
        PT_P2P_SecCH_SDM_FrP00_PP_P2P_SecCH_SDM_FrP00_Tx_427ad0d9_2e7839d1: PduLength=8, SysTPduToFrameMappingRef=P2P_SecCH_SDM_FrP00  # P2P_SecCH_SDM_FrP00_oCAN02
        PT_P2P_SecCH_Tester_GW_FrP14_PP_P2P_SecCH_Tester_GW_FrP14_Tx_427ad0d9_2e7839d1: PduLength=8, SysTPduToFrameMappingRef=P2P_SecCH_Tester_GW_FrP14  # P2P_SecCH_Tester_GW_FrP14_oCAN02
        PT_P2P_SecCH_SCS_FrP12_PP_P2P_SecCH_SCS_FrP12_Tx_427ad0d9_2e7839d1: PduLength=8, SysTPduToFrameMappingRef=P2P_SecCH_SCS_FrP12  # P2P_SecCH_SCS_FrP12_oCAN02
        PT_P2P_SecCH_EPB_FrP01_PP_P2P_SecCH_EPB_FrP01_Tx_427ad0d9_2e7839d1: PduLength=2, SysTPduToFrameMappingRef=P2P_SecCH_EPB_FrP01  # P2P_SecCH_EPB_FrP01_oCAN02
        PT_P2P_SecCH_HCU_FrP13_PP_P2P_SecCH_HCU_FrP13_Tx_427ad0d9_2e7839d1: PduLength=8, SysTPduToFrameMappingRef=P2P_SecCH_HCU_FrP13  # P2P_SecCH_HCU_FrP13_oCAN02
        PT_APA_SecCH_FrP02_PP_APA_SecCH_FrP02_Rx_427ad0d9_2e7839d1: PduLength=8, SysTPduToFrameMappingRef=APA_SecCH_FrP02  # APA_SecCH_FrP02_oCAN02
        PT_DIAG_DTCInfo_APA_PP_DIAG_DTCInfo_APA_Rx_427ad0d9_2e7839d1: PduLength=7, SysTPduToFrameMappingRef=DIAG_DTCInfo_APA  # DIAG_DTCInfo_APA_oCAN02
        PT_P2P_SecCH_FICM_FrP18_PP_P2P_SecCH_FICM_FrP18_Tx_427ad0d9_2e7839d1: PduLength=8, SysTPduToFrameMappingRef=P2P_SecCH_FICM_FrP18  # P2P_SecCH_FICM_FrP18_oCAN02
        PT_Read_LRU1_PP_Read_LRU1_Rx_45618847_8792e7c3: PduLength=8, SysTPduToFrameMappingRef=Read_LRU1  # Read_LRU1_oLIN00
        PT_Init_LRU1_PP_Init_LRU1_Tx_45618847_8792e7c3: PduLength=1, SysTPduToFrameMappingRef=Init_LRU1  # Init_LRU1_oLIN00
        PT_Init_SRU3_PP_Init_SRU3_Tx_45618847_8792e7c3: PduLength=2, SysTPduToFrameMappingRef=Init_SRU3  # Init_SRU3_oLIN00
        PT_Read_SRU3_PP_Read_SRU3_Rx_45618847_8792e7c3: PduLength=3, SysTPduToFrameMappingRef=Read_SRU3  # Read_SRU3_oLIN00
        PT_SlaveResp_Tp_PP_SlaveResp_Tp_Rx_45618847_8792e7c3: PduLength=8, SysTPduToFrameMappingRef=SlaveResp_Tp  # SlaveResp_Tp_oLIN00
        PT_MasterReq_Tp_PP_MasterReq_Tp_Tx_45618847_8792e7c3: PduLength=8, SysTPduToFrameMappingRef=MasterReq_Tp  # MasterReq_Tp_oLIN00
        Pdu_Aceinna_Accel: PduLength=8
        Pdu_Aceinna_AngleRate: PduLength=8
        Pdu_Aceinna_Angles: PduLength=8
        Pdu_CANextended_Tx_Test: PduLength=8
