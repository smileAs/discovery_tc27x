AUTOSAR XML (schema 4-2-1)
package /ActiveEcuC
  module config Can: implementation-config-variant=VARIANT-PRE-COMPILE, module-description=Can_Impl
    CanConfigSet
      CT_CAN00_388e5969 (CanController):
        CanControllerActivation = true
        CanBusoffProcessing = INTERRUPT
        CanControllerBaseAddress = 4026630656
        CanControllerId = 0
        CanRxProcessing = INTERRUPT
        CanTxProcessing = INTERRUPT
        CanWakeupProcessing = INTERRUPT
        CanWakeupSupport = false
        CanWakeupSourceId = 0
        CanPhysicalNode = Node0
        CanIOPort = b_011
        CanInterruptPriority = 10
        CanSRC = 0
        CanChannelCanObjectStartIndex = 0
        CanNumberOfCANObj = 7
        CanSrcTos = CPU0
        CanInterruptGroupPriority = 0
        CanClockFrequency = 80000000
        CanControllerDefaultBaudrate = CT_CAN00_388e5969/CanControllerBaudrateConfig
        CanWakeupSourceRef = CAN00_f26020e5
        CanCpuClockRef = McuClockReferencePoint
        CanControllerBaudrateConfig:
          CanControllerBaudRate = 500
          CanControllerBaudRateConfigID = 0
          CanControllerPropSeg = 5
          CanControllerSeg1 = 9
          CanControllerSeg2 = 5
          CanControllerSyncJumpWidth = 4
          CanBaudrateClock = 80000
          CanBaudratePrescaler = 8
          CanBaudrateDiv8 = false
        CanFilterMask: CanFilterMaskValue=0, CanFilterCodeValue=0, IsLocked=false
      3 x CanHardwareObject, all with CanHandleType=BASIC, CanIdType=STANDARD, CanIdValue=0, CanHwProcessing=false, CanMaxDataLen=8, CanFdPaddingValue=0:
        CN_CAN00_388e5969_Rx_Std: CanObjectType=RECEIVE, CanObjectId=1, CanObjectHwSize=2, CanObjectHwHandle=1, CanControllerRef=CT_CAN00_388e5969, CanFilterMaskRef=CT_CAN00_388e5969/CanFilterMask
        CN_CAN00_388e5969_Tx_Std: CanObjectType=TRANSMIT, CanObjectId=0, CanObjectHwSize=1, CanObjectHwHandle=0, CanControllerRef=CT_CAN00_388e5969
        CN_CAN01_388e5969_Tx_Std: CanObjectType=TRANSMIT, CanObjectId=2, CanObjectHwSize=1, CanObjectHwHandle=7, CanControllerRef=CT_CAN01_388e5969
      CT_CAN01_388e5969 (CanController):
        CanControllerActivation = true
        CanBusoffProcessing = INTERRUPT
        CanControllerBaseAddress = 4026630912
        CanControllerId = 1
        CanRxProcessing = INTERRUPT
        CanTxProcessing = INTERRUPT
        CanWakeupProcessing = INTERRUPT
        CanWakeupSupport = false
        CanWakeupSourceId = 0
        CanPhysicalNode = Node1
        CanIOPort = b_100
        CanInterruptPriority = 10
        CanSRC = 1
        CanChannelCanObjectStartIndex = 7
        CanNumberOfCANObj = 7
        CanSrcTos = CPU0
        CanInterruptGroupPriority = 0
        CanControllerDefaultBaudrate = CT_CAN01_388e5969/CanControllerBaudrateConfig
        CanWakeupSourceRef = CAN01_f26020e5
        CanCpuClockRef = McuClockReferencePoint
        CanControllerBaudrateConfig:
          CanControllerBaudRate = 500
          CanControllerBaudRateConfigID = 0
          CanControllerPropSeg = 5
          CanControllerSeg1 = 9
          CanControllerSeg2 = 5
          CanControllerSyncJumpWidth = 4
          CanBaudrateClock = 160000
          CanBaudratePrescaler = 16
          CanBaudrateDiv8 = false
        CanFilterMask: CanFilterMaskValue=0, CanFilterCodeValue=0, IsLocked=false
        CanFilterMask_001 (CanFilterMask): CanFilterMaskValue=0, CanFilterCodeValue=0, IsLocked=false
      3 x CanHardwareObject, all with CanHandleType=BASIC, CanIdType=STANDARD, CanIdValue=0, CanHwProcessing=false, CanObjectHwSize=1, CanMaxDataLen=8, CanFdPaddingValue=0:
        CN_CAN01_388e5969_Rx_Std: CanObjectType=RECEIVE, CanObjectId=3, CanObjectHwHandle=8, CanControllerRef=CT_CAN01_388e5969, CanFilterMaskRef=CT_CAN01_388e5969/CanFilterMask
        CN_CAN02_388e5969_Rx_Std: CanObjectType=RECEIVE, CanObjectId=6, CanObjectHwHandle=15, CanControllerRef=CT_CAN02_388e5969, CanFilterMaskRef=CT_CAN02_388e5969/CanFilterMask
        CN_CAN02_388e5969_Tx_Std: CanObjectType=TRANSMIT, CanObjectId=5, CanObjectHwHandle=14, CanControllerRef=CT_CAN02_388e5969
      CT_CAN02_388e5969 (CanController):
        CanControllerActivation = true
        CanBusoffProcessing = INTERRUPT
        CanControllerBaseAddress = 4026631168
        CanControllerId = 2
        CanRxProcessing = INTERRUPT
        CanTxProcessing = INTERRUPT
        CanWakeupProcessing = INTERRUPT
        CanWakeupSupport = false
        CanWakeupSourceId = 0
        CanPhysicalNode = Node2
        CanIOPort = b_001
        CanInterruptPriority = 10
        CanSRC = 2
        CanChannelCanObjectStartIndex = 14
        CanNumberOfCANObj = 7
        CanSrcTos = CPU0
        CanInterruptGroupPriority = 0
        CanControllerDefaultBaudrate = CT_CAN02_388e5969/CanControllerBaudrateConfig
        CanWakeupSourceRef = CAN02_f26020e5
        CanCpuClockRef = McuClockReferencePoint
        CanControllerBaudrateConfig:
          CanControllerBaudRate = 500
          CanControllerBaudRateConfigID = 0
          CanControllerPropSeg = 1
          CanControllerSeg1 = 13
          CanControllerSeg2 = 5
          CanControllerSyncJumpWidth = 4
          CanBaudrateClock = 160000
          CanBaudratePrescaler = 16
          CanBaudrateDiv8 = false
        CanFilterMask: CanFilterMaskValue=0, CanFilterCodeValue=0, IsLocked=false
      CanHardware_CN_CAN01_Rx_Std_Extended (CanHardwareObject):
        CanHandleType = BASIC
        CanIdType = EXTENDED
        CanIdValue = 0
        CanObjectId = 4
        CanObjectType = RECEIVE
        CanHwProcessing = false
        CanObjectHwSize = 1
        CanObjectHwHandle = 9
        CanMaxDataLen = 8
        CanFdPaddingValue = 0
        CanControllerRef = CT_CAN01_388e5969
        CanFilterMaskRef = CanFilterMask_001
    CanGeneral:
      CanIndex = 0
      CanChangeBaudrateApi = false
      CanDevErrorDetection = false
      CanHardwareCancellation = false
      CanIdenticalIdCancellation = false
      CanMainFunctionBusoffPeriod = 0.01
      CanMainFunctionModePeriod = 0.01
      CanMainFunctionWakeupPeriod = 0.01
      CanMultiplexedTransmission = false
      CanSetBaudrateApi = false
      CanTimeoutDuration = 0.01
      CanVersionInfoApi = false
      CanGenericPrecopy = false
      CanHardwareLoopCheck = true
      CanSecureTempBuffer = false
      CanRxFullCANSupport = false
      CanTxFullCANSupport = false
      CanRxBasicCANSupport = true
      CanUseNestedCANInterrupts = false
      CanHardwareCancelByAppl = false
      CanIndividualProcessing = false
      CanGenericConfirmation = false
      CanRxQueue = false
      CanSupportMixedID = true
      CanRxQueueSize = 10
      CanMultipleBasicCANObjects = true
      CanMultipleBasicCANTxObjects = false
      CanHardwareHandleType = UINT8
      CanOptimizeOneController = false
      CanInterruptCategory = CATEGORY2
      CanGetStatus = false
      CanInterruptLock = DRIVER
      CanWakeupSupport = false
      CanRamCheck = None
      CanOverrunNotification = None
      CanReinitStart = false
      CanGenericPreTransmit = false
      CanFdSupport = NONE
      CanRuntimeMeasurementSupport = false
      CanMaxRxDataLen = 8
      CanMaxTxDataLen = 8
      CanUsePeripheralAccessApi = false
      CanEnableMultipleCanDriver = false
      CanMaxNumberOfHwCANChannels = 8
      CanMaxNumberOfHwCANChannelsR = 0
      CanMaxNumberOfHwCANObj = 256
      CanMaxNumberOfHwCANObjR = 0
      CanClockDividerMode = NORMAL
      CanClockDivider = 1
      CanBaseAddress = 4026630144
      CanBaseAddressR = 0
      CanSrcAddress = 4026763520
      CanSrcAddressR = 0
      CanClockSourceSelection = Fclc
      CanFreezeDisable = false
      CanMirrorModeSupport = false
      CanUseOsInterruptControl = true
      CanRxHwFiFoFullNotification = false
      CanFdIsoSupport = false
      CanFdNiso = false
      CanFdPed = false
      CanCounterRef = SystemTimer_Core0
      CanMainFunctionRWPeriods
