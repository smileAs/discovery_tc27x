AUTOSAR XML (schema 4-2-1)
package /ActiveEcuC
  module config Rte: implementation-config-variant=VARIANT-PRE-COMPILE, module-description=Rte_Impl
    RteGeneration:
      RteGenerationMode = COMPATIBILITY_MODE
      RteIocInteractionReturnValue = RTE_IOC
      RteValueRangeCheckEnabled = false
      RteCalibrationSupport = NONE
      RteCodeVendorId = 30
      RteDevErrorDetect = false
      RteDevErrorDetectUninit = false
      RteMeasurementSupport = false
      RteOptimizationMode = MEMORY
      RteVfbTraceEnabled = false
      RteA2LVersion = V160
      RteCalibrationBufferSize = 1024
    RteInitializationBehavior: RteInitializationStrategy=RTE_INITIALIZATION_STRATEGY_AT_DATA_DECLARATION, RteSectionInitializationPolicy=INIT
    RteBswGeneral: RteSchMVersionInfoApi=false, RteUseComShadowSignalApi=false
    EcuM_EcuSwComposition (RteSwComponentInstance): RteSoftwareComponentInstanceRef=EcuM
      8 x RteEventToTaskMapping, all with RteImmediateRestart=false:
        OpEventSelectShutdownTarget_SelectShutdownTarget_EcuM_ShutdownTarget: RteEventRef=OpEventSelectShutdownTarget_SelectShutdownTarget_EcuM_ShutdownTarget
        OpEventGetShutdownTarget_GetShutdownTarget_EcuM_ShutdownTarget: RteEventRef=OpEventGetShutdownTarget_GetShutdownTarget_EcuM_ShutdownTarget
        OpEventGetLastShutdownTarget_GetLastShutdownTarget_EcuM_ShutdownTarget: RteEventRef=OpEventGetLastShutdownTarget_GetLastShutdownTarget_EcuM_ShutdownTarget
        OpEventSelectShutdownCause_SelectShutdownCause_EcuM_ShutdownTarget: RteEventRef=OpEventSelectShutdownCause_SelectShutdownCause_EcuM_ShutdownTarget
        OpEventGetShutdownCause_GetShutdownCause_EcuM_ShutdownTarget: RteEventRef=OpEventGetShutdownCause_GetShutdownCause_EcuM_ShutdownTarget
        OpEventSelectBootTarget_SelectBootTarget_EcuM_BootTarget: RteEventRef=OpEventSelectBootTarget_SelectBootTarget_EcuM_BootTarget
        OpEventGetBootTarget_GetBootTarget_EcuM_BootTarget: RteEventRef=OpEventGetBootTarget_GetBootTarget_EcuM_BootTarget
        Timer_EcuM_MainFunction: RtePositionInTask=7, RteEventRef=Timer_EcuM_MainFunction, RteUsedOsAlarmRef=Rte_Al_TE2_Default_BSW_Async_Task_Core0_0_10ms, RteUsedOsEventRef=Rte_Ev_Cyclic2_Default_BSW_Async_Task_Core0_10ms, RteMappedToTaskRef=Default_BSW_Async_Task_Core0
    BswM_EcuSwComposition (RteSwComponentInstance): RteSoftwareComponentInstanceRef=BswM
      Timer_BswM_MainFunction (RteEventToTaskMapping):
        RteImmediateRestart = false
        RtePositionInTask = 0
        RteEventRef = Timer_BswM_MainFunction
        RteMappedToTaskRef = Default_BSW_Async_Task_Core0
        RteUsedOsAlarmRef = Rte_Al_TE2_Default_BSW_Async_Task_Core0_0_10ms
        RteUsedOsEventRef = Rte_Ev_Cyclic2_Default_BSW_Async_Task_Core0_0_10ms
    7 x RteBswModuleInstance:
      Mcu: RteBswImplementationRef=Mcu_Impl, RteBswModuleConfigurationRef=Mcu
      BswM: RteBswImplementationRef=BswM_Impl, RteBswModuleConfigurationRef=BswM
        BSWM_EXCLUSIVE_AREA_0 (RteBswExclusiveAreaImpl): RteExclusiveAreaImplMechanism=ALL_INTERRUPT_BLOCKING, RteBswExclusiveAreaRef=BSWM_EXCLUSIVE_AREA_0
        BswM_MainFunctionTimingEvent0 (RteBswEventToTaskMapping):
          RteBswImmediateRestart = false
          RteBswPositionInTask = 0
          RteBswEventRef = BswM_MainFunctionTimingEvent0
          RteBswUsedOsAlarmRef = Rte_Al_TE2_Default_BSW_Async_Task_Core0_10ms
          RteBswUsedOsEventRef = Rte_Ev_Cyclic2_Default_BSW_Async_Task_Core0_10ms
          RteBswMappedToTaskRef = Default_BSW_Async_Task_Core0
      EcuM: RteBswImplementationRef=EcuM_Impl, RteBswModuleConfigurationRef=EcuM
        EcuM_MainFunctionTimingEvent0 (RteBswEventToTaskMapping):
          RteBswImmediateRestart = false
          RteBswPositionInTask = 7
          RteBswEventRef = EcuM_MainFunctionTimingEvent0
          RteBswUsedOsAlarmRef = Rte_Al_TE2_Default_BSW_Async_Task_Core0_10ms
          RteBswUsedOsEventRef = Rte_Ev_Cyclic2_Default_BSW_Async_Task_Core0_10ms
          RteBswMappedToTaskRef = Default_BSW_Async_Task_Core0
        3 x RteBswExclusiveAreaImpl, all with RteExclusiveAreaImplMechanism=ALL_INTERRUPT_BLOCKING:
          ECUM_EXCLUSIVE_AREA_{0..2}: RteBswExclusiveAreaRef=ECUM_EXCLUSIVE_AREA_{0..2}
        EcuM_MainFunctionTimingEvent1 (RteBswEventToTaskMapping):
          RteBswImmediateRestart = false
          RteBswPositionInTask = 0
          RteBswEventRef = EcuM_MainFunctionTimingEvent1
          RteBswMappedToTaskRef = Default_BSW_Async_Task_Core1
          RteBswUsedOsAlarmRef = Rte_Al_TE2_EcuM_EcuM_MainFunction
        EcuM_MainFunctionTimingEvent2 (RteBswEventToTaskMapping):
          RteBswImmediateRestart = false
          RteBswPositionInTask = 2
          RteBswEventRef = EcuM_MainFunctionTimingEvent2
          RteBswMappedToTaskRef = Default_BSW_Async_Task_Core2
          RteBswUsedOsAlarmRef = Rte_Al_TE3_EcuM_EcuM_MainFunction
      Rte: RteBswImplementationRef=Rte_Impl, RteBswModuleConfigurationRef=Rte
        Rte_ComSendSignalProxyPeriodicTimingEvent0 (RteBswEventToTaskMapping): RteBswImmediateRestart=false, RteBswEventRef=Rte_ComSendSignalProxyPeriodicTimingEvent0
      Dio: RteBswImplementationRef=Dio_Impl, RteBswModuleConfigurationRef=Dio
      Irq: RteBswImplementationRef=Irq_Impl, RteBswModuleConfigurationRef=Irq
      Gpt: RteBswImplementationRef=Gpt_Impl, RteBswModuleConfigurationRef=Gpt
    3 x RteSwComponentInstance:
      Os_OsCore_Core0_swc_EcuSwComposition: RteSoftwareComponentInstanceRef=Os_OsCore_Core0_swc
        OpEventGetCounterValue_GetCounterValue_OsService_SystemTimer_Core0 (RteEventToTaskMapping): RteImmediateRestart=false, RteEventRef=OpEventGetCounterValue_GetCounterValue_OsService_SystemTimer_Core0
        OpEventGetElapsedValue_GetElapsedValue_OsService_SystemTimer_Core0 (RteEventToTaskMapping): RteImmediateRestart=false, RteEventRef=OpEventGetElapsedValue_GetElapsedValue_OsService_SystemTimer_Core0
      Os_OsCore_Core1_swc_EcuSwComposition: RteSoftwareComponentInstanceRef=Os_OsCore_Core1_swc
        OpEventGetCounterValue_GetCounterValue_OsService_SystemTimer_Core1 (RteEventToTaskMapping):
          RteImmediateRestart = false
          RtePositionInTask = 0
          RteEventRef = OpEventGetCounterValue_GetCounterValue_OsService_SystemTimer_Core1
          RteMappedToTaskRef = Default_BSW_Async_Task_Core2
        OpEventGetElapsedValue_GetElapsedValue_OsService_SystemTimer_Core1 (RteEventToTaskMapping):
          RteImmediateRestart = false
          RtePositionInTask = 1
          RteEventRef = OpEventGetElapsedValue_GetElapsedValue_OsService_SystemTimer_Core1
          RteMappedToTaskRef = Default_BSW_Async_Task_Core2
      Os_OsCore_Core2_swc_EcuSwComposition: RteSoftwareComponentInstanceRef=Os_OsCore_Core2_swc
        OpEventGetCounterValue_GetCounterValue_OsService_SystemTimer_Core2 (RteEventToTaskMapping):
          RteImmediateRestart = false
          RtePositionInTask = 1
          RteEventRef = OpEventGetCounterValue_GetCounterValue_OsService_SystemTimer_Core2
          RteMappedToTaskRef = Default_BSW_Async_Task_Core1
        OpEventGetElapsedValue_GetElapsedValue_OsService_SystemTimer_Core2 (RteEventToTaskMapping):
          RteImmediateRestart = false
          RtePositionInTask = 2
          RteEventRef = OpEventGetElapsedValue_GetElapsedValue_OsService_SystemTimer_Core2
          RteMappedToTaskRef = Default_BSW_Async_Task_Core1
    RteOsInteraction
      10 x RteUsedOsActivation, all with RteExpectedActivationOffset=0, RteExpectedTickDuration=0:
        Rte_Al_TE2_Default_BSW_Async_Task_Core0_0_10ms: RteActivationOsAlarmRef=Rte_Al_TE2_Default_BSW_Async_Task_Core0_0_10ms, RteActivationOsTaskRef=Default_BSW_Async_Task_Core0
        Rte_Al_TE3_EcuM_EcuM_MainFunction: RteActivationOsAlarmRef=Rte_Al_TE3_EcuM_EcuM_MainFunction, RteActivationOsTaskRef=Default_BSW_Async_Task_Core2
        Rte_Al_TE2_Default_BSW_Async_Task_Core0_0_20ms: RteActivationOsAlarmRef=Rte_Al_TE2_Default_BSW_Async_Task_Core0_0_20ms, RteActivationOsTaskRef=Default_BSW_Async_Task_Core0
        Rte_Al_TE_disc_ecu_Core0_Task_10ms: RteActivationOsAlarmRef=Rte_Al_TE_disc_ecu_Core0_Task_10ms, RteActivationOsTaskRef=Default_BSW_Async_Task_Core0
        Rte_Al_TE_disc_ecu_Core0_Task_100ms: RteActivationOsAlarmRef=Rte_Al_TE_disc_ecu_Core0_Task_100ms, RteActivationOsTaskRef=Default_BSW_Async_Task_Core0
        Rte_Al_TE_disc_ecu_Core0_Task_20ms: RteActivationOsAlarmRef=Rte_Al_TE_disc_ecu_Core0_Task_20ms, RteActivationOsTaskRef=Default_BSW_Async_Task_Core0
        Rte_Al_TE_disc_ecu_Core0_Task_50ms: RteActivationOsAlarmRef=Rte_Al_TE_disc_ecu_Core0_Task_50ms, RteActivationOsTaskRef=Default_BSW_Async_Task_Core0
        Rte_Al_TE2_EcuM_EcuM_MainFunction: RteActivationOsAlarmRef=Rte_Al_TE2_EcuM_EcuM_MainFunction, RteActivationOsTaskRef=Default_BSW_Async_Task_Core1
        Rte_Al_TE_LinIf_LinIf_MainFunction: RteActivationOsAlarmRef=Rte_Al_TE_LinIf_LinIf_MainFunction, RteActivationOsTaskRef=Default_BSW_Async_Task_Core0
        Rte_Al_TE_Cycle_Task_1ms_Core0_Task_1ms: RteActivationOsAlarmRef=Rte_Al_TE_Cycle_Task_1ms_Core0_Task_1ms, RteActivationOsTaskRef=Core0_OsTask_1ms
    disc_ecu_EcuSwComposition (RteSwComponentInstance): RteSoftwareComponentInstanceRef=disc_ecu
      4 x RteEventToTaskMapping, all with RteImmediateRestart=false, RteMappedToTaskRef=Default_BSW_Async_Task_Core0:
        TMT_10ms_disc_ecu_main: RtePositionInTask=8, RteEventRef=TMT_10ms_disc_ecu_main, RteUsedOsEventRef=Rte_Ev_Run_disc_ecu_Core0_Task_10ms, RteUsedOsAlarmRef=Rte_Al_TE_disc_ecu_Core0_Task_10ms
        TMT_Core0_Task_100ms: RtePositionInTask=9, RteEventRef=TMT_Core0_Task_100ms, RteUsedOsEventRef=Rte_Ev_Run_disc_ecu_Core0_Task_100ms, RteUsedOsAlarmRef=Rte_Al_TE_disc_ecu_Core0_Task_100ms
        TMT_Core0_Task_20ms: RtePositionInTask=10, RteEventRef=TMT_Core0_Task_20ms, RteUsedOsEventRef=Rte_Ev_Run_disc_ecu_Core0_Task_20ms, RteUsedOsAlarmRef=Rte_Al_TE_disc_ecu_Core0_Task_20ms
        TMT_Core0_Task_50ms: RtePositionInTask=11, RteEventRef=TMT_Core0_Task_50ms, RteUsedOsEventRef=Rte_Ev_Run_disc_ecu_Core0_Task_50ms, RteUsedOsAlarmRef=Rte_Al_TE_disc_ecu_Core0_Task_50ms
    disc_ecu (RteSwComponentType): RteComponentTypeRef=disc_ecu, RteImplementationRef=disc_ecu_Implementation
      ComponentTypeCalibration (RteComponentTypeCalibration): RteCalibrationSupportEnabled=false
    11 x RteBswModuleInstance:
      Port: RteBswImplementationRef=Port_Impl, RteBswModuleConfigurationRef=Port
      Spi: RteBswImplementationRef=Spi_Impl, RteBswModuleConfigurationRef=Spi
        Spi_MainFunction_HandlingTimingEvent0 (RteBswEventToTaskMapping): RteBswImmediateRestart=false, RteBswEventRef=Spi_MainFunction_HandlingTimingEvent0
        7 x RteBswExclusiveAreaImpl, all with RteExclusiveAreaImplMechanism=ALL_INTERRUPT_BLOCKING:
          WriteIB: RteBswExclusiveAreaRef=WriteIB
          AsyncTransmit: RteBswExclusiveAreaRef=AsyncTransmit
          SyncTransmit: RteBswExclusiveAreaRef=SyncTransmit
          GetSequenceResult: RteBswExclusiveAreaRef=GetSequenceResult
          Cancel: RteBswExclusiveAreaRef=Cancel
          Init: RteBswExclusiveAreaRef=Init
          DeInit: RteBswExclusiveAreaRef=DeInit
      Pwm: RteBswImplementationRef=Pwm_Impl, RteBswModuleConfigurationRef=Pwm
      Icu: RteBswImplementationRef=Icu_Impl, RteBswModuleConfigurationRef=Icu
        6 x RteBswExclusiveAreaImpl, all with RteExclusiveAreaImplMechanism=ALL_INTERRUPT_BLOCKING:
          EnableWakeup: RteBswExclusiveAreaRef=EnableWakeup
          Ccu6IenUpdate: RteBswExclusiveAreaRef=Ccu6IenUpdate
          EnableNotification: RteBswExclusiveAreaRef=EnableNotification
          ResetEdgeCount: RteBswExclusiveAreaRef=ResetEdgeCount
          CcuInterruptHandle: RteBswExclusiveAreaRef=CcuInterruptHandle
          CcuVariableupdate: RteBswExclusiveAreaRef=CcuVariableupdate
      Can: RteBswImplementationRef=Can_Impl, RteBswModuleConfigurationRef=Can
        3 x RteBswEventToTaskMapping, all with RteBswImmediateRestart=false, RteBswMappedToTaskRef=Default_BSW_Async_Task_Core0, RteBswUsedOsEventRef=Rte_Ev_Cyclic2_Default_BSW_Async_Task_Core0_0_10ms, RteBswUsedOsAlarmRef=Rte_Al_TE2_Default_BSW_Async_Task_Core0_0_10ms:
          Can_MainFunction_BusOffTimingEvent0: RteBswPositionInTask=4, RteBswEventRef=Can_MainFunction_BusOffTimingEvent0
          Can_MainFunction_WakeupTimingEvent0: RteBswPositionInTask=6, RteBswEventRef=Can_MainFunction_WakeupTimingEvent0
          Can_MainFunction_ModeTimingEvent0: RteBswPositionInTask=5, RteBswEventRef=Can_MainFunction_ModeTimingEvent0
        7 x RteBswExclusiveAreaImpl, all with RteExclusiveAreaImplMechanism=ALL_INTERRUPT_BLOCKING:
          CAN_EXCLUSIVE_AREA_{0..6}: RteBswExclusiveAreaRef=CAN_EXCLUSIVE_AREA_{0..6}
      CanIf: RteBswImplementationRef=CanIf_Impl, RteBswModuleConfigurationRef=CanIf
        8 x RteBswExclusiveAreaImpl, all with RteExclusiveAreaImplMechanism=ALL_INTERRUPT_BLOCKING:
          CANIF_EXCLUSIVE_AREA_{0..7}: RteBswExclusiveAreaRef=CANIF_EXCLUSIVE_AREA_{0..7}
      Com: RteBswImplementationRef=Com_Impl, RteBswModuleConfigurationRef=Com
        Com_MainFunctionTxTimingEvent0 (RteBswEventToTaskMapping):
          RteBswImmediateRestart = false
          RteBswPositionInTask = 16
          RteBswEventRef = Com_MainFunctionTxTimingEvent0
          RteBswMappedToTaskRef = Default_BSW_Async_Task_Core0
          RteBswUsedOsEventRef = Rte_Ev_Cyclic2_Default_BSW_Async_Task_Core0_0_10ms
          RteBswUsedOsAlarmRef = Rte_Al_TE2_Default_BSW_Async_Task_Core0_0_10ms
        Com_MainFunctionRxTimingEvent0 (RteBswEventToTaskMapping):
          RteBswImmediateRestart = false
          RteBswPositionInTask = 15
          RteBswEventRef = Com_MainFunctionRxTimingEvent0
          RteBswMappedToTaskRef = Default_BSW_Async_Task_Core0
          RteBswUsedOsEventRef = Rte_Ev_Cyclic2_Default_BSW_Async_Task_Core0_0_10ms
          RteBswUsedOsAlarmRef = Rte_Al_TE2_Default_BSW_Async_Task_Core0_0_10ms
        3 x RteBswExclusiveAreaImpl, all with RteExclusiveAreaImplMechanism=ALL_INTERRUPT_BLOCKING:
          COM_EXCLUSIVE_AREA_TX: RteBswExclusiveAreaRef=COM_EXCLUSIVE_AREA_TX
          COM_EXCLUSIVE_AREA_RX: RteBswExclusiveAreaRef=COM_EXCLUSIVE_AREA_RX
          COM_EXCLUSIVE_AREA_BOTH: RteBswExclusiveAreaRef=COM_EXCLUSIVE_AREA_BOTH
      PduR: RteBswImplementationRef=PduR_Impl, RteBswModuleConfigurationRef=PduR
        PDUR_EXCLUSIVE_AREA_0 (RteBswExclusiveAreaImpl): RteExclusiveAreaImplMechanism=ALL_INTERRUPT_BLOCKING, RteBswExclusiveAreaRef=PDUR_EXCLUSIVE_AREA_0
        PDUR_EXCLUSIVE_AREA_1 (RteBswExclusiveAreaImpl): RteExclusiveAreaImplMechanism=ALL_INTERRUPT_BLOCKING, RteBswExclusiveAreaRef=PDUR_EXCLUSIVE_AREA_1
      CanTrcv: RteBswImplementationRef=CanTrcv_Impl, RteBswModuleConfigurationRef=CanTrcv
        CanTrcv_30_Tja1043_MainFunctionTimingEvent0 (RteBswEventToTaskMapping):
          RteBswImmediateRestart = false
          RteBswPositionInTask = 3
          RteBswEventRef = CanTrcv_30_Tja1043_MainFunctionTimingEvent0
          RteBswMappedToTaskRef = Default_BSW_Async_Task_Core0
          RteBswUsedOsEventRef = Rte_Ev_Cyclic2_Default_BSW_Async_Task_Core0_0_10ms
          RteBswUsedOsAlarmRef = Rte_Al_TE2_Default_BSW_Async_Task_Core0_0_10ms
        CANTRCV_30_TJA1043_EXCLUSIVE_AREA_0 (RteBswExclusiveAreaImpl): RteExclusiveAreaImplMechanism=ALL_INTERRUPT_BLOCKING, RteBswExclusiveAreaRef=CANTRCV_30_TJA1043_EXCLUSIVE_AREA_0
      CanSM: RteBswImplementationRef=CanSM_Impl, RteBswModuleConfigurationRef=CanSM
        CanSM_MainFunctionTimingEvent0 (RteBswEventToTaskMapping):
          RteBswImmediateRestart = false
          RteBswPositionInTask = 2
          RteBswEventRef = CanSM_MainFunctionTimingEvent0
          RteBswMappedToTaskRef = Default_BSW_Async_Task_Core0
          RteBswUsedOsEventRef = Rte_Ev_Cyclic2_Default_BSW_Async_Task_Core0_0_10ms
          RteBswUsedOsAlarmRef = Rte_Al_TE2_Default_BSW_Async_Task_Core0_0_10ms
        5 x RteBswExclusiveAreaImpl, all with RteExclusiveAreaImplMechanism=ALL_INTERRUPT_BLOCKING:
          CANSM_EXCLUSIVE_AREA_{1..5}: RteBswExclusiveAreaRef=CANSM_EXCLUSIVE_AREA_{1..5}
      ComM: RteBswImplementationRef=ComM_Impl, RteBswModuleConfigurationRef=ComM
        ComM_MainFunction_0TimingEvent0 (RteBswEventToTaskMapping):
          RteBswImmediateRestart = false
          RteBswPositionInTask = 1
          RteBswEventRef = ComM_MainFunction_0TimingEvent0
          RteBswMappedToTaskRef = Default_BSW_Async_Task_Core0
          RteBswUsedOsEventRef = Rte_Ev_Cyclic2_Default_BSW_Async_Task_Core0_0_20ms
          RteBswUsedOsAlarmRef = Rte_Al_TE2_Default_BSW_Async_Task_Core0_0_20ms
        COMM_EXCLUSIVE_AREA_0 (RteBswExclusiveAreaImpl): RteExclusiveAreaImplMechanism=ALL_INTERRUPT_BLOCKING, RteBswExclusiveAreaRef=COMM_EXCLUSIVE_AREA_0
        COMM_EXCLUSIVE_AREA_1 (RteBswExclusiveAreaImpl): RteExclusiveAreaImplMechanism=ALL_INTERRUPT_BLOCKING, RteBswExclusiveAreaRef=COMM_EXCLUSIVE_AREA_1
        3 x RteBswEventToTaskMapping, all with RteBswImmediateRestart=false, RteBswMappedToTaskRef=Default_BSW_Async_Task_Core0, RteBswUsedOsEventRef=Rte_Ev_Cyclic2_Default_BSW_Async_Task_Core0_0_20ms, RteBswUsedOsAlarmRef=Rte_Al_TE2_Default_BSW_Async_Task_Core0_0_20ms:
          ComM_MainFunction_1TimingEvent0: RteBswPositionInTask=14, RteBswEventRef=ComM_MainFunction_1TimingEvent0
          ComM_MainFunction_2TimingEvent0: RteBswPositionInTask=17, RteBswEventRef=ComM_MainFunction_2TimingEvent0
          ComM_MainFunction_3TimingEvent0: RteBswPositionInTask=18, RteBswEventRef=ComM_MainFunction_3TimingEvent0
    ComM_EcuSwComposition (RteSwComponentInstance): RteSoftwareComponentInstanceRef=ComM
      44 x RteEventToTaskMapping, all with RteImmediateRestart=false:
        Timer_ComM_MainFunction_0: RtePositionInTask=1, RteEventRef=Timer_ComM_MainFunction_0, RteMappedToTaskRef=Default_BSW_Async_Task_Core0, RteUsedOsEventRef=Rte_Ev_Cyclic2_Default_BSW_Async_Task_Core0_0_20ms, RteUsedOsAlarmRef=Rte_Al_TE2_Default_BSW_Async_Task_Core0_0_20ms
        OpEventLimitECUToNoComMode_LimitECUToNoComMode_modeLimitation: RteEventRef=OpEventLimitECUToNoComMode_LimitECUToNoComMode_modeLimitation
        OpEventReadInhibitCounter_ReadInhibitCounter_modeLimitation: RteEventRef=OpEventReadInhibitCounter_ReadInhibitCounter_modeLimitation
        OpEventResetInhibitCounter_ResetInhibitCounter_modeLimitation: RteEventRef=OpEventResetInhibitCounter_ResetInhibitCounter_modeLimitation
        OpEventSetECUGroupClassification_SetECUGroupClassification_modeLimitation: RteEventRef=OpEventSetECUGroupClassification_SetECUGroupClassification_modeLimitation
        OpEventLimitChannelToNoComMode_LimitChannelToNoComMode_CL_CAN00_f26020e5: RteEventRef=OpEventLimitChannelToNoComMode_LimitChannelToNoComMode_CL_CAN00_f26020e5
        OpEventRequestComMode_RequestComMode_UR_USR_CHNL_f276589c: RteEventRef=OpEventRequestComMode_RequestComMode_UR_USR_CHNL_f276589c
        OpEventGetInhibitionStatus_GetInhibitionStatus_CW_CAN00_f26020e5: RteEventRef=OpEventGetInhibitionStatus_GetInhibitionStatus_CW_CAN00_f26020e5
        OpEventPreventWakeUp_PreventWakeUp_CW_CAN00_f26020e5: RteEventRef=OpEventPreventWakeUp_PreventWakeUp_CW_CAN00_f26020e5
        OpEventGetInhibitionStatus_GetInhibitionStatus_CL_CAN00_f26020e5: RteEventRef=OpEventGetInhibitionStatus_GetInhibitionStatus_CL_CAN00_f26020e5
        OpEventGetMaxComMode_GetMaxComMode_UR_USR_CHNL_f276589c: RteEventRef=OpEventGetMaxComMode_GetMaxComMode_UR_USR_CHNL_f276589c
        OpEventGetRequestedComMode_GetRequestedComMode_UR_USR_CHNL_f276589c: RteEventRef=OpEventGetRequestedComMode_GetRequestedComMode_UR_USR_CHNL_f276589c
        OpEventGetCurrentComMode_GetCurrentComMode_UR_USR_CHNL_f276589c: RteEventRef=OpEventGetCurrentComMode_GetCurrentComMode_UR_USR_CHNL_f276589c
        OpEventPreventWakeUp_PreventWakeUp_CW_CAN01_f26020e5: RteEventRef=OpEventPreventWakeUp_PreventWakeUp_CW_CAN01_f26020e5
        OpEventGetInhibitionStatus_GetInhibitionStatus_CW_CAN01_f26020e5: RteEventRef=OpEventGetInhibitionStatus_GetInhibitionStatus_CW_CAN01_f26020e5
        OpEventLimitChannelToNoComMode_LimitChannelToNoComMode_CL_CAN01_f26020e5: RteEventRef=OpEventLimitChannelToNoComMode_LimitChannelToNoComMode_CL_CAN01_f26020e5
        Timer_ComM_MainFunction_1: RtePositionInTask=14, RteEventRef=Timer_ComM_MainFunction_1, RteMappedToTaskRef=Default_BSW_Async_Task_Core0, RteUsedOsEventRef=Rte_Ev_Cyclic2_Default_BSW_Async_Task_Core0_0_20ms, RteUsedOsAlarmRef=Rte_Al_TE2_Default_BSW_Async_Task_Core0_0_20ms
        OpEventRequestComMode_RequestComMode_UR_USR_CHNL_8571680a: RteEventRef=OpEventRequestComMode_RequestComMode_UR_USR_CHNL_8571680a
        OpEventGetRequestedComMode_GetRequestedComMode_UR_USR_CHNL_8571680a: RteEventRef=OpEventGetRequestedComMode_GetRequestedComMode_UR_USR_CHNL_8571680a
        OpEventGetInhibitionStatus_GetInhibitionStatus_CL_CAN01_f26020e5: RteEventRef=OpEventGetInhibitionStatus_GetInhibitionStatus_CL_CAN01_f26020e5
        OpEventGetMaxComMode_GetMaxComMode_UR_USR_CHNL_8571680a: RteEventRef=OpEventGetMaxComMode_GetMaxComMode_UR_USR_CHNL_8571680a
        OpEventGetCurrentComMode_GetCurrentComMode_UR_USR_CHNL_8571680a: RteEventRef=OpEventGetCurrentComMode_GetCurrentComMode_UR_USR_CHNL_8571680a
        OpEventGetCurrentComMode_GetCurrentComMode_UR_USR_CHNL_1c7839b0: RteEventRef=OpEventGetCurrentComMode_GetCurrentComMode_UR_USR_CHNL_1c7839b0
        Timer_ComM_MainFunction_2: RtePositionInTask=17, RteEventRef=Timer_ComM_MainFunction_2, RteMappedToTaskRef=Default_BSW_Async_Task_Core0, RteUsedOsEventRef=Rte_Ev_Cyclic2_Default_BSW_Async_Task_Core0_0_20ms, RteUsedOsAlarmRef=Rte_Al_TE2_Default_BSW_Async_Task_Core0_0_20ms
        OpEventPreventWakeUp_PreventWakeUp_CW_CAN02_f26020e5: RteEventRef=OpEventPreventWakeUp_PreventWakeUp_CW_CAN02_f26020e5
        OpEventGetInhibitionStatus_GetInhibitionStatus_CW_CAN02_f26020e5: RteEventRef=OpEventGetInhibitionStatus_GetInhibitionStatus_CW_CAN02_f26020e5
        OpEventLimitChannelToNoComMode_LimitChannelToNoComMode_CL_CAN02_f26020e5: RteEventRef=OpEventLimitChannelToNoComMode_LimitChannelToNoComMode_CL_CAN02_f26020e5
        OpEventRequestComMode_RequestComMode_UR_USR_CHNL_1c7839b0: RteEventRef=OpEventRequestComMode_RequestComMode_UR_USR_CHNL_1c7839b0
        OpEventGetMaxComMode_GetMaxComMode_UR_USR_CHNL_1c7839b0: RteEventRef=OpEventGetMaxComMode_GetMaxComMode_UR_USR_CHNL_1c7839b0
        OpEventGetRequestedComMode_GetRequestedComMode_UR_USR_CHNL_1c7839b0: RteEventRef=OpEventGetRequestedComMode_GetRequestedComMode_UR_USR_CHNL_1c7839b0
        OpEventGetInhibitionStatus_GetInhibitionStatus_CL_CAN02_f26020e5: RteEventRef=OpEventGetInhibitionStatus_GetInhibitionStatus_CL_CAN02_f26020e5
        Timer_ComM_MainFunction_3: RtePositionInTask=18, RteEventRef=Timer_ComM_MainFunction_3, RteMappedToTaskRef=Default_BSW_Async_Task_Core0, RteUsedOsEventRef=Rte_Ev_Cyclic2_Default_BSW_Async_Task_Core0_0_20ms, RteUsedOsAlarmRef=Rte_Al_TE2_Default_BSW_Async_Task_Core0_0_20ms
        OpEventGetMaxComMode_GetMaxComMode_UR_ComMUser_LIN: RteEventRef=OpEventGetMaxComMode_GetMaxComMode_UR_ComMUser_LIN
        OpEventGetRequestedComMode_GetRequestedComMode_UR_ComMUser_LIN: RteEventRef=OpEventGetRequestedComMode_GetRequestedComMode_UR_ComMUser_LIN
        OpEventRequestComMode_RequestComMode_UR_ComMUser_LIN: RteEventRef=OpEventRequestComMode_RequestComMode_UR_ComMUser_LIN
        OpEventGetCurrentComMode_GetCurrentComMode_UR_ComMUser_LIN: RteEventRef=OpEventGetCurrentComMode_GetCurrentComMode_UR_ComMUser_LIN
        OpEventGetInhibitionStatus_GetInhibitionStatus_CL_LIN00_f26020e5: RteEventRef=OpEventGetInhibitionStatus_GetInhibitionStatus_CL_LIN00_f26020e5
        OpEventGetInhibitionStatus_GetInhibitionStatus_CW_LIN00_f26020e5: RteEventRef=OpEventGetInhibitionStatus_GetInhibitionStatus_CW_LIN00_f26020e5
        OpEventGetRequestedComMode_GetRequestedComMode_UR_USR_CHNL_b592e7a2: RteEventRef=OpEventGetRequestedComMode_GetRequestedComMode_UR_USR_CHNL_b592e7a2
        OpEventRequestComMode_RequestComMode_UR_USR_CHNL_b592e7a2: RteEventRef=OpEventRequestComMode_RequestComMode_UR_USR_CHNL_b592e7a2
        OpEventLimitChannelToNoComMode_LimitChannelToNoComMode_CL_LIN00_f26020e5: RteEventRef=OpEventLimitChannelToNoComMode_LimitChannelToNoComMode_CL_LIN00_f26020e5
        OpEventGetMaxComMode_GetMaxComMode_UR_USR_CHNL_b592e7a2: RteEventRef=OpEventGetMaxComMode_GetMaxComMode_UR_USR_CHNL_b592e7a2
        OpEventPreventWakeUp_PreventWakeUp_CW_LIN00_f26020e5: RteEventRef=OpEventPreventWakeUp_PreventWakeUp_CW_LIN00_f26020e5
        OpEventGetCurrentComMode_GetCurrentComMode_UR_USR_CHNL_b592e7a2: RteEventRef=OpEventGetCurrentComMode_GetCurrentComMode_UR_USR_CHNL_b592e7a2
    CanTp (RteBswModuleInstance): RteBswImplementationRef=CanTp_Impl, RteBswModuleConfigurationRef=CanTp
      CanTp_MainFunctionTimingEvent0 (RteBswEventToTaskMapping):
        RteBswImmediateRestart = false
        RteBswPositionInTask = 12
        RteBswEventRef = CanTp_MainFunctionTimingEvent0
        RteBswMappedToTaskRef = Default_BSW_Async_Task_Core0
        RteBswUsedOsEventRef = Rte_Ev_Cyclic2_Default_BSW_Async_Task_Core0_0_10ms
        RteBswUsedOsAlarmRef = Rte_Al_TE2_Default_BSW_Async_Task_Core0_0_10ms
      CANTP_EXCLUSIVE_AREA_0 (RteBswExclusiveAreaImpl): RteExclusiveAreaImplMechanism=ALL_INTERRUPT_BLOCKING, RteBswExclusiveAreaRef=CANTP_EXCLUSIVE_AREA_0
    Dcm (RteBswModuleInstance): RteBswImplementationRef=Dcm_Impl, RteBswModuleConfigurationRef=Dcm
      Dcm_MainFunctionTimingEvent0 (RteBswEventToTaskMapping):
        RteBswImmediateRestart = false
        RteBswPositionInTask = 13
        RteBswEventRef = Dcm_MainFunctionTimingEvent0
        RteBswMappedToTaskRef = Default_BSW_Async_Task_Core0
        RteBswUsedOsEventRef = Rte_Ev_Cyclic2_Default_BSW_Async_Task_Core0_0_10ms
        RteBswUsedOsAlarmRef = Rte_Al_TE2_Default_BSW_Async_Task_Core0_0_10ms
      DCM_EXCLUSIVE_AREA_0 (RteBswExclusiveAreaImpl): RteExclusiveAreaImplMechanism=ALL_INTERRUPT_BLOCKING, RteBswExclusiveAreaRef=DCM_EXCLUSIVE_AREA_0
    Dcm_EcuSwComposition (RteSwComponentInstance): RteSoftwareComponentInstanceRef=Dcm
      6 x RteEventToTaskMapping, all with RteImmediateRestart=false:
        Timer_Dcm_MainFunction: RtePositionInTask=13, RteEventRef=Timer_Dcm_MainFunction, RteMappedToTaskRef=Default_BSW_Async_Task_Core0, RteUsedOsEventRef=Rte_Ev_Cyclic2_Default_BSW_Async_Task_Core0_0_10ms, RteUsedOsAlarmRef=Rte_Al_TE2_Default_BSW_Async_Task_Core0_0_10ms
        OpEventGetActiveProtocol_GetActiveProtocol_DCMServices: RteEventRef=OpEventGetActiveProtocol_GetActiveProtocol_DCMServices
        OpEventGetSesCtrlType_GetSesCtrlType_DCMServices: RteEventRef=OpEventGetSesCtrlType_GetSesCtrlType_DCMServices
        OpEventResetToDefaultSession_ResetToDefaultSession_DCMServices: RteEventRef=OpEventResetToDefaultSession_ResetToDefaultSession_DCMServices
        OpEventSetActiveDiagnostic_SetActiveDiagnostic_DCMServices: RteEventRef=OpEventSetActiveDiagnostic_SetActiveDiagnostic_DCMServices
        OpEventGetRequestKind_GetRequestKind_DCMServices: RteEventRef=OpEventGetRequestKind_GetRequestKind_DCMServices
    3 x RteBswModuleInstance:
      Lin: RteBswImplementationRef=Lin_Impl, RteBswModuleConfigurationRef=Lin
      LinSM: RteBswImplementationRef=LinSM_Impl, RteBswModuleConfigurationRef=LinSM
        LinSM_MainFunctionTimingEvent0 (RteBswEventToTaskMapping):
          RteBswImmediateRestart = false
          RteBswPositionInTask = 20
          RteBswEventRef = LinSM_MainFunctionTimingEvent0
          RteBswMappedToTaskRef = Default_BSW_Async_Task_Core0
          RteBswUsedOsEventRef = Rte_Ev_Cyclic2_Default_BSW_Async_Task_Core0_0_10ms
          RteBswUsedOsAlarmRef = Rte_Al_TE2_Default_BSW_Async_Task_Core0_0_10ms
        4 x RteBswExclusiveAreaImpl, all with RteExclusiveAreaImplMechanism=ALL_INTERRUPT_BLOCKING:
          LINSM_EXCLUSIVE_AREA_{0..3}: RteBswExclusiveAreaRef=LINSM_EXCLUSIVE_AREA_{0..3}
      LinIf: RteBswImplementationRef=LinIf_Impl, RteBswModuleConfigurationRef=LinIf
        LinIf_MainFunctionTimingEvent0 (RteBswEventToTaskMapping):
          RteBswImmediateRestart = false
          RteBswPositionInTask = 19
          RteBswEventRef = LinIf_MainFunctionTimingEvent0
          RteBswMappedToTaskRef = Default_BSW_Async_Task_Core0
          RteBswUsedOsEventRef = Rte_Ev_Run_LinIf_LinIf_MainFunction
          RteBswUsedOsAlarmRef = Rte_Al_TE_LinIf_LinIf_MainFunction
        LINIF_EXCLUSIVE_AREA_0 (RteBswExclusiveAreaImpl): RteExclusiveAreaImplMechanism=ALL_INTERRUPT_BLOCKING, RteBswExclusiveAreaRef=LINIF_EXCLUSIVE_AREA_0
        LINIF_EXCLUSIVE_AREA_1 (RteBswExclusiveAreaImpl): RteExclusiveAreaImplMechanism=ALL_INTERRUPT_BLOCKING, RteBswExclusiveAreaRef=LINIF_EXCLUSIVE_AREA_1
    Cycle_Task_1ms_EcuSwComposition (RteSwComponentInstance): RteSoftwareComponentInstanceRef=Cycle_Task_1ms
      TMT_Core0_Task_1ms (RteEventToTaskMapping):
        RteImmediateRestart = false
        RtePositionInTask = 0
        RteEventRef = TMT_Core0_Task_1ms
        RteMappedToTaskRef = Core0_OsTask_1ms
        RteUsedOsAlarmRef = Rte_Al_TE_Cycle_Task_1ms_Core0_Task_1ms
    cycle_task (RteSwComponentType): RteComponentTypeRef=cycle_task, RteImplementationRef=cycle_task_Implementation
      ComponentTypeCalibration (RteComponentTypeCalibration): RteCalibrationSupportEnabled=false
