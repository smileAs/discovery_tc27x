AUTOSAR XML (schema 4-3-0)
package /ECUCompositionTypes
  composition sw component type ECU_Composition
    component Cycle_Task_1ms: type=cycle_task
    component disc_ecu: type=disc_ecu
package /EndToEndProtections
  end to end protection set EndToEndConnections
package /VehicleProject
  system System: category=SYSTEM_EXTRACT
    system mapping System_MPPNG
    root-software-compositions:
      root sw composition prototype ECU_Composition: software-composition=ECU_Composition
