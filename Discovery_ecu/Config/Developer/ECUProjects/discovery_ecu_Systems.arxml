AUTOSAR XML (schema 4-3-0)
package /DaVinci/PKG_ECU
  ecu instance discovery_ecu
package /ECUCompositionTypes
  composition sw component type ECU_Composition
    component disc_ecu: type=disc_ecu
package /EndToEndProtections
  end to end protection set EndToEndConnections
package /Systems
  system discovery_ecu: category=SYSTEM_EXTRACT
    system mapping discovery_ecu_MPPNG
      sw-mappings:
        swc to ecu mapping discovery_ecu_Mapping: component=ECU_Composition.disc_ecu, ecu-instance=discovery_ecu
    root-software-compositions:
      root sw composition prototype ECU_Composition: software-composition=ECU_Composition
