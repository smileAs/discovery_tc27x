AUTOSAR XML (schema 4-3-0)
standard types defined: boolean, sint16, uint16, uint32, uint8
package /DataType
  base type uint8_7_iso_8859_1: category=FIXED_LENGTH, base-type-size=56, base-type-encoding=ISO-8859-1
  base type uint8_8_iso_8859_1: category=FIXED_LENGTH, base-type-size=64, base-type-encoding=ISO-8859-1
package /DataType/Semantics
  compu method CM_ABSA_SecCAN2: phys=raw for raw 0..1, 0=Cx0_False, 1=Cx1_True
  compu method CM_ABSAHSC2: phys=raw for raw 0..1, 0=Cx0_False, 1=Cx1_True
  compu method CM_AirbagDplHSC2: phys=raw for raw 0..1, 0=Cx0_False, 1=Cx1_True
  compu method CM_AirbagDplInvsnHSC2: phys=raw for raw 0..1, 0=Cx0_Airbag_Deployed (Airbag Deployed), 1=Cx1_No_Airbag_Deployed (No Airbag Deployed)
  compu method CM_AlisysrdyHSC4: phys=raw for raw 0..1, 0=Cx0_not_ready (not ready), 1=Cx1_ready
  compu method CM_APAAlvRC_sech2_SecCAN2: phys=raw for raw 0..255
  compu method CM_APAAlvRCHSC2: phys=raw for raw 0..255, 0=Cx00_0x0_0xFF_ ((0x0 - 0xFF))
  compu method CM_APAChksm_sech2_SecCAN2: phys=raw for raw 0..255
  compu method CM_APAChksmHSC2: phys=raw for raw 0..255, 0=Cx00_0x0_0xFF_ ((0x0 - 0xFF))
  compu method CM_APACmdEPSSts_sech2_SecCAN2: phys=raw for raw 0..3, 0=Cx0_No_request (No request), 1=Cx1_Control_EPS_request (Control EPS request), 2=Cx2_EPS_control (EPS control)
  compu method CM_APACmdEPSStsHSC2: phys=raw for raw 0..3, 0=Cx0_No_request (No request), 1=Cx1_Control_EPS_request (Control EPS request), 2=Cx2_EPS_control (EPS control)
  compu method CM_APACrpSpdReqSts_sech2_SecCAN2: phys=raw for raw 0..1, 0=Cx0_No_Request (No Request), 1=Cx1_Request
  compu method CM_APACrpSpdReqStsHSC2: phys=raw for raw 0..1, 0=Cx0_No_Request (No Request), 1=Cx1_Request
  compu method CM_APACrpSpdReqVal_sech2_SecCAN2: phys=raw*0.1 for raw 0..62; unit km/h
  compu method CM_APACrpSpdReqValHSC2: 0=Cx00_km_h_0x0_0x3F_ (km/h (0x0 - 0x3F)), phys=raw*0.1 for raw 0..62; unit km/h
  compu method CM_APACtrlAbotdRsn_SecCAN2: phys=raw for raw 0..15, 0=Cx0_No_Aborted (No Aborted), 1=Cx1_Driver_interference_SCU (Driver interference SCU), 2=Cx2_Driver_interference_Braking_System (Driver interference Braking System), 3=Cx3_Charger_is_connected (Charger is connected), 4=Cx4_Communication_Error (Communication Error), 5=Cx5_In_post_collision (In post collision), 6=Cx6_Energy_Low (Energy Low), 7=Cx7_Gradient_over_threshold (Gradient over threshold), 8=Cx8_Crank_Failed (Crank Failed), 9=Cx9_Reserve, 10=CxA_Reserve, 11=CxB_Reserve, 12=CxC_Reserve, 13=CxD_Reserve, 14=CxE_Reserve, 15=CxF_Unknown_Reason (Unknown Reason)
  compu method CM_APACtrlAbotdRsnHSC2: phys=raw for raw 0..15, 0=Cx0_No_Aborted (No Aborted), 1=Cx1_Driver_interference_SCU (Driver interference SCU), 2=Cx2_Driver_interference_Braking_System (Driver interference Braking System), 3=Cx3_Charger_is_connected (Charger is connected), 4=Cx4_Communication_Error (Communication Error), 5=Cx5_In_post_collision (In post collision), 6=Cx6_Energy_Low (Energy Low), 7=Cx7_Gradient_over_threshold (Gradient over threshold), 8=Cx8_Crank_Failed (Crank Failed), 9=Cx9_Reserve, 10=CxA_Reserve, 11=CxB_Reserve, 12=CxC_Reserve, 13=CxD_Reserve, 14=CxE_Reserve, 15=CxF_Unknown_Reason (Unknown Reason)
  compu method CM_APAEPBOPReq_sech2_SecCAN2: phys=raw for raw 0..3, 0=Cx0_No_Request (No Request), 1=Cx1_Apply, 2=Cx2_Release
  compu method CM_APAEPBOPReqHSC2: phys=raw for raw 0..3, 0=Cx0_No_Request (No Request), 1=Cx1_Apply, 2=Cx2_Release
  compu method CM_APAEPBOpReqValPV_sech2_SecCAN2: phys=raw for raw 0..255
  compu method CM_APAEPBOpReqValPVHSC2: phys=raw for raw 0..255, 0=Cx00_0x0_0xFF_ ((0x0 - 0xFF))
  compu method CM_APAEPBReqAlvRC_sech2_SecCAN2: phys=raw for raw 0..15
  compu method CM_APAEPBReqAlvRCHSC2: phys=raw for raw 0..15, 0=Cx0_0x0_0xF_ ((0x0 - 0xF))
  compu method CM_APAF_sech2_SecCAN2: phys=raw for raw 0..1, 0=Cx0_Normal, 1=Cx1_APA_failure (APA failure)
  compu method CM_APAFHSC2: phys=raw for raw 0..1, 0=Cx0_Normal, 1=Cx1_APA_failure (APA failure)
  compu method CM_APAInfoDispReq_sech2_SecCAN2: phys=raw for raw 0..63, 0=Cx00_Reserved, 1=Cx01_Please_select_parking_mode (Please select parking mode), 2=Cx02_Vehicle_speed_is_too_high_APA_system_abort (Vehicle speed is too high, APA system abort), 3=Cx03_Vehicle_speed_is_too_high_please_be_slow_down (Vehicle speed is too high, please be slow down), 4=Cx04_Parking_slot_searching (Parking slot searching), 5=Cx05_APA_system_quit (APA system quit), 6=Cx06_Please_drive_forward (Please drive forward), 7=Cx07_Please_stop_the_car_ (Please stop the car), 8=Cx08_Please_select_park_in_direction_or_turn_on_direction_indicator (Please select park in direction or turn on direction indicator), 9=Cx09_External_Disturbance_System_stop_work (External Disturbance, System stop work), 10=Cx0A_Reserved, 11=Cx0B_Reserved, 12=Cx0C_Reserved, 13=Cx0D_Reserved, 14=Cx0E_Reserved, 15=Cx0F_Reserved, 16=Cx10_Please_fasten_seat_belt (Please fasten seat belt), 17=Cx11_Door_is_open_Parking_manoeuvre_quit (Door is open: Parking manoeuvre quit), 18=Cx12_System_failed_APA_system_is_useless (System failed, APA system is useless), 19=Cx13_Please_close_the_door (Please close the door), 20=Cx14_Reserved, 21=Cx15_Reserved, 22=Cx16_Reserved, 23=Cx17_Please_step_brake_pedal_if_you_want_to_use_parking_manoeuvre (Please step brake pedal if you want to use parking manoeuvre), 24=Cx18_Reserved, 25=Cx19_Reserved, 26=Cx1A_Reserved, 27=Cx1B_Reserved, 28=Cx1C_Reserved, 29=Cx1D_Reserved, 30=Cx1E_Reserved, 31=Cx1F_Reserved, 32=Cx20_APA_switch_no_press_parking_manoeuvre_quit (APA switch no press, parking manoeuvre quit), 33=Cx21_Danger_zone_has_obstacle_parking_manoeuvre_suspend (Danger zone has obstacle, parking manoeuvre suspend), 34=Cx22_Do_not_touch_steering_wheel_during_parking_process_parking_manoeuvre_quit (Do not touch steering wheel during parking process, parking manoeuvre quit), 35=Cx23_Step_on_the_gas_Parking_manoeuvre_quit (Step on the gas: Parking manoeuvre quit), 36=Cx24_Brake_pedal_has_been_pushed_Parking_manoeuvre_quit (Brake pedal has been pushed: Parking manoeuvre quit), 37=Cx25_Shifter_lever_has_been_controlled_Parking_manoeuvre_quit (Shifter lever has been controlled: Parking manoeuvre quit), 38=Cx26_APA_system_abort_Please_take_over_vehicle (APA system abort, Please take over vehicle), 39=Cx27_Gradient_too_large_APA_system_quit (Gradient too large�� APA system quit), 40=Cx28_Reserved, 41=Cx29_Reserved, 42=Cx2A_Please_keep_away_steering_wheel_and_press_APA_switch_if_you_want_to_parking_in (Please keep away steering wheel and press APA switch if you want to parking in), 43=Cx2B_Parking_is_ready (Parking is ready), 44=Cx2C_Please_release_brake_and_pay_attention_to_surroundings_using_active_control_measure_if_necessary_ (Please release brake and pay attention to surroundings, using active control measure if necessary), 45=Cx2D_Parking_is_ongoing (Parking is ongoing), 46=Cx2E_Parking_manoeuvre_has_completed_Please_take_over_vehicle (Parking manoeuvre has completed: Please take over vehicle), 47=Cx2F_Please_keep_away_steering_wheel_and_re_press_APA_switch_if_you_want_to_parking_in_continually (Please keep away steering wheel and re-press APA switch if you want to parking in continually), 48=Cx30_System_timeout_APA_system_quit (System timeout, APA system quit), 49=Cx31_Please_select_park_out_direction_or_turn_on_direction_indicator (Please select park out direction or turn on direction indicator), 50=Cx32_Please_keep_away_steering_wheel_and_press_APA_switch_if_you_want_to_park_out (Please keep away steering wheel and press APA switch if you want to park out), 51=Cx33_Please_keep_away_steering_wheel_and_re_press_APA_switch_if_you_want_to_park_out_continually (Please keep away steering wheel and re-press APA switch if you want to park out continually), 52=Cx34_Reserved, 53=Cx35_Reserved, 54=Cx36_Reserved, 55=Cx37_Please_select_reverse_gear_and_keep_away_steering_wheel (Please select reverse gear and keep away steering wheel), 56=Cx38_Be_careful_drive_backward_and_prepare_for_stop (Be careful drive backward and prepare for stop), 57=Cx39_Please_select_drive_gear_and_move_forward (Please select drive gear and move forward), 58=Cx3A_Be_careful_drive_forward_and_prepare_for_stop (Be careful drive forward and prepare for stop), 59=Cx3B_Please_select_reverse_gear_and_move_backward (Please select reverse gear and move backward), 60=Cx3C_Vehicle_is_going_to_move_forward (Vehicle is going to move forward), 61=Cx3D_Vehicle_is_going_to_move_backward (Vehicle is going to move backward), 62=Cx3E_Reserved, 63=Cx3F_Reserved
  compu method CM_APAInfoDispReqHSC2: phys=raw for raw 0..63, 0=Cx00_Reserved, 1=Cx01_Please_select_parking_mode (Please select parking mode), 2=Cx02_Vehicle_speed_is_too_high_APA_system_abort (Vehicle speed is too high, APA system abort), 3=Cx03_Vehicle_speed_is_too_high_please_be_slow_down (Vehicle speed is too high, please be slow down), 4=Cx04_Parking_slot_searching (Parking slot searching), 5=Cx05_APA_system_quit (APA system quit), 6=Cx06_Please_drive_forward (Please drive forward), 7=Cx07_Please_stop_the_car_ (Please stop the car), 8=Cx08_Please_select_park_in_direction_or_turn_on_direction_indicator (Please select park in direction or turn on direction indicator), 9=Cx09_External_Disturbance_System_stop_work (External Disturbance, System stop work), 10=Cx0A_Reserved, 11=Cx0B_Reserved, 12=Cx0C_Reserved, 13=Cx0D_Reserved, 14=Cx0E_Reserved, 15=Cx0F_Reserved, 16=Cx10_Please_fasten_seat_belt (Please fasten seat belt), 17=Cx11_Door_is_open_Parking_manoeuvre_quit (Door is open: Parking manoeuvre quit), 18=Cx12_System_failed_APA_system_is_useless (System failed, APA system is useless), 19=Cx13_Please_close_the_door (Please close the door), 20=Cx14_Reserved, 21=Cx15_Reserved, 22=Cx16_Reserved, 23=Cx17_Please_step_brake_pedal_if_you_want_to_use_parking_manoeuvre (Please step brake pedal if you want to use parking manoeuvre), 24=Cx18_Reserved, 25=Cx19_Reserved, 26=Cx1A_Reserved, 27=Cx1B_Reserved, 28=Cx1C_Reserved, 29=Cx1D_Reserved, 30=Cx1E_Reserved, 31=Cx1F_Reserved, 32=Cx20_APA_switch_no_press_parking_manoeuvre_quit (APA switch no press, parking manoeuvre quit), 33=Cx21_Danger_zone_has_obstacle_parking_manoeuvre_suspend (Danger zone has obstacle, parking manoeuvre suspend), 34=Cx22_Do_not_touch_steering_wheel_during_parking_process_parking_manoeuvre_quit (Do not touch steering wheel during parking process, parking manoeuvre quit), 35=Cx23_Step_on_the_gas_Parking_manoeuvre_quit (Step on the gas: Parking manoeuvre quit), 36=Cx24_Brake_pedal_has_been_pushed_Parking_manoeuvre_quit (Brake pedal has been pushed: Parking manoeuvre quit), 37=Cx25_Shifter_lever_has_been_controlled_Parking_manoeuvre_quit (Shifter lever has been controlled: Parking manoeuvre quit), 38=Cx26_APA_system_abort_Please_take_over_vehicle (APA system abort, Please take over vehicle), 39=Cx27_Gradient_too_large_APA_system_quit (Gradient too large�� APA system quit), 40=Cx28_Reserved, 41=Cx29_Reserved, 42=Cx2A_Please_keep_away_steering_wheel_and_press_APA_switch_if_you_want_to_parking_in (Please keep away steering wheel and press APA switch if you want to parking in), 43=Cx2B_Parking_is_ready (Parking is ready), 44=Cx2C_Please_release_brake_and_pay_attention_to_surroundings_using_active_control_measure_if_necessary_ (Please release brake and pay attention to surroundings, using active control measure if necessary), 45=Cx2D_Parking_is_ongoing (Parking is ongoing), 46=Cx2E_Parking_manoeuvre_has_completed_Please_take_over_vehicle (Parking manoeuvre has completed: Please take over vehicle), 47=Cx2F_Please_keep_away_steering_wheel_and_re_press_APA_switch_if_you_want_to_parking_in_continually (Please keep away steering wheel and re-press APA switch if you want to parking in continually), 48=Cx30_System_timeout_APA_system_quit (System timeout, APA system quit), 49=Cx31_Please_select_park_out_direction_or_turn_on_direction_indicator (Please select park out direction or turn on direction indicator), 50=Cx32_Please_keep_away_steering_wheel_and_press_APA_switch_if_you_want_to_park_out (Please keep away steering wheel and press APA switch if you want to park out), 51=Cx33_Please_keep_away_steering_wheel_and_re_press_APA_switch_if_you_want_to_park_out_continually (Please keep away steering wheel and re-press APA switch if you want to park out continually), 52=Cx34_Reserved, 53=Cx35_Reserved, 54=Cx36_Reserved, 55=Cx37_Please_select_reverse_gear_and_keep_away_steering_wheel (Please select reverse gear and keep away steering wheel), 56=Cx38_Be_careful_drive_backward_and_prepare_for_stop (Be careful drive backward and prepare for stop), 57=Cx39_Please_select_drive_gear_and_move_forward (Please select drive gear and move forward), 58=Cx3A_Be_careful_drive_forward_and_prepare_for_stop (Be careful drive forward and prepare for stop), 59=Cx3B_Please_select_reverse_gear_and_move_backward (Please select reverse gear and move backward), 60=Cx3C_Vehicle_is_going_to_move_forward (Vehicle is going to move forward), 61=Cx3D_Vehicle_is_going_to_move_backward (Vehicle is going to move backward), 62=Cx3E_Reserved, 63=Cx3F_Reserved
  compu method CM_APAMd_sech2_SecCAN2: phys=raw for raw 0..7, 0=Cx0_Off, 1=Cx1_Parallel_Parking (Parallel Parking), 2=Cx2_Perpendicular_Parking (Perpendicular Parking), 3=Cx3_Park_Out (Park Out), 4=Cx4_Unknown_Parallel_Parking_or_Perpendicular_Parking (Unknown Parallel Parking or Perpendicular Parking), 5=Cx5_Unknown_Park_in_or_Park_Out (Unknown Park in or Park Out), 6=Cx6_Reserved, 7=Cx7_Reserved
  compu method CM_APAMdHSC2: phys=raw for raw 0..7, 0=Cx0_Off, 1=Cx1_Parallel_Parking (Parallel Parking), 2=Cx2_Perpendicular_Parking (Perpendicular Parking), 3=Cx3_Park_Out (Park Out), 4=Cx4_Unknown_Parallel_Parking_or_Perpendicular_Parking (Unknown Parallel Parking or Perpendicular Parking), 5=Cx5_Unknown_Park_in_or_Park_Out (Unknown Park in or Park Out), 6=Cx6_Reserved, 7=Cx7_Reserved
  compu method CM_APANRCDAvlbl_sech2_SecCAN2: phys=raw for raw 0..1, 0=Cx0_Not_available (Not available), 1=Cx1_Available
  compu method CM_APANRCDAvlblHSC2: phys=raw for raw 0..1, 0=Cx0_Not_available (Not available), 1=Cx1_Available
  compu method CM_APAParkngSched_sech2_SecCAN2: phys=raw*0.01 for raw 0..100
  compu method CM_APAParkngSchedHSC2: 0=Cx00_0x0_0x64_ ((0x0 - 0x64)), phys=raw*0.01 for raw 0..100
  compu method CM_APAParkngSchedV_sech2_SecCAN2: phys=raw for raw 0..1, 0=Cx0_Valid, 1=Cx1_Invalid
  compu method CM_APAParkngSchedVHSC2: phys=raw for raw 0..1, 0=Cx0_Valid, 1=Cx1_Invalid
  compu method CM_APAReq_sech2_SecCAN2: phys=raw for raw 0..7, 0=Cx0_Disable, 1=Cx1_Standby, 2=Cx2_Semi_APA_Mode_Request (Semi-APA Mode Request), 3=Cx3_Fully_APA_Mode_Request (Fully-APA Mode Request), 4=Cx4_Failed
  compu method CM_APAReqHSC2: phys=raw for raw 0..7, 0=Cx0_Disable, 1=Cx1_Standby, 2=Cx2_Semi_APA_Mode_Request (Semi-APA Mode Request), 3=Cx3_Fully_APA_Mode_Request (Fully-APA Mode Request), 4=Cx4_Failed
  compu method CM_APASCSAcclReqSts_sech2_SecCAN2: phys=raw for raw 0..1, 0=Cx0_no_request (no request), 1=Cx1_Deceleration_request (Deceleration request)
  compu method CM_APASCSAcclReqStsHSC2: phys=raw for raw 0..1, 0=Cx0_no_request (no request), 1=Cx1_Deceleration_request (Deceleration request)
  compu method CM_APASCSAcclReqVal_sech2_SecCAN2: phys=raw*0.1-12.7 for raw 0..255; unit m/s2
  compu method CM_APASCSAcclReqValHSC2: 0=Cx00_m_s2_0x0_0xFF_ (m/s2 (0x0 - 0xFF)), phys=raw*0.1-12.7 for raw 0..255; unit m/s2
  compu method CM_APASCSAcclReqValPV_sech2_SecCAN2: phys=raw for raw 0..1023
  compu method CM_APASCSAcclReqValPVHSC2: phys=raw for raw 0..1023, 0=Cx000_0x0_0x3FF_ ((0x0 - 0x3FF))
  compu method CM_APASCSAlvRC_sech2_SecCAN2: phys=raw for raw 0..15
  compu method CM_APASCSAlvRCHSC2: phys=raw for raw 0..15, 0=Cx0_0x0_0xF_ ((0x0 - 0xF))
  compu method CM_APAShifterPosReqd_sech2_SecCAN2: phys=raw for raw 0..15, 0=Cx0_Initial, 1=Cx1_S_Sport_mode_ (S(Sport mode)), 2=Cx2_W_Winter_mode_ (W(Winter mode)), 3=Cx3_M_Manual_mode_ (M(Manual mode)), 5=Cx5_D_Drive_ (D(Drive)), 6=Cx6_N_Neutral_ (N(Neutral)), 7=Cx7_R_Reverse_ (R(Reverse)), 8=Cx8_P_Park_ (P(Park)), 9=Cx9_Reserve, 10=CxA_Error
  compu method CM_APAShifterPosReqdHSC2: phys=raw for raw 0..15, 0=Cx0_Initial, 1=Cx1_S_Sport_mode_ (S(Sport mode)), 2=Cx2_W_Winter_mode_ (W(Winter mode)), 3=Cx3_M_Manual_mode_ (M(Manual mode)), 5=Cx5_D_Drive_ (D(Drive)), 6=Cx6_N_Neutral_ (N(Neutral)), 7=Cx7_R_Reverse_ (R(Reverse)), 8=Cx8_P_Park_ (P(Park)), 9=Cx9_Reserve, 10=CxA_Error
  compu method CM_APASlotBearng_sech2_SecCAN2: phys=raw for raw 0..3, 0=Cx0_No_slot (No slot), 1=Cx1_Left_slot (Left slot), 2=Cx2_Right_slot (Right slot), 3=Cx3_Both_left_and_right_slot (Both left and right slot)
  compu method CM_APASlotBearngHSC2: phys=raw for raw 0..3, 0=Cx0_No_slot (No slot), 1=Cx1_Left_slot (Left slot), 2=Cx2_Right_slot (Right slot), 3=Cx3_Both_left_and_right_slot (Both left and right slot)
  compu method CM_APASlotLngth_sech2_SecCAN2: phys=raw for raw 0..2047; unit cm
  compu method CM_APASlotLngthHSC2: phys=raw for raw 0..2047, 0=Cx000_cm_0x0_0x7FF_ (cm (0x0 - 0x7FF)); unit cm
  compu method CM_APASts_sech2_SecCAN2: phys=raw for raw 0..7, 0=Cx0_Disable, 1=Cx1_Standby, 2=Cx2_Semi_APA_Active (Semi-APA Active), 3=Cx3_Fully_APA_Active (Fully-APA Active), 4=Cx4_Failed
  compu method CM_APAStsHSC2: phys=raw for raw 0..7, 0=Cx0_Disable, 1=Cx1_Standby, 2=Cx2_Semi_APA_Active (Semi-APA Active), 3=Cx3_Fully_APA_Active (Fully-APA Active), 4=Cx4_Failed
  compu method CM_APASwReq_SecCAN2: phys=raw for raw 0..3, 0=Cx0_No_request (No request), 1=Cx1_Short_press (Short press), 2=Cx2_Long_press (Long press), 3=Cx3_Reserved
  compu method CM_APASwReqHSC2: phys=raw for raw 0..3, 0=Cx0_No_request (No request), 1=Cx1_Short_press (Short press), 2=Cx2_Long_press (Long press), 3=Cx3_Reserved
  compu method CM_APASwReqHSC4: phys=raw for raw 0..3, 0=Cx0_No_request (No request), 1=Cx1_Short_press (Short press), 2=Cx2_Long_press (Long press), 3=Cx3_Reserved
  compu method CM_APAToqReqSts_sech2_SecCAN2: phys=raw for raw 0..1, 0=Cx0_No_Request (No Request), 1=Cx1_Request
  compu method CM_APAToqReqStsHSC2: phys=raw for raw 0..1, 0=Cx0_No_Request (No Request), 1=Cx1_Request
  compu method CM_APAToqReqVal_sech2_SecCAN2: phys=raw*0.5-848 for raw 0..4095; unit Nm
  compu method CM_APAToqReqValHSC2: 0=Cx000_Nm_0x0_0xFFF_ (Nm (0x0 - 0xFFF)), phys=raw*0.5-848 for raw 0..4095; unit Nm
  compu method CM_APATrgtEPSStrgWhlAng_sech2_SecCAN2: phys=raw*0.0625-2048 for raw 0..65520
  compu method CM_APATrgtEPSStrgWhlAngHSC2: 0=Cx0000_0x0_0xFFF0_ ((0x0 - 0xFFF0)), phys=raw*0.0625-2048 for raw 0..65520
  compu method CM_APAVehCrdnatAzmth_sech2_SecCAN2: phys=raw for raw 0..511
  compu method CM_APAVehCrdnatAzmthHSC2: phys=raw for raw 0..511, 0=Cx000_0x0_0x1FF_ (�� (0x0 - 0x1FF))
  compu method CM_APAVehCrdnatPosX_sech2_SecCAN2: phys=raw-2048 for raw 0..4095; unit cm
  compu method CM_APAVehCrdnatPosXHSC2: 0=Cx000_cm_0x0_0xFFF_ (cm (0x0 - 0xFFF)), phys=raw-2048 for raw 0..4095; unit cm
  compu method CM_APAVehCrdnatPosY_sech2_SecCAN2: phys=raw-512 for raw 0..1023; unit cm
  compu method CM_APAVehCrdnatPosYHSC2: 0=Cx000_cm_0x0_0x3FF_ (cm (0x0 - 0x3FF)), phys=raw-512 for raw 0..1023; unit cm
  compu method CM_AutoDrvngSysStsHSC4: phys=raw for raw 0..255, 0=Cx00_Off, 1=Cx01_APA_Disable_ (APA Disable), 2=Cx02_APA_Standby_ (APA Standby), 3=Cx03_Semi_APA_Active_ (Semi-APA Active), 4=Cx04_Fully_APA_Active_ (Fully-APA Active), 5=Cx05_APA_Failed_ (APA Failed), 6=Cx06_Automated_driving_system_Disable (Automated driving system Disable), 7=Cx07_Automated_driving_system_Standby (Automated driving system Standby), 8=Cx08_Normal, 9=Cx09_P2P_Disable, 10=Cx0A_P2P_Learning, 11=Cx0B_P2P_SearchA, 12=Cx0C_P2P_Prepare, 13=Cx0D_P2P_Auto, 14=Cx0E_P2P_Manual, 15=Cx0F_P2P_Standby, 16=Cx10_reserved_0x10_0xFF_ (reserved (0x10 - 0xFF)); unit reserved  # Source signal range: [16,255]
  compu method CM_AVMAutoViewChgHSC4: phys=raw for raw 0..1, 0=Cx0_Autonoums, 1=Cx1_Manual
  compu method CM_BCMAvlbly_h2_SecCAN2: phys=raw for raw 0..1, 0=Cx0_False, 1=Cx1_True
  compu method CM_BCMAvlbly_h2HSC2: phys=raw for raw 0..1, 0=Cx0_False, 1=Cx1_True
  compu method CM_BCMImmoData4HSC4: phys=raw for raw 0..18446744073709551615
  compu method CM_BCMImmoData5HSC4: phys=raw for raw 0..18446744073709551615
  compu method CM_BCMSSBAHSC2: phys=raw for raw 0..1, 0=Cx0_Inactive, 1=Cx1_Active_
  compu method CM_BCMSSBAVHSC2: phys=raw for raw 0..1, 0=Cx0_Valid, 1=Cx1_Invalid
  compu method CM_BCMSSBFltStsHSC2: phys=raw for raw 0..7, 0=Cx0_No_Fault (No Fault), 1=Cx1_short_to_GND (short to GND), 2=Cx2_short_to_Battery (short to Battery), 3=Cx3_Stuck, 4=Cx4_Open_Circuit (Open Circuit), 5=Cx5_switch_failed (switch failed), 6=Cx6_Reserved, 7=Cx7_Reserved
  compu method CM_BCMToIECURmtCtrlPotclHSC2: phys=raw for raw 0..18446744073709551615
  compu method CM_BMSBscSta_h1HSC4: phys=raw for raw 0..31, 0=Cx00_Power_Up (Power Up), 1=Cx01_Drive_Ready (Drive Ready), 2=Cx02_Drive_Pre_charging (Drive Pre-charging), 3=Cx03_Drive_Mode (Drive Mode), 4=Cx04_On_board_Charge_Ready (On-board Charge Ready), 5=Cx05_Off_board_Charge_Ready (Off-board Charge Ready), 6=Cx06_On_board_Charging_Mode (On-board Charging Mode), 7=Cx07_Off_board_Charging_Mode (Off-board Charging Mode), 8=Cx08_Offline_Balance (Offline Balance), 9=Cx09_Off_board_Charging_Done (Off-board Charging Done), 10=Cx0A_On_board_Charging_Done (On-board Charging Done), 12=Cx0C_On_board_Pre_charging (On-board Pre-charging), 13=Cx0D_Collision_Mode (Collision Mode), 14=Cx0E_Balancing, 15=Cx0F_Fault, 16=Cx10_Off_board_Pre_charging (Off-board Pre-charging), 17=Cx11_Wireless_Charge_Ready (Wireless Charge Ready), 18=Cx12_Wireless_Charging_Mode (Wireless Charging Mode), 19=Cx13_Wireless_Charging_Done (Wireless Charging Done), 20=Cx14_Wireless_Pre_charging (Wireless Pre-charging)
  compu method CM_BntOpenSts_SecCAN2: phys=raw for raw 0..3, 0=Cx0_Bonnet_Closed (Bonnet Closed), 1=Cx1_Bonnet_Open (Bonnet Open), 2=Cx2_Bonnet_Switch_Disconnect (Bonnet Switch Disconnect), 3=Cx3_Reserved
  compu method CM_BntOpenStsHSC2: phys=raw for raw 0..3, 0=Cx0_Bonnet_Closed (Bonnet Closed), 1=Cx1_Bonnet_Open (Bonnet Open), 2=Cx2_Bonnet_Switch_Disconnect (Bonnet Switch Disconnect), 3=Cx3_Reserved
  compu method CM_BPMMstrAvlbly_h2_SecCAN2: phys=raw for raw 0..1, 0=Cx0_False, 1=Cx1_True
  compu method CM_BPMMstrAvlbly_h2HSC2: phys=raw for raw 0..1, 0=Cx0_False, 1=Cx1_True
  compu method CM_BrkPdlAppdHSC2: phys=raw for raw 0..1, 0=Cx0_brake_pedal_not_applied (brake pedal not applied), 1=Cx1_brake_pedal_applied (brake pedal applied)
  compu method CM_CalendarDay_SecCAN2: phys=raw for raw 0..31; unit days
  compu method CM_CalendarDayHSC2: phys=raw for raw 0..31, 0=Cx00_days_0x0_0x1F_ (days (0x0 - 0x1F)); unit days
  compu method CM_CalendarDayHSC4: phys=raw for raw 0..31, 0=Cx00_days_0x0_0x1F_ (days (0x0 - 0x1F)); unit days
  compu method CM_CalendarMonth_SecCAN2: phys=raw for raw 0..15, 0=Cx0_Unknown, 1=Cx1_January, 2=Cx2_February, 3=Cx3_March, 4=Cx4_April, 5=Cx5_May, 6=Cx6_June, 7=Cx7_July, 8=Cx8_August, 9=Cx9_September, 10=CxA_October, 11=CxB_November, 12=CxC_December
  compu method CM_CalendarMonthHSC2: phys=raw for raw 0..15, 0=Cx0_Unknown, 1=Cx1_January, 2=Cx2_February, 3=Cx3_March, 4=Cx4_April, 5=Cx5_May, 6=Cx6_June, 7=Cx7_July, 8=Cx8_August, 9=Cx9_September, 10=CxA_October, 11=CxB_November, 12=CxC_December
  compu method CM_CalendarMonthHSC4: phys=raw for raw 0..15, 0=Cx0_Unknown, 1=Cx1_January, 2=Cx2_February, 3=Cx3_March, 4=Cx4_April, 5=Cx5_May, 6=Cx6_June, 7=Cx7_July, 8=Cx8_August, 9=Cx9_September, 10=CxA_October, 11=CxB_November, 12=CxC_December
  compu method CM_CalendarYear_SecCAN2: phys=raw+2000 for raw 0..255; unit year
  compu method CM_CalendarYearHSC2: 0=Cx00_year_0x0_0xFF_ (year (0x0 - 0xFF)), phys=raw+2000 for raw 0..255; unit year
  compu method CM_CalendarYearHSC4: 0=Cx00_year_0x0_0xFF_ (year (0x0 - 0xFF)), phys=raw+2000 for raw 0..255; unit year
  compu method CM_DayTimeRunningLampOnHSC2: phys=raw for raw 0..1, 0=Cx0_False, 1=Cx1_True
  compu method CM_DiagnosticFuncAddrReq_h2: phys=raw for raw 0..18446744073709551615
  compu method CM_DiagnosticReqP2P_h2: phys=raw for raw 0..18446744073709551615
  compu method CM_DiagnosticRespP2P: phys=raw for raw 0..18446744073709551615
  compu method CM_DipdBeamLghtOnHSC2: phys=raw for raw 0..1, 0=Cx0_False, 1=Cx1_True
  compu method CM_DircnIndLampSwStsHSC2: phys=raw for raw 0..3, 0=Cx0_off, 1=Cx1_Left_on (Left on), 2=Cx2_Right_on (Right on), 3=Cx3_reserve
  compu method CM_DistRCAvgDrvn_SecCAN2: phys=raw*0.125 for raw 0..8191; unit m
  compu method CM_DistRCAvgDrvnHSC2: 0=Cx0000_m_0x0_0x1FFF_ (m (0x0 - 0x1FFF)), phys=raw*0.125 for raw 0..8191; unit m
  compu method CM_DistRCAvgDrvnRstOcd_SecCAN2: phys=raw for raw 0..1, 0=Cx0_False, 1=Cx1_True
  compu method CM_DistRCAvgDrvnRstOcdHSC2: phys=raw for raw 0..1, 0=Cx0_False, 1=Cx1_True
  compu method CM_DistRCAvgDrvnSrc_SecCAN2: phys=raw for raw 0..1, 0=Cx0_Transmission_Output_Speed (Transmission Output Speed), 1=Cx1_Wheel_Speed (Wheel Speed)
  compu method CM_DistRCAvgDrvnSrcHSC2: phys=raw for raw 0..1, 0=Cx0_Transmission_Output_Speed (Transmission Output Speed), 1=Cx1_Wheel_Speed (Wheel Speed)
  compu method CM_DistRCAvgDrvnV_SecCAN2: phys=raw for raw 0..1, 0=Cx0_Valid, 1=Cx1_Invalid
  compu method CM_DistRCAvgDrvnVHSC2: phys=raw for raw 0..1, 0=Cx0_Valid, 1=Cx1_Invalid
  compu method CM_DrvrDoorOpenSts_SecCAN2: phys=raw for raw 0..3, 0=Cx0_Driver_Door_Closed (Driver Door Closed), 1=Cx1_Driver_Door_Open_For_latch_switch_can_t_detect_door_ajar_status_ (Driver Door Open(For latch switch can't detect door ajar status)), 2=Cx2_Driver_Door_Ajar (Driver Door Ajar), 3=Cx3_Driver_Door_Full_Open (Driver Door Full Open)
  compu method CM_DrvrDoorOpenStsHSC2: phys=raw for raw 0..3, 0=Cx0_Driver_Door_Closed (Driver Door Closed), 1=Cx1_Driver_Door_Open_For_latch_switch_can_t_detect_door_ajar_status_ (Driver Door Open(For latch switch can't detect door ajar status)), 2=Cx2_Driver_Door_Ajar (Driver Door Ajar), 3=Cx3_Driver_Door_Full_Open (Driver Door Full Open)
  compu method CM_DrvrSbltAtc_SecCAN2: phys=raw for raw 0..1, 0=Cx0_False, 1=Cx1_True
  compu method CM_DrvrSbltAtcHSC2: phys=raw for raw 0..1, 0=Cx0_False, 1=Cx1_True
  compu method CM_DrvrSbltAtcV_SecCAN2: phys=raw for raw 0..1, 0=Cx0_Valid, 1=Cx1_Invalid
  compu method CM_DrvrSbltAtcVHSC2: phys=raw for raw 0..1, 0=Cx0_Valid, 1=Cx1_Invalid
  compu method CM_DrvrSelAPAParkngMd_SecCAN2: phys=raw for raw 0..7, 0=Cx0_No_select (No select), 1=Cx1_Select_parallel_parking (Select parallel parking), 2=Cx2_Select_perpendicular_parking (Select perpendicular parking), 3=Cx3_Select_park_in (Select park in), 4=Cx4_Select_park_out (Select park out), 5=Cx5_Reserved, 6=Cx6_Reserved, 7=Cx7_Reserved
  compu method CM_DrvrSelAPAParkngMdHSC2: phys=raw for raw 0..7, 0=Cx0_No_select (No select), 1=Cx1_Select_parallel_parking (Select parallel parking), 2=Cx2_Select_perpendicular_parking (Select perpendicular parking), 3=Cx3_Select_park_in (Select park in), 4=Cx4_Select_park_out (Select park out), 5=Cx5_Reserved, 6=Cx6_Reserved, 7=Cx7_Reserved
  compu method CM_DrvrSelAPAParkngMdHSC4: phys=raw for raw 0..7, 0=Cx0_No_select (No select), 1=Cx1_Select_parallel_parking (Select parallel parking), 2=Cx2_Select_perpendicular_parking (Select perpendicular parking), 3=Cx3_Select_park_in (Select park in), 4=Cx4_Select_park_out (Select park out), 5=Cx5_Reserved, 6=Cx6_Reserved, 7=Cx7_Reserved
  compu method CM_DrvrSelAPASlotBearng_SecCAN2: phys=raw for raw 0..3, 0=Cx0_No_select (No select), 1=Cx1_Select_Left_slot (Select Left slot), 2=Cx2_Select_Right_slot (Select Right slot), 3=Cx3_Reserved
  compu method CM_DrvrSelAPASlotBearngHSC2: phys=raw for raw 0..3, 0=Cx0_No_select (No select), 1=Cx1_Select_Left_slot (Select Left slot), 2=Cx2_Select_Right_slot (Select Right slot), 3=Cx3_Reserved
  compu method CM_DrvrSelAPASlotBearngHSC4: phys=raw for raw 0..3, 0=Cx0_No_select (No select), 1=Cx1_Select_Left_slot (Select Left slot), 2=Cx2_Select_Right_slot (Select Right slot), 3=Cx3_Reserved
  compu method CM_DTCInfomationAPA_SecCAN2: phys=raw for raw 0..72057594037927935
  compu method CM_DTCInfomationAPAHSC2: phys=raw for raw 0..72057594037927935
  compu method CM_DTCInfomationP2PHSC2: phys=raw for raw 0..72057594037927935
  compu method CM_ECMAvlbly_h2_SecCAN2: phys=raw for raw 0..1, 0=Cx0_False, 1=Cx1_True
  compu method CM_ECMAvlbly_h2HSC2: phys=raw for raw 0..1, 0=Cx0_False, 1=Cx1_True
  compu method CM_EnRunA_SecCAN2: phys=raw for raw 0..1, 0=Cx0_False, 1=Cx1_True
  compu method CM_EnRunAHSC2: phys=raw for raw 0..1, 0=Cx0_False, 1=Cx1_True
  compu method CM_EPBAppcnSts_SecCAN2: phys=raw for raw 0..3, 0=Cx0_Unknown, 1=Cx1_Park_Brake_Applied (Park Brake Applied), 2=Cx2_Park_Brake_Released (Park Brake Released), 3=Cx3_Park_Brake_Application_in_Progress (Park Brake Application in Progress)
  compu method CM_EPBAppcnStsHSC2: phys=raw for raw 0..3, 0=Cx0_Unknown, 1=Cx1_Park_Brake_Applied (Park Brake Applied), 2=Cx2_Park_Brake_Released (Park Brake Released), 3=Cx3_Park_Brake_Application_in_Progress (Park Brake Application in Progress)
  compu method CM_EPBAppcnStsPVHSC2: phys=raw for raw 0..3, 0=Cx0_0x0_0x3_ ((0x0 - 0x3))
  compu method CM_EPBAvlblySts_SecCAN2: phys=raw for raw 0..7, 0=Cx0_Unavailable_Not_Failed (Unavailable,Not Failed), 1=Cx1_Available_Not_Failed (Available,Not Failed), 2=Cx2_Unavailable_Failed_Applied (Unavailable,Failed Applied), 3=Cx3_Unavailable_Failed_Released (Unavailable,Failed Released), 4=Cx4_Unavailable_Failed_other (Unavailable,Failed other)
  compu method CM_EPBAvlblyStsHSC2: phys=raw for raw 0..7, 0=Cx0_Unavailable_Not_Failed (Unavailable,Not Failed), 1=Cx1_Available_Not_Failed (Available,Not Failed), 2=Cx2_Unavailable_Failed_Applied (Unavailable,Failed Applied), 3=Cx3_Unavailable_Failed_Released (Unavailable,Failed Released), 4=Cx4_Unavailable_Failed_other (Unavailable,Failed other)
  compu method CM_EPBAvlblyStsPV_SecCAN2: phys=raw for raw 0..7
  compu method CM_EPBAvlblyStsPVHSC2: phys=raw for raw 0..7, 0=Cx0_0x0_0x7_ ((0x0 - 0x7))
  compu method CM_EPBSwSts_SecCAN2: phys=raw for raw 0..3, 0=Cx0_NotActive, 1=Cx1_Release, 2=Cx2_Apply
  compu method CM_EPBSwStsHSC2: phys=raw for raw 0..3, 0=Cx0_NotActive, 1=Cx1_Release, 2=Cx2_Apply
  compu method CM_EPBSwStsV_SecCAN2: phys=raw for raw 0..1, 0=Cx0_Valid, 1=Cx1_Invalid
  compu method CM_EPBSwStsVHSC2: phys=raw for raw 0..1, 0=Cx0_Valid, 1=Cx1_Invalid
  compu method CM_EPSAPAAlvRC_SecCAN2: phys=raw for raw 0..255
  compu method CM_EPSAPAAlvRCHSC2: phys=raw for raw 0..255, 0=Cx00_0x0_0xFF_ ((0x0 - 0xFF))
  compu method CM_EPSAPAChksm_SecCAN2: phys=raw for raw 0..255
  compu method CM_EPSAPAChksmHSC2: phys=raw for raw 0..255, 0=Cx00_0x0_0xFF_ ((0x0 - 0xFF))
  compu method CM_EPSAPAInh_SecCAN2: phys=raw for raw 0..255, 0=Cx00_Normal_Operation (Normal Operation), 1=Cx01_Over_Speed (Over Speed), 2=Cx02_Driver_Interference (Driver Interference), 4=Cx04_Abnormal_CAN_input (Abnormal CAN input), 8=Cx08_Excess_Angle_Deviation (Excess Angle Deviation), 16=Cx10_EPS_failure (EPS failure), 32=Cx20_Reserve, 64=Cx40_Reserve, 128=Cx80_Reserve
  compu method CM_EPSAPAInhHSC2: phys=raw for raw 0..255, 0=Cx00_Normal_Operation (Normal Operation), 1=Cx01_Over_Speed (Over Speed), 2=Cx02_Driver_Interference (Driver Interference), 4=Cx04_Abnormal_CAN_input (Abnormal CAN input), 8=Cx08_Excess_Angle_Deviation (Excess Angle Deviation), 16=Cx10_EPS_failure (EPS failure), 32=Cx20_Reserve, 64=Cx40_Reserve, 128=Cx80_Reserve
  compu method CM_EPSAPASts_SecCAN2: phys=raw for raw 0..15, 0=Cx0_Inhibit, 1=Cx1_Available, 2=Cx2_Active, 3=Cx3_Abort, 4=Cx4_Reply_for_Control (Reply for Control), 5=Cx5_NRCD_Active (NRCD Active), 6=Cx6_ADAS_Active (ADAS Active), 7=Cx7_Failure; unit Reserve  # Source signal range: [8,15]
  compu method CM_EPSAPAStsHSC2: phys=raw for raw 0..15, 0=Cx0_Inhibit, 1=Cx1_Available, 2=Cx2_Active, 3=Cx3_Abort, 4=Cx4_Reply_for_Control (Reply for Control), 5=Cx5_NRCD_Active (NRCD Active), 6=Cx6_ADAS_Active (ADAS Active), 7=Cx7_Failure, 8=Cx8_Reserve_0x8_0xF_ (Reserve (0x8 - 0xF)); unit Reserve  # Source signal range: [8,15]
  compu method CM_EPTAccelActuPos_SecCAN2: phys=raw*0.392157 for raw 0..254; unit %
  compu method CM_EPTAccelActuPosHSC2: 0=Cx00_0x0_0xFF_ (% (0x0 - 0xFF)), phys=raw*0.392157 for raw 0..254; unit %
  compu method CM_EPTAccelActuPosV_SecCAN2: phys=raw for raw 0..1, 0=Cx0_Valid, 1=Cx1_Invalid
  compu method CM_EPTAccelActuPosVHSC2: phys=raw for raw 0..1, 0=Cx0_Valid, 1=Cx1_Invalid
  compu method CM_EPTBrkPdlDscrtInptSts_SecCAN2: phys=raw for raw 0..1, 0=Cx0_Brake_Not_Applied (Brake Not Applied), 1=Cx1_Brake_Applied (Brake Applied)
  compu method CM_EPTBrkPdlDscrtInptStsHSC2: phys=raw for raw 0..1, 0=Cx0_Brake_Not_Applied (Brake Not Applied), 1=Cx1_Brake_Applied (Brake Applied)
  compu method CM_EPTBrkPdlDscrtInptStsV_SecCAN2: phys=raw for raw 0..1, 0=Cx0_Valid, 1=Cx1_Invalid
  compu method CM_EPTBrkPdlDscrtInptStsVHSC2: phys=raw for raw 0..1, 0=Cx0_Valid, 1=Cx1_Invalid
  compu method CM_EPTRdy_h1_SecCAN2: phys=raw for raw 0..1, 0=Cx0_Not_ready (Not ready), 1=Cx1_Ready
  compu method CM_EPTRdy_h1HSC2: phys=raw for raw 0..1, 0=Cx0_Not_ready (Not ready), 1=Cx1_Ready
  compu method CM_EPTStCmdOn_h1_SecCAN2: phys=raw for raw 0..1, 0=Cx0_False, 1=Cx1_True
  compu method CM_EPTStCmdOn_h1HSC2: phys=raw for raw 0..1, 0=Cx0_False, 1=Cx1_True
  compu method CM_FICMAvlbly_h2_SecCAN2: phys=raw for raw 0..1, 0=Cx0_False, 1=Cx1_True
  compu method CM_FICMAvlbly_h2HSC2: phys=raw for raw 0..1, 0=Cx0_False, 1=Cx1_True
  compu method CM_FICMP2PQuitReqHSC4: phys=raw for raw 0..1, 0=Cx0_False, 1=Cx1_True
  compu method CM_FICMPLCRtCoverSwReqHSC4: phys=raw for raw 0..3, 0=Cx0_Initial, 1=Cx1_NO, 2=Cx2_YES
  compu method CM_FICMPLCRtEndSwReqHSC4: phys=raw for raw 0..3, 0=Cx0_Initial, 1=Cx1_NO, 2=Cx2_YES
  compu method CM_FICMPLCSwReqHSC4: phys=raw for raw 0..15, 0=Cx0_No_Request (No Request), 1=Cx1_Start_Routelearning (Start Routelearning), 2=Cx2_Finish_Routelearning (Finish Routelearning), 3=Cx3_Cancel_Routelearning (Cancel Routelearning), 4=Cx4_Save_Route1 (Save Route1), 5=Cx5_Save_Route2 (Save Route2), 6=Cx6_Delete_Route1 (Delete Route1), 7=Cx7_Delete_Route2 (Delete Route2), 8=Cx8_Reserved_for_Route3 (Reserved for Route3), 9=Cx9_Reserved_for_Route3 (Reserved for Route3), 10=CxA_Reserved_for_Route3 (Reserved for Route3), 11=CxB_Reserved_for_Route3 (Reserved for Route3), 12=CxC_Reserved_for_Route3 (Reserved for Route3), 13=CxD_Reserved_for_Route3 (Reserved for Route3), 14=CxE_Reserved_for_Route3 (Reserved for Route3), 15=CxF_Reserved_for_Route3 (Reserved for Route3)
  compu method CM_FICMRouteChangeCheckHSC4: phys=raw for raw 0..3, 0=Cx0_0, 1=Cx1_YES, 2=Cx2_NO, 3=Cx3_Reserved
  compu method CM_FICMRouteReqHSC4: phys=raw for raw 0..3, 0=Cx0_no_request (no request), 1=Cx1_Route1, 2=Cx2_Route2, 3=Cx3_Reserved
  compu method CM_FICMSilentSearchCheckHSC4: phys=raw for raw 0..3, 0=Cx0_0, 1=Cx1_YES, 2=Cx2_NO, 3=Cx3_Reserved
  compu method CM_FICMSilentSearchReqHSC4: phys=raw for raw 0..3, 0=Cx0_no_request (no request), 1=Cx1_Route1, 2=Cx2_Route2, 3=Cx3_Reserved
  compu method CM_FLDoorHadlSwAHSC4: phys=raw for raw 0..1, 0=Cx0_False, 1=Cx1_True
  compu method CM_FLObsDist_sech2_SecCAN2: phys=raw for raw 0..511
  compu method CM_FLObsRng_sech2_SecCAN2: phys=raw for raw 0..15, 0=Cx0_No_Obstacle (No Obstacle), 1=Cx1_Range_1 (Range 1), 2=Cx2_Range_2 (Range 2), 3=Cx3_Range_3 (Range 3), 4=Cx4_Range_4 (Range 4), 5=Cx5_Range_5 (Range 5), 6=Cx6_Range_6 (Range 6), 7=Cx7_Range_7 (Range 7), 8=Cx8_Range_8 (Range 8), 9=Cx9_Range_9 (Range 9), 10=CxA_Range_10 (Range 10), 11=CxB_Range_11 (Range 11), 12=CxC_Range_12 (Range 12), 13=CxD_Range_13 (Range 13), 14=CxE_Range_14 (Range 14), 15=CxF_Range_15 (Range 15)
  compu method CM_FLObsRngHSC2: phys=raw for raw 0..15, 0=Cx0_No_Obstacle (No Obstacle), 1=Cx1_Range_1 (Range 1), 2=Cx2_Range_2 (Range 2), 3=Cx3_Range_3 (Range 3), 4=Cx4_Range_4 (Range 4), 5=Cx5_Range_5 (Range 5), 6=Cx6_Range_6 (Range 6), 7=Cx7_Range_7 (Range 7), 8=Cx8_Range_8 (Range 8), 9=Cx9_Range_9 (Range 9), 10=CxA_Range_10 (Range 10), 11=CxB_Range_11 (Range 11), 12=CxC_Range_12 (Range 12), 13=CxD_Range_13 (Range 13), 14=CxE_Range_14 (Range 14), 15=CxF_Range_15 (Range 15)
  compu method CM_FLSideObsDist_sech2_SecCAN2: phys=raw for raw 0..511
  compu method CM_FLSideObsDistHSC2: phys=raw for raw 0..511, 0=Cx000_0x0_0x1FF_ ((0x0 - 0x1FF))
  compu method CM_FLTirePrsHSC4: 0=Cx00_kPa_0x0_0x7F_ (kPa (0x0 - 0x7F)), phys=raw*4 for raw 0..127; unit kPa
  compu method CM_FLTirePrsVHSC4: phys=raw for raw 0..1, 0=Cx0_Valid, 1=Cx1_Invalid
  compu method CM_FRDoorHadlSwAHSC4: phys=raw for raw 0..1, 0=Cx0_False, 1=Cx1_True
  compu method CM_FRObsDist_sech2_SecCAN2: phys=raw for raw 0..511
  compu method CM_FRObsRng_sech2_SecCAN2: phys=raw for raw 0..15, 0=Cx0_No_Obstacle (No Obstacle), 1=Cx1_Range_1 (Range 1), 2=Cx2_Range_2 (Range 2), 3=Cx3_Range_3 (Range 3), 4=Cx4_Range_4 (Range 4), 5=Cx5_Range_5 (Range 5), 6=Cx6_Range_6 (Range 6), 7=Cx7_Range_7 (Range 7), 8=Cx8_Range_8 (Range 8), 9=Cx9_Range_9 (Range 9), 10=CxA_Range_10 (Range 10), 11=CxB_Range_11 (Range 11), 12=CxC_Range_12 (Range 12), 13=CxD_Range_13 (Range 13), 14=CxE_Range_14 (Range 14), 15=CxF_Range_15 (Range 15)
  compu method CM_FRObsRngHSC2: phys=raw for raw 0..15, 0=Cx0_No_Obstacle (No Obstacle), 1=Cx1_Range_1 (Range 1), 2=Cx2_Range_2 (Range 2), 3=Cx3_Range_3 (Range 3), 4=Cx4_Range_4 (Range 4), 5=Cx5_Range_5 (Range 5), 6=Cx6_Range_6 (Range 6), 7=Cx7_Range_7 (Range 7), 8=Cx8_Range_8 (Range 8), 9=Cx9_Range_9 (Range 9), 10=CxA_Range_10 (Range 10), 11=CxB_Range_11 (Range 11), 12=CxC_Range_12 (Range 12), 13=CxD_Range_13 (Range 13), 14=CxE_Range_14 (Range 14), 15=CxF_Range_15 (Range 15)
  compu method CM_FRSideObsDist_sech2_SecCAN2: phys=raw for raw 0..511
  compu method CM_FRSideObsDistHSC2: phys=raw for raw 0..511, 0=Cx000_0x0_0x1FF_ ((0x0 - 0x1FF))
  compu method CM_FrtFogLghtOnHSC2: phys=raw for raw 0..1, 0=Cx0_False, 1=Cx1_True
  compu method CM_FRTirePrsHSC4: 0=Cx00_kPa_0x0_0x7F_ (kPa (0x0 - 0x7F)), phys=raw*4 for raw 0..127; unit kPa
  compu method CM_FRTirePrsVHSC4: phys=raw for raw 0..1, 0=Cx0_Valid, 1=Cx1_Invalid
  compu method CM_FrtMidLObsDist_sech2_SecCAN2: phys=raw for raw 0..511
  compu method CM_FrtMidLObsRng_sech2_SecCAN2: phys=raw for raw 0..15, 0=Cx0_No_Obstacle (No Obstacle), 1=Cx1_Range_1 (Range 1), 2=Cx2_Range_2 (Range 2), 3=Cx3_Range_3 (Range 3), 4=Cx4_Range_4 (Range 4), 5=Cx5_Range_5 (Range 5), 6=Cx6_Range_6 (Range 6), 7=Cx7_Range_7 (Range 7), 8=Cx8_Range_8 (Range 8), 9=Cx9_Range_9 (Range 9), 10=CxA_Range_10 (Range 10), 11=CxB_Range_11 (Range 11), 12=CxC_Range_12 (Range 12), 13=CxD_Range_13 (Range 13), 14=CxE_Range_14 (Range 14), 15=CxF_Range_15 (Range 15)
  compu method CM_FrtMidLObsRngHSC2: phys=raw for raw 0..15, 0=Cx0_No_Obstacle (No Obstacle), 1=Cx1_Range_1 (Range 1), 2=Cx2_Range_2 (Range 2), 3=Cx3_Range_3 (Range 3), 4=Cx4_Range_4 (Range 4), 5=Cx5_Range_5 (Range 5), 6=Cx6_Range_6 (Range 6), 7=Cx7_Range_7 (Range 7), 8=Cx8_Range_8 (Range 8), 9=Cx9_Range_9 (Range 9), 10=CxA_Range_10 (Range 10), 11=CxB_Range_11 (Range 11), 12=CxC_Range_12 (Range 12), 13=CxD_Range_13 (Range 13), 14=CxE_Range_14 (Range 14), 15=CxF_Range_15 (Range 15)
  compu method CM_FrtMidRObsDist_sech2_SecCAN2: phys=raw for raw 0..511
  compu method CM_FrtMidRObsRng_sech2_SecCAN2: phys=raw for raw 0..15, 0=Cx0_No_Obstacle (No Obstacle), 1=Cx1_Range_1 (Range 1), 2=Cx2_Range_2 (Range 2), 3=Cx3_Range_3 (Range 3), 4=Cx4_Range_4 (Range 4), 5=Cx5_Range_5 (Range 5), 6=Cx6_Range_6 (Range 6), 7=Cx7_Range_7 (Range 7), 8=Cx8_Range_8 (Range 8), 9=Cx9_Range_9 (Range 9), 10=CxA_Range_10 (Range 10), 11=CxB_Range_11 (Range 11), 12=CxC_Range_12 (Range 12), 13=CxD_Range_13 (Range 13), 14=CxE_Range_14 (Range 14), 15=CxF_Range_15 (Range 15)
  compu method CM_FrtMidRObsRngHSC2: phys=raw for raw 0..15, 0=Cx0_No_Obstacle (No Obstacle), 1=Cx1_Range_1 (Range 1), 2=Cx2_Range_2 (Range 2), 3=Cx3_Range_3 (Range 3), 4=Cx4_Range_4 (Range 4), 5=Cx5_Range_5 (Range 5), 6=Cx6_Range_6 (Range 6), 7=Cx7_Range_7 (Range 7), 8=Cx8_Range_8 (Range 8), 9=Cx9_Range_9 (Range 9), 10=CxA_Range_10 (Range 10), 11=CxB_Range_11 (Range 11), 12=CxC_Range_12 (Range 12), 13=CxD_Range_13 (Range 13), 14=CxE_Range_14 (Range 14), 15=CxF_Range_15 (Range 15)
  compu method CM_FrtObsDist_sech2_SecCAN2: phys=raw for raw 0..255; unit cm
  compu method CM_FrtObsDistHSC2: phys=raw for raw 0..255, 0=Cx00_cm_0x0_0xFF_ (cm (0x0 - 0xFF)); unit cm
  compu method CM_FrtPDCAudWrnng_sech2_SecCAN2: phys=raw for raw 0..15, 0=Cx0_No_Obstacle (No Obstacle), 1=Cx1_Range_1 (Range 1), 2=Cx2_Range_2 (Range 2), 3=Cx3_Range_3 (Range 3), 4=Cx4_Range_4 (Range 4), 5=Cx5_Range_5 (Range 5), 6=Cx6_Range_6 (Range 6), 7=Cx7_Range_7 (Range 7), 8=Cx8_Range_8 (Range 8), 9=Cx9_Range_9 (Range 9), 10=CxA_Range_10 (Range 10), 11=CxB_Range_11 (Range 11), 12=CxC_Range_12 (Range 12), 13=CxD_Range_13 (Range 13), 14=CxE_Range_14 (Range 14), 15=CxF_Range_15 (Range 15)
  compu method CM_FrtPDCAudWrnngHSC2: phys=raw for raw 0..15, 0=Cx0_No_Obstacle (No Obstacle), 1=Cx1_Range_1 (Range 1), 2=Cx2_Range_2 (Range 2), 3=Cx3_Range_3 (Range 3), 4=Cx4_Range_4 (Range 4), 5=Cx5_Range_5 (Range 5), 6=Cx6_Range_6 (Range 6), 7=Cx7_Range_7 (Range 7), 8=Cx8_Range_8 (Range 8), 9=Cx9_Range_9 (Range 9), 10=CxA_Range_10 (Range 10), 11=CxB_Range_11 (Range 11), 12=CxC_Range_12 (Range 12), 13=CxD_Range_13 (Range 13), 14=CxE_Range_14 (Range 14), 15=CxF_Range_15 (Range 15)
  compu method CM_FrtPsngDoorOpenSts_SecCAN2: phys=raw for raw 0..3, 0=Cx0_Front_Passenger_Door_Closed (Front Passenger Door Closed), 1=Cx1_Front_Passenger_Open_latch_switch_cann_t_detect_door_ajar_statu (Front Passenger Open(latch switch cann��t detect door ajar statu), 2=Cx2_Front_Passenger_Door_Ajar (Front Passenger Door Ajar), 3=Cx3_Front_Passenger_Door_Full_Open (Front Passenger Door Full Open)
  compu method CM_FrtPsngDoorOpenStsHSC2: phys=raw for raw 0..3, 0=Cx0_Front_Passenger_Door_Closed (Front Passenger Door Closed), 1=Cx1_Front_Passenger_Open_latch_switch_cann_t_detect_door_ajar_statu (Front Passenger Open(latch switch cann��t detect door ajar statu), 2=Cx2_Front_Passenger_Door_Ajar (Front Passenger Door Ajar), 3=Cx3_Front_Passenger_Door_Full_Open (Front Passenger Door Full Open)
  compu method CM_HCUAvlbly_h2_SecCAN2: phys=raw for raw 0..1, 0=Cx0_False, 1=Cx1_True
  compu method CM_HCUAvlbly_h2HSC2: phys=raw for raw 0..1, 0=Cx0_False, 1=Cx1_True
  compu method CM_HD_AVMCurViewHSC4: phys=raw for raw 0..15, 0=Cx0_No_request (No request), 1=Cx1_front_view, 2=Cx2_front_view_wide, 3=Cx3_Rear_view, 4=Cx4_2D_Rear_view_wide, 5=Cx5_left_right_view_wide, 6=Cx6_front_left_view_3D_ (front_left_view(3D)), 7=Cx7_front_right_view_3D_ (front_right_view(3D)), 8=Cx8_rear_left_view_3D_ (rear_left_view(3D)), 9=Cx9_rear_right_view_3D_ (rear_right_view(3D)), 10=CxA_full_screen, 11=CxB_Reserved, 12=CxC_Reserved, 13=CxD_Reserved, 14=CxE_Reserved, 15=CxF_Reserved
  compu method CM_HD_AVMErrorDisplay_h4HSC4: phys=raw for raw 0..15, 0=Cx0_No_Request (No Request), 1=Cx1_Cameras_Failure (Cameras Failure), 2=Cx2_Radar_Failure (Radar Failure), 3=Cx3_Auxilirary_Line_Failre (Auxilirary Line Failre), 4=Cx4_Transparent_Car_Function_Failure (Transparent Car Function Failure), 5=Cx5_MOD_Function_Failure (MOD Function Failure), 6=Cx6_EOL_After_Sale_Calibration_Function_Failure (EOL/After Sale Calibration Function Failure), 7=Cx7_reserved, 8=Cx8_reserved, 9=Cx9_reserved, 10=CxA_reserved, 11=CxB_reserved, 12=CxC_reserved, 13=CxD_reserved, 14=CxE_reserved, 15=CxF_reserved
  compu method CM_HD_AVMInfoDisplayHSC4: phys=raw for raw 0..15, 0=Cx0_no_Request (no Request), 1=Cx1_Vehicle_speed_is_too_fast (Vehicle speed is too fast), 2=Cx2_reserved, 3=Cx3_reserved, 4=Cx4_reserved, 5=Cx5_reserved, 6=Cx6_reserved, 7=Cx7_reserved, 8=Cx8_reserved, 9=Cx9_reserved, 10=CxA_reserved, 11=CxB_reserved, 12=CxC_reserved, 13=CxD_reserved, 14=CxE_reserved, 15=CxF_reserved
  compu method CM_HD_AVMsysrdyHSC4: phys=raw for raw 0..1, 0=Cx0_not_ready (not ready), 1=Cx1_ready
  compu method CM_HD_AVMVideoFmtStaHSC4: phys=raw for raw 0..15, 0=Cx0_Unlocked, 1=Cx1_1440_640 (1440*640), 2=Cx2_1200_900 (1200*900), 3=Cx3_FIRST_DRIVE, 4=Cx4_PDC_detected, 5=Cx5_Reserved, 6=Cx6_Reserved, 7=Cx7_Reserved, 8=Cx8_Reserved, 9=Cx9_Reserved, 10=CxA_Reserved, 11=CxB_Reserved, 12=CxC_Reserved, 13=CxD_Reserved, 14=CxE_Reserved, 15=CxF_Reserved
  compu method CM_HourOfDay_SecCAN2: phys=raw for raw 0..23
  compu method CM_HourOfDayHSC2: phys=raw for raw 0..23, 0=Cx00_0x0_0x17_ ((0x0 - 0x17))
  compu method CM_HourOfDayHSC4: phys=raw for raw 0..23, 0=Cx00_0x0_0x17_ ((0x0 - 0x17))
  compu method CM_HydBstrCmpstnReqHSC2: phys=raw for raw 0..1, 0=Cx0_HBC_inactive (HBC inactive), 1=Cx1_HBC_active (HBC active)
  compu method CM_IECUToBCMRmtCtrlPotclHSC2: phys=raw for raw 0..18446744073709551615
  compu method CM_IECUToTBOXCtrlPotclHSC4: phys=raw for raw 0..18446744073709551615
  compu method CM_IPCAvlbly_h2_SecCAN2: phys=raw for raw 0..1, 0=Cx0_False, 1=Cx1_True
  compu method CM_IPCAvlbly_h2HSC2: phys=raw for raw 0..1, 0=Cx0_False, 1=Cx1_True
  compu method CM_LDircnIO_SecCAN2: phys=raw for raw 0..1, 0=Cx0_False, 1=Cx1_True
  compu method CM_LDircnIOHSC2: phys=raw for raw 0..1, 0=Cx0_False, 1=Cx1_True
  compu method CM_LDrvnWhlRotlDistPlsCtr_SecCAN2: phys=raw for raw 0..1023
  compu method CM_LDrvnWhlRotlDistPlsCtrHSC2: phys=raw for raw 0..1023, 0=Cx000_0x0_0x3FF_ ((0x0 - 0x3FF))
  compu method CM_LDrvnWhlRotlDistTmsp_SecCAN2: phys=raw for raw 0..65535
  compu method CM_LDrvnWhlRotlDistTmspHSC2: phys=raw for raw 0..65535, 0=Cx0000_0x0_0xFFFF_ ((0x0 - 0xFFFF))
  compu method CM_LDrvnWhlRotlDistTRC_SecCAN2: phys=raw for raw 0..3
  compu method CM_LDrvnWhlRotlDistTRCHSC2: phys=raw for raw 0..3, 0=Cx0_0x0_0x3_ ((0x0 - 0x3))
  compu method CM_LDrvnWhlRotlDistV_SecCAN2: phys=raw for raw 0..1, 0=Cx0_Valid, 1=Cx1_Invalid
  compu method CM_LDrvnWhlRotlDistVHSC2: phys=raw for raw 0..1, 0=Cx0_Valid, 1=Cx1_Invalid
  compu method CM_LDrvnWhlRotlRstOcd_SecCAN2: phys=raw for raw 0..1, 0=Cx0_False, 1=Cx1_True
  compu method CM_LDrvnWhlRotlRstOcdHSC2: phys=raw for raw 0..1, 0=Cx0_False, 1=Cx1_True
  compu method CM_LDrvnWhlRotlSeqNum_SecCAN2: phys=raw for raw 0..3
  compu method CM_LDrvnWhlRotlSeqNumHSC2: phys=raw for raw 0..3, 0=Cx0_0x0_0x3_ ((0x0 - 0x3))
  compu method CM_LdspcOpenSts_SecCAN2: phys=raw for raw 0..3, 0=Cx0_Load_Space_Closed (Load Space Closed), 1=Cx1_Load_Space_Open (Load Space Open), 2=Cx2_Reserved, 3=Cx3_Reserved
  compu method CM_LdspcOpenStsHSC2: phys=raw for raw 0..3, 0=Cx0_Load_Space_Closed (Load Space Closed), 1=Cx1_Load_Space_Open (Load Space Open), 2=Cx2_Reserved, 3=Cx3_Reserved
  compu method CM_LNonDrvnWhlRotlDircn_SecCAN2: phys=raw for raw 0..3, 0=Cx0_No_moving (No moving), 1=Cx1_Moving_forward (Moving forward), 2=Cx2_Moving_backward (Moving backward), 3=Cx3_Error_Invalid (Error/Invalid)
  compu method CM_LNonDrvnWhlRotlDircnHSC2: phys=raw for raw 0..3, 0=Cx0_No_moving (No moving), 1=Cx1_Moving_forward (Moving forward), 2=Cx2_Moving_backward (Moving backward), 3=Cx3_Error_Invalid (Error/Invalid)
  compu method CM_LNonDrvnWhlRotlDistPC_SecCAN2: phys=raw for raw 0..1023
  compu method CM_LNonDrvnWhlRotlDistPCHSC2: phys=raw for raw 0..1023, 0=Cx000_0x0_0x3FF_ ((0x0 - 0x3FF))
  compu method CM_LNonDrvnWhlRotlDistT_SecCAN2: phys=raw for raw 0..65535
  compu method CM_LNonDrvnWhlRotlDistTHSC2: phys=raw for raw 0..65535, 0=Cx0000_0x0_0xFFFF_ ((0x0 - 0xFFFF))
  compu method CM_LNonDrvnWhlRotlDistTRC_SecCAN2: phys=raw for raw 0..3
  compu method CM_LNonDrvnWhlRotlDistTRCHSC2: phys=raw for raw 0..3, 0=Cx0_0x0_0x3_ ((0x0 - 0x3))
  compu method CM_LNonDrvnWhlRotlDistV_SecCAN2: phys=raw for raw 0..1, 0=Cx0_Valid, 1=Cx1_Invalid
  compu method CM_LNonDrvnWhlRotlDistVHSC2: phys=raw for raw 0..1, 0=Cx0_Valid, 1=Cx1_Invalid
  compu method CM_LNonDrvnWhlRotlRstOcd_SecCAN2: phys=raw for raw 0..1, 0=Cx0_False, 1=Cx1_True
  compu method CM_LNonDrvnWhlRotlRstOcdHSC2: phys=raw for raw 0..1, 0=Cx0_False, 1=Cx1_True
  compu method CM_LNonDrvnWhlRotlSeqNum_SecCAN2: phys=raw for raw 0..3
  compu method CM_LNonDrvnWhlRotlSeqNumHSC2: phys=raw for raw 0..3, 0=Cx0_0x0_0x3_ ((0x0 - 0x3))
  compu method CM_LRCTAWrnngHSC4: phys=raw for raw 0..3, 0=Cx0_no_warning (no warning), 1=Cx1_warning_level_1 (warning level 1), 2=Cx2_warning_level_2 (warning level 2)
  compu method CM_MainBeamLghtOnHSC2: phys=raw for raw 0..1, 0=Cx0_False, 1=Cx1_True
  compu method CM_MinuteOfHour_SecCAN2: phys=raw for raw 0..59
  compu method CM_MinuteOfHourHSC2: phys=raw for raw 0..59, 0=Cx00_0x0_0x3B_ ((0x0 - 0x3B))
  compu method CM_MinuteOfHourHSC4: phys=raw for raw 0..59, 0=Cx00_0x0_0x3B_ ((0x0 - 0x3B))
  compu method CM_NRCDAlvRC_SecCAN2: phys=raw for raw 0..255
  compu method CM_NRCDAlvRCHSC2: phys=raw for raw 0..255, 0=Cx00_0x0_0xFF_ ((0x0 - 0xFF))
  compu method CM_NRCDF_SecCAN2: phys=raw for raw 0..1, 0=Cx0_Normal, 1=Cx1_NRCD_failure (NRCD failure)
  compu method CM_NRCDFHSC2: phys=raw for raw 0..1, 0=Cx0_Normal, 1=Cx1_NRCD_failure (NRCD failure)
  compu method CM_NRCDMstrChlg_h2_SecCAN2: phys=raw
  compu method CM_NRCDMstrChlg_h2HSC2: phys=raw for raw 0, 0=Cx0000000000000000_0x0_0xFFFFFFFF_ ((0x0 - 0xFFFFFFFF))
  compu method CM_NRCDSts_h2_SecCAN2: phys=raw for raw 0..3, 0=Cx0_Inactive, 1=Cx1_NRCD_Active (NRCD Active), 2=Cx2_Semiautomatic_Parking_Assistant_Active (Semiautomatic Parking Assistant Active), 3=Cx3_Fully_APA_Active (Fully-APA Active)
  compu method CM_NRCDSts_h2HSC2: phys=raw for raw 0..3, 0=Cx0_Inactive, 1=Cx1_NRCD_Active (NRCD Active), 2=Cx2_Semiautomatic_Parking_Assistant_Active (Semiautomatic Parking Assistant Active), 3=Cx3_Fully_APA_Active (Fully-APA Active)
  compu method CM_OtsdAirTemCrVal_h2_SecCAN2: phys=raw*0.5-40 for raw 0..255; unit degC
  compu method CM_OtsdAirTemCrVal_h2HSC2: 0=Cx00_degC_0x0_0xFF_ (degC (0x0 - 0xFF)), phys=raw*0.5-40 for raw 0..255; unit degC
  compu method CM_OtsdAirTemCrValMsk_h2_SecCAN2: phys=raw for raw 0..1, 0=Cx0_Don_t_Use_Data (Don't Use Data), 1=Cx1_Use_Data (Use Data)
  compu method CM_OtsdAirTemCrValMsk_h2HSC2: phys=raw for raw 0..1, 0=Cx0_Don_t_Use_Data (Don't Use Data), 1=Cx1_Use_Data (Use Data)
  compu method CM_OtsdAirTemCrValV_h2_SecCAN2: phys=raw for raw 0..1, 0=Cx0_Valid, 1=Cx1_Invalid
  compu method CM_OtsdAirTemCrValV_h2HSC2: phys=raw for raw 0..1, 0=Cx0_Valid, 1=Cx1_Invalid
  compu method CM_P2PACTMdChngTmotHSC4: phys=raw for raw 0..255, 0=Cx00_s_0x0_0xFF_ (s (0x0 - 0xFF)); unit s
  compu method CM_P2PDisplayHSC4: phys=raw for raw 0..255, 0=Cx00_0x0_0xFF_ ((0x0 - 0xFF))
  compu method CM_P2PExeAvlblHSC4: phys=raw for raw 0..1, 0=Cx0_unavailable, 1=Cx1_available
  compu method CM_P2PExeAvlblVHSC4: phys=raw for raw 0..1, 0=Cx0_Valid, 1=Cx1_Invalid
  compu method CM_P2PProgressHSC4: phys=raw for raw 0..15, 0=Cx0_0_ (0%), 1=Cx1_10_ (10%), 2=Cx2_20_ (20%), 3=Cx3_30_ (30%), 4=Cx4_40_ (40%), 5=Cx5_50_ (50%), 6=Cx6_60_ (60%), 7=Cx7_70_ (70%), 8=Cx8_80_ (80%), 9=Cx9_90_ (90%), 10=CxA_100_ (100%), 15=CxF_No_request (No request)
  compu method CM_P2PSwReqHSC4: phys=raw for raw 0..1, 0=Cx0_False, 1=Cx1_True
  compu method CM_PDCCofignSts_sech2_SecCAN2: phys=raw for raw 0..7, 0=Cx0_3_rear_sensors (3 rear sensors), 1=Cx1_4_rear_sensors (4 rear sensors), 2=Cx2_4_rear_sensors_and_2_front_side_sensors (4 rear sensors and 2 front side sensors), 3=Cx3_4_rear_sensors_and_4_front_sensors (4 rear sensors and 4 front sensors), 4=Cx4_2_rear_sensors (2 rear sensors), 5=Cx5_Reserved, 6=Cx6_Reserved, 7=Cx7_Reserved
  compu method CM_PDCCofignStsHSC2: phys=raw for raw 0..7, 0=Cx0_3_rear_sensors (3 rear sensors), 1=Cx1_4_rear_sensors (4 rear sensors), 2=Cx2_4_rear_sensors_and_2_front_side_sensors (4 rear sensors and 2 front side sensors), 3=Cx3_4_rear_sensors_and_4_front_sensors (4 rear sensors and 4 front sensors), 4=Cx4_2_rear_sensors (2 rear sensors), 5=Cx5_Reserved, 6=Cx6_Reserved, 7=Cx7_Reserved
  compu method CM_PDCSwReq_SecCAN2: phys=raw for raw 0..3, 0=Cx0_No_request (No request), 1=Cx1_Short_press (Short press), 2=Cx2_Long_press (Long press), 3=Cx3_Reserved
  compu method CM_PDCSwReqHSC2: phys=raw for raw 0..3, 0=Cx0_No_request (No request), 1=Cx1_Short_press (Short press), 2=Cx2_Long_press (Long press), 3=Cx3_Reserved
  compu method CM_PDCSwReqHSC4: phys=raw for raw 0..3, 0=Cx0_No_request (No request), 1=Cx1_Short_press (Short press), 2=Cx2_Long_press (Long press), 3=Cx3_Reserved
  compu method CM_PDCSysSts_sech2_SecCAN2: phys=raw for raw 0..15, 0=Cx0_System_OK (System OK), 1=Cx1_System_initialization_sucessful (System initialization sucessful), 2=Cx2_System_Failed (System Failed), 3=Cx3_System_Disabled (System Disabled), 4=Cx4_Front_PDC_Disabled (Front PDC Disabled), 5=Cx5_Front_PDC_Failed (Front PDC Failed), 6=Cx6_Rear_PDC_Failed (Rear PDC Failed), 7=Cx7_Rear_PDC_Disabled (Rear PDC Disabled)
  compu method CM_PDCSysStsHSC2: phys=raw for raw 0..15, 0=Cx0_System_OK (System OK), 1=Cx1_System_initialization_sucessful (System initialization sucessful), 2=Cx2_System_Failed (System Failed), 3=Cx3_System_Disabled (System Disabled), 4=Cx4_Front_PDC_Disabled (Front PDC Disabled), 5=Cx5_Front_PDC_Failed (Front PDC Failed), 6=Cx6_Rear_PDC_Failed (Rear PDC Failed), 7=Cx7_Rear_PDC_Disabled (Rear PDC Disabled)
  compu method CM_Peak_LRU1: phys=raw for raw 0..255
  compu method CM_PEPSSSBAHSC4: phys=raw for raw 0..1, 0=Cx0_False, 1=Cx1_True
  compu method CM_PEPSSSBAVHSC4: phys=raw for raw 0..1, 0=Cx0_Valid, 1=Cx1_Invalid
  compu method CM_PEPSSSBFltStsHSC4: phys=raw for raw 0..7, 0=Cx0_No_Fault (No Fault), 1=Cx1_short_to_GND (short to GND), 2=Cx2_short_to_Battery (short to Battery), 3=Cx3_Stuck, 4=Cx4_Open_Circuit (Open Circuit), 5=Cx5_switch_failed (switch failed), 6=Cx6_Reserved_, 7=Cx7_Reserved_
  compu method CM_PwrMdAutoCtrlAvlblHSC2: phys=raw for raw 0..1, 0=Cx0_unavailable, 1=Cx1_available
  compu method CM_PwrMdMstrAccryA_h2_SecCAN2: phys=raw for raw 0..1, 0=Cx0_Inactive, 1=Cx1_Active
  compu method CM_PwrMdMstrAccryA_h2HSC2: phys=raw for raw 0..1, 0=Cx0_Inactive, 1=Cx1_Active
  compu method CM_PwrMdMstrRunCrkA_h2_SecCAN2: phys=raw for raw 0..1, 0=Cx0_Inactive, 1=Cx1_Active
  compu method CM_PwrMdMstrRunCrkA_h2HSC2: phys=raw for raw 0..1, 0=Cx0_Inactive, 1=Cx1_Active
  compu method CM_RDircnIO_SecCAN2: phys=raw for raw 0..1, 0=Cx0_False, 1=Cx1_True
  compu method CM_RDircnIOHSC2: phys=raw for raw 0..1, 0=Cx0_False, 1=Cx1_True
  compu method CM_RDrvnWhlRotlDistPlsCtr_SecCAN2: phys=raw for raw 0..1023
  compu method CM_RDrvnWhlRotlDistPlsCtrHSC2: phys=raw for raw 0..1023, 0=Cx000_0x0_0x3FF_ ((0x0 - 0x3FF))
  compu method CM_RDrvnWhlRotlDistTmsp_SecCAN2: phys=raw for raw 0..65535
  compu method CM_RDrvnWhlRotlDistTmspHSC2: phys=raw for raw 0..65535, 0=Cx0000_0x0_0xFFFF_ ((0x0 - 0xFFFF))
  compu method CM_RDrvnWhlRotlDistTRC_SecCAN2: phys=raw for raw 0..3
  compu method CM_RDrvnWhlRotlDistTRCHSC2: phys=raw for raw 0..3, 0=Cx0_0x0_0x3_ ((0x0 - 0x3))
  compu method CM_RDrvnWhlRotlDistV_SecCAN2: phys=raw for raw 0..1, 0=Cx0_Valid, 1=Cx1_Invalid
  compu method CM_RDrvnWhlRotlDistVHSC2: phys=raw for raw 0..1, 0=Cx0_Valid, 1=Cx1_Invalid
  compu method CM_RDrvnWhlRotlRstOcd_SecCAN2: phys=raw for raw 0..1, 0=Cx0_False, 1=Cx1_True
  compu method CM_RDrvnWhlRotlRstOcdHSC2: phys=raw for raw 0..1, 0=Cx0_False, 1=Cx1_True
  compu method CM_RDrvnWhlRotlSeqNum_SecCAN2: phys=raw for raw 0..3
  compu method CM_RDrvnWhlRotlSeqNumHSC2: phys=raw for raw 0..3, 0=Cx0_0x0_0x3_ ((0x0 - 0x3))
  compu method CM_RLDoorOpenSts_SecCAN2: phys=raw for raw 0..3, 0=Cx0_Rear_Left_Door_Closed (Rear Left Door Closed), 1=Cx1_Rear_Left_Door_Open_latch_switch_cann_t_detect_door_ajar_status (Rear Left Door Open(latch switch cann't detect door ajar status), 2=Cx2_Rear_Left_Door_Ajar (Rear Left Door Ajar), 3=Cx3_Rear_Left_Door_Full_Open (Rear Left Door Full Open)
  compu method CM_RLDoorOpenStsHSC2: phys=raw for raw 0..3, 0=Cx0_Rear_Left_Door_Closed (Rear Left Door Closed), 1=Cx1_Rear_Left_Door_Open_latch_switch_cann_t_detect_door_ajar_status (Rear Left Door Open(latch switch cann't detect door ajar status), 2=Cx2_Rear_Left_Door_Ajar (Rear Left Door Ajar), 3=Cx3_Rear_Left_Door_Full_Open (Rear Left Door Full Open)
  compu method CM_RLObsDist_sech2_SecCAN2: phys=raw for raw 0..511
  compu method CM_RLObsRng_sech2_SecCAN2: phys=raw for raw 0..15, 0=Cx0_No_Obstacle (No Obstacle), 1=Cx1_Range_1 (Range 1), 2=Cx2_Range_2 (Range 2), 3=Cx3_Range_3 (Range 3), 4=Cx4_Range_4 (Range 4), 5=Cx5_Range_5 (Range 5), 6=Cx6_Range_6 (Range 6), 7=Cx7_Range_7 (Range 7), 8=Cx8_Range_8 (Range 8), 9=Cx9_Range_9 (Range 9), 10=CxA_Range_10 (Range 10), 11=CxB_Range_11 (Range 11), 12=CxC_Range_12 (Range 12), 13=CxD_Range_13 (Range 13), 14=CxE_Range_14 (Range 14), 15=CxF_Range_15 (Range 15)
  compu method CM_RLObsRngHSC2: phys=raw for raw 0..15, 0=Cx0_No_Obstacle (No Obstacle), 1=Cx1_Range_1 (Range 1), 2=Cx2_Range_2 (Range 2), 3=Cx3_Range_3 (Range 3), 4=Cx4_Range_4 (Range 4), 5=Cx5_Range_5 (Range 5), 6=Cx6_Range_6 (Range 6), 7=Cx7_Range_7 (Range 7), 8=Cx8_Range_8 (Range 8), 9=Cx9_Range_9 (Range 9), 10=CxA_Range_10 (Range 10), 11=CxB_Range_11 (Range 11), 12=CxC_Range_12 (Range 12), 13=CxD_Range_13 (Range 13), 14=CxE_Range_14 (Range 14), 15=CxF_Range_15 (Range 15)
  compu method CM_RLSideObsDist_sech2_SecCAN2: phys=raw for raw 0..511
  compu method CM_RLSideObsDistHSC2: phys=raw for raw 0..511, 0=Cx000_0x0_0x1FF_ ((0x0 - 0x1FF))
  compu method CM_RLTirePrsHSC4: 0=Cx00_kPa_0x0_0x7F_ (kPa (0x0 - 0x7F)), phys=raw*4 for raw 0..127; unit kPa
  compu method CM_RLTirePrsVHSC4: phys=raw for raw 0..1, 0=Cx0_Valid, 1=Cx1_Invalid
  compu method CM_RNonDrvnWhlRotlDircn_SecCAN2: phys=raw for raw 0..3, 0=Cx0_No_moving (No moving), 1=Cx1_Moving_forward (Moving forward), 2=Cx2_Moving_backward (Moving backward), 3=Cx3_Error_Invalid (Error/Invalid)
  compu method CM_RNonDrvnWhlRotlDircnHSC2: phys=raw for raw 0..3, 0=Cx0_No_moving (No moving), 1=Cx1_Moving_forward (Moving forward), 2=Cx2_Moving_backward (Moving backward), 3=Cx3_Error_Invalid (Error/Invalid)
  compu method CM_RNonDrvnWhlRotlDistPC_SecCAN2: phys=raw for raw 0..1023
  compu method CM_RNonDrvnWhlRotlDistPCHSC2: phys=raw for raw 0..1023, 0=Cx000_0x0_0x3FF_ ((0x0 - 0x3FF))
  compu method CM_RNonDrvnWhlRotlDistT_SecCAN2: phys=raw for raw 0..65535
  compu method CM_RNonDrvnWhlRotlDistTHSC2: phys=raw for raw 0..65535, 0=Cx0000_0x0_0xFFFF_ ((0x0 - 0xFFFF))
  compu method CM_RNonDrvnWhlRotlDistTRC_SecCAN2: phys=raw for raw 0..3
  compu method CM_RNonDrvnWhlRotlDistTRCHSC2: phys=raw for raw 0..3, 0=Cx0_0x0_0x3_ ((0x0 - 0x3))
  compu method CM_RNonDrvnWhlRotlDistV_SecCAN2: phys=raw for raw 0..1, 0=Cx0_Valid, 1=Cx1_Invalid
  compu method CM_RNonDrvnWhlRotlDistVHSC2: phys=raw for raw 0..1, 0=Cx0_Valid, 1=Cx1_Invalid
  compu method CM_RNonDrvnWhlRotlRstOcd_SecCAN2: phys=raw for raw 0..1, 0=Cx0_False, 1=Cx1_True
  compu method CM_RNonDrvnWhlRotlRstOcdHSC2: phys=raw for raw 0..1, 0=Cx0_False, 1=Cx1_True
  compu method CM_RNonDrvnWhlRotlSeqNum_SecCAN2: phys=raw for raw 0..3
  compu method CM_RNonDrvnWhlRotlSeqNumHSC2: phys=raw for raw 0..3, 0=Cx0_0x0_0x3_ ((0x0 - 0x3))
  compu method CM_Route1SavePercentageHSC4: 0=Cx00_0x0_0x7F_ ((0x0 - 0x7F)), phys=raw*0.01 for raw 0..127
  compu method CM_Route1StateHSC4: phys=raw for raw 0..3, 0=Cx0_No_route (No route), 1=Cx1_Route_exist (Route exist), 2=Cx2_Saving
  compu method CM_Route2SavePercentageHSC4: 0=Cx00_0x0_0x7F_ ((0x0 - 0x7F)), phys=raw*0.01 for raw 0..127
  compu method CM_Route2StateHSC4: phys=raw for raw 0..3, 0=Cx0_No_route (No route), 1=Cx1_Route_exist (Route exist), 2=Cx2_Saving
  compu method CM_RRCTAWrnngHSC4: phys=raw for raw 0..3, 0=Cx0_no_warning (no warning), 1=Cx1_warning_level_1 (warning level 1), 2=Cx2_warning_level_2 (warning level 2)
  compu method CM_RRDoorOpenSts_SecCAN2: phys=raw for raw 0..3, 0=Cx0_Rear_Right_Door_Closed (Rear Right Door Closed), 1=Cx1_Rear_Right_Door_Open_latch_switch_cann_t_detect_door_ajar_status (Rear Right Door Open(latch switch cann't detect door ajar status), 2=Cx2_Rear_Right_Door_Ajar (Rear Right Door Ajar), 3=Cx3_Rear_Right_Door_Full_Open (Rear Right Door Full Open)
  compu method CM_RRDoorOpenStsHSC2: phys=raw for raw 0..3, 0=Cx0_Rear_Right_Door_Closed (Rear Right Door Closed), 1=Cx1_Rear_Right_Door_Open_latch_switch_cann_t_detect_door_ajar_status (Rear Right Door Open(latch switch cann't detect door ajar status), 2=Cx2_Rear_Right_Door_Ajar (Rear Right Door Ajar), 3=Cx3_Rear_Right_Door_Full_Open (Rear Right Door Full Open)
  compu method CM_RrFogLghtOnHSC2: phys=raw for raw 0..1, 0=Cx0_False, 1=Cx1_True
  compu method CM_RrMidLObsDist_sech2_SecCAN2: phys=raw for raw 0..511
  compu method CM_RrMidLObsRng_sech2_SecCAN2: phys=raw for raw 0..15, 0=Cx0_No_Obstacle (No Obstacle), 1=Cx1_Range_1 (Range 1), 2=Cx2_Range_2 (Range 2), 3=Cx3_Range_3 (Range 3), 4=Cx4_Range_4 (Range 4), 5=Cx5_Range_5 (Range 5), 6=Cx6_Range_6 (Range 6), 7=Cx7_Range_7 (Range 7), 8=Cx8_Range_8 (Range 8), 9=Cx9_Range_9 (Range 9), 10=CxA_Range_10 (Range 10), 11=CxB_Range_11 (Range 11), 12=CxC_Range_12 (Range 12), 13=CxD_Range_13 (Range 13), 14=CxE_Range_14 (Range 14), 15=CxF_Range_15 (Range 15)
  compu method CM_RrMidLObsRngHSC2: phys=raw for raw 0..15, 0=Cx0_No_Obstacle (No Obstacle), 1=Cx1_Range_1 (Range 1), 2=Cx2_Range_2 (Range 2), 3=Cx3_Range_3 (Range 3), 4=Cx4_Range_4 (Range 4), 5=Cx5_Range_5 (Range 5), 6=Cx6_Range_6 (Range 6), 7=Cx7_Range_7 (Range 7), 8=Cx8_Range_8 (Range 8), 9=Cx9_Range_9 (Range 9), 10=CxA_Range_10 (Range 10), 11=CxB_Range_11 (Range 11), 12=CxC_Range_12 (Range 12), 13=CxD_Range_13 (Range 13), 14=CxE_Range_14 (Range 14), 15=CxF_Range_15 (Range 15)
  compu method CM_RrMidRObsDist_sech2_SecCAN2: phys=raw for raw 0..511
  compu method CM_RrMidRObsRng_sech2_SecCAN2: phys=raw for raw 0..15, 0=Cx0_No_Obstacle (No Obstacle), 1=Cx1_Range_1 (Range 1), 2=Cx2_Range_2 (Range 2), 3=Cx3_Range_3 (Range 3), 4=Cx4_Range_4 (Range 4), 5=Cx5_Range_5 (Range 5), 6=Cx6_Range_6 (Range 6), 7=Cx7_Range_7 (Range 7), 8=Cx8_Range_8 (Range 8), 9=Cx9_Range_9 (Range 9), 10=CxA_Range_10 (Range 10), 11=CxB_Range_11 (Range 11), 12=CxC_Range_12 (Range 12), 13=CxD_Range_13 (Range 13), 14=CxE_Range_14 (Range 14), 15=CxF_Range_15 (Range 15)
  compu method CM_RrMidRObsRngHSC2: phys=raw for raw 0..15, 0=Cx0_No_Obstacle (No Obstacle), 1=Cx1_Range_1 (Range 1), 2=Cx2_Range_2 (Range 2), 3=Cx3_Range_3 (Range 3), 4=Cx4_Range_4 (Range 4), 5=Cx5_Range_5 (Range 5), 6=Cx6_Range_6 (Range 6), 7=Cx7_Range_7 (Range 7), 8=Cx8_Range_8 (Range 8), 9=Cx9_Range_9 (Range 9), 10=CxA_Range_10 (Range 10), 11=CxB_Range_11 (Range 11), 12=CxC_Range_12 (Range 12), 13=CxD_Range_13 (Range 13), 14=CxE_Range_14 (Range 14), 15=CxF_Range_15 (Range 15)
  compu method CM_RrObsDist_sech2_SecCAN2: phys=raw for raw 0..255
  compu method CM_RRObsDist_sech2_SecCAN2: phys=raw for raw 0..511
  compu method CM_RrObsDistHSC2: phys=raw for raw 0..255, 0=Cx00_0x0_0xFF_ ((0x0 - 0xFF))
  compu method CM_RRObsRng_sech2_SecCAN2: phys=raw for raw 0..15, 0=Cx0_No_Obstacle (No Obstacle), 1=Cx1_Range_1 (Range 1), 2=Cx2_Range_2 (Range 2), 3=Cx3_Range_3 (Range 3), 4=Cx4_Range_4 (Range 4), 5=Cx5_Range_5 (Range 5), 6=Cx6_Range_6 (Range 6), 7=Cx7_Range_7 (Range 7), 8=Cx8_Range_8 (Range 8), 9=Cx9_Range_9 (Range 9), 10=CxA_Range_10 (Range 10), 11=CxB_Range_11 (Range 11), 12=CxC_Range_12 (Range 12), 13=CxD_Range_13 (Range 13), 14=CxE_Range_14 (Range 14), 15=CxF_Range_15 (Range 15)
  compu method CM_RRObsRngHSC2: phys=raw for raw 0..15, 0=Cx0_No_Obstacle (No Obstacle), 1=Cx1_Range_1 (Range 1), 2=Cx2_Range_2 (Range 2), 3=Cx3_Range_3 (Range 3), 4=Cx4_Range_4 (Range 4), 5=Cx5_Range_5 (Range 5), 6=Cx6_Range_6 (Range 6), 7=Cx7_Range_7 (Range 7), 8=Cx8_Range_8 (Range 8), 9=Cx9_Range_9 (Range 9), 10=CxA_Range_10 (Range 10), 11=CxB_Range_11 (Range 11), 12=CxC_Range_12 (Range 12), 13=CxD_Range_13 (Range 13), 14=CxE_Range_14 (Range 14), 15=CxF_Range_15 (Range 15)
  compu method CM_RrPDCAudWrnng_sech2_SecCAN2: phys=raw for raw 0..15, 0=Cx0_No_Obstacle (No Obstacle), 1=Cx1_Range_1 (Range 1), 2=Cx2_Range_2 (Range 2), 3=Cx3_Range_3 (Range 3), 4=Cx4_Range_4 (Range 4), 5=Cx5_Range_5 (Range 5), 6=Cx6_Range_6 (Range 6), 7=Cx7_Range_7 (Range 7), 8=Cx8_Range_8 (Range 8), 9=Cx9_Range_9 (Range 9), 10=CxA_Range_10 (Range 10), 11=CxB_Range_11 (Range 11), 12=CxC_Range_12 (Range 12), 13=CxD_Range_13 (Range 13), 14=CxE_Range_14 (Range 14), 15=CxF_Range_15 (Range 15)
  compu method CM_RrPDCAudWrnngHSC2: phys=raw for raw 0..15, 0=Cx0_No_Obstacle (No Obstacle), 1=Cx1_Range_1 (Range 1), 2=Cx2_Range_2 (Range 2), 3=Cx3_Range_3 (Range 3), 4=Cx4_Range_4 (Range 4), 5=Cx5_Range_5 (Range 5), 6=Cx6_Range_6 (Range 6), 7=Cx7_Range_7 (Range 7), 8=Cx8_Range_8 (Range 8), 9=Cx9_Range_9 (Range 9), 10=CxA_Range_10 (Range 10), 11=CxB_Range_11 (Range 11), 12=CxC_Range_12 (Range 12), 13=CxD_Range_13 (Range 13), 14=CxE_Range_14 (Range 14), 15=CxF_Range_15 (Range 15)
  compu method CM_RRSideObsDist_sech2_SecCAN2: phys=raw for raw 0..511
  compu method CM_RRSideObsDistHSC2: phys=raw for raw 0..511, 0=Cx000_0x0_0x1FF_ ((0x0 - 0x1FF))
  compu method CM_RRTirePrsHSC4: 0=Cx00_kPa_0x0_0x7F_ (kPa (0x0 - 0x7F)), phys=raw*4 for raw 0..127; unit kPa
  compu method CM_RRTirePrsVHSC4: phys=raw for raw 0..1, 0=Cx0_Valid, 1=Cx1_Invalid
  compu method CM_RstrFctryDeftsReq_SecCAN2: phys=raw for raw 0..1, 0=Cx0_False, 1=Cx1_True
  compu method CM_RstrFctryDeftsReqHSC2: phys=raw for raw 0..1, 0=Cx0_False, 1=Cx1_True
  compu method CM_RstrFctryDeftsReqHSC4: phys=raw for raw 0..1, 0=Cx0_False, 1=Cx1_True
  compu method CM_SCREEN_COORD_AXHSC4: phys=raw for raw 0..4095, 0=Cx000_0x0_0xFFF_ ((0x0 - 0xFFF))
  compu method CM_SCREEN_COORD_AYHSC4: phys=raw for raw 0..4095, 0=Cx000_0x0_0xFFF_ ((0x0 - 0xFFF))
  compu method CM_SCREEN_COORD_BXHSC4: phys=raw for raw 0..4095, 0=Cx000_0x0_0xFFF_ ((0x0 - 0xFFF))
  compu method CM_SCREEN_COORD_BYHSC4: phys=raw for raw 0..4095, 0=Cx000_0x0_0xFFF_ ((0x0 - 0xFFF))
  compu method CM_SCSAPAAcclA_SecCAN2: phys=raw for raw 0..1, 0=Cx0_Inactive, 1=Cx1_Active
  compu method CM_SCSAPAAcclAHSC2: phys=raw for raw 0..1, 0=Cx0_Inactive, 1=Cx1_Active
  compu method CM_SCSAPAAlvRC_SecCAN2: phys=raw for raw 0..15
  compu method CM_SCSAPAAlvRCHSC2: phys=raw for raw 0..15, 0=Cx0_0x0_0xF_ ((0x0 - 0xF))
  compu method CM_SCSAPAAvlbl_SecCAN2: phys=raw for raw 0..1, 0=Cx0_Unavailable, 1=Cx1_Available
  compu method CM_SCSAPAAvlblHSC2: phys=raw for raw 0..1, 0=Cx0_Unavailable, 1=Cx1_Available
  compu method CM_SCSNRCDAvlbl_SecCAN2: phys=raw for raw 0..1, 0=Cx0_Unavailable_, 1=Cx1_Available_
  compu method CM_SCSNRCDAvlblHSC2: phys=raw for raw 0..1, 0=Cx0_Unavailable_, 1=Cx1_Available_
  compu method CM_SCUAvlbly_h2_SecCAN2: phys=raw for raw 0..1, 0=Cx0_False, 1=Cx1_True
  compu method CM_SCUAvlbly_h2HSC2: phys=raw for raw 0..1, 0=Cx0_False, 1=Cx1_True
  compu method CM_SCUDrvrIntrvnA_SecCAN2: phys=raw for raw 0..1, 0=Cx0_Inactive, 1=Cx1_Active
  compu method CM_SCUDrvrIntrvnAHSC2: phys=raw for raw 0..1, 0=Cx0_Inactive, 1=Cx1_Active
  compu method CM_SCUNRCDAvlbl_SecCAN2: phys=raw for raw 0..1, 0=Cx0_Unavailable, 1=Cx1_Available
  compu method CM_SCUNRCDAvlblHSC2: phys=raw for raw 0..1, 0=Cx0_Unavailable, 1=Cx1_Available
  compu method CM_SCUShifterLvrPosHSC2: phys=raw for raw 0..15, 0=Cx0_SCU_Initialization (SCU Initialization), 1=Cx1_S_Sport_mode_ (S(Sport mode)), 2=Cx2_W_Winter_mode_ (W(Winter mode)), 3=Cx3_M_Manual_mode_ (M(Manual mode)), 5=Cx5_D_Drive_ (D(Drive)), 6=Cx6_N_Neutral_ (N(Neutral)), 7=Cx7_R_Reverse_ (R(Reverse)), 8=Cx8_P_Park_ (P(Park)), 10=CxA_Error
  compu method CM_SCUShifterPosInvsnHSC2: phys=raw for raw 0..15, 5=Cx5_Error, 6=Cx6_Reserved, 7=Cx7_P_Park_ (P(Park)), 8=Cx8_R_Reverse_ (R (Reverse)), 9=Cx9_N_Neutral_ (N (Neutral)), 10=CxA_D_Drive_ (D (Drive)), 11=CxB_Reserved, 12=CxC_M_Manual_mode_ (M(Manual mode)), 13=CxD_W_Winter_mode_ (W(Winter mode)), 14=CxE_S_Sport_mode_ (S(Sport mode)), 15=CxF_SCU_initialization (SCU initialization)
  compu method CM_SCUShifterPosRCHSC2: phys=raw for raw 0..15, 0=Cx0_0x0_0xF_ ((0x0 - 0xF))
  compu method CM_SDMAvlbly_h2_SecCAN2: phys=raw for raw 0..1, 0=Cx0_False, 1=Cx1_True
  compu method CM_SDMAvlbly_h2HSC2: phys=raw for raw 0..1, 0=Cx0_False, 1=Cx1_True
  compu method CM_SecsOfMinute_SecCAN2: phys=raw for raw 0..59
  compu method CM_SecsOfMinuteHSC2: phys=raw for raw 0..59, 0=Cx00_0x0_0x3B_ ((0x0 - 0x3B))
  compu method CM_SecsOfMinuteHSC4: phys=raw for raw 0..59, 0=Cx00_0x0_0x3B_ ((0x0 - 0x3B))
  compu method CM_Sig_Init_SRU3: phys=raw for raw 0..255
  compu method CM_Sin_Init_LRU1: phys=raw for raw 0..255
  compu method CM_Status_LRU1: phys=raw for raw 0..255
  compu method CM_Status_SRU3: phys=raw for raw 0..1
  compu method CM_StrgWhlAng_SecCAN2: 65535=CxFFFF_error_mark (error mark), phys=raw*0.0625-2048 for raw 0..65535; unit degree  # Source signal range: [0,65534.08]
  compu method CM_StrgWhlAngHSC2: 0=Cx0000_degree_0x0_0xFFFE_ (degree (0x0 - 0xFFFE)), 65535=CxFFFF_error_mark (error mark), phys=raw*0.0625-2048 for raw 0..65535; unit degree  # Source signal range: [0,65534.08]
  compu method CM_StrgWhlAngV_SecCAN2: phys=raw for raw 0..1, 0=Cx0_Valid, 1=Cx1_Invalid
  compu method CM_StrgWhlAngVHSC2: phys=raw for raw 0..1, 0=Cx0_Valid, 1=Cx1_Invalid
  compu method CM_SurndViewSelnHSC4: phys=raw for raw 0..15, 0=Cx0_No_request (No request), 1=Cx1_front_view, 2=Cx2_front_view_wide, 3=Cx3_Rear_view, 4=Cx4_2D_Rear_view_wide, 5=Cx5_left_right_view_wide, 6=Cx6_front_left_view_3D_ (front_left_view(3D)), 7=Cx7_front_right_view_3D_ (front_right_view(3D)), 8=Cx8_rear_left_view_3D_ (rear_left_view(3D)), 9=Cx9_rear_right_view_3D_ (rear_right_view(3D)), 10=CxA_full_screen, 11=CxB_Reserved, 12=CxC_Reserved, 13=CxD_Reserved, 14=CxE_Reserved, 15=CxF_Reserved
  compu method CM_SysBPM_SecCAN2: phys=raw for raw 0..3, 0=Cx0_Off, 1=Cx1_ACC, 2=Cx2_Run, 3=Cx3_Crank_Request (Crank Request)
  compu method CM_SysBPMEnbd_SecCAN2: phys=raw for raw 0..1, 0=Cx0_False, 1=Cx1_True
  compu method CM_SysBPMEnbdHSC2: phys=raw for raw 0..1, 0=Cx0_False, 1=Cx1_True
  compu method CM_SysBPMHSC2: phys=raw for raw 0..3, 0=Cx0_Off, 1=Cx1_ACC, 2=Cx2_Run, 3=Cx3_Crank_Request (Crank Request)
  compu method CM_SysOpnlMd_h2_SecCAN2: phys=raw for raw 0..7, 0=Cx0_Normal_Mode (Normal Mode), 1=Cx1_Manufacturing_Mode (Manufacturing Mode), 2=Cx2_Transit_Mode (Transit Mode), 3=Cx3_Show_Room_Reserve_ (Show Room(Reserve)), 4=Cx4_Storage_Mode (Storage Mode), 5=Cx5_Diagnosic_or_Reprogramming_Reserve_ (Diagnosic or Reprogramming(Reserve))
  compu method CM_SysOpnlMd_h2HSC2: phys=raw for raw 0..7, 0=Cx0_Normal_Mode (Normal Mode), 1=Cx1_Manufacturing_Mode (Manufacturing Mode), 2=Cx2_Transit_Mode (Transit Mode), 3=Cx3_Show_Room_Reserve_ (Show Room(Reserve)), 4=Cx4_Storage_Mode (Storage Mode), 5=Cx5_Diagnosic_or_Reprogramming_Reserve_ (Diagnosic or Reprogramming(Reserve))
  compu method CM_SysPwrMd_h2_SecCAN2: phys=raw for raw 0..3, 0=Cx0_Off, 1=Cx1_Accessory, 2=Cx2_Run, 3=Cx3_Crank_Request (Crank Request)
  compu method CM_SysPwrMd_h2HSC2: phys=raw for raw 0..3, 0=Cx0_Off, 1=Cx1_Accessory, 2=Cx2_Run, 3=Cx3_Crank_Request (Crank Request)
  compu method CM_SysVol_h2_SecCAN2: phys=raw*0.1+3 for raw 0..255; unit V
  compu method CM_SysVol_h2HSC2: 0=Cx00_V_0x0_0xFF_ (V (0x0 - 0xFF)), phys=raw*0.1+3 for raw 0..255; unit V
  compu method CM_SysVolMd_h2_SecCAN2: phys=raw for raw 0..3, 0=Cx0_Normal, 1=Cx1_Low_System_Voltage (Low System Voltage), 2=Cx2_High_System_Voltage (High System Voltage), 3=Cx3_Illegal_System_Voltage (Illegal System Voltage)
  compu method CM_SysVolMd_h2HSC2: phys=raw for raw 0..3, 0=Cx0_Normal, 1=Cx1_Low_System_Voltage (Low System Voltage), 2=Cx2_High_System_Voltage (High System Voltage), 3=Cx3_Illegal_System_Voltage (Illegal System Voltage)
  compu method CM_SysVolMdV_h2_SecCAN2: phys=raw for raw 0..1, 0=Cx0_Valid, 1=Cx1_Invalid
  compu method CM_SysVolMdV_h2HSC2: phys=raw for raw 0..1, 0=Cx0_Valid, 1=Cx1_Invalid
  compu method CM_SysVolV_h2_SecCAN2: phys=raw for raw 0..1, 0=Cx0_Valid, 1=Cx1_Invalid
  compu method CM_SysVolV_h2HSC2: phys=raw for raw 0..1, 0=Cx0_Valid, 1=Cx1_Invalid
  compu method CM_TBOXAccelZHSC4: -2048=Cx800_m_s2_0xFFFFF800_0x7FF_ (m/s2 (0xFFFFF800 - 0x7FF)), phys=raw/64 for raw -2048..2047; unit m/s2
  compu method CM_TBOXAccelZVHSC4: phys=raw for raw 0..1, 0=Cx0_Valid, 1=Cx1_Invalid
  compu method CM_TboxP2PRCHSC4: phys=raw for raw 0..15, 0=Cx0_0x0_0xF_ ((0x0 - 0xF))
  compu method CM_TBOXToIECUCtrlPotclHSC4: phys=raw for raw 0..18446744073709551615
  compu method CM_TCAvlbly_h2_SecCAN2: phys=raw for raw 0..1, 0=Cx0_False, 1=Cx1_True
  compu method CM_TCAvlbly_h2HSC2: phys=raw for raw 0..1, 0=Cx0_False, 1=Cx1_True
  compu method CM_TCSA_SecCAN2: phys=raw for raw 0..1, 0=Cx0_False, 1=Cx1_True
  compu method CM_TCSAHSC2: phys=raw for raw 0..1, 0=Cx0_False, 1=Cx1_True
  compu method CM_TimeDspFmt_SecCAN2: phys=raw for raw 0..1, 0=Cx0_12_hour_mode (12 hour mode), 1=Cx1_24_hour_mode (24 hour mode)
  compu method CM_TimeDspFmtHSC2: phys=raw for raw 0..1, 0=Cx0_12_hour_mode (12 hour mode), 1=Cx1_24_hour_mode (24 hour mode)
  compu method CM_TimeDspFmtHSC4: phys=raw for raw 0..1, 0=Cx0_12_hour_mode (12 hour mode), 1=Cx1_24_hour_mode (24 hour mode)
  compu method CM_TMSpd_h1_SecCAN2: phys=raw-32768 for raw 0..65535; unit rpm
  compu method CM_TMSpd_h1HSC4: 0=Cx0000_rpm_0x0_0xFFFF_ (rpm (0x0 - 0xFFFF)), phys=raw-32768 for raw 0..65535; unit rpm
  compu method CM_TMSpdV_h1_SecCAN2: phys=raw for raw 0..1, 0=Cx0_Valid, 1=Cx1_Invalid
  compu method CM_TMSpdV_h1HSC4: phys=raw for raw 0..1, 0=Cx0_Valid, 1=Cx1_Invalid
  compu method CM_TOF_LRU1: phys=raw for raw 0..65535
  compu method CM_TOF_SRU3: phys=raw for raw 0..127
  compu method CM_TOUCH_SCREEN_ACMDHSC4: phys=raw for raw 0..15, 0=Cx0_No_command, 1=Cx1_Screen_touched (Screen touched), 2=Cx2_Screen_hold_reserved_ (Screen hold(reserved)), 3=Cx3_Screen_release (Screen release), 4=Cx4_Reserved, 5=Cx5_Reserved, 6=Cx6_Reserved, 7=Cx7_Reserved, 8=Cx8_Reserved, 9=Cx9_Reserved, 10=CxA_Reserved, 11=CxB_Reserved, 12=CxC_Reserved, 13=CxD_Reserved, 14=CxE_Reserved, 15=CxF_Reserved
  compu method CM_TOUCH_SCREEN_BCMDHSC4: phys=raw for raw 0..15, 0=Cx0_No_command, 1=Cx1_Screen_touched (Screen touched), 2=Cx2_Screen_hold_reserved_ (Screen hold(reserved)), 3=Cx3_Screen_release (Screen release), 4=Cx4_Reserved, 5=Cx5_Reserved, 6=Cx6_Reserved, 7=Cx7_Reserved, 8=Cx8_Reserved, 9=Cx9_Reserved, 10=CxA_Reserved, 11=CxB_Reserved, 12=CxC_Reserved, 13=CxD_Reserved, 14=CxE_Reserved, 15=CxF_Reserved
  compu method CM_TOUCH_SCREEN_STATUS_h4HSC4: phys=raw for raw 0..15, 0=Cx0_No_command (No command), 1=Cx1_double_point_touch (double point touch), 2=Cx2_one_point_touch (one point touch), 3=Cx3_one_point_swipe (one point swipe), 4=Cx4_Reserved, 5=Cx5_Reserved, 6=Cx6_Reserved, 7=Cx7_Reserved, 8=Cx8_Reserved, 9=Cx9_Reserved, 10=CxA_Reserved, 11=CxB_Reserved, 12=CxC_Reserved, 13=CxD_Reserved, 14=CxE_Reserved, 15=CxF_Reserved
  compu method CM_TPMSFHSC4: phys=raw for raw 0..1, 0=Cx0_False, 1=Cx1_True
  compu method CM_TrlrHitchSwA_SecCAN2: phys=raw for raw 0..1, 0=Cx0_False, 1=Cx1_True
  compu method CM_TrlrHitchSwAHSC2: phys=raw for raw 0..1, 0=Cx0_False, 1=Cx1_True
  compu method CM_TrShftLvrPos_h1_SecCAN2: phys=raw for raw 0..15, 0=Cx0_Between_Ranges (Between Ranges), 1=Cx1_Park_Range (Park Range), 2=Cx2_Reverse_Range (Reverse Range), 3=Cx3_Neutral_Range (Neutral Range), 4=Cx4_Forward_Range_A (Forward Range A), 5=Cx5_Forward_Range_B (Forward Range B), 6=Cx6_Forward_Range_C (Forward Range C), 7=Cx7_Forward_Range_D (Forward Range D), 8=Cx8_Forward_Range_E (Forward Range E), 9=Cx9_Forward_Range_F (Forward Range F), 10=CxA_Forward_Range_G (Forward Range G), 11=CxB_Forward_Range_H (Forward Range H), 15=CxF_Lever_Position_Unknown (Lever Position Unknown)
  compu method CM_TrShftLvrPos_h1HSC2: phys=raw for raw 0..15, 0=Cx0_Between_Ranges (Between Ranges), 1=Cx1_Park_Range (Park Range), 2=Cx2_Reverse_Range (Reverse Range), 3=Cx3_Neutral_Range (Neutral Range), 4=Cx4_Forward_Range_A (Forward Range A), 5=Cx5_Forward_Range_B (Forward Range B), 6=Cx6_Forward_Range_C (Forward Range C), 7=Cx7_Forward_Range_D (Forward Range D), 8=Cx8_Forward_Range_E (Forward Range E), 9=Cx9_Forward_Range_F (Forward Range F), 10=CxA_Forward_Range_G (Forward Range G), 11=CxB_Forward_Range_H (Forward Range H), 15=CxF_Lever_Position_Unknown (Lever Position Unknown)
  compu method CM_TrShftLvrPosV_h1_SecCAN2: phys=raw for raw 0..1, 0=Cx0_Valid, 1=Cx1_Invalid
  compu method CM_TrShftLvrPosV_h1HSC2: phys=raw for raw 0..1, 0=Cx0_Valid, 1=Cx1_Invalid
  compu method CM_VCUAccReqSts_SecCAN2: phys=raw for raw 0..1, 0=Cx0_No_Request (No Request), 1=Cx1_Request
  compu method CM_VCUAccReqStsHSC2: phys=raw for raw 0..1, 0=Cx0_No_Request (No Request), 1=Cx1_Request
  compu method CM_VCUAccReqVal_SecCAN2: phys=raw*0.1-12.7 for raw 0..255
  compu method CM_VCUAccReqValHSC2: 0=Cx00_0x0_0xFF_ ((0x0 - 0xFF)), phys=raw*0.1-12.7 for raw 0..255
  compu method CM_VCUNRCDAvlbl_SecCAN2: phys=raw for raw 0..1, 0=Cx0_Unavailable, 1=Cx1_Available
  compu method CM_VCUNRCDAvlblHSC2: phys=raw for raw 0..1, 0=Cx0_Unavailable, 1=Cx1_Available
  compu method CM_VehBkwdSwReqHSC4: phys=raw for raw 0..1, 0=Cx0_False, 1=Cx1_True
  compu method CM_VehBkwdSwReqVHSC4: phys=raw for raw 0..1, 0=Cx0_Valid, 1=Cx1_Invalid
  compu method CM_VehDynYawRate_SecCAN2: phys=raw*0.0625 for raw -2048..2047; unit deg/s
  compu method CM_VehDynYawRateHSC2: -2048=Cx800_deg_s_0xFFFFF800_0x7FF_ (deg/s (0xFFFFF800 - 0x7FF)), phys=raw*0.0625 for raw -2048..2047; unit deg/s
  compu method CM_VehDynYawRateV_SecCAN2: phys=raw for raw 0..1, 0=Cx0_Valid, 1=Cx1_Invalid
  compu method CM_VehDynYawRateVHSC2: phys=raw for raw 0..1, 0=Cx0_Valid, 1=Cx1_Invalid
  compu method CM_VehFwdSwReqHSC4: phys=raw for raw 0..1, 0=Cx0_False, 1=Cx1_True
  compu method CM_VehFwdSwReqVHSC4: phys=raw for raw 0..1, 0=Cx0_Valid, 1=Cx1_Invalid
  compu method CM_VehLckngStaHSC4: phys=raw for raw 0..7, 0=Cx0_Unlocked, 1=Cx1_Signal_Position_Entry_Unlocked (Signal Position Entry Unlocked), 2=Cx2_Interior_Locked (Interior Locked), 3=Cx3_Exterior_Locked (Exterior Locked), 4=Cx4_Super_locked (Super locked), 5=Cx5_Reserved, 6=Cx6_Reserved, 7=Cx7_Unknow
  compu method CM_VehOdo_h2_SecCAN2: phys=raw for raw 0..16777200
  compu method CM_VehOdo_h2HSC2: phys=raw for raw 0..16777200, 0=Cx000000_0x0_0xFFFFFF_ ((0x0 - 0xFFFFFF))
  compu method CM_VehOdoV_h2_SecCAN2: phys=raw for raw 0..1, 0=Cx0_Valid, 1=Cx1_Invalid
  compu method CM_VehOdoV_h2HSC2: phys=raw for raw 0..1, 0=Cx0_Valid, 1=Cx1_Invalid
  compu method CM_VehRoadWhlLReqHSC4: phys=raw for raw 0..1, 0=Cx0_False, 1=Cx1_True
  compu method CM_VehRoadWhlLReqVHSC4: phys=raw for raw 0..1, 0=Cx0_Valid, 1=Cx1_Invalid
  compu method CM_VehRoadWhlRReqHSC4: phys=raw for raw 0..1, 0=Cx0_False, 1=Cx1_True
  compu method CM_VehRoadWhlRReqVHSC4: phys=raw for raw 0..1, 0=Cx0_Valid, 1=Cx1_Invalid
  compu method CM_VehSideLghtStsHSC2: phys=raw for raw 0..3, 0=Cx0_No_side_light_on_ (No side light on), 1=Cx1_Left_side_light_on_only (Left side light on only), 2=Cx2_Right_side_light_on_only (Right side light on only), 3=Cx3_All_side_light_and_license_plate_light_on (All side light and license plate light on)
  compu method CM_VehSpdAvgDrvn_SecCAN2: phys=raw/64 for raw 0..32766; unit km/h
  compu method CM_VehSpdAvgDrvnHSC2: 0=Cx0000_km_h_0x0_0x7FFF_ (km/h (0x0 - 0x7FFF)), phys=raw/64 for raw 0..32766; unit km/h
  compu method CM_VehSpdAvgDrvnV_SecCAN2: phys=raw for raw 0..1, 0=Cx0_Valid, 1=Cx1_Invalid
  compu method CM_VehSpdAvgDrvnVHSC2: phys=raw for raw 0..1, 0=Cx0_Valid, 1=Cx1_Invalid
  compu method CM_VehSpdAvgNonDrvn_SecCAN2: phys=raw/64 for raw 0..32766; unit km/h
  compu method CM_VehSpdAvgNonDrvnHSC2: 0=Cx0000_km_h_0x0_0x7FFF_ (km/h (0x0 - 0x7FFF)), phys=raw/64 for raw 0..32766; unit km/h
  compu method CM_VehSpdAvgNonDrvnV_SecCAN2: phys=raw for raw 0..1, 0=Cx0_Valid, 1=Cx1_Invalid
  compu method CM_VehSpdAvgNonDrvnVHSC2: phys=raw for raw 0..1, 0=Cx0_Valid, 1=Cx1_Invalid
  compu method CM_VSELatAcc_SecCAN2: phys=raw/64 for raw -2048..2047; unit m/s^2
  compu method CM_VSELatAccHSC2: -2048=Cx800_m_s_2_0xFFFFF800_0x7FF_ (m/s^2 (0xFFFFF800 - 0x7FF)), phys=raw/64 for raw -2048..2047; unit m/s^2
  compu method CM_VSELatAccV_SecCAN2: phys=raw for raw 0..1, 0=Cx0_Valid, 1=Cx1_Invalid
  compu method CM_VSELatAccVHSC2: phys=raw for raw 0..1, 0=Cx0_Valid, 1=Cx1_Invalid
  compu method CM_VSELongtAcc_SecCAN2: phys=raw*0.03 for raw -512..511; unit m/s^2
  compu method CM_VSELongtAccHSC2: -512=Cx200_m_s_2_0xFFFFFE00_0x1FF_ (m/s^2 (0xFFFFFE00 - 0x1FF)), phys=raw*0.03 for raw -512..511; unit m/s^2
  compu method CM_VSELongtAccV_SecCAN2: phys=raw for raw 0..1, 0=Cx0_Valid, 1=Cx1_Invalid
  compu method CM_VSELongtAccVHSC2: phys=raw for raw 0..1, 0=Cx0_Valid, 1=Cx1_Invalid
  compu method CM_VSESysA_SecCAN2: phys=raw for raw 0..1, 0=Cx0_False, 1=Cx1_True
  compu method CM_VSESysAHSC2: phys=raw for raw 0..1, 0=Cx0_False, 1=Cx1_True
  compu method CM_WhlGndVelLDrvn_SecCAN2: phys=raw/32 for raw 0..16383; unit km/h
  compu method CM_WhlGndVelLDrvnHSC2: 0=Cx0000_km_h_0x0_0x3FFF_ (km/h (0x0 - 0x3FFF)), phys=raw/32 for raw 0..16383; unit km/h
  compu method CM_WhlGndVelLDrvnV_SecCAN2: phys=raw for raw 0..1, 0=Cx0_Valid, 1=Cx1_Invalid
  compu method CM_WhlGndVelLDrvnVHSC2: phys=raw for raw 0..1, 0=Cx0_Valid, 1=Cx1_Invalid
  compu method CM_WhlGndVelLNonDrvn_SecCAN2: phys=raw/32 for raw 0..16383; unit km/h
  compu method CM_WhlGndVelLNonDrvnHSC2: 0=Cx0000_km_h_0x0_0x3FFF_ (km/h (0x0 - 0x3FFF)), phys=raw/32 for raw 0..16383; unit km/h
  compu method CM_WhlGndVelLNonDrvnV_SecCAN2: phys=raw for raw 0..1, 0=Cx0_Valid, 1=Cx1_Invalid
  compu method CM_WhlGndVelLNonDrvnVHSC2: phys=raw for raw 0..1, 0=Cx0_Valid, 1=Cx1_Invalid
  compu method CM_WhlGndVelRDrvn_SecCAN2: phys=raw/32 for raw 0..16383; unit km/h
  compu method CM_WhlGndVelRDrvnHSC2: 0=Cx0000_km_h_0x0_0x3FFF_ (km/h (0x0 - 0x3FFF)), phys=raw/32 for raw 0..16383; unit km/h
  compu method CM_WhlGndVelRDrvnV_SecCAN2: phys=raw for raw 0..1, 0=Cx0_Valid, 1=Cx1_Invalid
  compu method CM_WhlGndVelRDrvnVHSC2: phys=raw for raw 0..1, 0=Cx0_Valid, 1=Cx1_Invalid
  compu method CM_WhlGndVelRNonDrvn_SecCAN2: phys=raw/32 for raw 0..16383; unit km/h
  compu method CM_WhlGndVelRNonDrvnHSC2: 0=Cx0000_km_h_0x0_0x3FFF_ (km/h (0x0 - 0x3FFF)), phys=raw/32 for raw 0..16383; unit km/h
  compu method CM_WhlGndVelRNonDrvnV_SecCAN2: phys=raw for raw 0..1, 0=Cx0_Valid, 1=Cx1_Invalid
  compu method CM_WhlGndVelRNonDrvnVHSC2: phys=raw for raw 0..1, 0=Cx0_Valid, 1=Cx1_Invalid
  compu method CM_Width_LRU1: phys=raw for raw 0..1
package /DataType/Unit
  18 x unit, all with factor-si-to-unit=1, offset-si-to-unit=0:
    U_cm: display-name=cm
    U_days: display-name=days
    U_degC: display-name=degC
    U_degree: display-name=degree
    U_degYs: display-name=deg/s
    U_kmYh: display-name=km/h
    U_kPa: display-name=kPa
    U_m: display-name=m
    U_mYs2: display-name=m/s2
    U_mYsX2: display-name=m/s^2
    U_Nm: display-name=Nm
    U_p: display-name=%
    U_Reserve: display-name=Reserve
    U_reserved: display-name=reserved
    U_rpm: display-name=rpm
    U_s: display-name=s
    U_V: display-name=V
    U_year: display-name=year
package /Predefined_DEV/ImplementationDataTypes
  impl type Dem_UdsStatusByteType: compu {mask 1: 1=DEM_UDS_STATUS_TF, mask 2: 2=DEM_UDS_STATUS_TFTOC, mask 4: 4=DEM_UDS_STATUS_PDTC, mask 8: 8=DEM_UDS_STATUS_CDTC, mask 16: 16=DEM_UDS_STATUS_TNCSLC, mask 32: 32=DEM_UDS_STATUS_TFSLC, mask 64: 64=DEM_UDS_STATUS_TNCTOC, mask 128: 128=DEM_UDS_STATUS_WIR}, range raw 0..255, implementation-data-type=uint8
  impl type NvM_RequestResultType: compu {0=NVM_REQ_OK, 1=NVM_REQ_NOT_OK, 2=NVM_REQ_PENDING, 3=NVM_REQ_INTEGRITY_FAILED, 4=NVM_REQ_BLOCK_SKIPPED, 5=NVM_REQ_NV_INVALIDATED, 6=NVM_REQ_CANCELED, 7=NVM_REQ_REDUNDANCY_FAILED, 8=NVM_REQ_RESTORED_FROM_ROM}, implementation-data-type=uint8
  impl type NvM_ServiceIdType: compu {6=NVM_READ_BLOCK, 7=NVM_WRITE_BLOCK, 8=NVM_RESTORE_BLOCK_DEFAULTS, 9=NVM_ERASE_BLOCK, 11=NVM_INVALIDATE_NV_BLOCK, 12=NVM_READ_ALL}, implementation-data-type=uint8
