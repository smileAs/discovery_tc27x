AUTOSAR XML (schema 4-3-0)
package /ComponentTypes
  application sw component type cycle_task
    behavior cycle_task_InternalBehavior
      timing event TMT_Core0_Task_1ms: start-on-event=Core0_Task_1ms, period=0.001
      runnable Core0_Task_1ms
  swc implementation cycle_task_Implementation: behavior=cycle_task_InternalBehavior
    code-descriptors:
      code Default: artifact-descriptors=autosar-engineering-object={short-label=Default, category=SWSRC}
