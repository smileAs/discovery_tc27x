AUTOSAR XML (schema 4-2-1)
package /MICROSAR
  10 x bsw implementation, all with programming-language=C, vendor-id=30:
    BswM_Impl: sw-version=9.01.01, used-code-generator=DaVinci Configurator, ar-release-version=4.00.03, behavior=BswMBehavior
    CanIf_Impl: sw-version=6.13.00, used-code-generator=cMSR, ar-release-version=4.00.03, behavior=CanIf_Behavior
    CanSM_Impl: sw-version=2.13.00, used-code-generator=DaVinci Configurator, ar-release-version=4.00.03, behavior=CanSMBehavior
    CanTp_Impl: sw-version=3.03.01, used-code-generator=DaVinci Configurator, ar-release-version=4.00.03, behavior=CanTpBehavior
    Com_Impl: sw-version=12.00.00, used-code-generator=DaVinci Configurator, ar-release-version=4.00.03, behavior=ComBehavior
    ComM_Impl: sw-version=8.01.00, used-code-generator=DaVinci Configurator, ar-release-version=4.00.03, behavior=ComMBehavior
    EcuM_Impl: sw-version=8.00.02, used-code-generator=DaVinci Configurator, ar-release-version=4.00.03, behavior=EcuMBehavior
    LinIf_Impl: sw-version=5.02.00, used-code-generator=DaVinci Configurator, ar-release-version=4.00.03, behavior=LinIfBehavior
    LinSM_Impl: sw-version=5.02.00, used-code-generator=DaVinci Configurator, ar-release-version=4.00.03, behavior=LinSMBehavior
    PduR_Impl: sw-version=9.00.01, used-code-generator=DaVinci Configurator, ar-release-version=4.01.02, behavior=PduRBehavior
package /MICROSAR/CanTrcv_Tja1043
  bsw implementation CanTrcv_Impl: programming-language=C, sw-version=4.02.00, used-code-generator=cMSR, vendor-id=30, ar-release-version=4.00.03, behavior=CanTrcv_Tja1043_Behavior, vendor-api-infix=Tja1043
package /MICROSAR/Lin_Tricore
  bsw implementation Lin_Impl: programming-language=C, used-code-generator=DaVinci Configurator, vendor-id=30, ar-release-version=4.00.03, behavior=LinBehavior
package /MICROSAR/Lin_Tricore/Lin_ib_bswmd/BswModuleDescriptions
  bsw module description Lin
    bsw internal behavior LinBehavior
package /MICROSAR/BswM_ib_bswmd/BswModuleDescriptions
  bsw module description BswM
    bsw internal behavior BswMBehavior
      exclusive area BSWM_EXCLUSIVE_AREA_0
      bsw schedulable entity BswM_MainFunction: implemented-entry=BswM_MainFunction
      bsw timing event BswM_MainFunctionTimingEvent0: starts-on-event=BswM_MainFunction, period=0.01
  bsw module entry BswM_MainFunction: call-type=SCHEDULED, execution-context=TASK
package /MICROSAR/CanIf_ib_bswmd/BswModuleDescriptions
  bsw module description CanIf
    bsw internal behavior CanIf_Behavior
      8 x exclusive area:
        CANIF_EXCLUSIVE_AREA_{0..7}
package /MICROSAR/CanSM_ib_bswmd/BswModuleDescriptions
  bsw module description CanSM
    bsw internal behavior CanSMBehavior
      5 x exclusive area:
        CANSM_EXCLUSIVE_AREA_{1..5}
      bsw schedulable entity CanSM_MainFunction: implemented-entry=CanSM_MainFunction
      bsw timing event CanSM_MainFunctionTimingEvent0: starts-on-event=CanSM_MainFunction, period=0.01
  bsw module entry CanSM_MainFunction: call-type=SCHEDULED, execution-context=TASK
package /MICROSAR/CanTp_ib_bswmd/BswModuleDescriptions
  bsw module description CanTp
    bsw internal behavior CanTpBehavior
      exclusive area CANTP_EXCLUSIVE_AREA_0
      bsw schedulable entity CanTp_MainFunction: implemented-entry=CanTp_MainFunction
      bsw timing event CanTp_MainFunctionTimingEvent0: starts-on-event=CanTp_MainFunction, period=0.01
  bsw module entry CanTp_MainFunction: call-type=SCHEDULED, execution-context=TASK
package /MICROSAR/CanTrcv_Tja1043_ib_bswmd/BswModuleDescriptions
  bsw module description CanTrcv
    bsw internal behavior CanTrcv_Tja1043_Behavior
      exclusive area CANTRCV_30_TJA1043_EXCLUSIVE_AREA_0
      bsw schedulable entity CanTrcv_30_Tja1043_MainFunction: implemented-entry=CanTrcv_30_Tja1043_MainFunction
      bsw timing event CanTrcv_30_Tja1043_MainFunctionTimingEvent0: starts-on-event=CanTrcv_30_Tja1043_MainFunction, period=0.01
  bsw module entry CanTrcv_30_Tja1043_MainFunction: call-type=SCHEDULED, execution-context=TASK
package /MICROSAR/ComM_ib_bswmd/BswModuleDescriptions
  bsw module description ComM
    bsw internal behavior ComMBehavior
      exclusive area COMM_EXCLUSIVE_AREA_0
      exclusive area COMM_EXCLUSIVE_AREA_1
      5 x bsw schedulable entity:
        ComM_MainFunction_{0..4}: implemented-entry=ComM_MainFunction_{0..4}
      4 x bsw timing event, all with period=0.02:
        ComM_MainFunction_{0..3}TimingEvent0: starts-on-event=ComM_MainFunction_{0..3}
  5 x bsw module entry, all with call-type=SCHEDULED, execution-context=TASK:
    ComM_MainFunction_{0..4}
package /MICROSAR/Com_ib_bswmd/BswModuleDescriptions
  bsw module description Com
    bsw internal behavior ComBehavior
      exclusive area COM_EXCLUSIVE_AREA_TX  # This critical section protects Tx ressources that can be accessed from various contexts. Therefore the critical section enclosed with COM_EXCLUSIVE_AREA_TX should never be interrupted by any Com API which accesses Tx ressources. For more details, see DocTechRef.
      exclusive area COM_EXCLUSIVE_AREA_RX  # This critical section protects Rx ressources that can be accessed from various contexts.Therefore the critical section enclosed with COM_EXCLUSIVE_AREA_RX should never be interrupted by any Com API which accesses Rx ressources. For more details, see DocTechRef.
      exclusive area COM_EXCLUSIVE_AREA_BOTH  # This critical section protects Rx and Tx ressources that are being accessed in context of Com_MainFunctionRouteSignals for signal gateway routings or description routings with configured deferred description source. For more details, see DocTechRef.
      bsw schedulable entity Com_MainFunctionTx: implemented-entry=Com_MainFunctionTx
      bsw schedulable entity Com_MainFunctionRx: implemented-entry=Com_MainFunctionRx
      bsw timing event Com_MainFunctionTxTimingEvent0: starts-on-event=Com_MainFunctionTx, period=0.01
      bsw timing event Com_MainFunctionRxTimingEvent0: starts-on-event=Com_MainFunctionRx, period=0.01
  bsw module entry Com_MainFunctionTx: call-type=SCHEDULED, execution-context=TASK
  bsw module entry Com_MainFunctionRx: call-type=SCHEDULED, execution-context=TASK
package /MICROSAR/EcuM_ib_bswmd/BswModuleDescriptions
  bsw module description EcuM
    bsw internal behavior EcuMBehavior
      exclusive area ECUM_EXCLUSIVE_AREA_0  # This exclusive area shall disable all wake up interrupts to prevent overwriting of some global variables.
      exclusive area ECUM_EXCLUSIVE_AREA_1  # This exclusive area is only used in case of multi core and if the the EcuM is configured to handle also the slave cores. It must be configured as a spinlock to allow access to some variables simultaneously from multiple cores.
      exclusive area ECUM_EXCLUSIVE_AREA_2  # This exclusive area is used for accessing the clock variable. It shall disable GPT interrupts and task changes. Only necessary if 32 Bit access is not atomic and Alarm Clock is present.
      bsw schedulable entity EcuM_MainFunction: implemented-entry=EcuM_MainFunction
      bsw timing event EcuM_MainFunctionTimingEvent{0..2}: starts-on-event=EcuM_MainFunction, period=0.01
  bsw module entry EcuM_MainFunction: call-type=SCHEDULED, execution-context=TASK
package /MICROSAR/LinIf_ib_bswmd/BswModuleDescriptions
  bsw module description LinIf
    bsw internal behavior LinIfBehavior
      exclusive area LINIF_EXCLUSIVE_AREA_0  # Exclusive area for LinIf channel main function
      exclusive area LINIF_EXCLUSIVE_AREA_1  # Exclusive area for asynchronous API functions
      bsw schedulable entity LinIf_MainFunction: implemented-entry=LinIf_MainFunction
      bsw timing event LinIf_MainFunctionTimingEvent0: starts-on-event=LinIf_MainFunction, period=0.005
  bsw module entry LinIf_MainFunction: call-type=SCHEDULED, execution-context=TASK
package /MICROSAR/LinSM_ib_bswmd/BswModuleDescriptions
  bsw module description LinSM
    bsw internal behavior LinSMBehavior
      4 x exclusive area:
        LINSM_EXCLUSIVE_AREA_0  # Must lock task interrupts, if LinIf_MainFunction(), LinSM_MainFunction() or BswM action BswMLinScheduleSwitch priority level is higher than the level of ComM_MainFunction().
        LINSM_EXCLUSIVE_AREA_1  # Must lock task interrupts, if ComM_MainFunction(), LinSM_MainFunction() or BswM action BswMLinScheduleSwitch priority level is higher than the level of LinIf_MainFunction().
        LINSM_EXCLUSIVE_AREA_2  # Must lock task interrupts, if ComM_MainFunction(), LinIf_MainFunction() or BswM action BswMLinScheduleSwitch priority level is higher than the level of LinSM_MainFunction().
        LINSM_EXCLUSIVE_AREA_3  # Must lock task interrupts, if ComM_MainFunction(), LinIf_MainFunction() or LinSM_MainFunction() interrupt priority level is higher than the level of the BswM action BswMLinScheduleSwitch.
      bsw schedulable entity LinSM_MainFunction: implemented-entry=LinSM_MainFunction
      bsw timing event LinSM_MainFunctionTimingEvent0: starts-on-event=LinSM_MainFunction, period=0.01
  bsw module entry LinSM_MainFunction: call-type=SCHEDULED, execution-context=TASK
package /MICROSAR/PduR_ib_bswmd/BswModuleDescriptions
  bsw module description PduR
    bsw internal behavior PduRBehavior
      exclusive area PDUR_EXCLUSIVE_AREA_0
      exclusive area PDUR_EXCLUSIVE_AREA_1
