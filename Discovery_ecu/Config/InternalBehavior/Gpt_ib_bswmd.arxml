AUTOSAR XML (schema 4-0-3)
package /AURIX/Gpt_ib_bswmd/BswModuleDescriptions
  bsw module description Gpt
    bsw internal behavior GptBehavior
