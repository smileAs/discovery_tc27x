AUTOSAR XML (schema 4-0-3)
package /AURIX/Spi_ib_bswmd/BswModuleDescriptions
  bsw module description Spi: provided-entrys=Spi_MainFunction_Handling
    bsw internal behavior SpiBehavior
      7 x exclusive area:
        WriteIB
        AsyncTransmit
        SyncTransmit
        GetSequenceResult
        Cancel
        Init
        DeInit
      bsw schedulable entity Spi_MainFunction_Handling: implemented-entry=Spi_MainFunction_Handling
      bsw timing event Spi_MainFunction_HandlingTimingEvent0: starts-on-event=Spi_MainFunction_Handling, period=0.005
  bsw module entry Spi_MainFunction_Handling: call-type=SCHEDULED, execution-context=TASK
