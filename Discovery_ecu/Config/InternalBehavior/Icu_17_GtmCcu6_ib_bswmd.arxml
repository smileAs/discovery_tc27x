AUTOSAR XML (schema 4-0-3)
package /AURIX/Icu_ib_bswmd/BswModuleDescriptions
  bsw module description Icu
    bsw internal behavior IcuBehavior
      6 x exclusive area:
        EnableWakeup
        Ccu6IenUpdate
        EnableNotification
        ResetEdgeCount
        CcuInterruptHandle
        CcuVariableupdate
