AUTOSAR XML (schema 4-2-1)
package /MICROSAR/Lin_Tricore
  bsw implementation Lin_Impl: programming-language=C, used-code-generator=DaVinci Configurator, vendor-id=30, ar-release-version=4.00.03
package /MICROSAR/Lin_Tricore/Lin_ib_bswmd/BswModuleDescriptions
  bsw module description Lin
    bsw internal behavior LinBehavior
