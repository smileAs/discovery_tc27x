AUTOSAR XML (schema 4-2-1)
package /MICROSAR
  bsw implementation ComM_Impl: programming-language=C, sw-version=8.01.00, used-code-generator=DaVinci Configurator, vendor-id=30, ar-release-version=4.00.03
package /MICROSAR/ComM_ib_bswmd/BswModuleDescriptions
  bsw module description ComM: provided-entrys=[ComM_MainFunction_0, ComM_MainFunction_1, ComM_MainFunction_2, ComM_MainFunction_3, ComM_MainFunction_4]
    bsw internal behavior ComMBehavior
      exclusive area COMM_EXCLUSIVE_AREA_0
      exclusive area COMM_EXCLUSIVE_AREA_1
      5 x bsw schedulable entity:
        ComM_MainFunction_{0..4}: implemented-entry=ComM_MainFunction_{0..4}
      4 x bsw timing event, all with period=0.02:
        ComM_MainFunction_{0..3}TimingEvent0: starts-on-event=ComM_MainFunction_{0..3}
  5 x bsw module entry, all with call-type=SCHEDULED, execution-context=TASK:
    ComM_MainFunction_{0..4}
