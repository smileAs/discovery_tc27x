AUTOSAR XML (schema 4-0-3)
# Copyright (C) Infineon Technologies (2015)
# All rights reserved.
package /AUTOSAR_Dio/BswModuleDescriptions
  bsw module description Dio: category=BSW_MODULE, module-id=120  # DIO Driver
    provided-entrys:
      Dio_ReadChannel
      Dio_WriteChannel
      Dio_ReadPort
      Dio_WritePort
      Dio_ReadChannelGroup
      Dio_WriteChannelGroup
      Dio_Init
      Dio_FlipChannel
      Dio_GetVersionInfo
    bsw module dependency DetDependency: target-module-id=15, required-entrys=Det_ReportError
    bsw module dependency SafeMcalDependency: target-module-id=255, required-entrys=SafeMcal_ReportError
    bsw internal behavior DioBehavior
      constant-memorys:
        parameter data prototype Dio_kConfigPtr: category=DATA_REFERENCE, sw-pointer-target-props={target-category=TYPE_REFERENCE, implementation-data-type=Dio_ConfigType}, type=Dio_ConfigType
        parameter data prototype Dio_kMSPortPin: implementation-data-type=uint8, type=uint8
        parameter data prototype Dio_kMaskUndefinedPortPins: category=DATA_REFERENCE, sw-pointer-target-props={target-category=TYPE_REFERENCE, implementation-data-type=Dio_PortLevelType}, type=Dio_PortLevelType
      static-memorys:
        data Dio_InitStatus: implementation-data-type=uint8, type=uint8
      9 x bsw called entity:
        Dio_ReadChannel: implemented-entry=Dio_ReadChannel
        Dio_WriteChannel: implemented-entry=Dio_WriteChannel
        Dio_ReadPort: implemented-entry=Dio_ReadPort
        Dio_WritePort: implemented-entry=Dio_WritePort
        Dio_ReadChannelGroup: implemented-entry=Dio_ReadChannelGroup
        Dio_WriteChannelGroup: implemented-entry=Dio_WriteChannelGroup
        Dio_Init: implemented-entry=Dio_Init
        Dio_FlipChannel: implemented-entry=Dio_FlipChannel
        Dio_GetVersionInfo: implemented-entry=Dio_GetVersionInfo
package /AUTOSAR_Dio/BswModuleEntrys
  9 x bsw module entry, all with is-synchronous=true, call-type=REGULAR, execution-context=UNSPECIFIED:
    Dio_ReadChannel: service-id=0, is-reentrant=true, sw-service-impl-policy=STANDARD
      return type Return: implementation-data-type=Dio_LevelType
      sw service arg ChannelId: implementation-data-type=Dio_ChannelType
    Dio_WriteChannel: service-id=1, is-reentrant=true, sw-service-impl-policy=STANDARD
      sw service arg ChannelId: implementation-data-type=Dio_ChannelType
      sw service arg Level: implementation-data-type=Dio_LevelType
    Dio_ReadPort: service-id=2, is-reentrant=true, sw-service-impl-policy=STANDARD
      return type Return: implementation-data-type=Dio_PortLevelType
      sw service arg PortId: implementation-data-type=Dio_PortType
    Dio_WritePort: service-id=3, is-reentrant=true, sw-service-impl-policy=STANDARD
      sw service arg PortId: implementation-data-type=Dio_PortType
      sw service arg Level: implementation-data-type=Dio_PortLevelType
    Dio_ReadChannelGroup: service-id=4, is-reentrant=true, sw-service-impl-policy=STANDARD
      return type Return: implementation-data-type=Dio_PortLevelType
      sw service arg ChannelGroupIdPtr: category=DATA_REFERENCE, sw-pointer-target-props={target-category=TYPE_REFERENCE, implementation-data-type=Dio_ChannelGroupType}
    Dio_WriteChannelGroup: service-id=5, is-reentrant=true, sw-service-impl-policy=STANDARD
      sw service arg ChannelGroupIdPtr: category=DATA_REFERENCE, sw-pointer-target-props={target-category=TYPE_REFERENCE, implementation-data-type=Dio_ChannelGroupType}
      sw service arg Level: implementation-data-type=Dio_PortLevelType
    Dio_Init: service-id=16, is-reentrant=false, sw-service-impl-policy=STANDARD
      sw service arg ConfigPtr: category=DATA_REFERENCE, sw-pointer-target-props={target-category=TYPE_REFERENCE, implementation-data-type=Dio_ConfigType}
    Dio_FlipChannel: service-id=17, is-reentrant=false, sw-service-impl-policy=STANDARD
      return type Return: implementation-data-type=Dio_LevelType
      sw service arg ChannelId: implementation-data-type=Dio_ChannelType
    Dio_GetVersionInfo: service-id=18, is-reentrant=false, sw-service-impl-policy=MACRO
      sw service arg VersionInfo: category=DATA_REFERENCE, sw-pointer-target-props={target-category=TYPE_REFERENCE, implementation-data-type=Std_VersionInfoType}
package /AUTOSAR_Dio/Implementations
  bsw implementation Dio: programming-language=C, sw-version=0.0.0, vendor-id=17, ar-release-version=4.0.3, behavior=DioBehavior, vendor-specific-module-def=Dio
    code-descriptors:
      code Files
        artifact-descriptors:
          short-label=ssc::src::Dio.c, category=SWSRC
          short-label=ssc::src::Dio_Ver.c, category=SWSRC
          short-label=ssc::src::Dio.h, category=SWHDR
          short-label=ssc::src::Dio_Ver.h, category=SWHDR
          short-label=mak::dio_infineon_tricore::ssc::mak::infineon_dio_cfg.mak, category=SWMAKE
          short-label=mak::dio_infineon_tricore::ssc::mak::infineon_dio_check.mak, category=SWMAKE
          short-label=mak::dio_infineon_tricore::ssc::mak::infineon_dio_defs.mak, category=SWMAKE
          short-label=mak::dio_infineon_tricore::ssc::mak::infineon_dio_rules.mak, category=SWMAKE
    compiler TASKING_COMPILE: name=TASKING, options="-c --core=tc1.6.x -t -Wa-gAHLs --emit-locals=-equ,-symbols -Wa-Ogs -Wa--error-limit=42 --iso=90 --eabi-compliant --integer-enumeration --language=-comments,-gcc,+volatile,-strings --switch=auto --align=0 --default-near-size=0 --default-a0-size=0 --default-a1-size=0 -O2ROPYG --tradeoff=4 -g --source -D_TASKING_C_TRICORE_=1 $(CALLFUNCTION)", vendor=Tasking, version=Tasking
    compiler DIAB_COMPILE: name=DIAB, options="-c -tTC27xAstep16PMG:cross -Xdialect-c89 -Xno-common -Xalign-functions=4 -Xfp-fast -Xsection-split=1 -Xkeep-assembly-file=2 -g3 -ew4084 -ei4177,4550,4549,4068,5388 -XO -D_DIABDATA_C_TRICORE_=1 $(CALLFUNCTION)", vendor=WindRiver, version=WindRiver
    compiler GNU_COMPILE:
      name=GNU
      options="-c -save-temps=obj -std=iso9899:1990 -ansi -fno-asm -ffreestanding -Wundef -Wp,-std=iso9899:1990 -fno-short-enums -fpeel-loops -falign-functions=4 -frecord-gcc-switches -fsection-anchors -funsigned-bitfields -ffunction-sections -fno-ivopts -fno-peephole2 -nostartfiles -O3 -g3 -W -Wall -Wuninitialized -DTRIBOARD_TC27XX -mcpu=tc27xx -D_GNU_C_TRICORE_=1 $(CALLFUNCTION)"
      vendor=Hightec
      version=Hightec
    generated-artifacts:
      5 x dependency on artifact, all with usages=CODEGENERATION:
        Dio_PBCfg_c: artifact-descriptor={short-label=generate::src::Dio_PBCfg.c, category=SWSRC}
        Dio_Cfg_h: artifact-descriptor={short-label=generate::src::Dio_Cfg.h, category=SWHDR}
        Dio_xdm: artifact-descriptor={short-label=config::Dio.xdm, category=SWTOOL}
        Dio_bmd: artifact-descriptor={short-label=autosar::Dio.bmd, category=SWTOOL}
        Dio_ConfigDoc_html: artifact-descriptor={short-label=generate::Dio_ConfigDoc.html, category=SWTOOL}
    linker TASKING_LINK: name=TASKING, options="-t -d_mcal_pjt.lsl -D__CPU__=tc27x -Cmpe:vtc -Otxycl --error-limit=42 -M -mcrfiklsmnoduq -lc -lfp -lrt", vendor=Tasking, version=Tasking
    linker DIAB_LINK: name=DIAB, options="-m6 "_mcal_pjt.dld" -lc", vendor=WindRiver, version=WindRiver
    linker GNU_LINK: name=GNU, options="-T"_mcal_pjt.ld" -nostartfiles -Wl,--allow-multiple-definition -Wl,--cref -Wl,--oformat=elf32-tricore -Wl,--mcpu=tc161 -Wl,--mem-holes -Wl,--extmap="a"", vendor=Hightec, version=Hightec
    resource consumption ResourceConsumption
      7 x memory section:
        DIO_CONST_8BIT: alignment=8, size=41, sw-addrmethod=CONST
        DIO_CONST_16BIT: alignment=16, size=82, sw-addrmethod=CONST
        DIO_VAR_32BIT: alignment=32, size=4, sw-addrmethod=VAR
        DIO_CONST_32BIT: alignment=32, size=4, sw-addrmethod=CONST
        DIO_CODE: alignment=UNSPECIFIED, size=1390, sw-addrmethod=CODE
        DIO_VAR_8BIT: alignment=8, size=1, sw-addrmethod=VAR
        DIO_POSTBUILDCFG: alignment=UNSPECIFIED, size=132, sw-addrmethod=CONFIG_DATA
      section name prefix DIO
package /AUTOSAR_Dio/ImplementationDataTypes
  6 x impl type, all with type-emitter=BSW:
    Dio_ChannelType: implementation-data-type=uint16
    Dio_LevelType: implementation-data-type=uint8
    Dio_PortType: implementation-data-type=uint8
    Dio_PortLevelType: implementation-data-type=uint16
    Dio_ChannelGroupType: category=STRUCTURE
      element Dio_PortLevelType
    Dio_ConfigType: category=STRUCTURE
      element Dio_PortChannelIdType*
