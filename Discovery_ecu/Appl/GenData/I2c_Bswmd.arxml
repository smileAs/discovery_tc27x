AUTOSAR XML (schema 4-0-3)
# Copyright (C) Infineon Technologies (2015)
# All rights reserved.
package /AURIX_I2c/BswModuleDescriptions
  bsw module description I2c: category=BSW_MODULE, module-id=255  # Inter Integrated Circuit Driver
    provided-entrys:
      I2c_Init
      I2c_DeInit
      I2c_SetupPacket
      I2c_SyncOperation
      I2c_GetStatus
      I2c_GetPacketResult
      I2c_GetVersionInfo
      I2c_GetHWUnitStatus
    bsw module dependency DetDependency: target-module-id=15, required-entrys=Det_ReportError
    bsw internal behavior I2cBehavior
      constant-memorys:
        parameter data prototype I2c_kConfigPtr: category=DATA_REFERENCE, sw-pointer-target-props={target-category=TYPE_REFERENCE, implementation-data-type=I2c_ConfigType}, type=I2c_ConfigType
      static-memorys:
        data I2c_InitStatus: implementation-data-type=uint8, type=uint8
      8 x bsw called entity:
        I2c_Init: implemented-entry=I2c_Init
        I2c_DeInit: implemented-entry=I2c_DeInit
        I2c_SetupPacket: implemented-entry=I2c_SetupPacket
        I2c_SyncOperation: implemented-entry=I2c_SyncOperation
        I2c_GetStatus: implemented-entry=I2c_GetStatus
        I2c_GetPacketResult: implemented-entry=I2c_GetPacketResult
        I2c_GetVersionInfo: implemented-entry=I2c_GetVersionInfo
        I2c_GetHWUnitStatus: implemented-entry=I2c_GetHWUnitStatus
package /AURIX_I2c/BswModuleEntrys
  8 x bsw module entry, all with is-reentrant=false, is-synchronous=true, call-type=REGULAR:
    I2c_Init: service-id=0, execution-context=TASK, sw-service-impl-policy=STANDARD
      sw service arg ConfigPtr: category=DATA_REFERENCE, sw-pointer-target-props={target-category=TYPE_REFERENCE, implementation-data-type=I2c_ConfigType}
    I2c_DeInit: service-id=1, execution-context=TASK, sw-service-impl-policy=STANDARD
      return type Return: implementation-data-type=Std_ReturnType
    I2c_SetupPacket: service-id=2, execution-context=TASK, sw-service-impl-policy=STANDARD
      return type Return: implementation-data-type=Std_ReturnType
      sw service arg Packet: implementation-data-type=I2c_PacketType
      sw service arg NativeDataPtr: category=DATA_REFERENCE, sw-pointer-target-props={target-category=TYPE_REFERENCE, implementation-data-type=I2c_DataType}
    I2c_SyncOperation: service-id=3, execution-context=TASK, sw-service-impl-policy=STANDARD
      return type Return: implementation-data-type=Std_ReturnType
      sw service arg Packet: implementation-data-type=I2c_PacketType
      sw service arg Operation: implementation-data-type=I2c_OperationType
    I2c_GetStatus: service-id=5, execution-context=TASK, sw-service-impl-policy=STANDARD
      return type Return: implementation-data-type=I2c_StatusType
    I2c_GetPacketResult: service-id=6, execution-context=TASK, sw-service-impl-policy=STANDARD
      return type Return: implementation-data-type=I2c_PacketResultType
      sw service arg Packet: implementation-data-type=I2c_PacketType
    I2c_GetVersionInfo: service-id=7, execution-context=UNSPECIFIED, sw-service-impl-policy=MACRO
      sw service arg VersioninfoPtr: category=DATA_REFERENCE, sw-pointer-target-props={target-category=TYPE_REFERENCE, implementation-data-type=Std_VersionInfoType}
    I2c_GetHWUnitStatus: service-id=8, execution-context=TASK, sw-service-impl-policy=STANDARD
      return type Return: implementation-data-type=I2c_StatusType
      sw service arg HwUnit: implementation-data-type=I2c_HWUnitType
package /AURIX_I2c/Implementations
  bsw implementation I2c: programming-language=C, sw-version=0.0.0, vendor-id=17, ar-release-version=4.0.3, behavior=I2cBehavior, vendor-specific-module-def=I2c
    code-descriptors:
      code Files
        artifact-descriptors:
          short-label=ssc::src::I2c.c, category=SWSRC
          short-label=ssc::inc::I2c.h, category=SWHDR
          short-label=mak::i2c_infineon_tricore::ssc::mak::infineon_i2c_cfg.mak, category=SWMAKE
          short-label=mak::i2c_infineon_tricore::ssc::mak::infineon_i2c_check.mak, category=SWMAKE
          short-label=mak::i2c_infineon_tricore::ssc::mak::infineon_i2c_defs.mak, category=SWMAKE
          short-label=mak::i2c_infineon_tricore::ssc::mak::infineon_i2c_rules.mak, category=SWMAKE
    compiler TASKING_COMPILE: name=TASKING, options="-c --core=tc1.6.x -t -Wa-gAHLs --emit-locals=-equ,-symbols -Wa-Ogs -Wa--error-limit=42 --iso=90 --eabi-compliant --integer-enumeration --language=-comments,-gcc,+volatile,-strings --switch=auto --align=0 --default-near-size=0 --default-a0-size=0 --default-a1-size=0 -O2ROPYG --tradeoff=4 -g --source -D_TASKING_C_TRICORE_=1 $(CALLFUNCTION)", vendor=Tasking, version=Tasking
    compiler DIAB_COMPILE: name=DIAB, options="-c -tTC27xAstep16PMG:cross -Xdialect-c89 -Xno-common -Xalign-functions=4 -Xfp-fast -Xsection-split=1 -Xkeep-assembly-file=2 -g3 -ew4084 -ei4177,4550,4549,4068,5388 -XO -D_DIABDATA_C_TRICORE_=1 $(CALLFUNCTION)", vendor=WindRiver, version=WindRiver
    compiler GNU_COMPILE:
      name=GNU
      options="-c -save-temps=obj -std=iso9899:1990 -ansi -fno-asm -ffreestanding -Wundef -Wp,-std=iso9899:1990 -fno-short-enums -fpeel-loops -falign-functions=4 -frecord-gcc-switches -fsection-anchors -funsigned-bitfields -ffunction-sections -fno-ivopts -fno-peephole2 -nostartfiles -O3 -g3 -W -Wall -Wuninitialized -DTRIBOARD_TC27XX -mcpu=tc27xx -D_GNU_C_TRICORE_=1 $(CALLFUNCTION)"
      vendor=Hightec
      version=Hightec
    generated-artifacts:
      4 x dependency on artifact, all with usages=CODEGENERATION:
        I2c_PBCfg_c: artifact-descriptor={short-label=generate::src::I2c_PBCfg.c, category=SWTOOL}
        I2c_Cfg_h: artifact-descriptor={short-label=generate::inc::I2c_Cfg.h, category=SWTOOL}
        I2c_xdm: artifact-descriptor={short-label=config::I2c.xdm, category=SWTOOL}
        I2c_bmd: artifact-descriptor={short-label=autosar::I2c.bmd, category=SWTOOL}
    linker TASKING_LINK: name=TASKING, options="-t -d_mcal_pjt.lsl -D__CPU__=tc27x -Cmpe:vtc -Otxycl --error-limit=42 -M -mcrfiklsmnoduq -lc -lfp -lrt", vendor=Tasking, version=Tasking
    linker DIAB_LINK: name=DIAB, options="-m6 "_mcal_pjt.dld" -lc", vendor=WindRiver, version=WindRiver
    linker GNU_LINK: name=GNU, options="-T"_mcal_pjt.ld" -nostartfiles -Wl,--allow-multiple-definition -Wl,--cref -Wl,--oformat=elf32-tricore -Wl,--mcpu=tc161 -Wl,--mem-holes -Wl,--extmap="a"", vendor=Hightec, version=Hightec
    resource consumption ResourceConsumption
      memory section I2C_VAR_8BIT: alignment=8, size=2, sw-addrmethod=VAR
      memory section I2C_VAR_32BIT: alignment=32, size=10, sw-addrmethod=VAR
      memory section I2C_POSTBUILDCFG: alignment=UNSPECIFIED, size=20, sw-addrmethod=CONFIG_DATA
      section name prefix I2C
package /AURIX_I2c/ImplementationDataTypes
  13 x impl type, all with type-emitter=BSW:
    I2c_DataType: implementation-data-type=uint8
    I2c_StatusType: compu {0=I2C_UNINIT, 0=I2C_IDLE, 0=I2C_BUSY}, implementation-data-type=uint32
    I2c_PacketResultType: compu {0=I2C_PACKET_OK, 0=I2C_PACKET_QUEUED, 0=I2C_PACKET_PENDING, 0=I2C_PACKET_FAILED, 0=I2C_PACKET_CANCELLED, 0=I2C_PACKET_INVALID}, implementation-data-type=uint32
    I2c_OperationType: compu {0=I2C_WRITE, 0=I2C_READ, 0=I2C_DUMMY_WRITE, 0=I2C_NO_OPERATION}, implementation-data-type=uint32
    I2c_HwUnitPacketStatusType: compu {0=I2C_HWUNIT_PKT_OK, 0=I2C_HWUNIT_PKT_STARTED, 0=I2C_HWUNIT_PKT_LAST_SINGLE_RCVD, 0=I2C_HWUNIT_PKT_NOT_OK, 0=I2C_HWUNIT_PKT_INVALID, 0=}, implementation-data-type=uint32
    I2c_CommunicationType: compu {0=I2C_COMMN_SYNCHRONOUS, 0=I2C_COMMN_ASYNCHRONOUS, 0=I2C_COMMN_INVALID}, implementation-data-type=uint32
    I2c_PacketInfoType: category=STRUCTURE
      element I2c_DataType
    I2c_PacketType: implementation-data-type=uint8
    I2c_NumberOfDataType: implementation-data-type=uint16
    I2c_HWUnitType: implementation-data-type=uint8
    I2c_PacketConfigType: category=STRUCTURE
      element uint8
    I2c_HWModuleConfigType: category=STRUCTURE
      element uint32
    I2c_ConfigType: category=STRUCTURE
      element I2c_PacketConfigType*
