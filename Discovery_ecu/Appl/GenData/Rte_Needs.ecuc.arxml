AUTOSAR XML (schema 4-0-3)
package /DaVinci_Project
  module config Rte
    22 x RteBswModuleInstance:
      BswM
        BswM_MainFunctionTimingEvent0 (RteBswEventToTaskMapping):
          RteBswUsedOsEventRef = Rte_Ev_Cyclic2_Default_BSW_Async_Task_Core0_0_10ms
          RteBswUsedOsAlarmRef = Os/Rte_Al_TE2_Default_BSW_Async_Task_Core0_0_10ms
      Can
        3 x RteBswEventToTaskMapping, all with RteBswUsedOsEventRef=Rte_Ev_Cyclic2_Default_BSW_Async_Task_Core0_0_10ms, RteBswUsedOsAlarmRef=Os/Rte_Al_TE2_Default_BSW_Async_Task_Core0_0_10ms:
          Can_MainFunction_BusOffTimingEvent0
          Can_MainFunction_ModeTimingEvent0
          Can_MainFunction_WakeupTimingEvent0
      CanIf
      CanSM
        CanSM_MainFunctionTimingEvent0 (RteBswEventToTaskMapping):
          RteBswUsedOsEventRef = Rte_Ev_Cyclic2_Default_BSW_Async_Task_Core0_0_10ms
          RteBswUsedOsAlarmRef = Os/Rte_Al_TE2_Default_BSW_Async_Task_Core0_0_10ms
      CanTp
        CanTp_MainFunctionTimingEvent0 (RteBswEventToTaskMapping):
          RteBswUsedOsEventRef = Rte_Ev_Cyclic2_Default_BSW_Async_Task_Core0_0_10ms
          RteBswUsedOsAlarmRef = Os/Rte_Al_TE2_Default_BSW_Async_Task_Core0_0_10ms
      CanTrcv
        CanTrcv_30_Tja1043_MainFunctionTimingEvent0 (RteBswEventToTaskMapping):
          RteBswUsedOsEventRef = Rte_Ev_Cyclic2_Default_BSW_Async_Task_Core0_0_10ms
          RteBswUsedOsAlarmRef = Os/Rte_Al_TE2_Default_BSW_Async_Task_Core0_0_10ms
      Com
        Com_MainFunctionRxTimingEvent0 (RteBswEventToTaskMapping):
          RteBswUsedOsEventRef = Rte_Ev_Cyclic2_Default_BSW_Async_Task_Core0_0_10ms
          RteBswUsedOsAlarmRef = Os/Rte_Al_TE2_Default_BSW_Async_Task_Core0_0_10ms
        Com_MainFunctionTxTimingEvent0 (RteBswEventToTaskMapping):
          RteBswUsedOsEventRef = Rte_Ev_Cyclic2_Default_BSW_Async_Task_Core0_0_10ms
          RteBswUsedOsAlarmRef = Os/Rte_Al_TE2_Default_BSW_Async_Task_Core0_0_10ms
      ComM
        4 x RteBswEventToTaskMapping, all with RteBswUsedOsEventRef=Rte_Ev_Cyclic2_Default_BSW_Async_Task_Core0_0_20ms, RteBswUsedOsAlarmRef=Os/Rte_Al_TE2_Default_BSW_Async_Task_Core0_0_20ms:
          ComM_MainFunction_{0..3}TimingEvent0
      Dcm
        Dcm_MainFunctionTimingEvent0 (RteBswEventToTaskMapping):
          RteBswUsedOsEventRef = Rte_Ev_Cyclic2_Default_BSW_Async_Task_Core0_0_10ms
          RteBswUsedOsAlarmRef = Os/Rte_Al_TE2_Default_BSW_Async_Task_Core0_0_10ms
      Dio
      EcuM
        3 x RteBswEventToTaskMapping:
          EcuM_MainFunctionTimingEvent0: RteBswUsedOsEventRef=Rte_Ev_Cyclic2_Default_BSW_Async_Task_Core0_0_10ms, RteBswUsedOsAlarmRef=Os/Rte_Al_TE2_Default_BSW_Async_Task_Core0_0_10ms
          EcuM_MainFunctionTimingEvent1: RteBswUsedOsAlarmRef=Os/Rte_Al_TE2_EcuM_EcuM_MainFunction
          EcuM_MainFunctionTimingEvent2: RteBswUsedOsAlarmRef=Os/Rte_Al_TE3_EcuM_EcuM_MainFunction
      Gpt
      Icu
      Irq
      Lin
      LinIf
        LinIf_MainFunctionTimingEvent0 (RteBswEventToTaskMapping): RteBswUsedOsEventRef=Rte_Ev_Run_LinIf_LinIf_MainFunction, RteBswUsedOsAlarmRef=Os/Rte_Al_TE_LinIf_LinIf_MainFunction
      LinSM
        LinSM_MainFunctionTimingEvent0 (RteBswEventToTaskMapping):
          RteBswUsedOsEventRef = Rte_Ev_Cyclic2_Default_BSW_Async_Task_Core0_0_10ms
          RteBswUsedOsAlarmRef = Os/Rte_Al_TE2_Default_BSW_Async_Task_Core0_0_10ms
      Mcu
      PduR
      Port
      Pwm
      Spi
        Spi_MainFunction_HandlingTimingEvent0 (RteBswEventToTaskMapping)
    9 x RteSwComponentInstance:
      BswM_EcuSwComposition
        Timer_BswM_MainFunction (RteEventToTaskMapping): RteUsedOsEventRef=Rte_Ev_Cyclic2_Default_BSW_Async_Task_Core0_0_10ms, RteUsedOsAlarmRef=Os/Rte_Al_TE2_Default_BSW_Async_Task_Core0_0_10ms
      ComM_EcuSwComposition
        4 x RteEventToTaskMapping, all with RteUsedOsEventRef=Rte_Ev_Cyclic2_Default_BSW_Async_Task_Core0_0_20ms, RteUsedOsAlarmRef=Os/Rte_Al_TE2_Default_BSW_Async_Task_Core0_0_20ms:
          Timer_ComM_MainFunction_{0..3}
      Cycle_Task_1ms_EcuSwComposition
        TMT_Core0_Task_1ms (RteEventToTaskMapping): RteUsedOsAlarmRef=Os/Rte_Al_TE_Cycle_Task_1ms_Core0_Task_1ms
      Dcm_EcuSwComposition
        Timer_Dcm_MainFunction (RteEventToTaskMapping): RteUsedOsEventRef=Rte_Ev_Cyclic2_Default_BSW_Async_Task_Core0_0_10ms, RteUsedOsAlarmRef=Os/Rte_Al_TE2_Default_BSW_Async_Task_Core0_0_10ms
      EcuM_EcuSwComposition
        Timer_EcuM_MainFunction (RteEventToTaskMapping): RteUsedOsEventRef=Rte_Ev_Cyclic2_Default_BSW_Async_Task_Core0_0_10ms, RteUsedOsAlarmRef=Os/Rte_Al_TE2_Default_BSW_Async_Task_Core0_0_10ms
      Os_OsCore_Core{0..2}_swc_EcuSwComposition
      disc_ecu_EcuSwComposition
        4 x RteEventToTaskMapping:
          TMT_Core0_Task_100ms: RteUsedOsEventRef=Rte_Ev_Run_disc_ecu_Core0_Task_100ms, RteUsedOsAlarmRef=Os/Rte_Al_TE_disc_ecu_Core0_Task_100ms
          TMT_10ms_disc_ecu_main: RteUsedOsEventRef=Rte_Ev_Run_disc_ecu_Core0_Task_10ms, RteUsedOsAlarmRef=Os/Rte_Al_TE_disc_ecu_Core0_Task_10ms
          TMT_Core0_Task_20ms: RteUsedOsEventRef=Rte_Ev_Run_disc_ecu_Core0_Task_20ms, RteUsedOsAlarmRef=Os/Rte_Al_TE_disc_ecu_Core0_Task_20ms
          TMT_Core0_Task_50ms: RteUsedOsEventRef=Rte_Ev_Run_disc_ecu_Core0_Task_50ms, RteUsedOsAlarmRef=Os/Rte_Al_TE_disc_ecu_Core0_Task_50ms
    RteOsInteraction
      10 x RteUsedOsActivation, all with RteExpectedActivationOffset=0:
        Rte_Al_TE_Cycle_Task_1ms_Core0_Task_1ms: RteActivationOsAlarmRef=Os/Rte_Al_TE_Cycle_Task_1ms_Core0_Task_1ms, RteActivationOsTaskRef=Core0_OsTask_1ms
        Rte_Al_TE2_Default_BSW_Async_Task_Core0_0_10ms: RteActivationOsAlarmRef=Os/Rte_Al_TE2_Default_BSW_Async_Task_Core0_0_10ms, RteActivationOsTaskRef=Default_BSW_Async_Task_Core0
        Rte_Al_TE2_Default_BSW_Async_Task_Core0_0_20ms: RteActivationOsAlarmRef=Os/Rte_Al_TE2_Default_BSW_Async_Task_Core0_0_20ms, RteActivationOsTaskRef=Default_BSW_Async_Task_Core0
        Rte_Al_TE_LinIf_LinIf_MainFunction: RteActivationOsAlarmRef=Os/Rte_Al_TE_LinIf_LinIf_MainFunction, RteActivationOsTaskRef=Default_BSW_Async_Task_Core0
        Rte_Al_TE_disc_ecu_Core0_Task_100ms: RteActivationOsAlarmRef=Os/Rte_Al_TE_disc_ecu_Core0_Task_100ms, RteActivationOsTaskRef=Default_BSW_Async_Task_Core0
        Rte_Al_TE_disc_ecu_Core0_Task_10ms: RteActivationOsAlarmRef=Os/Rte_Al_TE_disc_ecu_Core0_Task_10ms, RteActivationOsTaskRef=Default_BSW_Async_Task_Core0
        Rte_Al_TE_disc_ecu_Core0_Task_20ms: RteActivationOsAlarmRef=Os/Rte_Al_TE_disc_ecu_Core0_Task_20ms, RteActivationOsTaskRef=Default_BSW_Async_Task_Core0
        Rte_Al_TE_disc_ecu_Core0_Task_50ms: RteActivationOsAlarmRef=Os/Rte_Al_TE_disc_ecu_Core0_Task_50ms, RteActivationOsTaskRef=Default_BSW_Async_Task_Core0
        Rte_Al_TE2_EcuM_EcuM_MainFunction: RteActivationOsAlarmRef=Os/Rte_Al_TE2_EcuM_EcuM_MainFunction, RteActivationOsTaskRef=Default_BSW_Async_Task_Core1
        Rte_Al_TE3_EcuM_EcuM_MainFunction: RteActivationOsAlarmRef=Os/Rte_Al_TE3_EcuM_EcuM_MainFunction, RteActivationOsTaskRef=Default_BSW_Async_Task_Core2
  module config NvM
  module config Os
    Core0_OsTask_1ms (OsTask):
      OsTaskActivation = 1
      OsTaskPriority = 50
      OsTaskSchedule = NON
      OsTaskAccessingApplication = Untrusted_BSW_Core1
      OsTaskAccessingApplication = Untrusted_BSW_Core2
    Rte_Al_TE_Cycle_Task_1ms_Core0_Task_1ms (OsAlarm): OsAlarmCounterRef=SystemTimer_Core0, OsAlarmAccessingApplication=Untrusted_BSW_Core1, OsAlarmAccessingApplication=Untrusted_BSW_Core2
      OsAlarmAction
        OsAlarmActivateTask: OsAlarmActivateTaskRef=Core0_OsTask_1ms
    Default_BSW_Async_Task_Core0 (OsTask):
      OsTaskActivation = 1
      OsTaskPriority = 30
      OsTaskSchedule = NON
      OsTaskEventRef = Rte_Ev_Cyclic2_Default_BSW_Async_Task_Core0_0_10ms
      OsTaskEventRef = Rte_Ev_Cyclic2_Default_BSW_Async_Task_Core0_0_20ms
      OsTaskEventRef = Rte_Ev_Run_LinIf_LinIf_MainFunction
      OsTaskEventRef = Rte_Ev_Run_disc_ecu_Core0_Task_100ms
      OsTaskEventRef = Rte_Ev_Run_disc_ecu_Core0_Task_10ms
      OsTaskEventRef = Rte_Ev_Run_disc_ecu_Core0_Task_20ms
      OsTaskEventRef = Rte_Ev_Run_disc_ecu_Core0_Task_50ms
      OsTaskAccessingApplication = Untrusted_BSW_Core1
      OsTaskAccessingApplication = Untrusted_BSW_Core2
    7 x OsAlarm, all with OsAlarmCounterRef=SystemTimer_Core0, OsAlarmAccessingApplication=Untrusted_BSW_Core1, OsAlarmAccessingApplication=Untrusted_BSW_Core2:
      Rte_Al_TE2_Default_BSW_Async_Task_Core0_0_10ms
        OsAlarmAction
          OsAlarmSetEvent: OsAlarmSetEventRef=Rte_Ev_Cyclic2_Default_BSW_Async_Task_Core0_0_10ms, OsAlarmSetEventTaskRef=Default_BSW_Async_Task_Core0
      Rte_Al_TE2_Default_BSW_Async_Task_Core0_0_20ms
        OsAlarmAction
          OsAlarmSetEvent: OsAlarmSetEventRef=Rte_Ev_Cyclic2_Default_BSW_Async_Task_Core0_0_20ms, OsAlarmSetEventTaskRef=Default_BSW_Async_Task_Core0
      Rte_Al_TE_LinIf_LinIf_MainFunction
        OsAlarmAction
          OsAlarmSetEvent: OsAlarmSetEventRef=Rte_Ev_Run_LinIf_LinIf_MainFunction, OsAlarmSetEventTaskRef=Default_BSW_Async_Task_Core0
      Rte_Al_TE_disc_ecu_Core0_Task_100ms
        OsAlarmAction
          OsAlarmSetEvent: OsAlarmSetEventRef=Rte_Ev_Run_disc_ecu_Core0_Task_100ms, OsAlarmSetEventTaskRef=Default_BSW_Async_Task_Core0
      Rte_Al_TE_disc_ecu_Core0_Task_10ms
        OsAlarmAction
          OsAlarmSetEvent: OsAlarmSetEventRef=Rte_Ev_Run_disc_ecu_Core0_Task_10ms, OsAlarmSetEventTaskRef=Default_BSW_Async_Task_Core0
      Rte_Al_TE_disc_ecu_Core0_Task_20ms
        OsAlarmAction
          OsAlarmSetEvent: OsAlarmSetEventRef=Rte_Ev_Run_disc_ecu_Core0_Task_20ms, OsAlarmSetEventTaskRef=Default_BSW_Async_Task_Core0
      Rte_Al_TE_disc_ecu_Core0_Task_50ms
        OsAlarmAction
          OsAlarmSetEvent: OsAlarmSetEventRef=Rte_Ev_Run_disc_ecu_Core0_Task_50ms, OsAlarmSetEventTaskRef=Default_BSW_Async_Task_Core0
    Default_BSW_Async_Task_Core1 (OsTask):
      OsTaskActivation = 1
      OsTaskPriority = 25
      OsTaskSchedule = NON
      OsTaskAccessingApplication = Untrusted_BSW_Core0
      OsTaskAccessingApplication = Untrusted_BSW_Core2
    Rte_Al_TE2_EcuM_EcuM_MainFunction (OsAlarm): OsAlarmCounterRef=SystemTimer_Core1, OsAlarmAccessingApplication=Untrusted_BSW_Core0, OsAlarmAccessingApplication=Untrusted_BSW_Core2
      OsAlarmAction
        OsAlarmActivateTask: OsAlarmActivateTaskRef=Default_BSW_Async_Task_Core1
    Default_BSW_Async_Task_Core2 (OsTask):
      OsTaskActivation = 1
      OsTaskPriority = 20
      OsTaskSchedule = NON
      OsTaskAccessingApplication = Untrusted_BSW_Core0
      OsTaskAccessingApplication = Untrusted_BSW_Core1
    Rte_Al_TE3_EcuM_EcuM_MainFunction (OsAlarm): OsAlarmCounterRef=SystemTimer_Core2, OsAlarmAccessingApplication=Untrusted_BSW_Core0, OsAlarmAccessingApplication=Untrusted_BSW_Core1
      OsAlarmAction
        OsAlarmActivateTask: OsAlarmActivateTaskRef=Default_BSW_Async_Task_Core2
    7 x OsEvent:
      Rte_Ev_Cyclic2_Default_BSW_Async_Task_Core0_0_10ms
      Rte_Ev_Cyclic2_Default_BSW_Async_Task_Core0_0_20ms
      Rte_Ev_Run_LinIf_LinIf_MainFunction
      Rte_Ev_Run_disc_ecu_Core0_Task_100ms
      Rte_Ev_Run_disc_ecu_Core0_Task_10ms
      Rte_Ev_Run_disc_ecu_Core0_Task_20ms
      Rte_Ev_Run_disc_ecu_Core0_Task_50ms
    3 x OsApplication, all with OsTrusted=true:
      Untrusted_BSW_Core0: OsAppTaskRef=Core0_OsTask_1ms, OsAppAlarmRef=Os/Rte_Al_TE_Cycle_Task_1ms_Core0_Task_1ms, OsAppTaskRef=Default_BSW_Async_Task_Core0, OsAppAlarmRef=Os/Rte_Al_TE2_Default_BSW_Async_Task_Core0_0_10ms, OsAppAlarmRef=Os/Rte_Al_TE2_Default_BSW_Async_Task_Core0_0_20ms, OsAppAlarmRef=Os/Rte_Al_TE_LinIf_LinIf_MainFunction, OsAppAlarmRef=Os/Rte_Al_TE_disc_ecu_Core0_Task_100ms, OsAppAlarmRef=Os/Rte_Al_TE_disc_ecu_Core0_Task_10ms, OsAppAlarmRef=Os/Rte_Al_TE_disc_ecu_Core0_Task_20ms, OsAppAlarmRef=Os/Rte_Al_TE_disc_ecu_Core0_Task_50ms
      Untrusted_BSW_Core1: OsAppTaskRef=Default_BSW_Async_Task_Core1, OsAppAlarmRef=Os/Rte_Al_TE2_EcuM_EcuM_MainFunction
      Untrusted_BSW_Core2: OsAppTaskRef=Default_BSW_Async_Task_Core2, OsAppAlarmRef=Os/Rte_Al_TE3_EcuM_EcuM_MainFunction
  ecuc value collection DaVinci_Project: ecuc-values=[Com, Rte, Os, NvM]
