AUTOSAR XML (schema 4-3-0)
package /MICROSAR
  module definition StbM [0..1]: category=VENDOR_SPECIFIC_MODULE_DEFINITION, refined-module-def=StbM, variants pre-compile  # Configuration of the Synchronized Time-base Manager (StbM) module.
    container StbMGeneral  # This container holds the general parameters of the Synchronized Time-base Manager
      boolean StbMDevErrorDetect: set at pre-compile, default-value=true  # Switch for enabling the development error detection.
      boolean StbMGetCurrentTimeExtendedAvailable [0..1]: multiplicity set at pre-compile, set at pre-compile, default-value=false  # This allows to define whether an additional variant of the API GetCurrentTime with a 64 bit argument is provided.
      float StbMMainFunctionPeriod: 1E-6..1.7976931348623157E+308, set at pre-compile  # Schedule period of the main function StbM_MainFunction. Unit: [s].
      boolean StbMVersionInfo: set at pre-compile, default-value=false  # Activate/Deactivate the version information API (StbM_GetVersionInfo). True: version information API activated False: version information API deactivated.
    container StbMSynchronizedTimeBase [1..65536]  # Synchronized time.base collects the information about a specific time-base provider within the system.
      boolean StbMAllowMasterRateCorrection [0..1]: multiplicity set at pre-compile, set at pre-compile, default-value=false  # This attribute describes whether the rate correction value of a Time Base can be set by StbM_SetRateCorrection(): | * false: the rate correction value can not be set by StbM_SetRateCorrection() * true: the rate correction value can be set by StbM_SetRateCorrection()
      boolean StbMIsSystemWideGlobalTimeMaster: set at pre-compile  # This parameter shall be set to true for a global time master that acts as a system-wide source of time information with respect to global time. | It is possible that several global time masters exist that have set this parameter set to true because the global time masters exist once per global time domain and one ECU may start several global time domains on different busses it is connected to.
      integer StbMMasterRateDeviationMax [0..1]: 0..32000, multiplicity set at pre-compile, set at pre-compile, default-value=0  # This attribute describes the maximum allowed absolute value of the rate deviation value to be set by StbM_SetRateCorrection() [unit: seconds].
      enumeration StbMStoreTimebaseNonVolatile [0..1]: {NO_STORAGE, STORAGE_AT_SHUTDOWN}, multiplicity set at pre-compile, set at pre-compile, default-value=NO_STORAGE  # This allows for specifying that the timebase shall be stored in the NvRam
      float StbMSyncLossThreshold [0..1]: 0..1.7976931348623157E+308, multiplicity set at pre-compile, set at pre-compile  # This represents the minimum delta between the time value in two sync messages for which the sync loss flag is set. Unit: seconds.
      float StbMSyncLossTimeout [0..1]: 0..1.7976931348623157E+308, multiplicity set at pre-compile, set at pre-compile  # This attribute describes the timeout for the situation that the time synchronization gets lost in the scope of the time domain. Unit: seconds
      integer StbMSynchronizedTimeBaseIdentifier: 0..65535, set at pre-compile, symbolic-name-value=true, default-value=0  # Identification of a synchronized time-base via a unique identifier. This parameter is automatically calculated and set by an auto solving action.
      reference StbMOffsetTimeBase [0..1]: multiplicity set at pre-compile, set at pre-compile, destination=StbMSynchronizedTimeBase  # This is the reference to another time base with a given offset
      container StbMLocalTimeClock [0..1]: multiplicity set at pre-compile  # References the hardware reference clock of this Synchronized Time Base.
        choice reference StbMLocalTimeHardware [0..1]: multiplicity set at pre-compile, set at pre-compile, destination=[EthTSynGlobalTimeDomain, GptChannelConfiguration, OsCounter]  # Reference to the local time hardware.
      container StbMTimeCorrection [0..1]: multiplicity set at pre-compile  # Collects the information relevant for the rate- and offset correction of a Time Base.
        float StbMOffsetCorrectionAdaptionInterval [0..1]: 0..1.7976931348623157E+308, multiplicity set at pre-compile, set at pre-compile  # Defines the interval during which the adaptive rate correction cancels out the rate- and time deviation [unit: seconds].
        float StbMOffsetCorrectionJumpThreshold [0..1]: 0..1.7976931348623157E+308, multiplicity set at pre-compile, set at pre-compile  # Threshold for the correction method. Deviations below this value will be corrected by a linear reduction over a defined timespan. Values equal- and greater than this value will be corrected by immediately setting the correct time- and rate in form of a jump [unit: seconds].
        float StbMRateCorrectionMeasurementDuration [0..1]: 0..1.7976931348623157E+308, multiplicity set at pre-compile, set at pre-compile, default-value=1  # Definition of the time span [s] which is used to calculate the rate deviation.
        integer StbMRateCorrectionsPerMeasurementDuration [0..1]: 1..65535, multiplicity set at pre-compile, set at pre-compile, default-value=1  # Number of simultaneous rate measurements to determine the current rate deviation.
    container StbMTriggeredCustomer [0..65536]  # The triggered customer is directly triggered by the Synchronized Time-base Manager by getting synchronized with the current (global) definition of time and passage of time.
      integer StbMTriggeredCustomerPeriod: 1..4294967295, set at pre-compile  # The triggering period of the triggered customer, called by the StbM_MainFunction. | The period is documented in microseconds.
      reference StbMOSScheduleTableRef: multiplicity set at pre-compile, set at pre-compile, destination=OsScheduleTable  # Mandatory reference to synchronized OS ScheduleTable, which will be explicitly synchronized by the StbM.
      symbolic name reference StbMSynchronizedTimeBaseRef: set at pre-compile, destination=StbMSynchronizedTimeBase  # Mandatory reference to the required synchronized time-base.
  bsw implementation StbM_Impl: programming-language=C, sw-version=4.02.00, used-code-generator=DaVinci Configurator, vendor-id=30, ar-release-version=4.03.00, behavior=StbMBehavior, preconfigured-configuration=StbM_Pre, recommended-configuration=StbM_Rec, vendor-specific-module-def=StbM
  module config StbM_Pre: definition=StbM
  module config StbM_Rec: definition=StbM
