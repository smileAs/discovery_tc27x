AUTOSAR XML (schema 4-0-3)
# COPYRIGHT
# Copyright (c) 2014 by Vector Informatik GmbH. All rights reserved.
# This software is copyright protected and proprietary to Vector Informatik GmbH.
# Vector Informatik GmbH grants to you only those rights as set out in the license conditions.
package /MICROSAR/EthTrcv_Ethmii
  module definition EthTrcv [0..*]: category=VENDOR_SPECIFIC_MODULE_DEFINITION, refined-module-def=EthTrcv, variants pre-compile  # Configuration of the EthTrcv (Ethernet Transceiver driver) module.
    container EthTrcvGeneral  # General configuration of Ethernet Transceiver Driver module.
      boolean EthTrcvDevErrorDetect: set at pre-compile, default-value=true  # Dev Error Detect | This parameter switches the Development Error Detection and Notification ON or OFF. true: Development error detection is enabled. false: Development error detection is disabled. Note: In general, the development error detection is recommended during pre-test phase. It is not recommended to enable the development error detection in production code due to increased runtime and ROM needs.
      boolean EthTrcvGetBaudRateApi: set at pre-compile, default-value=true  # Get Baud Rate API | This parameter defines if the EthTrcv_GetBaudRate() API is enabled to get the current transceiver baud rate.
      boolean EthTrcvGetDuplexModeApi: set at pre-compile, default-value=true  # Get Duplex Mode API | This parameter defines if the EthTrcv_GetDuplexMode() API is enabled to get the current transceiver duplex mode.
      boolean EthTrcvGetLinkStateApi: set at pre-compile, default-value=true  # Get Transceiver Link State API | This parameter defines if the EthTrcv_GetLinkState() API is enbled to get the current transceiver link state.
      boolean EthTrcvGetTransceiverModeApi: set at pre-compile, default-value=true  # Get Transceiver Mode API | This parameter defines if the EthTrcv_GetTransceiverMode() API is enabled to get the current transceiver mode.
      integer EthTrcvMaxTrcvsSupported: 1..255, set at pre-compile, default-value=1  # Max Trcvs Supported | This value specifies the maximum number of transceiver configurations per transceiver driver.
      boolean EthTrcvSetTransceiverModeApi: set at pre-compile, default-value=true  # Set Transceiver Mode API | This parameter defines if the EthTrcv_SetTransceiverMode() API is enabled to set the transceiver mode.
      boolean EthTrcvStartAutoNegotiationApi: set at pre-compile, default-value=true  # Start Auto Negotiaion API | This parameter defines if the EthTrcv_StartAutoNegotiation() is enabled to start the transceiver auto negotiation.
      boolean EthTrcvVersionInfoApi: set at pre-compile, default-value=false  # Version Info API | This parameter enables/disables the function EthTrcv_GetVersionInfo() to get major, minor and patch version information.
      string EthTrcvUserConfigFile [0..1]: set at pre-compile, origin=Vector Informatik  # User Config File | Reference to an external text file that will be included during generation to EthTrcv_Cfg.h. The content of the user configuration file will be added at the end of the generated module configuration file and allows altering or extending the generated code. Caution: User configuration files can cause the software module to malfunction and must only be used with great care!
      boolean EthTrcvVersionInfoApiMacro [0..1]: set at pre-compile, default-value=false  # Version Info API Macro | Parameter not used. This parameter defines if EthTrcv_GetVersionInfo() is implemented as a macro. Restrictions: 'EthTrcvVersionInfoApiMacro' is only relevant, if 'EthTrcvVersionInfoApi' is set to 'true'.
      integer EthTrcvIndex: 0..255, set at pre-compile, default-value=0  # Specifies the InstanceId of this module instance. If only one instance is present it shall have the Id 0.
      boolean EthTrcvRuntimeMeasurementSupport: set at pre-compile, origin=Vector Informatik, default-value=false  # If enabled runtime measurement points are added to the BSW module code and are added to the module configuration of MICROSAR RTM. The available measurement points can be seen and configured in the RTM module configuration. Availability of the MICROSAR RTM module is a prerequisite to make use of the runtime measurement functionality. Runtime measurement should be disabled in production code as measurement points may inflict additional runtime.
      boolean EthTrcvGetTransceiverWakeupModeApi [0..1]: set at pre-compile, default-value=true  # Get Transceiver Wakeup Mode API | This parameter defines if the EthTrcv_GetTransceiverWakeupMode() API is enabled to get the current transceiver wakeup mode. The API can only be used if EthTrcvWakeUpSupport is not configured to ETHTRCV_WAKEUP_NOT_SUPPORTED.
      enumeration EthTrcvWakeUpSupport: {ETHTRCV_WAKEUP_BY_INTERRUPT, ETHTRCV_WAKEUP_BY_POLLING, ETHTRCV_WAKEUP_NOT_SUPPORTED}, set at pre-compile, default-value=ETHTRCV_WAKEUP_NOT_SUPPORTED  # Wakeup Support | This parameter specifies the kinde of wakeup support the transceiver provides. ETHTRCV_WAKEUP_BY_INTERRUPT: Wakeup is realised through a interrupt triggered by Icu. ETHTRCV_WAKEUP_BY_POLLING: Wakeup is realised trough polling of EthTrcv_CheckWakeup() through EcuM. ETHTRCV_WAKEUO_NOT_SUPPORTED: Wakeup capability is either not supported by hardware/driver or is disabled.
      float EthTrcvMainFunctionPeriod [0..1]: 0.001..1, set at pre-compile, origin=Vector Informatik, default-value=0.02  # This value specifies the period the EthTrcv_MainFunction is called.
      string EthTrcvWakeUpCalloutIncludeFiles [0..*]: set at pre-compile, origin=Vector Informatik  # This parameter defines include files for the declaration of wakeup callouts.
      boolean EthTrcvSafeBswChecks: set at pre-compile, default-value=false  # Selects if safety checks are used. These checks improve robustness as e.g. invalid parameters are checked before function is executed. This attribute has to be enabled for safety projects where this component is mapped to an ASIL partition.
      integer EthTrcvHwAccessLoopCount: 0..4294967296, set at pre-compile, default-value=0  # On some platforms there is a additional waiting time required before the hardware access is possible. This waiting is implemented as busy waiting. The loop count can be configured using this parameter.
      boolean EthTrcvSoftResetOnInit: set at pre-compile, origin=Vector Informatik, default-value=false  # This parameter speficies if a soft reset during transceiver initialization re-initializes all transceiver registers. In case the user sets some transceiver registers during runtime and wants to restore the default settings when transceiver is re-initialized, this option must be enabled.
      integer EthTrcvSoftResetWaitCycles [0..1]: 1..65535, set at pre-compile, origin=Vector Informatik, default-value=120  # This value specifies the wait time until a soft reset is performed. After soft reset the driver polls the transceiver register and checks that the reset is performed or not. This is the maximum wait time.
      integer EthTrcvCableDiagLoopCount: 0..4294967296, set at pre-compile, default-value=10000  # The cable diagnostic result can only be obtained after some waiting time. This parameter specifies the loop cycles the software performs until a timeout occurs.
    container EthTrcvConfigSet  # This conainter includes multiple configuration set containers.
      container EthTrcvConfig [1..*]  # This container includes the configuration of the individual transceiver.
        integer EthTrcvIdx: 0..255, set at pre-compile, symbolic-name-value=true, default-value=0  # Transceiver Index | This value specifies the instance ID of the configured transceiver.
        enumeration EthTrcvSpeed: set at pre-compile, default-value=TRCV_SPEED_100  # This parameter specifies the speed of the Ethernet transceiver link in MBit/s. RESTRICTION: If Auto Negotiation is enabled this is the maximum speed advertised for Auto-Negotiation
          TRCV_SPEED_10  # ETHTRCV_BAUD_RATE_10MBIT
          TRCV_SPEED_100  # ETHTRCV_BAUD_RATE_100MBIT
          TRCV_SPEED_1000  # ETHTRCV_BAUD_RATE_1000MBIT
        boolean EthTrcvEnableAccessCheck: set at pre-compile, default-value=false  # Enables a check for MDIO Communication in TransceiverInit.
        integer EthTrcvAccessCheckRegisterValue: set at pre-compile, default-value=0  # Expected register value of PHY-Identifier 1 register (MII register 0x02) for MDIO access check.
        function name EthTrcvWakeUpCallout [0..1]: set at pre-compile  # This parameter specifies a callout function that is called during EthTrcv_SetTransceiverMode() for transceiver activation if a wakeup event has occured. The callout can be used for e.g. initiating a remote wakeup of related ECUs by setting a activation line connected to them. The function must be declared as followed: void &lt;EthTrcvWakeUpCallout&gt;(uint8 TrcvIdx)
        enumeration EthTrcvWakeupInspectionType [0..1]: {ETHTRCV_ICU_CHANNEL, ETHTRCV_TRCV_REGISTERS, ETHTRCV_USER_CODE}, set at pre-compile, origin=Vector Informatik, default-value=ETHTRCV_ICU_CHANNEL  # Wakeup Inspection Type | This parameter specifies the method used for inspection of wakeup events. ETHTRCV_ICU_CHANNEL: Uses the Icu_GetInputState() API for the related Icu channel to verify if a wakeup event occured and the corresponding AUTOSAR wakeup reason must be set. ETHTRCV_TRCV_REGISTERS: If hardware supports waking up by the transceiver itself the driver checks its registers if a wakeup event occured and the corresponding AUTOSAR wakeup reason must be set. ETHTRCV_USER_CODE: The user must provide integration code by itself for wakeup event inspection. This code must be embedded within the function EthTrcv_WakeupInspection generated into EthTrcv_Lcfg.c. For a more detailed information please refere to the Technical Reference of the driver.
        boolean EthTrcvPreTransceiverInitCallout: set at pre-compile, default-value=false  # This parameter defines if a callout is generated, which can be used to add special startup handling before TransceiverInit() is execeuted.
        boolean EthTrcvPostTransceiverInitCallout: set at pre-compile, default-value=false  # This parameter defines if a callout is generated, which can be used to add special startup handling after TransceiverInit() is execeuted.
        enumeration EthTrcvConnNeg: {ETHTRCV_CONN_NEG_AUTO, ETHTRCV_CONN_NEG_MASTER, ETHTRCV_CONN_NEG_SLAVE, ETHTRCV_CONN_NEG_MANUAL}, set at pre-compile, default-value=ETHTRCV_CONN_NEG_MANUAL  # Connection Negotiation | This parameter specifies the connection negotiation of the Ethernet transceiver link.
        integer EthTrcvPhySignalQualityMeanValueLength: 1..1000, set at pre-compile, default-value=100  # This parameter specifies how many consecutive data points of the phy's signal quality are used for the calculated mean value.
        symbolic name reference EthTrcvIcuChannelRef [0..1]: set at pre-compile, destination=IcuChannel  # Reference to a Icu channel container. The reference is used for enabling/disabling the wakeup notifications triggered by Icu in case EthTrcvWakeupSupport is configured to ETHTRCV_WAKEUP_BY_INTERRUPT. Additionally the reference is used to check for a proper wakeup signal if the parameter EthTrcvWakeupVerificationType is set to ETHTRCV_ICU_CHANNEL.
        container EthTrcvDemEventParameterRefs [0..1]  # This container includes the references to DemEventParameter elements which shall be invoked using the API Dem_ReportErrorStatus API in case the corresponding error occurs. The EventId is taken from the referenced DemEventParameter's DemEventId value.
          symbolic name reference ETHTRCV_E_ACCESS [0..1]: set at pre-compile, destination=DemEventParameter  # This parameter references the Ethernet Transceiver DEM Event.
        choice container EthTrcvMgmtInterface  # This container includes either a MII interface or Switch interface container. Depending on the physical hardware the transceiver is either connected to an Ethernet Controller via MII interface or is integrated into an Ethernet Switch.
          container EthTrcvMiiInterface [0..1]  # This container includes the MII interface configuration between an Ethernet Controller and the Ethernet Transceiver.
            integer EthTrcvMiiIdx: 0..255, set at pre-compile, origin=Vector Informatik, default-value=1  # Transceiver MII Index | This value specifies the transceiver index used for MII (Media Independent Interface) access of the transceiver. A transceiver is usually associated with a constant MII address, that can be selected via strapping pins on the hardware. The adress is used to identify the transceiver during communication.
            enumeration EthTrcvMiiSelection: {ETHTRCV_MII_MODE}, set at pre-compile, origin=Vector Informatik, default-value=ETHTRCV_MII_MODE  # This parameter specifies the type of transceiver/controller interface. For the Ethmii transceiver driver this selection is not possible since vendor specific registers are used. Extended register acces can be used instead.
            symbolic name reference EthTrcvCtrlRef: set at pre-compile, origin=Vector Informatik, destination=EthCtrlConfig  # Reference to a physical Ethernet controller configuration.
          container EthTrcvSwitchInterface [0..1]  # This container includes the Switch interface configuration between an Ethernet Switch and an Ethernet Transceiver.
            enumeration EthTrcvMiiSelection: {ETHTRCV_MII_MODE, ETHTRCV_INTERNAL_PHY}, set at pre-compile, origin=Vector Informatik, default-value=ETHTRCV_MII_MODE  # This parameter specifies the type of transceiver/controller interface. In case the configured element is an intenal PHY choose INTERNAL PHY, in case it is an external PHY managed by a switch the interface must be selected. For the Ethmii transceiver driver this selection is not possible since vendor specific registers are used. Extended register acces can be used instead.
            symbolic name reference EthTrcvSwitchRef: set at pre-compile, origin=Vector Informatik, destination=EthSwtConfig  # Reference to a switch configuration container. The switch configuration is associated with the hardware switch this transceiver is connected into.
            symbolic name reference EthTrcvSwitchPortRef: set at pre-compile, origin=Vector Informatik, destination=EthSwtPort  # Reference to a switch port reference. The port configuration is associated with the port of a hardware switch this transceiver connected to.
          container EthTrcvSpiInterface [0..1]
            symbolic name reference EthTrcvCtrlRef: set at pre-compile, origin=Vector Informatik, destination=EthCtrlConfig  # Reference to a physical Ethernet controller configuration.
        container EthTrcvWakeupMap [0..7]  # Container for the mapping of wake up reasons to wake up sources. At least one container is needed if EthTrcvWakeUpSupport is not ETHTRCV_WAKEUP_NOT_SUPPORTED.
          enumeration EthTrcvWakeupReason: {ETHTRCV_WUR_BUS, ETHTRCV_WUR_GENERAL, ETHTRCV_WUR_INTERNAL, ETHTRCV_WUR_PIN, ETHTRCV_WUR_POWER_ON, ETHTRCV_WUR_RESET, ETHTRCV_WUR_SYSERR}, set at pre-compile, default-value=ETHTRCV_WUR_BUS  # Trcv Wakeup Reason | This parameter specifies the corresponding wakeup reason mapped to the wakeup source of the EcuM. ETHTRCV_WUR_BUS: Reason for the wakeup is a event on the Ethernet network. ETHTRCV_WUR_GENERAL: Reason for the wakeup is a general event. ETHTRCV_WUR_INTERNAL: Reason for the wakeup is a internal transceiver event. ETHTRCV_WUR_PIN: Reason for the wakeup is a event on the related Icu channel. ETHTRCV_WUR_POWER_ON: Reason for the wakeup is the power on of the ECU. ETHTRCV_WUR_RESET: Reason for the wakeup is the reset of the ECU. ETHTRCV_WUR_SYSERR: Reason for the wakeup is a system error.
          symbolic name reference EthTrcvWakeupSourceRef: set at pre-compile, destination=EcuMWakeupSource  # EcuM Wakeup Source | Reference to a EcuM wakeup source container. This wakeup source is mapped to the wakeup reason and is issued to the EcuM during EcuM_CheckWakeup() with EcuM_SetWakeupEvent() if the corresponding wakeup reason occured.
        container EthTrcvExtendedRegisterAccess [0..*]  # This container includes the configuration for accessing vendor specific registers, which a not part of the basic MII register set.
          integer EthTrcvExtendedRegisterAccessAddress: 4..255, set at pre-compile  # This parameter defines the register adresses for accessing vendor specific registers, which a not part of the basic MII register set. Registers 0-3 are managed by the transceiver driver and not accessible.
          integer EthTrcvExtendedRegisterAccessValue: 0..65535, set at pre-compile  # This parameter defines the register value for accessing vendor specific registers, which a not part of the basic MII register set.
  bsw implementation EthTrcv_Impl: programming-language=C, sw-version=1.03.02, used-code-generator=DaVinci Configurator, vendor-id=30, ar-release-version=4.01.01, behavior=EthTrcv_30_EthmiiBehavior, preconfigured-configuration=EthTrcv_Pre, recommended-configuration=EthTrcv_Rec, vendor-api-infix=Ethmii, vendor-specific-module-def=EthTrcv
  module config EthTrcv_Pre: definition=EthTrcv
  module config EthTrcv_Rec: definition=EthTrcv
