AUTOSAR XML (schema 4-0-3)
package /MICROSAR/Lin_Tricore
  module config Lin_Pre: definition=Lin
    LinPlatformConfig:
      LinRegisterAddresses = 0xF0000600UL 0xF0000700UL 0xF0000800UL 0xF0000900UL 0xF0000A00UL 0xF0000B00UL 0xF0000C00UL 0xF0000D00UL
      LinClockRegister = F_OSC=0x04 F_ASCLINF=0x02 F_ASCLINS=0x04
