AUTOSAR XML (schema 4-0-3)
package /MICROSAR
  module definition SecOC [0..1]: category=VENDOR_SPECIFIC_MODULE_DEFINITION, refined-module-def=SecOC, variants pre-compile/post-build-loadable/post-build-selectable  # Configuration of the SecOC (SecureOnboardCommunication) module.
    container SecOCGeneral  # Contains the general configuration parameters of SecOC module.
      boolean SecOCDevErrorDetect: set at pre-compile, default-value=true  # Pre-processor switch for enabling development error detection support.
      float SecOCMainFunctionPeriod: 0..0.255, set at pre-compile, default-value=0.01  # Allow to configure the time for the MainFunction (as float in seconds). Note: This parameter is not used by the generator. Deprecated! This function is deprecated and will be removed with the next release.
      float SecOCMainFunctionPeriodRx: 0..0.255, set at pre-compile, origin=Vector Informatik, default-value=0.01  # Allow to configure the time for the MainFunction of the Rx path (as float in seconds).
      float SecOCMainFunctionPeriodTx: 0..0.255, set at pre-compile, origin=Vector Informatik, default-value=0.01  # Allow to configure the time for the MainFunction of the Tx path (as float in seconds).
      string SecOCMaxAlignScalarType: set at pre-compile  # The scalar type which has the maximum alignment restrictions on the given platform. This type can be e.g. uint8, uint16 or uint32.
      function name SecOCVerificationStatusCallout [0..*]: set at pre-compile  # Entry address of the customer specific call out routine which shall be invoked in case of a verification attempt.
      boolean SecOCVersionInfoApi: set at pre-compile, default-value=false  # If true the SecOC_GetVersionInfo API is available.
      string SecOCUserConfigFile [0..1]: set at pre-compile, origin=Vector Informatik  # Reference to an external user configuration file that will be included during generation. The content of the user configuration file will be added at the end of the generated module configuration file and allows altering or extending the generated code. Caution: User configuration files can cause the software module to malfunction and must only be used with great care!
      integer SecOCKeyMaxSize: 0..4294967295, set at pre-compile, origin=Vector Informatik  # The SecOCKeyMaxSize shall be equal the CAL_SYM_KEY_MAX_SIZE. The SecOCKeyMaxSize is used as length of the data array of the SecOC_KeyType.
      boolean SecOCEnableForcedPassOverride: set at pre-compile, origin=Vector Informatik, default-value=false  # If SecOCEnableForcedPassOverride is set to true the API SecOC_VerifyStatusOverride accepts the overrideStatus Pass.
      boolean SecOCIgnoreVerificationResult: set at pre-compile, origin=Vector Informatik, default-value=false  # If set to true the result of the authentication process (e.g. MAC Verify) is ignored after the first try and the SecOC proceeds like the result was a success. The calculation of the authenticator is still done, only its result will be ignored.
      enumeration SecOCQueryFreshnessValue: {NONE, RTE, CFUNC}, set at pre-compile, origin=Vector Informatik, default-value=CFUNC  # This parameter specifies if the freshness value shall be determined through a C-function (CDD), a software component (SW-C) or the counter support within the SecOC shall be used. NONE The freshness value is not queried by the SecOC at all. RTE The SecOC queries the freshness for every PDU to process using the Rte service port FreshnessManagement CFUNC The SecOC queries the freshness for every PDU to process using C function. Note: NONE mode is deprecated!
      integer SecOCMaxMessageLinkerSizeOfRxPdus: 0..65535, set at pre-compile, origin=Vector Informatik, default-value=0  # Max byte size of Message Linker used with Rx Secured Collection Pdus.
      boolean SecOCEnableKeyInterface: set at pre-compile, origin=Vector Informatik, default-value=true  # Enables the SecOC_AssociateKey interface. This interface is not required if the Autosar CSM 4.3 is used.
      symbolic name reference SecOCNvMBlockDescriptor [0..1]: set at pre-compile, destination=NvMBlockDescriptor  # Reference to NVRAM block containing the none volatile data. If this parameter is not configured it means that no NVRam is used at all. Note: This parameter is deprecated!
    container SecOCGeneration  # Contains the generation configuration parameters of the module SecOC.
      enumeration SecOCOutOfBoundsWriteProtectionStrategy: set at pre-compile, origin=Vector Informatik, default-value=NONE  # This parameter is used to configure a strategy to protect the code to write out of bounds. NONE: no protection strategy is generated in the data access. INDEX_SATURATION: arrays are blown up and the data access index is saturated by an appropriate mask. The advantage is the speed of the data access, but own data elements at other indexes of the same variable can be overridden. INDEX_CHECKING: the data access index is validated by a runtime check. The advantage is that values are never written to incorrect indexes of the data access.
        NONE  # none
        INDEX_SATURATION  # index saturation
        INDEX_CHECKING  # index checking
      boolean SecOCOutOfBoundsWriteSanitizer: set at pre-compile, origin=Vector Informatik, default-value=false  # This parameter activates/deactivates the generation of runtime checks which call a DET error notification function to find easily out of bounds write problems. FALSE: no checks are generated in the data access. TRUE: the data access is enriched with DET checks to validate indexes.
      boolean SecOCOutOfBoundsReadSanitizer: set at pre-compile, origin=Vector Informatik, default-value=false  # This parameter activates/deactivates the generation of runtime checks which call a DET error notification function to find easily out of bounds read problems. FALSE: no checks are generated in the data access. TRUE: the data access is enriched with DET checks to validate indexes.
      boolean SecOCShortSymbols: set at pre-compile, origin=Vector Informatik, default-value=false  # This parameter activates/deactivates the capability to generate shortened symbol names. FALSE: symbol names are generated in a human readable style based on the MIP, tags and variant names. TRUE: symbol names are generated based on the MIP and a CRC32.
      boolean SecOCInterfacesForDeactivatedData: set at pre-compile, origin=Vector Informatik, default-value=false  # This parameter activates/deactivates the capability to generate bsw data interfaces for deactivated data elements. This is an advantage for the BSW developer to reduce the time to market with a development environment using auto completition and to investigate potential interfaces. FALSE: data interfaces are not generated if the data elementis deactivated. TRUE: data interfaces are generated as e.g. emty macros.
      boolean SecOCReferringKeysInComments: set at pre-compile, origin=Vector Informatik, default-value=false  # This parameter activates/deactivates the capability to generate referring keys in comments. This is an advantage for the developer to investigate indirections, but this feature reduces the overall readability of the generated data. FALSE: referring keys are not generated in comments. TRUE: referring keys are generated in comments.
    container SecOCRxPduProcessing [0..*]: post-build-changeable=true  # Contains the parameters to configure the RxPdus to be verified by the SecureOnboardCommunication module.
      integer SecOCAuthInfoTxLength: 0..65535, set at post-build in variant post-build-loadable+post-build-selectable / pre-compile in variant pre-compile  # This parameter defines the length in bits of the authentication code to be included in the payload of the authenticated Pdu.
      integer SecOCDataId: 0..65535, set at post-build in variant post-build-loadable+post-build-selectable / pre-compile in variant pre-compile  # This parameter defines a unique numerical identifier for the secured Pdu.
      integer SecOCFreshnessTimestampTimePeriodFactor [0..1]: 0..4294967295, set at pre-compile, default-value=0  # This parameter defines a factor that specifies the time period for the Freshness Timestamp. It holds a multiplication factor that specifies the concrete meaning of a Freshness Timestamp increment by one on basis of microseconds. Note: This parameter is not used by the generator. Note: This parameter is deprecated!
      integer SecOCFreshnessValueId: 0..65535, set at post-build in variant post-build-loadable+post-build-selectable / pre-compile in variant pre-compile, default-value=0  # This parameter defines the Id of the Freshness Value. | The Freshness Value might be a normal counter or a time value.
      integer SecOCFreshnessValueLength: 0..64, set at post-build in variant post-build-loadable+post-build-selectable / pre-compile in variant pre-compile  # This parameter defines the complete length in bits of the Freshness Value. As long as the key doesn't change the counter shall not overflow. The length of the counter shall be determined based on the expected life time of the corresponding key and frequency of usage of the counter.
      integer SecOCFreshnessValueTxLength: 0..64, set at post-build in variant post-build-loadable+post-build-selectable / pre-compile in variant pre-compile  # This parameter defines the length in bits of the Freshness Value to be included in the payload of the Secured I-PDU. This length is specific to the least significant bits of the complete Freshness Counter. If the parameter is 0 no Freshness Value is included in the Secured I-PDU.
      integer SecOCKeyId [0..1]: 0..65535, set at post-build in variant post-build-loadable+post-build-selectable / pre-compile in variant pre-compile  # This parameter specifies the local Key identifier of the stored Key used to generate or verify a MAC.
      boolean SecOCUseFreshnessTimestamp [0..1]: set at pre-compile, default-value=false  # This parameter specifies whether the Freshness Value is generated through individual Freshness Counters or by a Timestamps. The value is set to TRUE when Timestamps are used. Note: This parameter is not used by the generator. Note: This parameter is deprecated!
      enumeration SecOCVerificationStatusPropagationMode: {BOTH, FAILURE_ONLY, NONE}, set at post-build in variant post-build-loadable+post-build-selectable / pre-compile in variant pre-compile, default-value=NONE  # This parameter is used to describe the propagation of the status of each verification attempt from the SecOC module to SWCs.
      boolean SecOCUseAuthDataFreshness: set at post-build in variant post-build-loadable+post-build-selectable / pre-compile in variant pre-compile, origin=Vector Informatik, default-value=false  # A Boolean value that indicates if a part of the Authentic-PDU shall be passed on to the SWC that verifies and generates the Freshness. If it is set to TRUE, the values SecOCAuthDataFreshnessStartPosition and SecOCAuthDataFreshnessLen must be set to specify the bit position and length within the Authentic-PDU.
      integer SecOCAuthDataFreshnessStartPosition [0..1]: 0..65535, set at post-build in variant post-build-loadable+post-build-selectable / pre-compile in variant pre-compile, origin=Vector Informatik  # This value determines the starting bit position in bits (uint16) of the Authentic PDU that shall be passed on to the Freshness SWC. The bit position starts counting from the MSB of the first byte of the PDU.
      integer SecOCAuthDataFreshnessLen [0..1]: 0..65535, set at post-build in variant post-build-loadable+post-build-selectable / pre-compile in variant pre-compile, origin=Vector Informatik  # The length of the external authentic PDU data in bits (uint16).
      integer SecOCAuthenticationBuildAttempts: 1..65535, set at post-build in variant post-build-loadable+post-build-selectable / pre-compile in variant pre-compile, origin=Vector Informatik, default-value=1  # This parameter specifies the number of authentication build attempts.
      integer SecOCAuthenticationVerifyAttempts: 1..65535, set at post-build in variant post-build-loadable+post-build-selectable / pre-compile in variant pre-compile, origin=Vector Informatik, default-value=1  # This parameter specifies the number of authentication verify attempts that are to be carried out when the verification of the authentication information failed for a given Secured I-PDU. If zero is set, then only one authentication verification attempt is done.
      choice reference SecOCRxAuthServiceConfigRef: set at post-build in variant post-build-loadable+post-build-selectable / pre-compile in variant pre-compile, destination=[CalMacVerifyConfig, CsmMacVerifyConfig, CsmJob]  # This choice container is used to define which module and which service is used for verification.
      reference SecOCSameBufferPduRef [0..1]: set at pre-compile, destination=SecOCSameBufferPduCollection  # This reference is used to collect Pdus that are using the same SecOC buffer.
      container SecOCRxAuthenticPduLayer  # This container specifies the Pdu that is transmitted by the SecOC module to the PduR after the Mac was verified.
        reference SecOCRxAuthenticLayerPduRef: set at post-build in variant post-build-loadable / pre-compile in variant post-build-selectable+pre-compile, destination=Pdu  # Reference to the global Pdu.
      choice container SecOCRxSecuredPduLayer  # Choice between normal Secured I-PDUs and Secured PDU Collections.
        container SecOCRxSecuredPdu [0..1]  # Contains the Normal Secured I-PDU.
          integer SecOCRxSecuredLayerPduId: 0..65535, set at pre-compile, origin=Vector Informatik, symbolic-name-value=true, default-value=0  # PDU identifier assigned by SecureOnboardCommunication module. Used by PduR for SecOC_PduRRxIndication.
          reference SecOCRxSecuredLayerPduRef: set at post-build in variant post-build-loadable / pre-compile in variant post-build-selectable+pre-compile, origin=Vector Informatik, destination=Pdu  # Reference to the global Pdu.
        container SecOCRxSecuredPduCollection [0..1]  # Contains the Secured PDU Collection.
          container SecOCRxAuthenticPdu  # Contains the Authentic Pdu of a Secured PDU Collection.
            integer SecOCRxAuthenticPduId: 0..65535, set at pre-compile, origin=Vector Informatik, symbolic-name-value=true, default-value=0  # PDU identifier assigned by SecureOnboardCommunication module. Used by PduR for SecOC_PduRRxIndication.
            reference SecOCRxAuthenticPduRef: set at post-build in variant post-build-loadable / pre-compile in variant post-build-selectable+pre-compile, origin=Vector Informatik, destination=Pdu  # Reference to the global Pdu.
          container SecOCRxCryptographicPdu  # Contains the Cryptographic PDU of a Secured PDU Collection.
            integer SecOCRxCryptographicPduId: 0..65535, set at pre-compile, origin=Vector Informatik, symbolic-name-value=true, default-value=0  # PDU identifier assigned by SecureOnboardCommunication module. Used by PduR for SecOC_PduRRxIndication.
            reference SecOCRxCryptographicPduRef: set at post-build in variant post-build-loadable / pre-compile in variant post-build-selectable+pre-compile, origin=Vector Informatik, destination=Pdu  # Reference to the global Pdu.
          container SecOCMessageLink [0..1]  # This container is a sub-container of SecOCTxSecuredPduCollection and contains the configuration for the message linker feature. Multiplicity 0 implies that the message linker is not used for the associated Secured I-PDU.
            integer SecOCMessageLinkPos: 0..65535, set at post-build in variant post-build-loadable+post-build-selectable / pre-compile in variant pre-compile, origin=Vector Informatik, default-value=0  # The position of the Message Linker inside the Authentic I-PDU in bits.
            integer SecOCMessageLinkLen: 0..65535, set at pre-compile in variant post-build-loadable+pre-compile / post-build in variant post-build-selectable, origin=Vector Informatik, default-value=0  # Length of the Message Linker in bits
    container SecOCSameBufferPduCollection [0..0]  # SecOCBuffer configuration that may be used by a collection of Pdus. Note: This container is not used by the generator.
      integer SecOCBufferLength: 0..4294967295, set at pre-compile  # This parameter defines the Buffer in bytes that is used by the SecOC module. Note: This parameter is not used by the generator.
    container SecOCTxPduProcessing [0..*]: post-build-changeable=true  # Contains the parameters to configure the TxPdus to be secured by the SecureOnboardCommunication module.
      integer SecOCAuthInfoTxLength: 0..65535, set at post-build in variant post-build-loadable+post-build-selectable / pre-compile in variant pre-compile  # This parameter defines the length in bits of the authentication code to be included in the payload of the authenticated Pdu.
      integer SecOCAuthenticationRetries: 0..65535, set at post-build in variant post-build-loadable+post-build-selectable / pre-compile in variant pre-compile, default-value=0  # This parameter defines the additional number of authentication attempts that are to be carried out when the generation of the authentication information failed for a given Secured I-PDU. If zero is set than only one authentication attempt is done. Note: This parameter is not used by the generator. Note: This parameter is deprecated!
      integer SecOCDataId: 0..65535, set at post-build in variant post-build-loadable+post-build-selectable / pre-compile in variant pre-compile  # This parameter defines a unique numerical identifier for the secured Pdu.
      integer SecOCFreshnessTimestampTimePeriodFactor [0..1]: 0..4294967295, set at pre-compile, default-value=0  # This parameter defines a factor that specifies the time period for the Freshness Timestamp. It holds a multiplication factor that specifies the concrete meaning of a Freshness Timestamp increment by one on basis of microseconds. Note: This parameter is not used by the generator. Note: This parameter is deprecated!
      integer SecOCFreshnessValueId: 0..65535, set at post-build in variant post-build-loadable+post-build-selectable / pre-compile in variant pre-compile, default-value=0  # This parameter defines the Id of the Freshness Value. | The Freshness Value might be a normal counter or a time value.
      integer SecOCFreshnessValueLength: 0..64, set at post-build in variant post-build-loadable+post-build-selectable / pre-compile in variant pre-compile  # This parameter defines the complete length in bits of the Freshness Value. As long as the key doesn't change the counter shall not overflow. The length of the counter shall be determined based on the expected life time of the corresponding key and frequency of usage of the counter.
      integer SecOCFreshnessValueTxLength: 0..64, set at post-build in variant post-build-loadable+post-build-selectable / pre-compile in variant pre-compile  # This parameter defines the length in bits of the Freshness Value to be included in the payload of the Secured I-PDU. This length is specific to the least significant bits of the complete Freshness Counter. If the parameter is 0 no Freshness Value is included in the Secured I-PDU.
      integer SecOCKeyId [0..1]: 0..65535, set at post-build in variant post-build-loadable+post-build-selectable / pre-compile in variant pre-compile  # This parameter specifies the local Key identifier of the stored Key used to generate or verify a MAC.
      boolean SecOCProvideTxTruncatedFreshnessValue: set at post-build in variant post-build-loadable+post-build-selectable / pre-compile in variant pre-compile, origin=Vector Informatik, default-value=false  # This parameter specifies if the Tx query freshness function provides the truncated freshness info instead of generating this by SecOC In this case, SecOC shall add this data to the Authentic PDU instead of truncating the freshness value.
      integer SecOCAuthenticationBuildAttempts: 1..65535, set at post-build in variant post-build-loadable+post-build-selectable / pre-compile in variant pre-compile, origin=Vector Informatik, default-value=1  # This parameter specifies the number of authentication build attempts.
      boolean SecOCUseTxConfirmation: set at post-build in variant post-build-loadable+post-build-selectable / pre-compile in variant pre-compile, origin=Vector Informatik, default-value=false  # A Boolean value that indicates if the function SecOC_SPduTxConfirmation shall be called for this PDU.
      boolean SecOCUseFreshnessTimestamp [0..1]: set at pre-compile, default-value=false  # This parameter specifies whether the Freshness Value is generated through individual Freshness Counters or by a Timestamps. The value is set to TRUE when Timestamps are used. Note: This parameter is not used by the generator. Note: This parameter is deprecated!
      choice reference SecOCTxAuthServiceConfigRef: set at post-build in variant post-build-loadable+post-build-selectable / pre-compile in variant pre-compile, destination=[CalMacGenerateConfig, CsmMacGenerateConfig, CsmJob]  # This choice container is used to define which module and which service is used for authentication.
      reference SecOCSameBufferPduRef [0..1]: set at pre-compile, destination=SecOCSameBufferPduCollection  # This reference is used to collect Pdus that are using the same SecOC buffer.
      container SecOCTxAuthenticPduLayer  # This container specifies the Pdu that is received by the SecOC module from the PduR. For this Pdu the Mac generation is provided.
        integer SecOCTxAuthenticLayerPduId: 0..65535, set at pre-compile, symbolic-name-value=true, default-value=0  # PDU identifier assigned by SecureOnboardCommunication module. Used by PduR for SecOC_PduRTransmit.
        reference SecOCTxAuthenticLayerPduRef: set at post-build in variant post-build-loadable / pre-compile in variant post-build-selectable+pre-compile, destination=Pdu  # Reference to the global Pdu.
      choice container SecOCTxSecuredPduLayer  # Choice between normal Secured I-PDUs and Secured PDU Collections.
        container SecOCTxSecuredPdu [0..1]  # Contains the Normal Secured I-PDU.
          integer SecOCTxSecuredLayerPduId: 0..65535, set at pre-compile, origin=Vector Informatik, symbolic-name-value=true, default-value=0  # PDU identifier assigned by SecureOnboardCommunication module. Used by PduR for confirmation (SecOC_PduRTxConfirmation) and for TriggerTransmit.
          reference SecOCTxSecuredLayerPduRef: set at post-build in variant post-build-loadable / pre-compile in variant post-build-selectable+pre-compile, origin=Vector Informatik, destination=Pdu  # Reference to the global Pdu.
        container SecOCTxSecuredPduCollection [0..1]  # Contains the Secured PDU Collection.
          container SecOCTxAuthenticPdu  # Contains the Authentic Pdu of a Secured PDU Collection.
            integer SecOCTxAuthenticPduId: 0..65535, set at pre-compile, origin=Vector Informatik, symbolic-name-value=true, default-value=0  # PDU identifier assigned by SecureOnboardCommunication module. Used by PduR for confirmation (SecOC_PduRTxConfirmation) and for TriggerTransmit.
            reference SecOCTxAuthenticPduRef: set at post-build in variant post-build-loadable / pre-compile in variant post-build-selectable+pre-compile, origin=Vector Informatik, destination=Pdu  # Reference to the global Pdu.
          container SecOCTxCryptographicPdu  # Contains the Cryptographic PDU of a Secured PDU Collection.
            integer SecOCTxCryptographicPduId: 0..65535, set at pre-compile, origin=Vector Informatik, symbolic-name-value=true, default-value=0  # PDU identifier assigned by SecureOnboardCommunication module. Used by PduR for confirmation (SecOC_PduRTxConfirmation) and for TriggerTransmit.
            reference SecOCTxCryptographicPduRef: set at post-build in variant post-build-loadable / pre-compile in variant post-build-selectable+pre-compile, origin=Vector Informatik, destination=Pdu  # Reference to the global Pdu.
          container SecOCMessageLink [0..1]  # This container is a sub-container of SecOCTxSecuredPduCollection and contains the configuration for the message linker feature. Multiplicity 0 implies that the message linker is not used for the associated Secured I-PDU.
            integer SecOCMessageLinkPos: 0..65535, set at post-build in variant post-build-loadable+post-build-selectable / pre-compile in variant pre-compile, origin=Vector Informatik, default-value=0  # The position of the Message Linker inside the Authentic I-PDU in bits.
            integer SecOCMessageLinkLen: 0..65535, set at pre-compile in variant post-build-loadable+pre-compile / post-build in variant post-build-selectable, origin=Vector Informatik, default-value=0  # Length of the Message Linker in bits
  bsw implementation SecOC_Impl: programming-language=C, sw-version=3.01.00, used-code-generator=DaVinci Configurator, vendor-id=30, ar-release-version=4.02.01, behavior=SecOCBehavior, preconfigured-configuration=SecOC_Pre, recommended-configuration=SecOC_Rec, vendor-specific-module-def=SecOC
  module config SecOC_Pre: definition=SecOC
  module config SecOC_Rec: definition=SecOC
