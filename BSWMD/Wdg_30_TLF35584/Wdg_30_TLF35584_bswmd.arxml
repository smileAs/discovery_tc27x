AUTOSAR XML (schema 4-0-3)
# COPYRIGHT
# Copyright (c) 2016 by Vector Informatik GmbH. All rights reserved.
# This software is copyright protected and proprietary to Vector Informatik GmbH.
# Vector Informatik GmbH grants to you only those rights as set out in the license conditions.
package /MICROSAR/Wdg_30_Tlf35584
  module definition Wdg [0..*]: category=VENDOR_SPECIFIC_MODULE_DEFINITION, refined-module-def=Wdg, variants pre-compile  # Configuration of the Wdg (Watchdog driver) module.
    container WdgDemEventParameterRefs  # Container for the references to DemEventParameter elements which shall be invoked using the API Dem_ReportErrorStatus in case the corresponding error occurs. The EventId is taken from the referenced DemEventParameter's DemEventId value. | The standardized errors are provided in the container and can be extended by vendor-specific error references.
      choice reference WDG_E_DISABLE_REJECTED: set at pre-compile, destination=[DemEventParameter, DemEventParameter]  # Reference to the DemEventParameter which shall be issued when the error "Initialization or mode switch failed because it would disable the watchdog" has occurred.
      choice reference WDG_E_MODE_FAILED: set at pre-compile, destination=[DemEventParameter, DemEventParameter]  # Reference to the DemEventParameter which shall be issued when the error "Setting a watchdog mode failed (during initialization or mode switch)" has occurred.
    container WdgGeneral  # All general parameters of the watchdog driver are collected here.
      boolean WdgDevErrorDetect: set at pre-compile  # Compile switch to enable / disable development error detection for this module. | True: Development error detection enabled False: Development error detection disabled
      boolean WdgDisableAllowed: set at pre-compile  # Compile switch to allow / forbid disabling the watchdog driver during runtime. | True: Disabling the watchdog driver at runtime is allowed. False: Disabling the watchdog driver at runtime is not allowed.
      integer WdgIndex: 0..255, set at pre-compile, symbolic-name-value=true  # Represents the watchdog driver's ID so that it can be referenced by the watchdog interface.
      float WdgInitialTimeout: 0..65.535, set at pre-compile  # The initial timeout (sec) for the trigger condition to be initialized during Init function. It shall be not larger than WdgMaxTimeout.
      float WdgMaxTimeout: 0..65.535, set at pre-compile  # The maximum timeout (sec) to which the watchdog trigger condition can be initialized.
      enumeration WdgRunArea: {RAM, ROM}, set at pre-compile  # Not used. Represents the watchdog driver execution area is either from ROM(Flash) or RAM as required with the particular microcontroller.
      function name WdgTriggerLocation: set at pre-compile  # Location (memory address) of the watchdog trigger routine.
      boolean WdgVersionInfoApi: set at pre-compile  # Compile switch to enable / disable the version information API | * True: API enabled * False: API disabled
      boolean WdgInitGoToNormalState: set at pre-compile, origin=Vector Informatik, default-value=false  # This parameter decides whether NORMAL state is requested during initialization routine. TRUE: Transition to NORMAL state is requested during initialization routine. FALSE: Transition to NORMAL state is not requested during initialization routine.
      boolean WdgDioTrigger: set at pre-compile, origin=Vector Informatik, default-value=false  # This parameter determines whether triggering of the TLF35584 window watchdog is performed via pin WDI or SPI. TRUE: Triggering of window watchdog is done via IO-Pin WDI (Dio used) FALSE: Triggering of window watchdog is performed via SPI.
      string WdgUserConfigFile [0..1]: set at pre-compile, origin=Vector Informatik  # Reference to an external text file that will be included during generation to Wdg_30_TLF35584_Cfg.h. The content of the user configuration file will be added at the end of the generated module configuration file and allows altering or extending the generated code. Caution: User configuration files can cause the software module to malfunction and must only be used with great care!
    container WdgPublishedInformation  # Container holding all Wdg specific published information parameters
      enumeration WdgTriggerMode: {WDG_BOTH, WDG_TOGGLE, WDG_WINDOW}, set at published-information, default-value=WDG_WINDOW  # Watchdog trigger mode (toggle/window/both)
    container WdgSettingsConfig: multiple-configuration-container=true  # Configuration items for the different watchdog settings, including those for external watchdog hardware. | Note: All postbuild parameters are handled via this container.
      enumeration WdgDefaultMode: {WDGIF_FAST_MODE, WDGIF_OFF_MODE, WDGIF_SLOW_MODE}, set at pre-compile  # Default mode for watchdog driver initialization. | ImplementationType: WdgIf_ModeType
      integer WdgErrorTreshold: 0..15, set at pre-compile, origin=Vector Informatik, default-value=9  # Number of WWD errors to generate CPU reset and enter into INIT state.
      boolean WdgInitEnableErrPinMonitor: set at pre-compile, origin=Vector Informatik, default-value=true  # Value that is set for field ERREN in register SYSPCFG1 during initialization. FALSE: ERR pin monitor is disabled. TRUE: ERR pin monitor is enabled.
      container WdgExternalConfiguration [0..1]  # Configuration items for an external watchdog hardware
        choice reference WdgExternalContainerRef [0..1]: set at pre-compile, destination=[DioChannelGroup, SpiSequence]  # Reference to either a DioChannelGroup or an SpiSequence. | - a DioChannelGroup container in case the hardware watchdog is connected via DIO pins - an SpiSequenceConfiguration container in case the watchdog hardware is accessed via SPI
        choice reference WdgDioWdiRef [0..1]: set at pre-compile, origin=Vector Informatik, destination=[DioChannel, DioChannel]  # Reference to DioChannel connected to Pin WDI.
        choice reference WdgSpiSequenceRef: set at pre-compile, origin=Vector Informatik, destination=[SpiSequence, SpiSequence]  # Reference to the Spi Referene that is used to access the TLF35584.
        choice reference WdgSpiChannelRef: set at pre-compile, destination=[SpiChannel, SpiChannel]  # Reference to the Spi Channel that is used to access the TLF35584.
      container WdgSettingsFast  # Hardware dependent settings for the watchdog driver's "fast" mode.
        integer WdgFastClosedWindow: 0..31, set at pre-compile, origin=Vector Informatik, default-value=9  # Closed window period of Window Watchdog (WWD) defined as a multiple of 50 watchdog cycles. 0 = 50 watchdog cycles 1 = 100 watchdog cycles 2 = 150 watchdog cycles ... 31 = 1600 wd cycles
        integer WdgFastOpenWindow: 0..31, set at pre-compile, origin=Vector Informatik, default-value=11  # Open window period of Window Watchdog (WWD) defined as a multiple of 50 watchdog cycles. 0 = 50 watchdog cycles 1 = 100 watchdog cycles 2 = 150 watchdog cycles ... 31 = 1600 wd cycles
        enumeration WdgFastCycleTime: {CycleTime_1000us, CycleTime_100us}, set at pre-compile, origin=Vector Informatik, default-value=CycleTime_1000us
      container WdgSettingsOff  # Hardware dependent settings for the watchdog driver's "off" mode.
      container WdgSettingsSlow  # Hardware dependent settings for the watchdog driver's "slow" mode.
        integer WdgSlowOpenWindow: 0..31, set at pre-compile, origin=Vector Informatik, default-value=11  # Open window period of Window Watchdog (WWD) defined as a multiple of 50 watchdog cycles. 0 = 50 watchdog cycles 1 = 100 watchdog cycles 2 = 150 watchdog cycles ... 31 = 1600 wd cycles
        integer WdgSlowClosedWindow: 0..31, set at pre-compile, origin=Vector Informatik, default-value=9  # Closed window period of Window Watchdog (WWD) defined as a multiple of 50 watchdog cycles. 0 = 50 watchdog cycles 1 = 100 watchdog cycles 2 = 150 watchdog cycles ... 31 = 1600 wd cycles
        enumeration WdgSlowCycleTime: {CycleTime_1000us, CycleTime_100us}, set at pre-compile, origin=Vector Informatik, default-value=CycleTime_1000us
      container WdgGptChannelParameterRef  # Container that hold references to GptChannels.
        float WdgTriggerTimerFreq: 0.., set at pre-compile  # Frequency of gpt channel reference WdgTriggerTimer in Hz
        integer WdgTickValueMax: 1..18446744073709551615, set at pre-compile  # Maximum value in ticks, the timer channel is able to count. With the next tick, the timer rolls over to zero.
        choice reference WdgTriggerTimer: set at pre-compile, origin=Vector Informatik, destination=[GptChannelConfiguration, GptChannelConfiguration]  # Reference to GptChannel that is used to time watchdog triggering.
      container WdgInit [0..1]  # Configuration items to configure module initialization.
        boolean WdgInitVREFEN: set at pre-compile, origin=Vector Informatik, default-value=false  # This parameter decides whether VREF will be enabled when NORMAL mode is entered during initialization. TRUE: VREF will be enabled when NORMAL mode is entered. FALSE: VREF will be disabled when NORMAL mode is entered.
        boolean WdgInitCOMEN: set at pre-compile, origin=Vector Informatik, default-value=false  # This parameter decides whether COM LDO will be enabled when NORMAL mode is entered during initialization. TRUE: COM LDO will be enabled when NORMAL mode is entered. FALSE: COM LDO will be disabled when NORMAL mode is entered.
        boolean WdgInitTRK1EN: set at pre-compile, origin=Vector Informatik, default-value=false  # This parameter decides whether TR1 will be enabled when NORMAL mode is entered during initialization. TRUE: TR1 will be enabled when NORMAL state is entered. FALSE: TR1 will be disabled when NORMAL state is entered.
        boolean WdgInitTRK2EN: set at pre-compile, origin=Vector Informatik, default-value=false  # This parameter decides whether TR2 will be enabled when NORMAL mode is entered during initialization. TRUE: TR2 will be enabled when NORMAL mode is entered. FALSE: TR2 will be disabled when NORMAL mode is entered.
    container WdgAsr3Compatibility [0..1]  # Container to configure ASR3 compatibility
      float WdgTriggerTimeout: 0..65.535, set at pre-compile, origin=Vector Informatik  # The timeout (sec) for the trigger condition to be set everytime when Wdg_Trigger is called.
  bsw implementation Wdg_Impl: programming-language=C, sw-version=1.02.02, used-code-generator=DaVinci Configurator, vendor-id=30, ar-release-version=04.00.03, behavior=WdgBehavior, preconfigured-configuration=Wdg_Pre, recommended-configuration=Wdg_Rec, vendor-api-infix=TLF35584, vendor-specific-module-def=Wdg
  module config Wdg_Pre: definition=Wdg
  module config Wdg_Rec: definition=Wdg
