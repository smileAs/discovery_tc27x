AUTOSAR XML (schema 4-1-1)
package /MICROSAR/Eth_Tricore
  module definition Eth [0..*]: category=VENDOR_SPECIFIC_MODULE_DEFINITION, refined-module-def=Eth, variants pre-compile  # Ethernet Controller Driver | Configuration of the Eth (Ethernet driver) module.
    container EthGeneral  # General configuration of Ethernet Driver module
      boolean EthDevErrorDetect: set at pre-compile, default-value=true  # Dev Error Detect | This parameter switches the Development Error Detection and Notification ON or OFF. true: Development error detection is enabled. false: Development error detection is disabled. Note: In general, the development error detection is recommended during pre-test phase. It is not recommended to enable the development error detection in production code due to increased runtime and ROM needs.
      boolean EthVersionInfoApi: set at pre-compile, default-value=false  # Version Info API | This parameter enables/disables the function Eth_GetVersionInfo() to get major, minor and patch version information.
      boolean EthVersionInfoApiMacro [0..1]: set at pre-compile, default-value=false  # Version Info API Macro | Parameter not used. This parameter defines if Eth_GetVersionInfo() is implemented as a macro.
      string EthUserConfigFile [0..1]: set at pre-compile, origin=Vector Informatik  # User Config File | Reference to an external text file that will be included during generation to Eth_Cfg.h. The content of the user configuration file will be added at the end of the generated module configuration file and allows altering or extending the generated code. Caution: User configuration files can cause the software module to malfunction and must only be used with great care!
      boolean EthEnableMibCounter: set at pre-compile, origin=Vector Informatik, default-value=true  # Enable Mib Counter | This parameter defines if the MIB (Management information base) counter support is enabled.
      boolean EthEnableRxInterrupt: set at pre-compile, origin=Vector Informatik, default-value=true  # Enable Rx Interrupt | This parameter defines if the receive interrupt is used. Restrictions: 'EthEnableRxInterrupt' and 'EthIfEnableRxInterrupt' must be set to the same value.
      boolean EthEnableTxInterrupt: set at pre-compile, origin=Vector Informatik, default-value=true  # Enable Tx Interrupt | This parameter defines if the transmit interrupt is used. Restrictions: 'EthEnableTxInterrupt' and 'EthIfEnableTxInterrupt' must be set to the same value.
      integer EthIndex: 0..255, set at pre-compile, default-value=0  # Specifies the InstanceId of this module instance. If only one instance is present it shall have the Id 0.
      integer EthMaxCtrlsSupported: 1..255, set at pre-compile, default-value=1  # This value specifies the maximum number of controller configurations per driver.
      boolean EthUpdatePhysAddrFilter: set at pre-compile, default-value=false  # Enables/Disables optional API Eth_UpdatePhysAddrFilter.
      boolean EthEnableExplicitBufferMapping: set at pre-compile, origin=Vector Informatik, default-value=false  # This parameter defines if RX and TX Ethernet buffers of different controllers and descriptor queues can be mapped to different memory locations. The final mapping is done via AUTOSAR Memory Map, whereas the user must implement the buffer specific memory sections within the memory map by himself.
      enumeration EthOsIsrCategory: {CATEGORY_1, CATEGORY_2, NO_OS_SUPPORT}, set at pre-compile, origin=Vector Informatik, default-value=CATEGORY_2  # This parameter specifies how the interrupt routines will be handled. If CATEGORY_1 or CATEGORY_2 is selected the Os will handle the interrupts according to the seleted category. For interrupt handling without support from Os the value NO_OS_SUPPORT must be selected.
      boolean EthRuntimeMeasurementSupport: set at pre-compile, origin=Vector Informatik, default-value=false  # If enabled runtime measurement points are added to the BSW module code and are added to the module configuration of MICROSAR RTM. The available measurement points can be seen and configured in the RTM module configuration. Availability of the MICROSAR RTM module is a prerequisite to make use of the runtime measurement functionality. Runtime measurement should be disabled in production code as measurement points may inflict additional runtime.
      boolean EthUsePeripheralAccessApi: set at pre-compile, origin=Vector Informatik, default-value=false  # Use Peripheral Access Api | This parameter defines if the Peripheral Access APIs are used for accessing protected registers related to the Ethernet driver. Depending on the derivative some Ethernet driver related register may be only accessibly in a Privileged Mode. If the Ethernet driver is not running in a necessary Privileged Mode then the OS has to support the register access by Peripheral Access APIs.
      integer EthZeroCopyBufferStartOffset [0..1]: 0.., set at pre-compile, origin=Vector Informatik, default-value=0  # Zero Copy Buffer Start Offset | Configure the buffer start offset for zero copy extension. This offset will be added to each buffer start. The additional space can be used for transmission on other bus systems. It will not be used for external provided buffers. Note: The size of the offset must be a multiple of the expected controller alignment size. Value 0 is allowed to disable the offset.
      integer EthMainfunctionPeriod: 1.., set at pre-compile, default-value=5  # This parameter specifies the period for the Mainfunction call of the Ethernet driver. The Mainfuction is used for processing descriptors, which could not be finished in interrupt context.
      string EthAdditionalIncludes [0..*]: set at pre-compile, origin=Vector Informatik  # Additional Includes | This parameter defines an additional file to be included in the Eth_Lcfg.h.
      enumeration EthRuntimeEnvironment: {ETH_AUTOSAR_OS, ETH_GREENHILLS_INTEGRITY}, set at pre-compile, origin=Vector Informatik, default-value=ETH_AUTOSAR_OS  # Runtime Environment | This parameter defines the runtime environment the Ethernet driver is executed on. ETH_AUTOSAR_OS: The driver is executed in a common AUTOSAR OS environment. ETH_GREENHILLS_INTEGRITY: The driver is executed in a Greenhills INTEGRITY OS environment.
      boolean EthSafeBswChecks: set at pre-compile, origin=Vector Informatik, default-value=false  # Selects if safety checks are used. These checks improve robustness as e.g. invalid parameters are checked before function is executed. This attribute has to be enabled for safety projects where this component is mapped to an ASIL partition.
    container EthConfigSet  # This container includes containers and parameters that may be part of a multiple configuration set.
      container EthCtrlConfig [1..*]  # This container includes the configuration of the individual controller.
        boolean EthCtrlEnableMii: set at pre-compile, default-value=true  # Enable MII | This parameter defines if the Media Independent Interface (MII) for transceiver access is enabled. Restrictions: Must be enabled for transceiver usage.
        boolean EthCtrlEnableRxInterrupt: set at pre-compile, default-value=true  # Enable Rx Interrupt | This parameter defines if the receive interrupt for the controller is enabled. Restrictions: 'EthCtrlEnableRxInterrupt' must be equal for all controllers and equal to 'EthEnableRxInterrupt'
        boolean EthCtrlEnableTxInterrupt: set at pre-compile, default-value=true  # Enable Tx Interrupt | This parameter defines if the transmit interrupt for the controller is enabled. Restrictions: 'EthCtrlEnableTxInterrupt' must be equal for all controllers and equal to 'EthEnableTxInterrupt'
        integer EthCtrlIdx: 0..255, set at pre-compile, symbolic-name-value=true, default-value=0  # Controller Index | This value specifies the instance ID of the configured controller.
        integer EthCtrlRxBufLenByte: 64..1522, set at pre-compile, default-value=1522  # Rx Buffer Length | This value specifies the maximum receive buffer length (frame length). Restrictions: Value has to be the maximum value of all 'EthCtrlRxBufLenByte' in 'EthRxBufConfig' containers.
        integer EthCtrlTxBufLenByte: 64..1522, set at pre-compile, default-value=1522  # Tx Buffer Length | This value specifies the maximum transmit buffer length (frame length). Resctrictions: Value has to be the maximum value of all 'EthCtrlTxBufLenByte' in 'EthTxBufConfig' containers.
        integer EthRxBufTotal: 0..255, set at pre-compile, default-value=2  # Rx Buffer Count | This value specifies the number of receive buffers. Resctrictions: Value has to be the sum of all values of 'EthRxBufTotal' in container 'EthRxBufConfig'.
        integer EthTxBufTotal: 0..255, set at pre-compile, default-value=2  # Tx Buffer Count | This value specifies the number of transmit buffers. Restrictions: Value has to be the sum of all values of 'EthTxBufTotal' in container 'EthTxBufConfig'.
        string EthCtrlPhysAddr [0..1]: set at pre-compile  # Physical Address (MAC-Address) | This parameter defines the Controller Physical Hardware Address (MAC-Address). The input format has to match xx:xx:xx:xx:xx:xx, where x stands for a hex value between 0 and F.
        boolean EthCtrlEnableMacWriteAccess: set at pre-compile, origin=Vector Informatik, default-value=false  # Enable MAC-Address Write Access | This parameter defines if access to an NvM block containing the MAC address and the corresponding API is enabled.
        integer EthMmcMemBaseAddress: 0..4294967295, set at pre-compile, origin=Vector Informatik, default-value=4026654976  # This parameter specifies the controllers MAC Management Counters (MMC) start address.
        integer EthMmcMemLastAddress: 0..4294967295, set at pre-compile, origin=Vector Informatik, default-value=4026655484  # This parameter specifies the controllers MAC Management Counters (MMC) end address.
        boolean EthCtrlEnablePtp: set at pre-compile, origin=Vector Informatik, default-value=false  # This parameter defines if Precision-Time-Protocol support is enabled or not. PTP is mostly used in combination with Audio Video Bridging (AVB)
        boolean EthCtrlEnableOsfMode: set at pre-compile, default-value=true  # This parameter defines whether OSF mode is used for frame transmission. When OSF mode is enabled, the processing of a second Tx-descriptor is started before the first one is transmitted completely. This results in increased throughput in transmission.
        enumeration EthCtrlMiiInterface: {ETH_MII_MODE, ETH_RMII_MODE}, set at pre-compile, origin=Vector Informatik, default-value=MII  # PHY Managment Interface | This parameter defines the management interface type used to connect PHY and MAC. Please refere to the derivative's reference manual and the board schematic to retrieve the correct management interface type.
        boolean EthCtrlPreControllerInitCallout: set at pre-compile, origin=Vector Informatik, default-value=false  # Pre Controller Init Callout | This parameter defines if a callout is generated, which can be used to add special startup handling before Eth_ControllerInit is execeuted.
        boolean EthCtrlPostControllerInitCallout: set at pre-compile, origin=Vector Informatik, default-value=false  # Post Controller Init Callout | This parameter defines if a callout is generated, which can be used to add special startup handling after Eth_ControllerInit is execeuted.
        function name EthCtrlPeripheralRegionOsIdentifier [0..1]: set at pre-compile, origin=Vector Informatik  # Peripheral Region Os Identifier | Unique C Identifier which is used by the Ethernet Controller driver for accessing the OS configured peripheral region.
        boolean EthCtrlEnableRxBufferSegmentation: set at pre-compile, origin=Vector Informatik, default-value=false  # This parameter defines whether Rx Buffer Segmentation is enabled, This allows splitting frames into several buffers / descriptors for more efficient memory usage.
        integer EthCtrlResetLoopMaxCycles: 1..1000000, set at pre-compile, origin=Vector Informatik, default-value=1000  # Controller Reset Loop Cycles | This value specifies the number of loop cycles after the controller reset timeout occurs.
        integer EthCtrlLoopMaxCycles: 1..1000000, set at pre-compile, origin=Vector Informatik, default-value=1000  # Controller Loop Cycles | This value specifies the number of loop cycles after hardware dependent loop timeouts occur.
        integer EthCtrlMiiLoopMaxCycles: 1..1000000, set at pre-compile, origin=Vector Informatik, default-value=1000  # Controller MII Loop Cycles | This value specifies the number of loop cycles after the timeout for MII accesses occurs.
        reference EthCtrlNvmBlockDescriptor [0..1]: set at pre-compile, origin=Vector Informatik, destination=NvMBlockDescriptor  # NvM Block Descriptor | Reference to an NvM block descriptor which is used to store the MAC address that is used as Ethernet source address.
        reference EthPtpRefClock [0..1]: set at pre-compile, origin=Vector Informatik, destination=McuClockReferencePoint  # Ctrl Ptp Ref Clock | This value specifies the frequency of the PTP reference clock.
        container EthTxBufConfig [1..*]  # This container includes configuration of a Tx buffer.
          integer EthCtrlTxBufLenByte: 64..1522, set at pre-compile, origin=Vector Informatik, default-value=1518  # Maximum Tx Buffer Size | This value limits the maximum length (including Ethernet header + payload + CRC) of the Ethernet frame in bytes. In case VLAN is enabled the Ethernet header length is 18, otherwise 14. The maximum payload length is 1500 bytes and the minimum length is 46 bytes. The CRC consists of 4 bytes. Example: - Configuring a buffer that shall hold a VLAN tagged Ethernet frame with a maximum payload of 1500 bytes, the overall frame length is 1500 bytes payload + 18 bytes header + 4 bytes CRC = 1522 bytes. - Configuring a buffer that shall hold an Ethernet frame without VLAN tag and a minimum payload of 46 bytes, the overall frame length is 46 bytes payload + 14 bytes header + 4 bytes CRC = 64 bytes.
          integer EthTxBufTotal: 2..255, set at pre-compile, origin=Vector Informatik, default-value=2  # Number of Tx Buffers | This value specifies the number of transmit buffers.
        container EthDemEventParameterRefs [0..1]  # This container includes the references to DemEventParameter elements which shall be invoked using the API Dem_ReportErrorStatus API in case the corresponding error occurs. The EventId is taken from the referenced DemEventParameter's DemEventId value.
          symbolic name reference ETH_E_ACCESS [0..1]: set at pre-compile, origin=Vector Informatik, destination=DemEventParameter  # Reference to the DemEventParameter which shall be issued when the error ETH_E_ACCESS has occurred.
        container EthRxBufConfig [1..*]  # This container includes the configuration of an Rx buffer.
          integer EthRxSegmentNumber: 2..65535, set at pre-compile, origin=Vector Informatik, default-value=2  # Number of Rx Segments | This value defines the number of Rx segments the receiver buffer is assembled of.
          integer EthRxSegmentSize: 60..1522, set at pre-compile, origin=Vector Informatik, default-value=1518  # Rx Buffer Segment Size | This parameter defines the size of a segment the receive buffer is built of. Multiple of these segments are used to hold a complete Ethernet frame.
          integer EthRxMaxFrameSize: 60..1522, set at pre-compile, origin=Vector Informatik, default-value=1518  # Maximum Rx Frame Size | This parameter defines the maximum length of an Ethernet frame, which is allowed to be received.
        container EthCtrlOffloading  # This container includes the configuration for checksum offloading.
          boolean EthCtrlEnableOffloadChecksumIPv4: set at pre-compile, default-value=false  # This parameter defines that the IPv4 checksum calculation is offloaded to the ethernet controller and calculated by hardware.
          boolean EthCtrlEnableOffloadChecksumICMP: set at pre-compile, default-value=false  # This parameter defines that the ICMP checksum calculation is offloaded to the ethernet controller and calculated by hardware.
          boolean EthCtrlEnableOffloadChecksumTCP: set at pre-compile, default-value=false  # This parameter defines that the checksum calculation for IPv4 encapsulated TCP segments is offloaded to the ethernet controller and calculated by hardware.
          boolean EthCtrlEnableOffloadChecksumUDP: set at pre-compile, default-value=false  # This parameter defines that the checksum calculation for IPv4 encapsulated UDP is offloaded to the ethernet controller and calculated by hardware.
          boolean EthCtrlEnableOffloadChecksumTCPv6: set at pre-compile, origin=Vector Informatik, default-value=false  # Ctrl Enable Offload Checksum IPv6 encapsulated TCP | This parameter defines that the checksum calculation for IPv6 encapsulated TCPis offloaded to the ethernet controller and calculated by hardware.
          boolean EthCtrlEnableOffloadChecksumICMPv6: set at pre-compile, origin=Vector Informatik, default-value=false  # Ctrl Enable Offload Checksum ICMPv6 | This parameter defines that the ICMPv6 checksum calculation is offloaded to the ethernet controller and calculated by hardware.
          boolean EthCtrlEnableOffloadChecksumIPv6HeaderRouting: set at pre-compile, origin=Vector Informatik, default-value=false  # This parameter defines that the checksum offloading for protocols encapsulated in IPv6 with Routing extension header is enabled.
          boolean EthCtrlEnableOffloadChecksumIPv6HeaderDestinationOptions: set at pre-compile, origin=Vector Informatik, default-value=false  # This parameter defines that the checksum offloading for protocols encapsulated in IPv6 with Destination Options extension header is enabled.
          boolean EthCtrlEnableOffloadChecksumIPv6HeaderHopByHopOptions: set at pre-compile, origin=Vector Informatik, default-value=false  # This parameter defines that the checksum offloading for protocols encapsulated in IPv6 with Hop by Hop Options extension header is enabled.
          boolean EthCtrlEnableOffloadChecksumUDPv6: set at pre-compile, origin=Vector Informatik, default-value=false  # Ctrl Enable Offload Checksum IPv6 encapsulated UDP | This parameter defines that the checksum calculation for IPv6 encapsulated UDP is offloaded to the ethernet controller and calculated by hardware.
        container EthCtrlPinRouting  # This container contains parameter for pin routing, which is done by ETH_GPCTL register.
          enumeration Eth_GPCTL_ALT0: {ETH_ALT_0, ETH_ALT_1, ETH_ALT_2, ETH_ALT_3}, set at pre-compile, origin=Vector Informatik, default-value=ETH_ALT_1  # This parameter defines the value of ALT0 of the ETH_GPCTL register.
          enumeration Eth_GPCTL_ALT{1..10}: {ETH_ALT_0, ETH_ALT_1, ETH_ALT_2, ETH_ALT_3}, set at pre-compile, origin=Vector Informatik, default-value=ETH_ALT_0  # This parameter defines the value of ALT{1..10} of the ETH_GPCTL register.
        choice container EthRuntimeEnvironment
          container EthAutosarOs [0..1]
            integer EthRegBaseAddress: 0..18446744073709551615, set at pre-compile, origin=Vector Informatik, default-value=0  # Register Base Address | This parameter defines the register base address for the Ethernet controller used.
          container EthGreenhillsIntegrityOs [0..1]
            linker symbol EthRegMemRegionIdentifier: set at pre-compile, origin=Vector Informatik, default-value=EthRegisterMemRegion, max-length=254, min-length=1  # Register Memory Region Identifier | This parameter defines the identifier used to identify the phyiscal Memory Region representing the Ethernet controllers register space.
            linker symbol EthDeviceIdentifier: set at pre-compile, origin=Vector Informatik, default-value=EthIODevice, max-length=254, min-length=1  # Device Identifier | This parameter defines the identifier used to identify the IO Device object representing the Ethernet controller within INTEGRITY.
            linker symbol EthResManagerPassword: set at pre-compile, origin=Vector Informatik, default-value=NULL, max-length=254, min-length=1  # Resource Manager Password | This paramter defines the password used to grant access to the Resource Manager of INTEGRITY. This password is used within calls to the INTEGRITY Resource Manager (e.g. RequestResource()) to retrieve the needed OS objects for IO Device, register memory region and so on. If no password is used by the Resource Manager NULL must be provided as value to signal the omit of the password check.
            linker symbol EthRegMemRegionPool: set at pre-compile, origin=Vector Informatik, default-value=__ghs_VirtualMemoryRegionPool, min-length=1  # Register Memory Region Pool | This parameter defines the Memory Region Pool where the virtual Memory Region to map the registers into the virtual address space is drawn from.
            integer EthEventPriority: 0..65535, set at pre-compile, origin=Vector Informatik, default-value=0  # Event Priority | This parameter defines the prioirty of the event issued to user space to handle interrupt events issued by the Ethernet controller.
            linker symbol EthAsrOsWrapperIsrNo: set at pre-compile, origin=Vector Informatik, default-value=EthIsr_0, min-length=1  # AUTOSAR OS Wrapper ISR Number | This parameter defines the define generated by the INTEGRITY AUTOSAR OS wrapper for the ISR number related to the Ethernet controller.
  bsw implementation Eth_Impl: programming-language=C, sw-version=2.05.03, used-code-generator=DaVinci Configurator, vendor-id=30, ar-release-version=4.01.01, behavior=EthBehavior, preconfigured-configuration=Eth_Pre, recommended-configuration=Eth_Rec, vendor-api-infix=Tricore, vendor-specific-module-def=Eth
  module config Eth_Pre: definition=Eth
  module config Eth_Rec: definition=Eth
