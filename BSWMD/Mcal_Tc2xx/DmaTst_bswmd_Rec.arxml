AUTOSAR XML (schema 4-0-3)
package /AURIX
  module config DmaTst_Rec: definition=DmaTst
  bsw implementation DmaTst_Impl: programming-language=C, recommended-configuration=DmaTst_Rec, vendor-specific-module-def=DmaTst
