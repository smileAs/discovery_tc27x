AUTOSAR XML (schema 4-0-3)
package /AURIX
  module config Icu_Rec: definition=Icu
  bsw implementation Icu_Impl: programming-language=C, vendor-id=17, behavior=IcuBehavior, recommended-configuration=Icu_Rec, vendor-api-infix=GtmCcu6, vendor-specific-module-def=Icu
