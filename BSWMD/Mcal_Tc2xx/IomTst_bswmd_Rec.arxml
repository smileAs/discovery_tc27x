AUTOSAR XML (schema 4-0-3)
package /AURIX
  module config IomTst_Rec: definition=IomTst
  bsw implementation IomTst_Impl: programming-language=C, recommended-configuration=IomTst_Rec, vendor-specific-module-def=IomTst
