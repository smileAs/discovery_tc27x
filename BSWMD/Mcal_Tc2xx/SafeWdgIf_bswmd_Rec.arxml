AUTOSAR XML (schema 4-0-3)
package /AURIX
  module config SafeWdgIf_Rec: definition=SafeWdgIf
  bsw implementation SafeWdgIf_Impl: programming-language=C, recommended-configuration=SafeWdgIf_Rec, vendor-specific-module-def=SafeWdgIf
