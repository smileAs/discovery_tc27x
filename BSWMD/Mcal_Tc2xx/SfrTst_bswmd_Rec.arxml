AUTOSAR XML (schema 4-0-3)
package /AURIX
  module config SfrTst_Rec: definition=SfrTst
  bsw implementation SfrTst_Impl: programming-language=C, recommended-configuration=SfrTst_Rec, vendor-specific-module-def=SfrTst
