AUTOSAR XML (schema 4-0-3)
package /AURIX
  module config SramEccTst_Rec: definition=SramEccTst
  bsw implementation SramEccTst_Impl: programming-language=C, recommended-configuration=SramEccTst_Rec, vendor-specific-module-def=SramEccTst
