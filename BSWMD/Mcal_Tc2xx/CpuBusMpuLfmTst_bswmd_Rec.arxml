AUTOSAR XML (schema 4-0-3)
package /AURIX
  module config CpuBusMpuLfmTst_Rec: definition=CpuBusMpuLfmTst
  bsw implementation CpuBusMpuLfmTst_Impl: programming-language=C, recommended-configuration=CpuBusMpuLfmTst_Rec, vendor-specific-module-def=CpuBusMpuLfmTst
