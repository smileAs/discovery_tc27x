AUTOSAR XML (schema 4-0-3)
package /AURIX
  module config SafeWdgAscLin_Rec: definition=SafeWdgAscLin
  bsw implementation SafeWdgAscLin_Impl: programming-language=C, recommended-configuration=SafeWdgAscLin_Rec, vendor-specific-module-def=SafeWdgAscLin
