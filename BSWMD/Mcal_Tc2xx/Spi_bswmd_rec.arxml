AUTOSAR XML (schema 4-0-3)
package /AURIX
  module config Spi_Rec: definition=Spi
  bsw implementation Spi_Impl: programming-language=C, behavior=SpiBehavior, recommended-configuration=Spi_Rec, vendor-specific-module-def=Spi
