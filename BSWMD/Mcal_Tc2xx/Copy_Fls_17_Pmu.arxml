AUTOSAR XML (schema 4-0-3)
package /AURIX
  module definition Fls [0..*]: refined-module-def=Fls, variants post-build-loadable/post-build-selectable  # Configuration of the Fls (internal or external flash driver) module.
    container FlsConfigSet: multiple-configuration-container=true  # Container for runtime configuration parameters of the flash driver. Implementation Type: Fls_ConfigType.
      integer FlsProtection [0..1]: 0..4294967295, set at post-build, default-value=0  # This parameter is NOT SUPPORTED as there are no separate erase/write protection settings for the DFlash
      float FlsCallCycle: 1.0E-4..1.0, set at post-build, default-value=0.01  # Cycle time of calls of the flash driver main function in seconds .
      enumeration FlsDefaultMode: {MEMIF_MODE_FAST, MEMIF_MODE_SLOW}, set at post-build, default-value=MEMIF_MODE_FAST  # This parameter is the default FLS device mode after initialization.
      integer FlsMaxWriteNormalMode: 32..32, set at post-build, default-value=32  # The maximum number of bytes to write in one cycle of the flash driver job processing routine. Each write operation programs 32 bytes. Any value greater than 32 would cause the main function to remain in a loop to detect the completion of programming of the previous page.
      integer FlsMaxWriteFastMode: 32..32, set at post-build, default-value=32  # The maximum number of bytes to write in one cycle of the flash driver job processing routine. Each write operation programs 32 bytes. This parameter is NOT supported as Aurix does not support any MODES.
      integer FlsMaxReadNormalMode: 1..196608, set at post-build, default-value=32  # The maximum number of bytes to read in one cycle of the flash driver job processing routine
      integer FlsMaxReadFastMode: 1..196608, set at post-build, default-value=64  # The maximum number of bytes to read in one cycle of the flash driver job processing routine.
      integer FlsAcErase: 0..4294967295, set at post-build, default-value=1880101320  # FlsAcLoadOnJobStart = ON : This parameter specifies the RAM address to which the Erase command cycles will be copied and executed. Note: The user should reserve this address space in the linker (.lsl) file. Refer User Manual FlsAcLoadOnJobStart = OFF : The user entry is disabled and the location of Write command cycles in PFLASH is used
      integer FlsAcWrite: 0..4294967295, set at post-build, default-value=1880101120  # FlsAcLoadOnJobStart = ON : This parameter specifies the RAM address to which the Write command cycles will be copied and executed. Note: The user should reserve this address space in the linker (.lsl) file. Refer User Manual FlsAcLoadOnJobStart = OFF : The user entry is disabled and the location of Write command cycles in PFLASH is used
      function name FlsJobEndNotification [0..1]: set at post-build, default-value=NULL_PTR  # User defined Notification Function Pointer of type void <fn_name> (void). This notification function will be called by the FLS Driver on successful completion of the job
      function name FlsJobErrorNotification [0..1]: set at post-build, default-value=NULL_PTR  # User defined Notification Function Pointer of type void <fn_name> (void). This notification function will be called by the FLS Driver on cancellation of the job or a failure in executing the job
      enumeration FlsWaitStateRead: {FLS_WAIT_STATE_READACCESS1, FLS_WAIT_STATE_READACCESS2, FLS_WAIT_STATE_READACCESS3, FLS_WAIT_STATE_READACCESS4, FLS_WAIT_STATE_READACCESS5, FLS_WAIT_STATE_READACCESS6, FLS_WAIT_STATE_READACCESS7, FLS_WAIT_STATE_READACCESS8, FLS_WAIT_STATE_READACCESS9, FLS_WAIT_STATE_READACCESS10, FLS_WAIT_STATE_READACCESS11, FLS_WAIT_STATE_READACCESS12, FLS_WAIT_STATE_READACCESS13, FLS_WAIT_STATE_READACCESS14, FLS_WAIT_STATE_READACCESS15, FLS_WAIT_STATE_READACCESS16, FLS_WAIT_STATE_READACCESS17, FLS_WAIT_STATE_READACCESS18, FLS_WAIT_STATE_READACCESS19, FLS_WAIT_STATE_READACCESS20, FLS_WAIT_STATE_READACCESS21, FLS_WAIT_STATE_READACCESS22, FLS_WAIT_STATE_READACCESS23, FLS_WAIT_STATE_READACCESS24, FLS_WAIT_STATE_READACCESS25, FLS_WAIT_STATE_READACCESS26, FLS_WAIT_STATE_READACCESS27, FLS_WAIT_STATE_READACCESS28, FLS_WAIT_STATE_READACCESS29, FLS_WAIT_STATE_READACCESS30, FLS_WAIT_STATE_READACCESS31, FLS_WAIT_STATE_READACCESS32, FLS_WAIT_STATE_READACCESS33, FLS_WAIT_STATE_READACCESS34, FLS_WAIT_STATE_READACCESS35, FLS_WAIT_STATE_READACCESS36, FLS_WAIT_STATE_READACCESS37, FLS_WAIT_STATE_READACCESS38, FLS_WAIT_STATE_READACCESS39, FLS_WAIT_STATE_READACCESS40, FLS_WAIT_STATE_READACCESS41, FLS_WAIT_STATE_READACCESS42, FLS_WAIT_STATE_READACCESS43, FLS_WAIT_STATE_READACCESS44, FLS_WAIT_STATE_READACCESS45, FLS_WAIT_STATE_READACCESS46, FLS_WAIT_STATE_READACCESS47, FLS_WAIT_STATE_READACCESS48, FLS_WAIT_STATE_READACCESS49, FLS_WAIT_STATE_READACCESS50, FLS_WAIT_STATE_READACCESS51, FLS_WAIT_STATE_READACCESS52, FLS_WAIT_STATE_READACCESS53, FLS_WAIT_STATE_READACCESS54, FLS_WAIT_STATE_READACCESS55, FLS_WAIT_STATE_READACCESS56, FLS_WAIT_STATE_READACCESS57, FLS_WAIT_STATE_READACCESS58, FLS_WAIT_STATE_READACCESS59, FLS_WAIT_STATE_READACCESS60, FLS_WAIT_STATE_READACCESS61, FLS_WAIT_STATE_READACCESS62, FLS_WAIT_STATE_READACCESS63}, set at post-build, origin=INFINEON_AURIX, default-value=FLS_WAIT_STATE_READACCESS9  # Defines Wait State Configuration for read access from DFLASH.
      enumeration FlsWaitStateErrorCorrection: {FLS_WAIT_STATE_ERRORCORRECTION0, FLS_WAIT_STATE_ERRORCORRECTION1, FLS_WAIT_STATE_ERRORCORRECTION2, FLS_WAIT_STATE_ERRORCORRECTION3, FLS_WAIT_STATE_ERRORCORRECTION4, FLS_WAIT_STATE_ERRORCORRECTION5, FLS_WAIT_STATE_ERRORCORRECTION6, FLS_WAIT_STATE_ERRORCORRECTION7}, set at post-build, origin=INFINEON_AURIX, default-value=FLS_WAIT_STATE_ERRORCORRECTION1  # Defines Wait State Configuration for error correction
      container FlsDemEventParameterRefs [0..1]  # Container for the references to DemEventParameter elements which shall be invoked using the API Dem_ReportErrorStatus API in case the corresponding error occurs. The EventId is taken from the referenced DemEventParameter's DemEventId value. The standardized errors are provided in the container and can be extended by vendor specific error references.
        symbolic name reference FLS_E_ERASE_FAILED [0..1]: set at pre-compile, destination=DemEventParameter  # Reference to configured DEM event to report FLS Erase fail error.
        symbolic name reference FLS_E_READ_FAILED [0..1]: set at pre-compile, destination=DemEventParameter  # Reference to configured DEM event to report FLS Read error.
        symbolic name reference FLS_E_WRITE_FAILED [0..1]: set at pre-compile, destination=DemEventParameter  # Reference to configured DEM event to report FLS Write error.
        symbolic name reference FLS_E_COMPARE_FAILED [0..1]: set at pre-compile, destination=DemEventParameter  # Reference to configured DEM event to report FLS Compare error.
        symbolic name reference FLS_E_UNEXPECTED_FLASH_ID [0..1]: set at pre-compile, destination=DemEventParameter  # Reference to configured DEM event to report when expected HW ID not matched. Disabled as External flash is not supported
      container FlsSectorList  # List of flashable sectors and pages.
        container FlsSector [1..*]  # Configuration description of a flashable sector
          integer FlsSectorStartaddress: 0..0, set at pre-compile, default-value=0  # Start address of the Fls Sector
          integer FlsSectorSize: 196608..196608, set at pre-compile, default-value=196608  # Size of the Fls Sector
          integer FlsPageSize: 8..8, set at pre-compile, default-value=8  # Size of the Fls Page
          integer FlsNumberOfSectors: 2..2, set at pre-compile, default-value=2  # Number of Fls Sectors
      container FlsExternalDriver [0..1]  # Container for the External Flash.
        symbolic name reference FlsSpiReference: set at pre-compile, destination=SpiSequence  # Reference to SPI sequence. This param is applicable only for External Flash hence disabled.
    container FlsGeneral  # Container for general parameters of the flash driver. These parameters are always pre-compile.
      boolean FlsDevErrorDetect: set at pre-compile, default-value=true  # Pre-processor switch for enabling the development error detection and Reporting.
      boolean FlsPBFixedAddress: set at pre-compile, origin=INFINEON_AURIX, default-value=false  # Pre-processor switch to enable using the configuration fixed at link time i.e. Fls_ConfigRoot[0]
      boolean FlsDebugSupport: set at pre-compile, origin=INFINEON_AURIX, default-value=false  # Pre-processor switch for enabling/disabling the debugging support.
      boolean FlsUseInterrupts: set at pre-compile, default-value=false  # Pre-processor switch for enabling the interrupts.
      integer FlsBaseAddress: 2936012800..2936012800, set at pre-compile, default-value=2936012800  # This parameter defines the lower boundary for read/write/erase jobs.
      integer FlsTotalSize: 16384..393216, set at pre-compile, default-value=393216  # This parameter is used to calculate the the upper boundary for read/write/erase jobs. This parameter should be updated accordingly for marking option with reduced DF_EEPROM size. FlsTotalSize should be: [1]Between 16kB and DF_EEPROM size [2]Multiple of 16kB
      boolean FlsAcLoadOnJobStart: set at pre-compile, default-value=false  # If this Macro is Enabled then, Erase access code will be loaded in RAM during Fls_Erase API call and unloaded after completion or cancellation of job. Similarly Write access code will be loaded in RAM during Fls_Write API call and unloaded after completion or cancellation of job. If this Macro is Disabled then, Write and Erase flash access code will be executed from Flash.
      boolean FlsVersionInfoApi: set at pre-compile, default-value=false  # Pre-processor switch to enable / disable the API to read out the modules version information. true: Version info API enabled. false: Version info API disabled.
      boolean FlsCancelApi: set at pre-compile, default-value=false  # This is used to enable/disable the Fls_Cancel API
      boolean FlsCompareApi: set at pre-compile, default-value=false  # Compile switch to enable and disable the Fls_Compare function. true: API supported / function provided. false: API not supported / function not provided / EL: This is used to enable/disable the Fls_Compare API
      boolean FlsSetModeApi: set at pre-compile, default-value=false  # Compile switch to enable and disable the Fls_SetMode function. true: API supported / function provided. false: API not supported / function not provided
      boolean FlsGetStatusApi: set at pre-compile, default-value=false  # Compile switch to enable and disable the Fls_GetStatus function. true: API supported / function provided. false: API not supported / function not provided
      boolean FlsGetJobResultApi: set at pre-compile, default-value=false  # Compile switch to enable and disable the Fls_GetJobResult function. true: API supported / function provided. false: API not supported / function not provided
      boolean FlsResetSfrAtInit: set at pre-compile, origin=INFINEON_AURIX, default-value=false  # Compile switch to enable and disable the Reset of SFR in Fls_17_Pmu_Init function. true: Feature to Reset SFR in Init enabled. false: Feature to Reset SFR in Init disabled.
      integer FlsDriverIndex: 0..254, set at pre-compile, symbolic-name-value=true, default-value=0  # This parameter is used to assign an index to the FlsDriver.
      boolean FlsRunningInUser0Mode: set at pre-compile, origin=INFINEON_AURIX, default-value=false  # If this parameter is set to FALSE, then Protected Mode(user mode) register access will not be done and API is run in Supervisor mode.
      boolean FlsUserModeInitApiEnable: set at pre-compile, origin=INFINEON_AURIX, default-value=false  # Pre-processor switch to enable / disable protected register access in all the Init API.
      boolean FlsUserModeRuntimeApiEnable: set at pre-compile, origin=INFINEON_AURIX, default-value=false  # Pre-processor switch to enable / disable protected register access in all the APIs other than Init/Deinit APIs.
    container FlsPublishedInformation  # Additional published parameters not covered by CommonPublishedInformation container. Note that these parameters do not have any configuration class setting, since they are published information.
      integer FlsAcSizeErase: 0..4294967295, set at published-information, default-value=200  # Number of bytes in RAM needed for the erase flash access code
      integer FlsAcSizeWrite: 0..4294967295, set at published-information, default-value=200  # Number of bytes in RAM needed for the Write flash access code
      float FlsEraseTime: 0.0..4.294967295E9, set at published-information, default-value=1000000  # Maximum time in Microseconds to erase one complete flash sector.
      integer FlsErasedValue: 0..0, set at published-information, default-value=0  # The contents of an erased flash memory cell.
      integer FlsSpecifiedEraseCycles: 0..4294967295, set at published-information, default-value=125000  # Number of erase cycles specified for the flash device (usually given in the device data sheet). FLS198: If the number of specified erase cycles depends on the operating environment (temperature, voltage, ...) during reprogramming of the flash device, the minimum number for which a data retention of at least 15 years over the temperature range from -40C .. +125C can be guaranteed shall be given. Note: If there are different numbers of specified erase cycles for different flash sectors of the device this parameter has to be extended to a parameter list (similar to the sector list above).
      float FlsWriteTime: 0.0..4.294967295E9, set at published-information, default-value=150  # Maximum time in Microseconds to program one complete flash page.
      integer FlsAcLocationErase: 0..4294967295, set at published-information, default-value=0  # Location of the erase command cycles. This parameter is unused and instead FlsAcErase is used
      integer FlsAcLocationWrite: 0..4294967295, set at published-information, default-value=0  # Location of the write command cycles. This parameter is unused and instead FlsAcWrite is used
      string FlsExpectedHwId [0..1]: set at published-information, default-value=0  # Unique identifier ofthe hardware device that is expected by this driver (the device for which this driver has been implemented). Only relevant for external flash drivers
    container FlsIfxSpecificConfig  # This container is used to provide the Ifx specific parameters.
      string FlsStateVarStruct: set at post-build, origin=INFINEON_AURIX, default-value=FlsStateVar  # This parameter is used to provide the name of the structure containing the entire global variables specific to the Flash driver.
      boolean FlsUseEraseSuspend: set at pre-compile, origin=INFINEON_AURIX, default-value=false  # Compile switch to enable or disable the FLS erase suspend and erase resume feature
      integer FlsEraseSuspendTimeout: 0..65535, set at pre-compile, origin=INFINEON_AURIX, default-value=6000  # Timeout for Erase Suspend feature(loop count).
      function name FlsIllegalStateNotification: set at pre-compile, origin=INFINEON_AURIX, default-value=NULL_PTR  # This parameter is a pointer to a notification function, which is called when FLS reaches an Illegal state. Illegal state here means that FLS is not able to proceed. No more FLS request shall be triggered; Reset of the system is recommended.
    container CommonPublishedInformation  # Common container, aggregated by all modules. It contains published information about vendor and versions.
      integer ArMajorVersion: 0..65535, set at published-information, origin=INFINEON_AURIX, default-value=3  # Major version number of AUTOSAR specification on which the appropriate implementation is based on.
      integer ArMinorVersion: 0..65535, set at published-information, origin=INFINEON_AURIX, default-value=2  # Minor version number of AUTOSAR specification on which the appropriate implementation is based on.
      integer ArPatchVersion: 0..65535, set at published-information, origin=INFINEON_AURIX, default-value=0  # Patch level version number of AUTOSAR specification on which the appropriate implementation is based on.
      integer SwMajorVersion: 0..65535, set at published-information, origin=INFINEON_AURIX, default-value=2  # Major version number of the vendor specific implementation of the module. The numbering is vendor specific.
      integer SwMinorVersion: 0..65535, set at published-information, origin=INFINEON_AURIX, default-value=3  # Minor version number of the vendor specific implementation of the module. The numbering is vendor specific.
      integer SwPatchVersion: 0..65535, set at published-information, origin=INFINEON_AURIX, default-value=0  # Patch level version number of the vendor specific implementation of the module. The numbering is vendor specific.
      integer ModuleId: 0..65535, set at published-information, origin=INFINEON_AURIX, default-value=92  # Module ID of this module from Module List
      integer VendorId: 0..65535, set at published-information, origin=INFINEON_AURIX, default-value=17  # Vendor ID of the dedicated implementation of this module according to the AUTOSAR vendor list
      string VendorApiInfix: set at published-information, origin=INFINEON_AURIX, default-value=Pmu  # In driver modules which can be instantiated several times on a single ECU, BSW00347 requires that the name of APIs is extended by the VendorId and a vendor specific name. This parameter is used to specify the vendor specific name. In total, the implementation specific name is generated as follows: <ModuleName>_>VendorId>_<VendorApiInfix><Api name from SWS>. E.g. assuming that the VendorId of the implementor is 123 and the implementer chose a VendorApiInfix of "v11r456" a api name Can_Write defined in the SWS will translate to Can_123_v11r456Write. This parameter is mandatory for all modules with upper multiplicity > 1. It shall not be used for modules with upper multiplicity =1.
      string Release: set at published-information, origin=INFINEON_AURIX, default-value=_TRICORE_TC277  # Aurix derivative used for the implementation
