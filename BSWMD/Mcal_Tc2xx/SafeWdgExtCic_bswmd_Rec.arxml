AUTOSAR XML (schema 4-0-3)
package /AURIX
  module config SafeWdgExtCic_Rec: definition=SafeWdgExtCic
  bsw implementation SafeWdgExtCic_Impl: programming-language=C, recommended-configuration=SafeWdgExtCic_Rec, vendor-specific-module-def=SafeWdgExtCic
