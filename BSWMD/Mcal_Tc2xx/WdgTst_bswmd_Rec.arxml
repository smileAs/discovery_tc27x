AUTOSAR XML (schema 4-0-3)
package /AURIX
  module config WdgTst_Rec: definition=WdgTst
  bsw implementation WdgTst_Impl: programming-language=C, recommended-configuration=WdgTst_Rec, vendor-specific-module-def=WdgTst
