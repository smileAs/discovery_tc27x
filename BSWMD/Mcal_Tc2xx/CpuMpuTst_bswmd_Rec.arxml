AUTOSAR XML (schema 4-0-3)
package /AURIX
  module config CpuMpuTst_Rec: definition=CpuMpuTst
  bsw implementation CpuMpuTst_Impl: programming-language=C, recommended-configuration=CpuMpuTst_Rec, vendor-specific-module-def=CpuMpuTst
