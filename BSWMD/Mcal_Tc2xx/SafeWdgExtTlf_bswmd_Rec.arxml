AUTOSAR XML (schema 4-0-3)
package /AURIX
  module config SafeWdgExtTlf_Rec: definition=SafeWdgExtTlf
  bsw implementation SafeWdgExtTlf_Impl: programming-language=C, recommended-configuration=SafeWdgExtTlf_Rec, vendor-specific-module-def=SafeWdgExtTlf
