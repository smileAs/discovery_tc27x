AUTOSAR XML (schema 4-0-3)
package /AURIX
  module config IRTst_Rec: definition=IRTst
  bsw implementation IRTst_Impl: programming-language=C, recommended-configuration=IRTst_Rec, vendor-specific-module-def=IRTst
