AUTOSAR XML (schema 4-0-3)
package /AURIX
  module config Mcu_Rec: definition=Mcu
  bsw implementation Mcu_Impl: programming-language=C, behavior=McuBehavior, recommended-configuration=Mcu_Rec, vendor-specific-module-def=Mcu
