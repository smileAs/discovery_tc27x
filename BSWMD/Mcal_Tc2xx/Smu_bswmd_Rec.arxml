AUTOSAR XML (schema 4-0-3)
package /AURIX
  module config Smu_Rec: definition=Smu
  bsw implementation Smu_Impl: programming-language=C, recommended-configuration=Smu_Rec, vendor-specific-module-def=Smu
