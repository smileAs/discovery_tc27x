AUTOSAR XML (schema 4-0-3)
package /AURIX
  module config PhlSramTst_Rec: definition=PhlSramTst
  bsw implementation PhlSramTst_Impl: programming-language=C, recommended-configuration=PhlSramTst_Rec, vendor-specific-module-def=PhlSramTst
