AUTOSAR XML (schema 4-0-3)
package /AURIX
  module config Irq_Rec: definition=Irq
  bsw implementation Irq_Impl: programming-language=C, behavior=IrqBehavior, recommended-configuration=Irq_Rec, vendor-specific-module-def=Irq
