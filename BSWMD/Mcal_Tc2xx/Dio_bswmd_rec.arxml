AUTOSAR XML (schema 4-0-3)
package /AURIX
  module config Dio_Rec: definition=Dio
  bsw implementation Dio_Impl: programming-language=C, behavior=DioBehavior, recommended-configuration=Dio_Rec, vendor-specific-module-def=Dio
