AUTOSAR XML (schema 4-0-3)
package /AURIX
  module config Cry_Rec: definition=CryHsm
  bsw implementation Cry_Impl: programming-language=C, behavior=CryBehavior, recommended-configuration=Cry_Rec, vendor-specific-module-def=CryHsm
