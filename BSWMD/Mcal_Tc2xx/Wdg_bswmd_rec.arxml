AUTOSAR XML (schema 4-0-3)
package /AURIX
  module config Wdg_Rec: definition=Wdg
  bsw implementation Wdg_Impl: programming-language=C, vendor-id=17, behavior=WdgBehavior, recommended-configuration=Wdg_Rec, vendor-api-infix=Scu, vendor-specific-module-def=Wdg
