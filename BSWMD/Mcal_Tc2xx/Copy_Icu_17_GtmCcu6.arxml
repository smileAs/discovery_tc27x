AUTOSAR XML (schema 4-0-3)
package /AURIX
  module definition Icu: refined-module-def=Icu, variants post-build-loadable/post-build-selectable  # Configuration of the Icu (Input Capture Unit) module.
    container IcuConfigSet: multiple-configuration-container=true  # This container is the base for a multiple configuration set
      integer IcuMaxChannel: 0..32, set at post-build, derivation=informal-formula=verbatim=l-5=number of configured icu channels, default-value=1  # This parameter contains the number of Channels configured. It will be gathered by tools during the configuration stage. calculation Formula = Number of configured Icu Channels Implementation Type: Icu_ChannelType. Press the Calculate button beside the parameter to automatically update the field. This parameter doesnt have any influence on the generated code file
      container IcuChannel [1..*]  # Configuration of an individual ICU channel.
        integer IcuChannelId: 0..65535, set at post-build, symbolic-name-value=true, default-value=0  # Channel Id of the ICU channel. This value will be assigned to the symbolic name derived of the IcuChannel container short name.
        enumeration IcuDefaultStartEdge: {ICU_BOTH_EDGES, ICU_FALLING_EDGE, ICU_RISING_EDGE}, set at post-build, default-value=ICU_RISING_EDGE  # Configures the default-activation-edge which shall be used for this channel if there was no activation-edge configured by the call of service Icu_SetActivationCondition(). In case the Measurement Mode is IcuSignalMeasurement and the properties DutyCycle or Period are set, the edge configured here is used as Default Period Start Edge. Implementation Type: Icu_ActivationType
        enumeration IcuMeasurementMode: {ICU_MODE_EDGE_COUNTER, ICU_MODE_SIGNAL_EDGE_DETECT, ICU_MODE_SIGNAL_MEASUREMENT, ICU_MODE_TIMESTAMP}, set at post-build, default-value=ICU_MODE_SIGNAL_EDGE_DETECT  # Configures the measurement mode of this channel. Implementation Type: Icu_MeasurementModeType
        boolean IcuWakeupCapability: set at post-build, default-value=false  # Information about the wakeup-capability of this channel. true: Channel is wakeup capable. false: Channel is not wakeup capable.
        enumeration IcuSignalType: {ICU_ASIL_SIGNAL, ICU_QM_SIGNAL}, set at post-build, origin=INFINEON_AURIX, default-value=ICU_QM_SIGNAL  # IcuSignalType : QM or ASIL signal
        choice reference IcuAssignedHwUnit: set at post-build, origin=INFINEON_AURIX, destination=[TimChannel, ERU0, ERU1, ERU2, ERU3, ERU4, ERU5, ERU6, ERU7, Cc6]  # The HW resource required for the measurement. TIM, ERU and CCU
        container IcuSignalEdgeDetection [0..1]  # This container contains the configuration (parameters) in case the measurement mode is IcuSignalEdgeDetection.
          function name IcuSignalNotification [0..1]: set at post-build, default-value=NULL  # Notification function for signal notification.
        container IcuSignalMeasurement [0..1]  # This container contains the configuration (parameters) in case the measurement mode is IcuSignalMeasurement.
          enumeration IcuSignalMeasurementProperty [0..1]: {ICU_ACTIVE_TIME, ICU_HIGH_TIME, ICU_LOW_TIME, ICU_PERIOD_TIME}, set at post-build  # Configures the property that could be measured in case the mode is IcuSignalMeasurement. This property can not be changed during runtime. Implementation Type: Icu_SignalMeasurementPropertyType
          integer IcuDutycycleBufferMarker: 0..65535, set at post-build, origin=INFINEON_AURIX, default-value=0  # Marker for Dutycycle buffer
        container IcuTimestampMeasurement [0..1]  # This container contains the configuration (parameters) in case the measurement mode is IcuTimestamp
          enumeration IcuTimestampMeasurementProperty [0..1]: {ICU_CIRCULAR_BUFFER, ICU_LINEAR_BUFFER}, set at post-build  # Configures the handling of the buffer in case the mode is Timestamp; Implementation Type: Icu_TimestampBufferType
          integer IcuTimestampBufferMarker: 0..65535, set at post-build, origin=INFINEON_AURIX, default-value=0  # Marker for timestamp buffer
          function name IcuTimestampNotification [0..1]: set at post-build, default-value=NULL  # Notification function if the number of requested timestamps (Notification interval is greater 0) are acquired.
        container IcuWakeup [0..1]  # This container contains the configuration (parameters) needed to configure a wakeup capable channel
          symbolic name reference IcuChannelWakeupInfo [0..1]: set at post-build, destination=EcuMWakeupSource  # If the wakeup-capability is true the wakeup source referenced is transmitted to the ECU State Manager (EcuM) . Implementation Type: reference to EcuM_WakeupSourceType
    container IcuGeneral  # Configuration of general ICU parameters.
      boolean IcuDevErrorDetect: set at pre-compile, default-value=false  # Switches the Development Error Detection on or off. true: Enabled. false: Disabled.
      boolean IcuDebugSupport: set at pre-compile, origin=INFINEON_AURIX, default-value=false  # Pre-processor switch for enabling/disabling the debugging support.
      integer IcuIndex: 0..255, set at pre-compile, default-value=0  # Specifies the InstanceId of this module instance. If only one instance is present it shall have the Id 0.
      boolean IcuReportWakeupSource: set at pre-compile, default-value=false  # Switch for enabling Wakeup source reporting. true: Report Wakeup source. false: Do not report Wakeup source.
      boolean IcuPBFixedAddress: set at pre-compile, origin=INFINEON_AURIX, default-value=false  # This parameter indicates whether the Icu configuration to be used is decided at link time or changeable by user at runtime. true: Icu Configuration to be used is fixed i.e Icu_ConfigRoot[0] false: The user has to choose the Icu configuration to be used and pass the same as a parameter to Icu_Init.
      boolean IcuResetSfrAtInit: set at pre-compile, origin=INFINEON_AURIX, default-value=false  # Pre-processor switch to enable / disable the CCU and ERU SFR resetting at initialization
      boolean IcuUserModeRuntimeApiEnable: set at pre-compile, origin=INFINEON_AURIX, default-value=false  # Pre-processor switch to enable / disable protected register access in all the APIs other than Init/Deinit APIs
      boolean IcuUserModeInitApiEnable: set at pre-compile, origin=INFINEON_AURIX, default-value=false  # Pre-processor switch to enable / disable protected register access in Init API
      boolean IcuUserModeDeInitApiEnable: set at pre-compile, origin=INFINEON_AURIX, default-value=false  # Pre-processor switch to enable / disable protected register access in DeInit API
      boolean IcuRunningInUser0Mode: set at pre-compile, origin=INFINEON_AURIX, default-value=false  # Pre-processor switch to enable / disable user0 mode
    container IcuOptionalApis  # This container contains all configuration switches for configuring optional API services of the ICU driver.
      boolean IcuDeInitApi: set at pre-compile, default-value=false  # Adds / removes the service Icu_17_GtmCcu6_DeInit() from the code. true: Icu_17_GtmCcu6_DeInit() can be used. false: Icu_17_GtmCcu6_DeInit() can not be used.
      boolean IcuDisableWakeupApi: set at pre-compile, default-value=false  # Adds / removes the service Icu_17_GtmCcu6_DisableWakeup() from the code. true: Icu_17_GtmCcu6_DisableWakeup() can be used. false: Icu_17_GtmCcu6_DisableWakeup() can not be used.
      boolean IcuEdgeCountApi: set at pre-compile, default-value=false  # Adds / removes all services related to the edge counting functionality as listed below, from the code: Icu_17_GtmCcu6_ResetEdgeCount(), Icu_17_GtmCcu6_EnableEdgeCount(), Icu_17_GtmCcu6_DisableEdgeCount(), Icu_17_GtmCcu6_GetEdgeNumbers(). true: The services listed above can be used. false: The services listed above can not be used.
      boolean IcuEdgeDetectApi: set at pre-compile, default-value=true  # Adds / removes all services related to the edge detection functionality as listed below from the code: Icu_17_GtmCcu6_EnableEdgeDetection(),Icu_17_GtmCcu6_DisableEdgeDetection(). true: The services listed above can be used. false: The services listed above can not be used.
      boolean IcuEnableWakeupApi: set at pre-compile, default-value=false  # Adds / removes the service Icu_17_GtmCcu6_EnableWakeup() from the code. true: Icu_17_GtmCcu6_EnableWakeup() can be used. false: Icu_17_GtmCcu6_EnableWakeup() can not be used.
      boolean IcuGetDutyCycleValuesApi: set at pre-compile, default-value=false  # Adds / removes the service Icu_17_GtmCcu6_GetDutyCycleValues() from the code. true: Icu_17_GtmCcu6_GetDutyCycleValues() can be used. false: Icu_17_GtmCcu6_GetDutyCycleValues() can not be used.
      boolean IcuGetInputStateApi: set at pre-compile, default-value=false  # Adds / removes the service Icu_17_GtmCcu6_GetInputState() from the code. true: Icu_17_GtmCcu6_GetInputState() can be used. false: Icu_17_GtmCcu6_GetInputState() can not be used.
      boolean IcuGetTimeElapsedApi: set at pre-compile, default-value=false  # Adds / removes the service Icu_17_GtmCcu6_GetTimeElapsed() from the code. true: Icu_17_GtmCcu6_GetTimeElapsed() can be used. false: Icu_17_GtmCcu6_GetTimeElapsed() can not be used.
      boolean IcuGetVersionInfoApi: set at pre-compile, default-value=false  # Adds / removes the service Icu_17_GtmCcu6_GetVersionInfo() from the code. true: Icu_17_GtmCcu6_GetVersionInfo() can be used. false: Icu_17_GtmCcu6_GetVersionInfo() can not be used.
      boolean IcuSetModeApi: set at pre-compile, default-value=false  # Adds / removes the service Icu_17_GtmCcu6_SetMode() from the code. true: Icu_17_GtmCcu6_SetMode() can be used. false: Icu_17_GtmCcu6_SetMode() can not be used.
      boolean IcuSignalMeasurementApi: set at pre-compile, default-value=false  # Adds / removes the services Icu_17_GtmCcu6_StartSignalMeasurement() and Icu_17_GtmCcu6_StopSignalMeasurement() from the code. true: Icu_17_GtmCcu6_StartSignalMeasurement() and Icu_17_GtmCcu6_StopSignalMeasurement() can be used. false: Icu_17_GtmCcu6_StartSignalMeasurement() and Icu_17_GtmCcu6_StopSignalMeasurement() can not be used.
      boolean IcuTimestampApi: set at pre-compile, default-value=false  # Adds / removes all services related to the timestamping functionality as listed below from the code: Icu_17_GtmCcu6_StartTimestamp(), Icu_17_GtmCcu6_StopTimestamp(), Icu_17_GtmCcu6_GetTimestampIndex(). true: The services listed above can be used. false: The services listed above can not be used.
      boolean IcuWakeupFunctionalityApi: set at pre-compile, default-value=false  # Adds / removes the service Icu_17_GtmCcu6_CheckWakeup() from the code. true: Icu_17_GtmCcu6_CheckWakeup() can be used. false: Icu_17_GtmCcu6_CheckWakeup() can not be used.
    container IcuSafety  # This container contains the configuration for the safety features of the Icu driver.
      boolean IcuSafetyEnable: set at pre-compile, origin=INFINEON_AURIX, default-value=false  # Pre-processor switch for enabling/disabling the Icu driver safety features. By default, - Range check on API parameters shall be done - Icu configuration structure shall have a unique marker field which will be verified by the driver - Publish the safety usage of Icu driver for user to set the respective MPU settings
      boolean IcuInitCheckApi: set at pre-compile, origin=INFINEON_AURIX, default-value=false  # If this parameter is set to TRUE, the Icu initialization check will be done as a safety measure. If this parameter is set to FALSE, the Icu driver shall not verify the initialization.
      boolean IcuGetModeApi: set at pre-compile, origin=INFINEON_AURIX, default-value=false  # If this parameter is set to TRUE, the Icu_17_GtmCcu6_GetMode API shall be enabled. If this parameter is set to FALSE, the Icu_17_GtmCcu6_GetMode API shall not be enabled.
    container CommonPublishedInformation  # Common container, aggregated by all modules. It contains published information about vendor and versions.
      integer ArMajorVersion: 0..65535, set at published-information, origin=INFINEON_AURIX, default-value=4  # Major version number of AUTOSAR specification on which the appropriate implementation is based on.
      integer ArMinorVersion: 0..65535, set at published-information, origin=INFINEON_AURIX, default-value=2  # Minor version number of AUTOSAR specification on which the appropriate implementation is based on.
      integer ArPatchVersion: 0..65535, set at published-information, origin=INFINEON_AURIX, default-value=0  # Patch level version number of AUTOSAR specification on which the appropriate implementation is based on.
      integer SwMajorVersion: 0..65535, set at published-information, origin=INFINEON_AURIX, default-value=3  # Major version number of the vendor specific implementation of the module. The numbering is vendor specific.
      integer SwMinorVersion: 0..65535, set at published-information, origin=INFINEON_AURIX, default-value=11  # Minor version number of the vendor specific implementation of the module. The numbering is vendor specific.
      integer SwPatchVersion: 0..65535, set at published-information, origin=INFINEON_AURIX, default-value=0  # Patch level version number of the vendor specific implementation of the module. The numbering is vendor specific.
      integer ModuleId: 0..65535, set at published-information, origin=INFINEON_AURIX, default-value=122  # Module ID of this module from Module List
      integer VendorId: 0..65535, set at published-information, origin=INFINEON_AURIX, default-value=17  # Vendor ID of the dedicated implementation of this module according to the AUTOSAR vendor list
      string Release: set at published-information, origin=INFINEON_AURIX, default-value=_TRICORE_TC277  # Aurix derivative used for thr implementation
      string VendorApiInfix: set at published-information, origin=INFINEON_AURIX, default-value=GtmCcu6  # In driver modules which can be instantiated several times on a single ECU, BSW00347 requires that the name of APIs is extended by the VendorId and a vendor specific name. This parameter is used to specify the vendor specific name. In total, the implementation specific name is generated as follows: <ModuleName>_>VendorId>_<VendorApiInfix><Api name from SWS>. E.g. assuming that the VendorId of the implementor is 123 and the implementer chose a VendorApiInfix of "v11r456" a api name Can_Write defined in the SWS will translate to Can_123_v11r456Write. This parameter is mandatory for all modules with upper multiplicity > 1. It shall not be used for modules with upper multiplicity =1.
