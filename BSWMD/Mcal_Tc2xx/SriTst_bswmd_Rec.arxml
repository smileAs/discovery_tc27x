AUTOSAR XML (schema 4-0-3)
package /AURIX
  module config SriTst_Rec: definition=SriTst
  bsw implementation SriTst_Impl: programming-language=C, recommended-configuration=SriTst_Rec, vendor-specific-module-def=SriTst
