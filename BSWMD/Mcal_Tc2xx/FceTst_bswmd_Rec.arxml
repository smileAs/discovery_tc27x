AUTOSAR XML (schema 4-0-3)
package /AURIX
  module config FceTst_Rec: definition=FceTst
  bsw implementation FceTst_Impl: programming-language=C, recommended-configuration=FceTst_Rec, vendor-specific-module-def=FceTst
