AUTOSAR XML (schema 4-0-3)
package /AURIX
  module config CpuSbstTst_Rec: definition=CpuSbstTst
  bsw implementation CpuSbstTst_Impl: programming-language=C, recommended-configuration=CpuSbstTst_Rec, vendor-specific-module-def=CpuSbstTst
