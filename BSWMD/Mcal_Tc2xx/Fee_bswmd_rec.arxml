AUTOSAR XML (schema 4-0-3)
package /AURIX
  module config Fee_Rec: definition=Fee
  bsw implementation Fee_Impl: programming-language=C, behavior=FeeBehavior, recommended-configuration=Fee_Rec, vendor-specific-module-def=Fee
