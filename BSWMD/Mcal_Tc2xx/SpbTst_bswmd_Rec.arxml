AUTOSAR XML (schema 4-0-3)
package /AURIX
  module config SpbTst_Rec: definition=SpbTst
  bsw implementation SpbTst_Impl: programming-language=C, recommended-configuration=SpbTst_Rec, vendor-specific-module-def=SpbTst
