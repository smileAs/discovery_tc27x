AUTOSAR XML (schema 4-0-3)
package /AURIX
  module config PmuEccEdcTst_Rec: definition=PmuEccEdcTst
  bsw implementation PmuEccEdcTst_Impl: programming-language=C, recommended-configuration=PmuEccEdcTst_Rec, vendor-specific-module-def=PmuEccEdcTst
