AUTOSAR XML (schema 4-0-3)
package /AURIX
  module config SafeWdgQspi_Rec: definition=SafeWdgQspi
  bsw implementation SafeWdgQspi_Impl: programming-language=C, recommended-configuration=SafeWdgQspi_Rec, vendor-specific-module-def=SafeWdgQspi
