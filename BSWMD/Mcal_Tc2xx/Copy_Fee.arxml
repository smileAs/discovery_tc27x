AUTOSAR XML (schema 4-0-3)
package /AURIX
  module definition Fee: refined-module-def=Fee, variants pre-compile  # Configuration of the Fee (Flash EEPROM Emulation) module.
    container FeeBlockConfiguration [1..8139]  # Configuration of block specific parameters for the Flash EEPROM Emulation module.
      integer FeeBlockNumber: 1..65534, set at pre-compile, symbolic-name-value=true, default-value=1  # This parameter defines the block number of a particular logical block Block identifier (handle). 0x0000 and 0xFFFF shall not be used for block numbers.
      integer FeeBlockSize: 1..65535, set at pre-compile, default-value=7  # This parameter defines the block size of a particular logical block in bytes
      boolean FeeImmediateData: set at pre-compile, default-value=false  # This parameter defines the type of a particular logical block. TRUE: Immediate data block, FALSE: Normal data block
      integer FeeNumberOfWriteCycles: 0..16777215, set at pre-compile, default-value=0  # This parameter defines the block cycle count of a particular logical block. It denotes the maximum number of times a particular logical block can be written, invalidated. However , the value 0 denotes that this block is not bound by any limit and can be written as many times as desired by the user
      symbolic name reference FeeDeviceIndex: set at pre-compile, destination=FlsGeneral  # Device index (handle). Range: 0 .. 254 (0xFF reserved for broadcast call to GetStatus function). This information is needed by the NVRAM manager respectively the Memory Abstraction Interface to address a certain logical block.
    container FeeGeneral  # Container for general parameters. These parameters are not specific to a block.
      boolean FeeDevErrorDetect: set at pre-compile, default-value=false  # Pre-processor switch to enable and disable development error detection.
      integer FeeIndex: 0..254, set at pre-compile, default-value=0  # Specifies the InstanceId of this module instance. Since only one instance is present, it is preconfigured (fixed) to Id 0.
      function name FeeNvmJobEndNotification [0..1]: set at pre-compile, default-value=NULL_PTR  # This parameter is the Job End notification function name and is called if the job is successfully completed. The user must define a function by this name. If no notification is required this parameter must be configured as NULL_PTR
      function name FeeNvmJobErrorNotification [0..1]: set at pre-compile, default-value=NULL_PTR  # This parameter is the Job Error notification function name and is called if the job is NOT completed successfully. The user must define a function by this name. If no notification is required this parameter must be configured as NULL_PTR
      boolean FeePollingMode: set at pre-compile, default-value=false  # Switch to enable/disable Polling Mode. As callback functions are always provided to the FLS module, this parameter is pre-configured (fixed) as FALSE.
      boolean FeeSetModeSupported: set at pre-compile, default-value=false  # Pre-processor switch to enable / disable the API to set FEE mode. TRUE: Fee_SetMode API enabled. FALSE: Fee_SetMode API disabled. Note: FeeSetModeSupported can be TRUE only if FlsSetModeApi is TRUE.
      boolean FeeVersionInfoApi: set at pre-compile, default-value=false  # Pre-processor switch to enable / disable the API to read out the module's version information. TRUE: Version info API enabled. FALSE: Version info API disabled.
      integer FeeVirtualPageSize: 8..8, set at pre-compile, default-value=8  # The size in bytes to which logical blocks will be aligned. This AUTOSAR requirement is violated by the implementation. Due to the usage of double-sector algorithm with implementation specific block management pages for each of the logical blocks, blocks will not be aligned as per the relation between FeeBlockNumber and FeeVirtualPageSize specified by AUTOSAR.
      boolean FeeDebugSupport: set at pre-compile, origin=INFINEON_AURIX, default-value=false  # Switches the debug support ON or OFF.
    container FeePublishedInformation  # Additional published parameters not covered by CommonPublishedInformation container. Note that these parameters do not have any configuration class setting, since they are published information.
      integer FeeBlockOverhead: 17..17, set at published-information, default-value=17  # Management overhead per logical block in bytes. The actual overhead per block is calculated as: (i) If ((FeeBlockSize % 7) == 0): FeeBlockOverhead = ((FeeBlockSize / 7) * 8) + 16 - FeeBlockSize. (ii)If ((FeeBlockSize % 7) != 0): FeeBlockOverhead = (((FeeBlockSize / 7) + 1) * 8) + 16 - FeeBlockSize. Note: Integer arithmetic is used in the above calculation.
      float FeeMaximumBlockingTime: 0.0..1000.0, set at published-information, default-value=10.0  # The maximum time (in ms) the FEE module's API routines shall be blocked (delayed) by internal operations. Note: Following scenarios may result in a blocking time exceeding the value specified: Here, job execution delay is mentioned and not the blocking time of the API (i.e., API will not be blocked without returning): (i) During initialization, for the configuration FEE_GC_RESTART_WRITE: For the first FEE job after Fee_Init, time would be consumed for reading the state pages as well as for updating the cache table. A write request will be pending until this time. (ii) During GC copy state: Start of the immediate block's write operation will be delayed until the current block being copied is completely copied. So, the worst case depends upon the maximum block size configured. (iii)If erase suspend feature is not enabled then the user request's execution will be delayed until the FEE sector is erased.
      integer FeePageOverhead: 1..1, set at published-information, default-value=1  # Block management overhead per page in bytes. Note: This value is applicable only for the pages containing logical block data bytes (i.e., it is not applicable for the pages which contain only implementation specific management data).
    container FeeIfxSpecificConfig  # This container has IFX specific parameters required for the working of FEE
      integer FeeThresholdValue: 0..195560, set at pre-compile, origin=INFINEON_AURIX, default-value=200  # This parameter describes the threshold value (in bytes from the end of FEE sector) for triggering garbage collection/sector change.
      integer FeeMaxBlockCount: 1..8139, set at pre-compile, origin=INFINEON_AURIX, default-value=1  # This configuration parameter specifies the total number of blocks throughout all configurations; Note that the blocks which are shared across configurations are counted only once. This parameter decides the cache table size at pre-compile time. The cache table holds the information of both configured and un-configured blocks. Configuration of this parameter shall be carefully done. Higher value implies higher RAM area consumption for cache table. Lower value would result in loss of un-configured block(s) during GC (if FeeUnConfigBlkOverflowHandle is FEE_CONTINUE) or illegal state of FEE (if FeeUnConfigBlkOverflowHandle is FEE_STOP_AT_GC). Example 1: Configuration sets having mutually exclusive blocks: Configuration A: Number of blocks configured is 10. Configuration B: Number of blocks configured is 25. Then, FeeMaxBlockCount = 35. Example 2: 5 blocks are shared/used by both Configuration A and Configuration B: Configuration A: Number of blocks configured is 10. Configuration B: Number of blocks configured is 25. Then, FeeMaxBlockCount = 30 (i.e., shared blocks are counted only once).
      boolean FeeUseEraseSuspend: set at pre-compile, origin=INFINEON_AURIX, default-value=false  # This parameter specifies the usage of the erase suspend feature provided by the DFLASH hardware. If it is configured as TRUE, then the read/write requests from the user are serviced during the erase operation of the GC. If it is configured as FALSE, then the user request is kept pending till the erase operation is completed. Note: This parameter can be true only if FlsUseEraseSuspend is true.
      string FeeStateVarStructure: set at pre-compile, origin=INFINEON_AURIX, default-value=Fee_StateVar  # This parameter is the name of the structure, which would contain all the global variables of FEE. Using this user can allocate the space for the variables at his behest to avoid any possible linking problems.
      enumeration FeeUnConfigBlock: {FEE_UNCONFIG_BLOCK_IGNORE, FEE_UNCONFIG_BLOCK_KEEP}, set at pre-compile, origin=INFINEON_AURIX, default-value=FEE_UNCONFIG_BLOCK_IGNORE  # This parameter is used to configure if unconfigured blocks should be copied or not during GC operation
      enumeration FeeUnConfigBlkOverflowHandle: {FEE_CONTINUE, FEE_STOP_AT_GC}, set at pre-compile, origin=INFINEON_AURIX, default-value=FEE_CONTINUE  # This parameter is used to configure the behavior of FEE upon detection of overflow of number of unconfigured blocks. FEE_CONTINUE: Un-configured blocks which could not be accommodated in the cache table, will be lost after the GC. FEE will continue as expected for the currently active configuration. FEE_STOP_AT_GC: During GC, FEE will enter a pseudo illegal state where only read is allowed but write is not allowed.
      enumeration FeeGcRestart: {FEE_GC_RESTART_INIT, FEE_GC_RESTART_WRITE}, set at pre-compile, origin=INFINEON_AURIX, default-value=FEE_GC_RESTART_INIT  # This parameter is used to configure Garbage Collection restarting point. FEE_GC_RESTART_INIT: (if GC was interrupted in previous run) Restart GC after FEE Initialization. Hence, internal activities like repairing state pages, building lookup table are done after Fee_Init is called. FEE_GC_RESTART_WRITE: (if GC was interrupted in previous run) Restart GC when the first read/write/invalidate request is issued. Also, other internal activities like repairing state pages, building lookup table are done only after the first Read/write/invalidate request is issued
      boolean FeeGetCycleCountApi: set at pre-compile, origin=INFINEON_AURIX, default-value=false  # Pre-processor switch to enable / disable the API to get the block cycle count and erase cycle count.
      boolean FeeEraseAllEnable: set at pre-compile, origin=INFINEON_AURIX, default-value=false  # This parameter allows the user to configure if the sectors should be erased when FEE reaches an illegal state. TRUE: An erase all (DF_EEPROM Erase and Format) is performed. In such a case FEE shall resume back to normal state but previous data (if any) cannot be recovered. FALSE: FEE settles in the illegal state and cannot continue normally. However, data is kept intact in DF_EEPROM and may be recovered.
      boolean FeeGetPrevDataApi: set at pre-compile, origin=INFINEON_AURIX, default-value=false  # This parameter allows the user to read old copy (one instance old) of the required block.
      enumeration FeeMaxBytesPerCycle: {FEE_MAX_BYTES_64, FEE_MAX_BYTES_128, FEE_MAX_BYTES_256, FEE_MAX_BYTES_512}, set at pre-compile, origin=INFINEON_AURIX, default-value=FEE_MAX_BYTES_64  # This parameter allows user to configure maximum number of bytes to be processed in one FEE MAIN Function cycle. The value is including the extra FEE overhead like header, consecutive page id etc
      function name FeeIllegalStateNotification: set at pre-compile, origin=INFINEON_AURIX, default-value=NULL_PTR  # This parameter is a pointer to a notification API which is called when Fee reaches an Illegal state. Illegal state here means that FEE is not able to proceed and user should do a power-on reset. Illegal notification can also be raised due to HW errors during FEE's internal activities like GC, Initialisation of GC
      boolean FeeVirginFlashIllegalState: set at pre-compile, origin=INFINEON_AURIX, default-value=false  # This parameter enables FEE to reach illegal state upon detection of virgin flash (DF_EEPROM). TRUE: Upon detection of virgin flash (DF_EEPROM) - FEE reaches illegal state and calls the configured illegal state notification function. FALSE: Upon detection of virgin flash (DF_EEPROM) - FEE programs the initial state pages and will be available for user requests.
    container FeeDemEventParameterRefs [0..1]  # This container contains the references to DemEventParameter elements.
      symbolic name reference FEE_E_GC_INIT [0..1]: set at pre-compile, origin=INFINEON_AURIX, destination=DemEventParameter  # Reference to DemEventParameter for the production error FEE_E_GC_INIT.
      symbolic name reference FEE_E_WRITE [0..1]: set at pre-compile, origin=INFINEON_AURIX, destination=DemEventParameter  # Reference to DemEventParameter for the production error FEE_E_WRITE.
      symbolic name reference FEE_E_READ [0..1]: set at pre-compile, origin=INFINEON_AURIX, destination=DemEventParameter  # Reference to DemEventParameter for the production error FEE_E_READ.
      symbolic name reference FEE_E_GC_READ [0..1]: set at pre-compile, origin=INFINEON_AURIX, destination=DemEventParameter  # Reference to DemEventParameter for the production error FEE_E_GC_READ.
      symbolic name reference FEE_E_GC_WRITE [0..1]: set at pre-compile, origin=INFINEON_AURIX, destination=DemEventParameter  # Reference to DemEventParameter for the production error FEE_E_GC_WRITE.
      symbolic name reference FEE_E_GC_ERASE [0..1]: set at pre-compile, origin=INFINEON_AURIX, destination=DemEventParameter  # Reference to DemEventParameter for the production error FEE_E_GC_ERASE.
      symbolic name reference FEE_E_INVALIDATE [0..1]: set at pre-compile, origin=INFINEON_AURIX, destination=DemEventParameter  # Reference to DemEventParameter for the production error FEE_E_INVALIDATE.
      symbolic name reference FEE_E_WRITE_CYCLES_EXHAUSTED [0..1]: set at pre-compile, origin=INFINEON_AURIX, destination=DemEventParameter  # Reference to DemEventParameter for the production error FEE_E_WRITE_CYCLES_EXHAUSTED.
      symbolic name reference FEE_E_GC_TRIG [0..1]: set at pre-compile, origin=INFINEON_AURIX, destination=DemEventParameter  # Reference to DemEventParameter for the production error FEE_E_GC_TRIG.
      symbolic name reference FEE_E_UNCONFIG_BLK_EXCEEDED [0..1]: set at pre-compile, origin=INFINEON_AURIX, destination=DemEventParameter  # Reference to DemEventParameter for the production error FEE_E_UNCONFIG_BLK_EXCEEDED.
    container CommonPublishedInformation  # Common container, aggregated by all modules. It contains published information about vendor and versions.
      integer ArMajorVersion: 0..65535, set at published-information, origin=INFINEON_AURIX, default-value=2  # Major version number of AUTOSAR specification on which the appropriate implementation is based on.
      integer ArMinorVersion: 0..65535, set at published-information, origin=INFINEON_AURIX, default-value=0  # Minor version number of AUTOSAR specification on which the appropriate implementation is based on.
      integer ArPatchVersion: 0..65535, set at published-information, origin=INFINEON_AURIX, default-value=0  # Patch level version number of AUTOSAR specification on which the appropriate implementation is based on.
      integer SwMajorVersion: 0..65535, set at published-information, origin=INFINEON_AURIX, default-value=2  # Major version number of the vendor specific implementation of the module. The numbering is vendor specific.
      integer SwMinorVersion: 0..65535, set at published-information, origin=INFINEON_AURIX, default-value=4  # Minor version number of the vendor specific implementation of the module. The numbering is vendor specific.
      integer SwPatchVersion: 0..65535, set at published-information, origin=INFINEON_AURIX, default-value=0  # Patch level version number of the vendor specific implementation of the module. The numbering is vendor specific.
      integer ModuleId: 0..65535, set at published-information, origin=INFINEON_AURIX, default-value=21  # Module ID of this module from Module List
      integer VendorId: 0..65535, set at published-information, origin=INFINEON_AURIX, default-value=17  # Vendor ID of the dedicated implementation of this module according to the AUTOSAR vendor list
      string VendorApiInfix: set at published-information, origin=INFINEON_AURIX  # In driver modules which can be instantiated several times on a single ECU, BSW00347 requires that the name of APIs is extended by the VendorId and a vendor specific name. This parameter is used to specify the vendor specific name. In total, the implementation specific name is generated as follows: <ModuleName>_>VendorId>_<VendorApiInfix><Api name from SWS>. E.g. assuming that the VendorId of the implementor is 123 and the implementer chose a VendorApiInfix of "v11r456" a api name Can_Write defined in the SWS will translate to Can_123_v11r456Write. This parameter is mandatory for all modules with upper multiplicity > 1. It shall not be used for modules with upper multiplicity =1.
      string Release: set at published-information, origin=INFINEON_AURIX, default-value=_TRICORE_TC277  # Aurix derivative used for the implementation
