AUTOSAR XML (schema 4-0-3)
package /AURIX
  module config SafeWdgInt_Rec: definition=SafeWdgInt
  bsw implementation SafeWdgInt_Impl: programming-language=C, recommended-configuration=SafeWdgInt_Rec, vendor-specific-module-def=SafeWdgInt
