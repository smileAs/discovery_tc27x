AUTOSAR XML (schema 4-0-3)
package /AURIX
  module config Fls_Rec: definition=Fls
  bsw implementation Fls_Impl: programming-language=C, vendor-id=17, behavior=FlsBehavior, recommended-configuration=Fls_Rec, vendor-api-infix=Pmu, vendor-specific-module-def=Fls
