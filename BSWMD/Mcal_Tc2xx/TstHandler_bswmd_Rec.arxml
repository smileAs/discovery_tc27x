AUTOSAR XML (schema 4-0-3)
package /AURIX
  module config TstHandler_Rec: definition=TstHandler
  bsw implementation TstHandler_Impl: programming-language=C, recommended-configuration=TstHandler_Rec, vendor-specific-module-def=TstHandler
