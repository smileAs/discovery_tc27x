AUTOSAR XML (schema 4-2-1)
# COPYRIGHT
# Copyright (c) 2013 by Vector Informatik GmbH. All rights reserved.
# This software is copyright protected and proprietary to Vector Informatik GmbH.
# Vector Informatik GmbH grants to you only those rights as set out in the license conditions.
package /MICROSAR
  bsw implementation AvTp_Impl: programming-language=C, sw-version=4.01.00, used-code-generator=DaVinci Configurator, vendor-id=30, ar-release-version=4.02.01, behavior=AvTpBehavior, preconfigured-configuration=AvTp_Pre, recommended-configuration=AvTp_Rec, vendor-specific-module-def=AvTp
  module definition AvTp [1..*]: category=VENDOR_SPECIFIC_MODULE_DEFINITION, refined-module-def=AvTp, variants pre-compile  # Audio Video Transport Protocol | Configuration of the Audio Video Transport Protocol AvTp defined by IEEE 1722
    container AvTpGeneral
      boolean AvTpDevErrorDetect: origin=Vector Informatik, set at pre-compile, default-value=true  # If 'Dev Error Detection' is enabled, all development errors are reported to the Development Error Tracer (DET). The errors are described in the [TechnicalReference_AvTp.pdf]. Note: In general, the development error detection is recommended during pre-test phase. It is not recommended to enable the development error detection in production code due to increased runtime and ROM needs.
      boolean AvTpVersionInfoApi: origin=Vector Informatik, default-value=false  # Version Info API | If 'AvTpVersionInfoApi' is enabled, the function AvTp_GetVersionInfo() is available to get major, minor and patch version information.
      boolean AvTpEnableRxPduInfo: origin=Vector Informatik, default-value=true  # Enable Rx Pdu Info | If 'AvTpEnableStreamInfo' is enabled, the upper layer rx indication function gets an additional structure containing information about the incoming stream pdu. If the switch is enabled, the upper layer function has the prototype: App_RxIndication( AVTP_P2CONST(AvTp_DataType) DataPtr, AVTP_P2CONST(AvTp_RxPduInfoType) StreamInfoPtr, uint16 LenByte ) Otherwise the upper layer function has to look like: App_RxIndication( AVTP_P2CONST(AvTp_DataType) DataPtr, uint16 LenByte )
      float AvTpMainFunctionPeriod: 0.001..32.767, origin=Vector Informatik, default-value=0.005  # Main Function Period | Determines the frequency in seconds at which the AvTp_MainFunction() is called.
      string AvTpPublicCddHeaderFile [0..255]: multiplicity set at , origin=Vector Informatik, set at   # These parameters defines header files for callback functions which shall be included in case of CDDs.
      boolean AvTpEnableRxFrameChecks: origin=Vector Informatik, set at pre-compile, default-value=true  # If 'TRUE' received frames are checked if they correspond to configured values. If 'FALSE' received frames are only checked whether they are valid. E.g. In case of 'FALSE' a AAF-message with Format=INT_16 would be accepted even though the configured subtype has Format=INT_24. However a AAF-message containing a invalid Format=Reserved would be discarded. In case of 'TRUE' a AAF-message with Format=INT_16 would be discarded when the configured (expected) subtype has Format=INT_24.
      boolean AvTpEnableBinarySearch: origin=Vector Informatik, default-value=true  # TRUE: Use 'Binary Search' to find corresponding StreamIdx of received StreamId. FALSE: Use 'Linear Search' instead.
      boolean AvTpEnableDiagnosticCounters: origin=Vector Informatik, default-value=false  # Diagnostic Counters | If enabled, every stream has a set of Diagnostic Counters available. The purpose of these counters is to acertain the relative health of the device. Further information can be found in Annex E (Diagnostics and Counters) in IEEE 1722a-2014-d8.
      enumeration AvTpIEEE1722aConformance: {IEEE1722A_2014_D8, IEEE1722A_2015_D16, IEEE1722A_2014_D8_WITH_D6_AAF}, origin=Vector Informatik, default-value=IEEE1722A_2014_D8  # Select the draft version of the AvTp Specification (IEEE1722a) which should be supported. Note: Currently only the Versions IEEE1722a-2014-d8 and IEEE1722a-2015-d16 are supported
      reference AvTpFrameType: origin=Vector Informatik, destination=EthIfFrameOwnerConfig  # Frame Type | Reference to the AvTp Frame Type used by the EthIf
    container AvTpConfigSet
      container AvTpRxStreamConfig [0..*]
        string AvTpRxStreamId: origin=Vector Informatik, default-value=00:00:00:00:00:00:00:00, max-length=23, min-length=23  # Receive Stream Id | Determines the 8 byte Stream Id of rx stream. Input format has to match xx:xx:xx:xx:xx:xx:xx:xx, where x stands for a hex value between 0 and F.
        integer AvTpRxStreamIdx: 0..255, origin=Vector Informatik, symbolic-name-value=true, default-value=0  # Receive Stream Index | Determines the used rx stream index. The rx steam index must be unique.
        function name AvTpRxStreamIndication: origin=Vector Informatik  # Receive Indication Function | Determines the Rx Indication function which is called when an stream pdu is incoming. If 'AvTpEnableStreamInfo' is enabled, the upper layer rx indication function gets an additional structure containing information about the incoming stream pdu. If the switch is ebalbled, the upper layer function has to look like: App_RxIndication( AVTP_P2CONST(AvTp_DataType) DataPtr, AVTP_P2CONST(AvTp_RxPduInfoType) StreamInfoPtr, uint16 LenByte ) Otherwise the upper layer function has to look like: App_RxIndication( AVTP_P2CONST(AvTp_DataType) DataPtr, uint16 LenByte )
        reference AvTpRxEthIfController: origin=Vector Informatik, destination=EthIfController  # EthIf Controller | Reference to the EthIf Controller that is used for AvTp Frame transmission.
        choice reference AvTpRxSubtype: origin=Vector Informatik, destination=[AvTpAVTPAudio, AvTpIEC61883, AvTpCompressedVideo, AvTpClockReference, AvTpVendorSpecificFormat]  # Subtype | Reference to a subtype received on this stream.
      container AvTpTxStreamConfig [0..*]: multiplicity set at pre-compile
        string AvTpTxStreamId: origin=Vector Informatik, default-value=00:00:00:00:00:00:00:00  # Transmit Stream Id | Determines the 8 byte Stream Id of tx stream. Input format has to match xx:xx:xx:xx:xx:xx:xx:xx, where x stands for a hex value between 0 and F.
        integer AvTpTxStreamIdx: 0..255, origin=Vector Informatik, symbolic-name-value=true, default-value=0  # Transmit Stream Index | Determines the used tx stream index. The tx steam index must be unique.
        integer AvTpTxPresentationTimeOffset [0..1]: 0..4294, origin=Vector Informatik, default-value=2  # Presentation Time Offset | Defines Presenation Time Offset = Max Transit Time. IEEE 1722-2011 defines Class A (2ms) and Class B (50ms). This parameter is only considered if TIME STAMPING ENABLE is TRUE.
        string AvTpTxDefaultMulticastMac: origin=Vector Informatik, default-value=91:E0:F0:00:FF:00, max-length=17, min-length=17  # Default Multicast Mac | Destination Physical Hardware Address (MAC-Address) of AvTp Frames. This address is used when 'MAAP Support' is disabled. If 'MAAP Support' is enabled, this address is assigned dynamically. Input format has to match xx::xx::xx::xx::xx::xx, where x stands for a hex value between 0 and F.
        integer AvTpTxFramePriority: 0..7, origin=Vector Informatik, default-value=0  # Frame Priority | Determines the IEEE802.1Q priority in VLAN-Tag. A stream is mapped to a queue according to its frame priority. To ensure that a stream is sent e.g. on a class A queue the priority mapping done in Ethernet Driver and the given frame priority must be consistent.
        function name AvTpTxStreamStateChangedCbk: origin=Vector Informatik  # State Changed Callback | Determines the callback function for stream state callbacks. This callback-function has the following prototype: App_TxStateChangedCbk( AvTp_StateType NewState )
        function name AvTpTxTimeSourceFunction [0..1]: origin=Vector Informatik  # Time Source Function | If 'User-Callout' is selected as 'Time Source' a function for getting the current time has to be provided. This function has the following prototype: Msn_GetCurrentTime( AVTP_P2VAR(AvTp_GlobalTimestampType) TimestampPtr, AVTP_P2VAR(AvTp_SyncStateType) SyncStatePtr ) This parameter is only considered if TIME STAMPING ENABLE is TRUE.
        enumeration AvTpTxTimeSource [0..1]: origin=Vector Informatik, set at pre-compile, default-value=EthTSyn  # Time Source | Determines from which module (EthTSyn or GPtp) AvTp obtains time stamp information. Furthermore a User-Callout can be used to provide time stamp information to the AvTp module. This parameter is only considered if TIME STAMPING ENABLE is TRUE.
          EthTSyn  # Time Synchronization over Ethernet
          GPtp  # Generalized PrecisionTime Protocol
          UserCallout  # User-Callout
        boolean AvTpTxTimeStampingEnable: origin=Vector Informatik, default-value=false  # Time Stamping Enable | Enable: Frames from this stream contain a AVTP_Timestamp Disable: Frames do not contain a AVTP_Timestamp
        reference AvTpTxEthIfController: origin=Vector Informatik, destination=EthIfController  # EthIf Controller | Reference to the EthIf Controller that is used for AvTp Frame transmission.
        choice reference AvTpTxSubtype: origin=Vector Informatik, destination=[AvTpAVTPAudio, AvTpIEC61883, AvTpCompressedVideo, AvTpClockReference, AvTpVendorSpecificFormat]  # Subtype | Reference to a subtype sent on this stream.
        choice reference AvTpTxTimeDomain [0..1]: origin=Vector Informatik, destination=[GPtpPortConfig, EthTSynGlobalTimeDomain]  # Time Domain | References used for presentation time generation. Supported are EthTSynGlobalTimeDomains or GPtpPortConfigs. This parameter is only considered if TIME STAMPING ENABLE is TRUE.
      container AvTpSubtype
        container AvTpAVTPAudio [0..*]  # AVTP Audio Format (AAF) with Subtype 0x02
          enumeration AvTpAudioFormat: origin=Vector Informatik, default-value=INT_16BIT  # Format | The format field describes the size of samples contained within the stream
            USERSPEC  # User specified
            FLOAT_32BIT  # 32-Bit Float
            INT_32BIT  # 32-Bit Integer
            INT_24BIT  # 24-Bit Integer
            INT_16BIT  # 16-Bit Integer
          enumeration AvTpAudioNominalSampleRate: origin=Vector Informatik, default-value=NSR_48KHZ  # Nominal Sample Rate | The nominal_sample_rate field describes the sample rate of the audio stream
            NSR_USERSPEC  # User specific
            NSR_8KHZ  # 8 kHz
            NSR_16KHZ  # 16 kHz
            NSR_32KHZ  # 32 kHz
            NSR_441KHZ  # 44.1 kHz
            NSR_48KHZ  # 48 kHz
            NSR_882KHZ  # 88.2 kHz
            NSR_96KHZ  # 96 kHz
            NSR_1764KHZ  # 176.4 kHz
            NSR_192KHZ  # 192 kHz
            NSR_24KHZ  # 24 kHz
            NSR_33_1_3RPM  # 33 1/3 RPM
            NSR_45RPM  # 45 RPM
            NSR_78RPM  # 78 RPM
          integer AvTpAudioChannelsPerFrame: 1..1023, origin=Vector Informatik, default-value=2  # Channels Per Frame | The number of audio channels represented in the audio sample frame. The value of this field shall be a positive integer greater than zero (0). For example, an audio stream conveying "7.1 surround sound" shall be indicated as having 8 channels.
          integer AvTpAudioBitDepth: 0..255, origin=Vector Informatik, default-value=16  # Bit Depth | The bit_depth field describes how many bits within the sample that the talker is filling with valid data. The value of bit_depth shall not be set to a number which is larger than the size of the format set in the format field. If the format field is set to a non-integer format then the bit_depth field shall be set to zero (0).
          boolean AvTpAudioTimestampSparseMode: origin=Vector Informatik, default-value=true  # Timestamp Sparse Mode | The sp field indicates whether the stream is in sparse timestamp mode. If the sp bit is set to one (1) then the stream is in sparse timestamp mode (every eigth packet is timestamped). If the sp bit is set to zero (0) then the stream is in normal timestamp mode.
          integer AvTpAudioSampleFramesPerPacket: 1..65535, origin=Vector Informatik, default-value=48  # Sample Frames Per Packet | Determines number of SampleFrames in one AVTP Audio packet. A SampleFrame contain a sample for ever channel. The number of samples in on SampleFrame is determined by 'Channels Per Frame' .Recommended values are found in '8.6.1 AVTP Audio and SRP', IEEE 1722a-2014-d8
        container AvTpIEC61883 [0..*]  # IEC 61883/IIDC over AVTP | IEC 61883/IIDC Format with Subtype (0x00)
          enumeration AvTpIecTag: origin=Vector Informatik, default-value=CIP  # Tag | Determines wheater a CIP header is included or not.
            NO_CIP  # No CIP header included
            CIP  # CIP header included
          integer AvTpIecChannel: 0..63, origin=Vector Informatik, default-value=31  # Channel Id | 0 to 30 and 32 to 63: Originating channel ID from an IEEE 1394 serial bus via IEEE 1394/IEC 61883 to IEEE 1722/IEC 61883 gateway 31: Originating source is on AVB network (native AVB)
        container AvTpMaap [0..1]  # AvTp Mac Address Aquisition Protocol (0xFE)
          integer AvTpMaapProbeRetransmits: 1..255, origin=Vector Informatik, default-value=3  # Determines the count of MAAP Probe retransmissions until the probed mac address is used.
          integer AvTpMaapProbeInterval: 100..65535, origin=Vector Informatik, default-value=500  # Maap Probe Interval | Determines the MAAP Probe retransmission time interval.
          integer AvTpMaapAnnounceInterval: 100..65536, origin=Vector Informatik, set at pre-compile, default-value=30000  # Determines the MAAP Announce retransmission time interval.
          string AvTpMaapMulticastMac: origin=Vector Informatik, default-value=91:E0:F0:00:FF:00  # Destination Physical Hardware Address (MAC-Address) of MAAP Frames. Input format has to match xx::xx::xx::xx::xx::xx, where x stands for a hex value between 0 and F. This value should be 91:E0:F0:00:FF:00
          integer AvTpMaapFramePriority: 0..7, origin=Vector Informatik, default-value=0  # Frame Priority | Determines the IEEE802.1Q priority in VLAN-Tag.
        container AvTpCompressedVideo [0..*]  # AvTp Compressed Video (0x03)
          enumeration AvTpCmpVideoFormat: origin=Vector Informatik, default-value=RFC  # Format | The format field identifies the compressed video payload format.
            RFC  # RFC Payload
          enumeration AvTpCmpVideoFormatSubtype: {MJPEG, H264, JPEG2000}, origin=Vector Informatik, default-value=MJPEG  # Format Subtype | The valid format subtypes for the RFC Payload type.
        container AvTpClockReference [0..*]  # AvTp Clock Reference (0x04)
          enumeration AvTpCrfType: {USER, AUDIO_SAMPLE, VIDEO_FRAME, VIDEO_LINE, MACHINE_CYCLE}, origin=Vector Informatik, default-value=AUDIO_SAMPLE  # Type | The type field indicates the type of timestamp represented by the CRF AVTPDU and the format of the CRF payload.
          integer AvTpCrfClockFrequency: 1..536870911, origin=Vector Informatik, default-value=48000  # Clock Frequency | The clock_frequency field represents the base frequency of the audio sample clock in Hertz, prior to being adjusted by clock_multiplier. Note: This parameter represents the base_frequency in IEEE1722a-2015-d16
          enumeration AvTpCrfClockMultiplier: {NOMINAL_FREQUENCY, NTSC_VIDEO_DROP_DOWN, NTSC_VIDEO_PULL_UP, PAL_VIDEO_DROP_DOWN, PAL_VIDEO_PULL_UP, ONE_EIGHTH}, origin=Vector Informatik, default-value=NOMINAL_FREQUENCY  # Clock Multiplier | The nominal frequency of the audio sample clock is the clock_frequency field multiplied by the multiplier specified by the clock_multiplier field (see table 11.3 IEEE 1722a-2014-d8). Note: For IEEE1722a-2015-d16: pull field (see Table 27)
          integer AvTpCrfTimestampInterval: 0..65534, origin=Vector Informatik, default-value=8  # Timestamp Interval | The timestamp_interval field is an 16 bit field which indicates the number of audio samples between each Audio Sample Timestamp given in the CRF AVTPDU.
        container AvTpVendorSpecificFormat [0..*]  # AvTp Vendor specific format (0x6F)
          string AvTpVendorEUI: origin=Vector Informatik, max-length=17, min-length=17  # The Vender EUI (48 Bit) used to identifie the format. Input format has to match xx:xx:xx:xx:xx:xx , where x stands for a hex value between 0 and F.
