AUTOSAR XML (schema 4-0-3)
# COPYRIGHT
# Copyright (c) 2014-2017 by Vector Informatik GmbH. All rights reserved.
# This software is copyright protected and proprietary to Vector Informatik GmbH.
# Vector Informatik GmbH grants to you only those rights as set out in the license conditions.
package /MICROSAR
  bsw implementation NmOsek_Impl: programming-language=C, sw-version=7.00.00, used-code-generator=DaVinci Configurator, vendor-id=30, ar-release-version=4.00.03, behavior=NmOsekBehavior, preconfigured-configuration=NmOsek_Pre, recommended-configuration=NmOsek_Rec, vendor-specific-module-def=NmOsek
  module definition NmOsek [0..1]: category=VENDOR_SPECIFIC_MODULE_DEFINITION, variants pre-compile/post-build-loadable/post-build-selectable  # This component represents the direct OSEK network management (Direct OSEK NM, further referred to as NM). The NM provides network services for an application operating on a CAN bus. These services are mainly: - control the transition to the bus sleep state - determine and monitor the network configuration - provide status information - handle and recover Bus Off - exchange user data in the NM messages The most important task of the NM is the safe transition into a power saving bus sleep state. Therefore the NM is mainly used in communication systems which cannot derive the need for communication from a hardware setting like e.g. the ignition state. A detailed explanation of the Nm_AsrNmDirOsek can be found in the technical reference.
    container NmOsekGlobalConfig  # This container contains the global configuration parameter of the NmOsek.
      boolean NmOsekApiOptimization: set at pre-compile, origin=Vector Informatik, default-value=false  # If the OSEK NM just consists of a single channel and the pre-compile configuration variant is available the API and parts of the code can be optimized to save ROM, RAM and runtime. Note: Since this is a pre-compile parameter it can only be customized during the PRE-COMPILE configuration phase. RESTRICTIONS: If (multiplicity(NmOsekChannelConfig) &gt; 1) then (NmOsekApiOptimization = False) If (NmOsekApiOptimization = True) then (multiplicity(NmOsekChannelConfig) == 1)
      string NmOsekUserConfigFile [0..1]: set at pre-compile, origin=Vector Informatik  # Reference to an external text file that will be included during generation to NmOsek_Cfg.h. The content of the user configuration file will be added at the end of the generated module configuration file and allows altering or extending the generated code. Caution: User configuration files can cause the software module to malfunction and must only be used with great care!
      boolean NmOsekUseNmNodeList: set at pre-compile, origin=Vector Informatik, default-value=false  # This attribute enables/disables a feature to monitor and store the currently available nodes of the logical ring in a bit field. If this attribute is enabled, the API functions 'NmOsek_GetConfig()' and 'NmOsek_CmpConfig()' are provided by the NM. Hints on usage: - Enable this attribute if you have to monitor and/or to check the present nodes. Otherwise you can disable this attribute in order to save memory and runtime resources.
      integer NmOsekNumberOfNmConfigNodes: 8..256, set at pre-compile, origin=Vector Informatik, default-value=32  # This attribute defines the number of nodes that have to be covered by the node list. There is a node list for NM node monitoring and a list for the transceiver error status. The value of this attribute is used to calculate the size of the bit field that stores the mentioned information for each node. Value limitations: - Value must be an integer multiple of 8 and must fit into the CanIfRxPduCanIdRange. RESTRICTIONS: This attribute is only necessary if attribute 'NmOsekUseNmNodeList' is activated.
      boolean NmOsekImmediateAlive: set at pre-compile, origin=Vector Informatik, default-value=true  # This attribute enables/disables the immediate transmission of an ALIVE message. If an ECU receives a flag 'SleepAcknowledge', but is not ready for sleep any more (e.g. due to an internal wake event) the node may not enter BusSleep mode. There are two possibilities on how the NM proceeds: - If this attribute is disabled, the NM node will stay in its previous mode. When time 'TMax' has elapsed, the node will detect a missing NM message and changes to its startup phase. - If this attribute is enabled, the NM immediately changes to its startup phase and an ALIVE message is transmitted.
      boolean NmOsekDevErrorDetect: set at pre-compile, origin=Vector Informatik, default-value=true  # This parameter switches the Development Error Detection and Notification ON or OFF. true: Development error detection is enabled. false: Development error detection is disabled. Note: In general, the development error detection is recommended during pre-test phase. It is not recommended to enable the development error detection in production code due to increased runtime and ROM needs. If it is enabled development errors are reported to the Development Error Tracer (Det). The following development errors are reported: <TBD>
      boolean NmOsekTokenMonitoring: set at pre-compile, origin=Vector Informatik, default-value=false  # This attribute enables/disables a feature that monitors if the own NM node has the token or not.
      float NmOsekMainFunctionPeriod: 0.001..0.255, set at pre-compile, origin=Vector Informatik, default-value=0.01  # Call cycle of NmOsek_MainFunction.
      boolean NmOsekVersionInfoApi: set at pre-compile, origin=Vector Informatik, default-value=false  # This parameter enables/disables the function NmOsek_GetVersionInfo() to get major, minor and patch version information.
      integer NmOsekInstanceId: 0..255, set at pre-compile, origin=Vector Informatik, default-value=0  # As NmOsek is not an official AUTOSAR component an instance identifier is necessary to allow distinction in case of reporting errors to DET. Refer also to the Technical Reference for details. RESTRICTIONS: This parameter is only used if (NmOsekDevErrorDetect == True).
      boolean NmOsekBusOffNotificationEnabled: set at pre-compile, origin=Vector Informatik, default-value=false  # This switch enables the implementation of the CanSM callback functions for BusOff occurrence and recovery notification. RESTRICTIONS: This parameter can only be set to true if CanSM.CanSMBusOffBegin and CanSM.CanSMBusOffEnd are defined.
      boolean NmOsekLastByteOfCanIdAsNodeIdEnabled: set at pre-compile, origin=Vector Informatik, default-value=false  # Enable/disable whether the last byte of the CAN Identifier of the NM Messages should be used for all destination IDs in the NM PDU. Example: Let the Base Address be 0x440 and let there be a node with Node Identifier 0x04. If the feature is enabled: Everytime this node is addressed, the destination ID byte contains 0x44. If the feature is disabled: Everytime this node is addressed, the destination ID byte contains 0x04. Note: If the Base Address has 0x00 in its last byte (e.g. 0x400), the feature can be disabled to save ROM consumption and runtime. If there are multiple NmOsekRxPdus, the setting NmOsekLastByteOfCanIdAsNodeIdEnabled = ON has the following semantics for each channel: Each CanIfRxPduRange that belongs to a NmOsekRxPdu extends the possible number of NM nodes. Example: There is - a NmOsekRxPdu that is associated with an CanIfRxPduRange container that has CanIfRxPduRange.CanIfRxPduCanIdRangeLowerCanId = 0x400 and CanIfRxPduRange.CanIfRxPduCanIdRangeUpperCanId = 0x43F - a NmOsekRxPdu that is associated with an CanIfRxPduRange container that has CanIfRxPduRange.CanIfRxPduCanIdRangeLowerCanId = 0x540 and CanIfRxPduRange.CanIfRxPduCanIdRangeUpperCanId = 0x57F This allows a total number of 128 NM nodes in the network with an unique node identifier. If there are multiple NmOsekRxPdus, the setting NmOsekLastByteOfCanIdAsNodeIdEnabled = OFF has the following semantics for each channel: Each CanIfRxPduRange that belongs to a NmOsekRxPdu provides another possiblity to have the same node identifier inside the CanIfRxPduRange. Example: - a NmOsekRxPdu that is associated with an CanIfRxPduRange container that has CanIfRxPduRange.CanIfRxPduCanIdRangeLowerCanId = 0x400 and CanIfRxPduRange.CanIfRxPduCanIdRangeUpperCanId = 0x43F - a NmOsekRxPdu that is associated with an CanIfRxPduRange container that has CanIfRxPduRange.CanIfRxPduCanIdRangeLowerCanId = 0x540 and CanIfRxPduRange.CanIfRxPduCanIdRangeUpperCanId = 0x57F This allows a total number of 64 NM nodes in the network. Each node identifier must either exist in the first or in the second CanIfRxPduRange. So for instance the node 1, if it exists, must either have 0x401 or 0x541 as CAN Identifier for its NM message.
      boolean NmOsekResetTMaxInLHPrepSleepOnRxRingEnabled: set at pre-compile, origin=Vector Informatik, default-value=true  # Enable/disable the functionality that the timer TMax shall be reset if a Ring Message is received in NMLimpHomePrepSleep in order to delay the transition to sleep when reception is possible but transmission is not possible and the own node is ready to sleep. Note that this feature is a Vector Extension to the OSEK NM specification.
      boolean NmOsekNMResetIgnoreRxExceptAliveEnabled: set at pre-compile, origin=Vector Informatik, default-value=false  # Enable/disable the functionality that the reception of any message except an Alive Message is ignored in NMReset. If this feature is enabled, the implementation is in accordance with the OSEK NM Specification. However, important messages (Ring, LimpHome, Wake-Up) could be ignored within the time where OSEK NM is in the state NMReset (up to one main function period), including messages that should trigger the transition to sleep (Ring messages with sleep acknowledge bit set to 1). Switch this feature off if those messages should not be ignored.
      boolean NmOsekLeaveLHOnlyOnRxIndicationEnabled: set at pre-compile, origin=Vector Informatik, default-value=false  # Enable/disable the functionality that NMLimpHome may only be left to NMReset at the moment of a successful reception of the NM message. If this switch is OFF, LimpHome is left to NMReset if these two events have occurred (no matter which one occurred first): (1) the LimpHome message has been successfully sent AND (2) an NM message has been successfully received. In other words, the sequences: - (1), (2) - (2), (1) lead to a transition to NMReset from LimpHome. If this switch is ON, LimpHome is left to NMReset because of the same conditions (1), (2), but the transition is delayed to the next occurrence of (2). In other words, the sequences: - (2), (1), (2) - (1), (2) lead to a transition to NMReset from LimpHome. If this feature is enabled, the implementation is closer to the OSEK NM specification, but it takes much longer to leave LimpHome.
      boolean NmOsekWBSTransitionOnRingMsgOnlyEnabled: set at pre-compile, origin=Vector Informatik, default-value=false  # Enable/disable the functionality that a transition to Wait Bus Sleep from NMNormalPrepSleep may only be triggered by the reception/transmission of a RING Message with the Sleep Acknowledge Bit set to one. If this switch is ON, the transition to Wait Bus Sleep from NMNormalPrepSleep may only be triggered by sending or receiving an NM Ring Message with the Sleep Acknowledge Bit set to one. If this switch is OFF, the transition to Wait Bus Sleep from NMNormalPrepSleep may be triggered by sending an NM Ring Message with the Sleep Acknowledge Bit set to one or by receiving any NM message with the Sleep Acknowledge Bit set to one. The original OSEK NM Specification is ambiguous about this topic, so this behavior has been made configurable.
      enumeration NmOsekType: {NMOSEK_TYPE_VECTOR_OSEK, NMOSEK_TYPE_VECTOR2_OSEK}, set at pre-compile, origin=Vector Informatik  # This attribute determines the message layout and other OEM-specific behavior. NMOSEK_TYPE_VECTOR_OSEK: Vector specific NM message layout NM PDU Message layout: Byte 0: Destination Identifier byte Byte 1: OpCode byte including Sleep flags Byte 2-7: User Data bytes ALIVE message: bit 0 is set in OpCode byte, bits 1 and 2 are not set in OpCode byte RING message: bit 1 is set in OpCode byte, bits 0 and 2 are not set in OpCode byte LIMPHOME message: bit 2 is set in OpCode byte, bits 0 and 1 are not set in OpCode byte Sleep Indication Bit in message: bit 4 in OpCode byte Sleep Acknowledge Bit in message: bit 5 in OpCode byte Control Bytes (Destination Identifier and OpCode) are initialized with 0x00 User Data Bytes (other bytes) are initialized with 0x00 NMOSEK_TYPE_VECTOR2_OSEK: Vector specific NM message layout according to the Implementation proposal in OSEK/VDX Network Management Concept and Application Programming Interface Version 2.5.3, chapter 7.0.3 NM PDU Message layout: Byte 0: Destination Identifier byte Byte 1: OpCode byte including Sleep flags Byte 2-7: User Data bytes ALIVE message with Sleep Indication/Acknowledge Bits set to 0: bit 1 is set in OpCode byte, bits 0 and 2 are not set in OpCode byte ALIVE message with Sleep Indication Bit set to 1, Sleep Acknowledge Bit set to 0: bit 1 and bit 2 are set in OpCode byte, bit 0 is not set in OpCode byte RING message with Sleep Indication/Acknowledge Bits set to 0: bit 0 is set in OpCode byte, bits 1 and 2 are not set in OpCode byte RING message with Sleep Indication Bit set to 1, Sleep Acknowledge Bit set to 0: bit 0 and bit 2 are set in OpCode byte, bit 1 is not set in OpCode byte LIMPHOME message with Sleep Indication/Acknowledge Bits set to 0: bits 0, 1 and 2 are not set in OpCode byte LIMPHOME message with Sleep Indication Bit set to 1, Sleep Acknowledge Bit set to 0: bit 2 is set in OpCode byte, bits 0 and 1 are not set in OpCode byte Other bits in the OpCode byte are reserved for future usage Control Bytes (Destination Identifier and OpCode) are initialized with 0x00 User Data Bytes (other bytes) are initialized with 0x00
      boolean NmOsekSleepackNotificationEnabled: set at pre-compile, origin=Vector Informatik, default-value=false  # Enable/disable the functionality that the application may decide whether the Sleep Acknowledge bit is set to 1 in a RING message sent by the node. The information whether it is allowed to be set to 1 and whether it has been sent on the bus or is about to be sent on the bus can be determined by the APIs NmOsek_GetPrepareSendSleepAck() and NmOsek_GetSendSleepAck(). If this switch is ON, the functions - NmOsek_GetPrepareSendSleepAck - NmOsek_GetSendSleepAck are provided and may be called by the application. Also, if this switch is ON, the application needs to implement the callback function Appl_NmOsek_SendSleepAck() (for the exact function signature see NmOsek.h). Appl_NmOsek_SendSleepAck() shall return TRUE if the Sleep Acknowledge bit needs to be set to 1 in the current RING message that is about to be sent by the node. Otherwise this function shall return FALSE. If this switch is OFF, these functions are not provided and the callback does not need to be implemented. Please note that only the decision to send a RING message with Sleep Acknowledge bit set to 1 can be delayed by this feature. It cannot prevent other nodes from sending a RING message with Sleep Acknowledge bit set to 1.
      boolean NmOsekFirstMessageShallBeNmMessage: set at pre-compile, origin=Vector Informatik, default-value=false  # Enable/disable the functionality that the NM message sent by NmOsek shall be the first one on the bus if the NM has been actively woken up (i.e. no NM message has been previously received after the active wake-up event). If this switch is turned ON: - NM message transmission observation is mandatory, i.e. NmOsekTxConfirmationTimeoutTime needs to be defined for every NmOsekChannelConfig. See the description of the NmOsekTxConfirmationTimeoutTime parameter below a NmOsekChannelConfig container for details. - the API NmOsek_CancelWaitForTxConfOrRxInd() is available - the current NM state - notified by Nm_StateChangeNotification() and returned by Nm_GetState() - may only be changed to NM_STATE_READY_SLEEP, NM_STATE_NORMAL_OPERATION or NM_STATE_REPEAT_MESSAGE if NmOsek has successfully received or transmitted a NM message or NmOsek_CancelWaitForTxConfOrRxInd() has been called - a state change to NM_STATE_WAIT_STARTUP indicates that there is a pending NM state change to one of NM_STATE_READY_SLEEP, NM_STATE_NORMAL_OPERATION or NM_STATE_REPEAT_MESSAGE but there has not been a successful transmission or reception of the NM message yet (or NmOsek_CancelWaitForTxConfOrRxInd() has not been called) Note: In previous releases, NmOsek required the Pn Wake-up Filter to be turned ON if this feature is turned ON. In this release, NmOsek requires the Pn Wake-up Filter to be turned OFF in CanIf. If this switch is turned OFF, - observing the NM message transmission is optional and depends on the existence of NmOsekTxConfirmationTimeoutTime. - the transition to the NM states NM_STATE_REPEAT_MESSAGE, NM_STATE_NORMAL_OPERATION and NM_STATE_READY_SLEEP does not depend on the aspect whether a NM PDU has been successfully sent or received - the API NmOsek_CancelWaitForTxConfOrRxInd() is not available RESTRICTIONS: This parameter can only be turned ON if 'Passive Mode Enabled' is turned OFF in Nm.
      boolean NmOsekTxDeadlineMonitoringInComEnabled: set at pre-compile, origin=Vector Informatik, default-value=false  # Enable/disable the Tx-Deadline Monitoring for the Nm Pdu by Com. If this switch is ON, the parameter NmOsekTxConfirmationTimeoutTime is not considered for Tx-Deadline Monitoring. Instead, the Com module is used for that purpose. In this case there will be no function call of Nm_TxTimeoutException(), but instead a signal inside the I-PDU which is referenced by NmOsekTxUserDataPduRef can be used for the timeout notification. If this switch is OFF, the parameter NmOsekTxConfirmationTimeoutTime will be considered for Tx-Deadline Monitoring. There will be a function call of Nm_TxTimeoutException() for the timeout notification. The Com module is not used for that purpose. RESTRICTIONS: This parameter can only be turned ON if 'Passive Mode Enabled' is turned OFF in Nm and if 'First Message Shall Be Nm Message' is turned OFF and if 'Com User Data Support' is turned ON in Nm.
      container NmOsekChannelConfig [0..*]  # This container contains the channel specific configuration parameters of the NmOsek.
        integer NmOsekNodeId: 0..255, set at post-build in variant post-build-loadable+post-build-selectable / pre-compile in variant pre-compile, origin=Vector Informatik, default-value=0  # This attribute defines the NM node address of the currently used network node. The value of this attribute is required to define the CAN identifier of the node's NM message. This setting can't be modified. Its value is derived from settings in the configuration file: The node address is calculated out of the CAN identifier of the assigned NM message and the CanIfRxPduCanIdRange. Example: CanIfRxPduCanIdRange.CanIfRxPduCanIdRangeLowerCanId=0x400 The current node has an NM message with CAN identifier 0x405 => NmOsekNodeId=0x05 Note: This attribute may be derived from the DBC attribute 'NmNodeAddress'. This parameter is only used if Nm.NmPassiveModeEnabled = False.
        float NmOsekRingTypTime: 0.0010..65.535, set at link in variant post-build-loadable / post-build in variant post-build-selectable / pre-compile in variant pre-compile, origin=Vector Informatik, default-value=0.1  # This attribute defines the typical time interval between two ring messages (TTyp). Value limitations: - Value must be an integer multiple of attribute 'NmOsekMainFunctionPeriod'
        float NmOsekRingMaxTime: 0.0010..65.535, set at link in variant post-build-loadable / post-build in variant post-build-selectable / pre-compile in variant pre-compile, origin=Vector Informatik, default-value=0.26  # This attribute defines the maximum time interval between two ring messages (TMax). Value limitations: - Value must be an integer multiple of attribute 'NmOsekMainFunctionPeriod' - Value must be greater than the value of attribute 'NmOsekRingTypTime'
        float NmOsekLimpHomeTime: 0.001..65.535, set at link in variant post-build-loadable / post-build in variant post-build-selectable / pre-compile in variant pre-compile, origin=Vector Informatik, default-value=1  # This attribute defines the time interval between two limp home messages (TError). Value limitations: - Value must be an integer multiple of 'NmOsekMainFunctionPeriod' - Value is typically: 'NmOsekLimpHomeTime' = 10.0 * 'NmOsekRingTypTime'
        float NmOsekWaitBusSleepTime: 0.001..65.535, set at link in variant post-build-loadable / post-build in variant post-build-selectable / pre-compile in variant pre-compile, origin=Vector Informatik, default-value=1.5  # This attribute defines the time between the detection of a SleepAcknowledge and the transition to BusSleep mode. Value limitations: - Value must be an integer multiple of 'NmOsekMainFunctionPeriod' - Value must be greater than 'NmOsekLimpHomeTime' - Value must be greater than 'NmOsekRingMaxTime' - Value is typically: 'NmOsekWaitBusSleepTime' = 1.5 * 'NmOsekLimpHomeTime'
        float NmOsekTxConfirmationTimeoutTime [0..1]: 0.001..65.535, set at link in variant post-build-loadable / post-build in variant post-build-selectable / pre-compile in variant pre-compile, origin=Vector Informatik, default-value=0.02  # Time for how long the NM should wait for the TX confirmation of the NM message. If this parameter is defined, it is used for every NM message transmission request. It is mandatory if - NmOsekFirstMessageShallBeNmMessage is turned ON Refer to the Technical Reference for the actions on timeout. Value limitations: - Value must be an integer multiple of 'NmOsekMainFunctionPeriod' RESTRICTIONS: This parameter is not used if Nm.NmPassiveModeEnabled is True.
        reference NmOsekComMNetworkHandleRef: set at link in variant post-build-loadable / post-build in variant post-build-selectable / pre-compile in variant pre-compile, origin=Vector Informatik, destination=ComMChannel  # ComM Network Handle Ref | Reference to the unique channel defined by the ComMChannel. It provides access to the unique channel index value in ComMChannelId.
        container NmOsekRxPdu [1..*]  # This container includes the configuration of Rx PDU properties that are used for the NmOsek Channel.
          reference NmOsekRxPduRef: set at post-build in variant post-build-loadable+post-build-selectable / pre-compile in variant pre-compile, origin=Vector Informatik, destination=Pdu  # Reference to the global Rx PDU that is used by this NmOsek Channel.
        container NmOsekTxPdu [0..1]  # This container includes the configuration of Tx PDU properties that are used for the NmOsek Channel.
          reference NmOsekTxPduRef: set at post-build in variant post-build-loadable+post-build-selectable / pre-compile in variant pre-compile, origin=Vector Informatik, destination=Pdu  # Reference to the global Tx PDU that is used by this NmOsek Channel. RESTRICTIONS: This parameter is only relevant if Nm.NmPassiveModeEnabled = False.
        container NmOsekUserDataTxPdu [0..2]  # This optional container is used to configure the UserNm PDU. This container is only available if Nm.NmComUserDataSupport is enabled.
          integer NmOsekTxUserDataPduId: 0..65535, set at link in variant post-build-loadable+post-build-selectable / pre-compile in variant pre-compile, origin=Vector Informatik, symbolic-name-value=true, default-value=0  # This value specifies the Handle ID of the NM User Data PDU. If NM user data has been changed, NmOsek_Transmit may be called by PduR using this handle ID. RESTRICTIONS: This parameter is only relevant if Nm.NmComUserDataSupport = True.
          enumeration NmOsekTxUserDataPduType [0..1]: set at post-build in variant post-build-loadable+post-build-selectable / pre-compile in variant pre-compile, origin=Vector Informatik  # The NmOsekTxUserDataPduType defines whether the I-PDU provides a reasons for Wake-Up or for Awake. Wake-Up reasons inside the configured I-PDU are put inside ALIVE messages. Awake reasons inside the configured I-PDU are put inside RING and LIMPHOME messages. Configure this setting if the multiplicity of NmOsekUserDataTxPdu is 2, otherwise delete this parameter. RESTRICTIONS: This parameter is only used and needs to be defined if Nm.NmComUserDataSupport = True and there are two NmOsekUserDataTxPdu containers.
            WakeUp  # Wake-Up
            Awake
          reference NmOsekTxUserDataPduRef: set at post-build in variant post-build-loadable+post-build-selectable / pre-compile in variant pre-compile, origin=Vector Informatik, destination=Pdu  # Reference to the global User Data Tx PDU that is used by this NmOsek Channel. RESTRICTIONS: This parameter is only relevant if Nm.NmComUserDataSupport = True.
  module config NmOsek_Pre: definition=NmOsek
  module config NmOsek_Rec: definition=NmOsek
